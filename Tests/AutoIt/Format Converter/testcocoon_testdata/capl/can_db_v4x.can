/*@@var:*/
/* TemplateVersion: 1.0.2 */
variables 
{
    /**********************************************************************************************/
    /* BEGIN AUTO                                                                                 */
    /**********************************************************************************************/
    
    message ACC_1 MsgObj_ACC_1;
    message ACC_System MsgObj_ACC_System;
    message Airbag_1 MsgObj_Airbag_1;
    message Allrad_1 MsgObj_Allrad_1;
    message BEM_1 MsgObj_BEM_1;
    message BSG_Last MsgObj_BSG_Last;
    message Batman_1 MsgObj_Batman_1;
    message Booster_1 MsgObj_Booster_1;
    message Bremse_1 MsgObj_Bremse_1;
    message Bremse_10 MsgObj_Bremse_10;
    message Bremse_11 MsgObj_Bremse_11;
    message Bremse_2 MsgObj_Bremse_2;
    message Bremse_3 MsgObj_Bremse_3;
    message Bremse_4 MsgObj_Bremse_4;
    message Bremse_5 MsgObj_Bremse_5;
    message Bremse_8 MsgObj_Bremse_8;
    message Clima_1 MsgObj_Clima_1;
    message Diagnose_1 MsgObj_Diagnose_1;
    message EPB_1 MsgObj_EPB_1;
    message EPB_2 MsgObj_EPB_2;
    message GME MsgObj_GME;
    message GRA_Neu MsgObj_GRA_Neu;
    message Gate_Komf_1 MsgObj_Gate_Komf_1;
    message Gate_Komf_2 MsgObj_Gate_Komf_2;
    message Gate_Komf_3 MsgObj_Gate_Komf_3;
    message Getriebe_1 MsgObj_Getriebe_1;
    message Getriebe_2 MsgObj_Getriebe_2;
    message Getriebe_3_Momente MsgObj_Getriebe_3_Momente;
    message Getriebe_6 MsgObj_Getriebe_6;
    message Getriebe_Hybrid_1 MsgObj_Getriebe_Hybrid_1;
    message Klima_5 MsgObj_Klima_5;
    message Kombi_1 MsgObj_Kombi_1;
    message Kombi_2 MsgObj_Kombi_2;
    message Kombi_3 MsgObj_Kombi_3;
    message LW_1 MsgObj_LW_1;
    message Lenkhilfe_3 MsgObj_Lenkhilfe_3;
    message NMH_Gateway MsgObj_NMH_Gateway;
    message Niveau_1 MsgObj_Niveau_1;
    message OBD_Tankgeber_01 MsgObj_OBD_Tankgeber_01;
    message Parkhilfe_01 MsgObj_Parkhilfe_01;
    message Parkhilfe_1 MsgObj_Parkhilfe_1;
    message Remotestart_FFB MsgObj_Remotestart_FFB;
    message Soll_Verbauliste_neu MsgObj_Soll_Verbauliste_neu;
    message Systeminfo_1 MsgObj_Systeminfo_1;
    message TOG MsgObj_TOG;
    message ZAS_1 MsgObj_ZAS_1;

    const FRM_HANDLE_ACC_1 = 0;
    const FRM_HANDLE_ACC_System = 1;
    const FRM_HANDLE_Airbag_1 = 2;
    const FRM_HANDLE_Allrad_1 = 3;
    const FRM_HANDLE_BEM_1 = 4;
    const FRM_HANDLE_BSG_Last = 5;
    const FRM_HANDLE_Batman_1 = 6;
    const FRM_HANDLE_Booster_1 = 7;
    const FRM_HANDLE_Bremse_1 = 8;
    const FRM_HANDLE_Bremse_10 = 9;
    const FRM_HANDLE_Bremse_11 = 10;
    const FRM_HANDLE_Bremse_2 = 11;
    const FRM_HANDLE_Bremse_3 = 12;
    const FRM_HANDLE_Bremse_4 = 13;
    const FRM_HANDLE_Bremse_5 = 14;
    const FRM_HANDLE_Bremse_8 = 15;
    const FRM_HANDLE_Clima_1 = 16;
    const FRM_HANDLE_Diagnose_1 = 17;
    const FRM_HANDLE_EPB_1 = 18;
    const FRM_HANDLE_EPB_2 = 19;
    const FRM_HANDLE_GME = 20;
    const FRM_HANDLE_GRA_Neu = 21;
    const FRM_HANDLE_Gate_Komf_1 = 22;
    const FRM_HANDLE_Gate_Komf_2 = 23;
    const FRM_HANDLE_Gate_Komf_3 = 24;
    const FRM_HANDLE_Getriebe_1 = 25;
    const FRM_HANDLE_Getriebe_2 = 26;
    const FRM_HANDLE_Getriebe_3_Momente = 27;
    const FRM_HANDLE_Getriebe_6 = 28;
    const FRM_HANDLE_Getriebe_Hybrid_1 = 29;
    const FRM_HANDLE_Klima_5 = 30;
    const FRM_HANDLE_Kombi_1 = 31;
    const FRM_HANDLE_Kombi_2 = 32;
    const FRM_HANDLE_Kombi_3 = 33;
    const FRM_HANDLE_LW_1 = 34;
    const FRM_HANDLE_Lenkhilfe_3 = 35;
    const FRM_HANDLE_NMH_Gateway = 36;
    const FRM_HANDLE_Niveau_1 = 37;
    const FRM_HANDLE_OBD_Tankgeber_01 = 38;
    const FRM_HANDLE_Parkhilfe_01 = 39;
    const FRM_HANDLE_Parkhilfe_1 = 40;
    const FRM_HANDLE_Remotestart_FFB = 41;
    const FRM_HANDLE_Soll_Verbauliste_neu = 42;
    const FRM_HANDLE_Systeminfo_1 = 43;
    const FRM_HANDLE_TOG = 44;
    const FRM_HANDLE_ZAS_1 = 45;

    const FRM_NUM_MAX = 46;


    /**********************************************************************************************/
    /* END AUTO                                                                                   */
    /**********************************************************************************************/


    /* ------------------------------------------------------------------------------------------ */
    /*  timer                                                                                     */
    /* ------------------------------------------------------------------------------------------ */
    msTimer Timer_10ms;                   /* 10ms base timer */
    const TIMER_DURATION_10MS = 10;       /* timer duration for 10ms timer */
    

    /* ------------------------------------------------------------------------------------------ */
    /*  frame scheduler                                                                           */
    /* ------------------------------------------------------------------------------------------ */
    int FrmSched_SchedTmr[FRM_NUM_MAX];   /* schedule timer, incremented every 10ms, resolution [1ms] */
    int FrmSched_CycleTime[FRM_NUM_MAX];  /* cycle time of the CAN frame, resolution [1ms] */
    int FrmSched_FrmEna[FRM_NUM_MAX];     /* frame enable status */


    /* ------------------------------------------------------------------------------------------ */
    /*  frame manager                                                                             */
    /* ------------------------------------------------------------------------------------------ */
    int Frm_MsgCounter[FRM_NUM_MAX];      /* current message counter value */
    int Frm_MsgCounterEna[FRM_NUM_MAX];   /* message counter enable status */
    int Frm_MsgChksmEna[FRM_NUM_MAX];     /* checksum enable status */
    int Frm_DLC[FRM_NUM_MAX];             /* DLC */
    int Frm_DLCOk[FRM_NUM_MAX];           /* DLC status (0=DLC wrong, 1=DLC ok) */

    
    /* ------------------------------------------------------------------------------------------ */
    /*  CAPL control                                                                              */
    /* ------------------------------------------------------------------------------------------ */
    const CAPLCTRL_LEVEL_NOSEL = 0;
    const CAPLCTRL_LEVEL_FRAME = 1;
    const CAPLCTRL_LEVEL_SIGNAL = 2;

    const CAPLCTRL_NOVAL = -1;

    const CAPLCTRL_INPUTBUF_LEN = 32;
    const CAPLCTRL_CHARBUF_LEN = 64;

    const CAPLCTRL_PROMPTMODE_NUM = 0;
    const CAPLCTRL_PROMPTMODE_CHAR = 1;

    int  CaplCtrl_LevelActv = CAPLCTRL_LEVEL_NOSEL;  /* current active level */
    int  CaplCtrl_FrameActv = 0;                     /* current selected frame */
    int  CaplCtrl_SignalActv = 0;                    /* current selected signal */
    long CaplCtrl_InputValue = 0;                    /* current input value */
    char CaplCtrl_InputBuf[CAPLCTRL_INPUTBUF_LEN];   /* user input buffer */
    int  CaplCtrl_InputIdx = 0;                      /* index into input buffer */
    char CaplCtrl_FrameName[32];                     /* buffer to store frame name */
    char CaplCtrl_SignalName[64];                    /* buffer to store signal name */
    int  CaplCtrl_PromptMode;                        /* prompt mode */
    char CaplCtrl_CharBuf[CAPLCTRL_CHARBUF_LEN];     /* buffer for char output in prompt */


    /* ------------------------------------------------------------------------------------------ */
    /*  key codes                                                                                 */
    /* ------------------------------------------------------------------------------------------ */
    const KEY_ENTER = 0x0D;
    const KEY_BACKSPACE = 0x08;
    const KEY_UP = 0x4800;
    const KEY_DOWN = 0x5000;
    const KEY_TAB = 0x09;
    const KEY_LEVEL_DOWN = '.';
    const KEY_TIMEOUT = 'a';
    const KEY_MSGCNT = 'b';
    const KEY_CHKSM = 'c';
    const KEY_DLC = 'd';
    const KEY_HELP = '?';


    /* ------------------------------------------------------------------------------------------ */
    /*  checksum related variables                                                                */
    /* ------------------------------------------------------------------------------------------ */
    byte CRC8_tab_256[256] =
    {
        0x00, 0x2f, 0x5e, 0x71, 0xbc, 0x93, 0xe2, 0xcd,
        0x57, 0x78, 0x09, 0x26, 0xeb, 0xc4, 0xb5, 0x9a,
        0xae, 0x81, 0xf0, 0xdf, 0x12, 0x3d, 0x4c, 0x63,
        0xf9, 0xd6, 0xa7, 0x88, 0x45, 0x6a, 0x1b, 0x34,
        0x73, 0x5c, 0x2d, 0x02, 0xcf, 0xe0, 0x91, 0xbe,
        0x24, 0x0b, 0x7a, 0x55, 0x98, 0xb7, 0xc6, 0xe9,
        0xdd, 0xf2, 0x83, 0xac, 0x61, 0x4e, 0x3f, 0x10,
        0x8a, 0xa5, 0xd4, 0xfb, 0x36, 0x19, 0x68, 0x47,
        0xe6, 0xc9, 0xb8, 0x97, 0x5a, 0x75, 0x04, 0x2b,
        0xb1, 0x9e, 0xef, 0xc0, 0x0d, 0x22, 0x53, 0x7c,
        0x48, 0x67, 0x16, 0x39, 0xf4, 0xdb, 0xaa, 0x85,
        0x1f, 0x30, 0x41, 0x6e, 0xa3, 0x8c, 0xfd, 0xd2,
        0x95, 0xba, 0xcb, 0xe4, 0x29, 0x06, 0x77, 0x58,
        0xc2, 0xed, 0x9c, 0xb3, 0x7e, 0x51, 0x20, 0x0f,
        0x3b, 0x14, 0x65, 0x4a, 0x87, 0xa8, 0xd9, 0xf6,
        0x6c, 0x43, 0x32, 0x1d, 0xd0, 0xff, 0x8e, 0xa1,
        0xe3, 0xcc, 0xbd, 0x92, 0x5f, 0x70, 0x01, 0x2e,
        0xb4, 0x9b, 0xea, 0xc5, 0x08, 0x27, 0x56, 0x79,
        0x4d, 0x62, 0x13, 0x3c, 0xf1, 0xde, 0xaf, 0x80,
        0x1a, 0x35, 0x44, 0x6b, 0xa6, 0x89, 0xf8, 0xd7,
        0x90, 0xbf, 0xce, 0xe1, 0x2c, 0x03, 0x72, 0x5d,
        0xc7, 0xe8, 0x99, 0xb6, 0x7b, 0x54, 0x25, 0x0a,
        0x3e, 0x11, 0x60, 0x4f, 0x82, 0xad, 0xdc, 0xf3,
        0x69, 0x46, 0x37, 0x18, 0xd5, 0xfa, 0x8b, 0xa4,
        0x05, 0x2a, 0x5b, 0x74, 0xb9, 0x96, 0xe7, 0xc8,
        0x52, 0x7d, 0x0c, 0x23, 0xee, 0xc1, 0xb0, 0x9f,
        0xab, 0x84, 0xf5, 0xda, 0x17, 0x38, 0x49, 0x66,
        0xfc, 0xd3, 0xa2, 0x8d, 0x40, 0x6f, 0x1e, 0x31,
        0x76, 0x59, 0x28, 0x07, 0xca, 0xe5, 0x94, 0xbb,
        0x21, 0x0e, 0x7f, 0x50, 0x9d, 0xb2, 0xc3, 0xec,
        0xd8, 0xf7, 0x86, 0xa9, 0x64, 0x4b, 0x3a, 0x15,
        0x8f, 0xa0, 0xd1, 0xfe, 0x33, 0x1c, 0x6d, 0x42
    };
}
/*@@end*/

/*@@timer:Timer_10ms:*/
on timer Timer_10ms
{
    int FrmIdx;

    /* restart the 10ms timer */
    setTimer(Timer_10ms,TIMER_DURATION_10MS);


    /* ------------------------------------------------------------------------------------------ */
    /*  BEGIN Frame Scheduler                                                                     */
    /* ------------------------------------------------------------------------------------------ */

    for (FrmIdx = 0; FrmIdx < FRM_NUM_MAX; FrmIdx++)
    {
        /* check if frame is enabled */
        if (FrmSched_FrmEna[FrmIdx] != 0)
        {
            /* increment schedule timer */
            FrmSched_SchedTmr[FrmIdx] += 10;
        }
        else
        {
            /* frame disabled, stop schedule timer */
            FrmSched_SchedTmr[FrmIdx] = 0;
        }

        /* if schedule timer reaches cycle time, trigger transfer of CAN frame */
        if (FrmSched_SchedTmr[FrmIdx] >= FrmSched_CycleTime[FrmIdx])
        {
            /* reset schedule timer */
            FrmSched_SchedTmr[FrmIdx] = 0;

            /* trigger transmission of frame */
            FrmSched_SendFrame(FrmIdx);
        }
    }

    /* ------------------------------------------------------------------------------------------ */
    /*  END Frame Scheduler                                                                       */
    /* ------------------------------------------------------------------------------------------ */
}
/*@@end*/

/*@@preStart:PreStart:*/
on preStart
{
    dword fhdlIn;
    dword fhdlOut;
    
    /* ------------------------------------------------------------------------------------------ */
    /*  BEGIN frame and signal handle export for remote control of CAPL by Perl script            */
    /* ------------------------------------------------------------------------------------------ */

    /* check if CAPL is remote controlled by CaplCtrl Perl script */
    /* NOTE: Communication between CAPL program and Perl scritp is done via file, since with */
    /*       CANalyzer Version v4 it is not possible to use environment variables, so this is */
    /*       just a workaround. */
    fhdlIn = openFileRead ("caplctrl_req.txt", 0);
    if (fhdlIn != 0)
    {
        /* close input file */
        fileClose(fhdlIn);

        /* export frame and signal handles to file for remote control scripts */
        fhdlOut = openFileWrite ("caplctrl.txt", 0);
        if (fhdlOut != 0)
        {
            /* NOTE:   handles are 2 bytes long. */
            /* LAYOUT: frame handle: lower byte = 0xFF, upper byte = frame handle for CAPL program */
            /*         signal handle: lower byte = signal index, upper byte = frame index */
            filePutString ("ACC_1;255\n", 10, fhdlOut);
            filePutString ("ACC_1;ACC1_RX;AliasName\n", 24, fhdlOut);    /* alias frame handle for ACC_1 */
            filePutString ("ACC_System;511\n", 15, fhdlOut);
            filePutString ("ACC_System;ACCA;AliasName\n", 26, fhdlOut);    /* alias frame handle for ACC_System */
            filePutString ("Airbag_1;767\n", 13, fhdlOut);
            filePutString ("Airbag_1;AIRBG1;AliasName\n", 26, fhdlOut);    /* alias frame handle for Airbag_1 */
            filePutString ("Allrad_1;1023\n", 14, fhdlOut);
            filePutString ("Allrad_1;AWD1;AliasName\n", 24, fhdlOut);    /* alias frame handle for Allrad_1 */
            filePutString ("BEM_1;1279\n", 11, fhdlOut);
            filePutString ("BEM_1;BEM1;AliasName\n", 21, fhdlOut);    /* alias frame handle for BEM_1 */
            filePutString ("BSG_Last;1535\n", 14, fhdlOut);
            filePutString ("BSG_Last;ESCU;AliasName\n", 24, fhdlOut);    /* alias frame handle for BSG_Last */
            filePutString ("Batman_1;1791\n", 14, fhdlOut);
            filePutString ("Batman_1;BATMAN1;AliasName\n", 27, fhdlOut);    /* alias frame handle for Batman_1 */
            filePutString ("Booster_1;2047\n", 15, fhdlOut);
            filePutString ("Booster_1;BST1;AliasName\n", 25, fhdlOut);    /* alias frame handle for Booster_1 */
            filePutString ("Bremse_1;2303\n", 14, fhdlOut);
            filePutString ("Bremse_1;BRK1;AliasName\n", 24, fhdlOut);    /* alias frame handle for Bremse_1 */
            filePutString ("Bremse_10;2559\n", 15, fhdlOut);
            filePutString ("Bremse_10;BRK10;AliasName\n", 26, fhdlOut);    /* alias frame handle for Bremse_10 */
            filePutString ("Bremse_11;2815\n", 15, fhdlOut);
            filePutString ("Bremse_11;BRK11;AliasName\n", 26, fhdlOut);    /* alias frame handle for Bremse_11 */
            filePutString ("Bremse_2;3071\n", 14, fhdlOut);
            filePutString ("Bremse_2;BRK2;AliasName\n", 24, fhdlOut);    /* alias frame handle for Bremse_2 */
            filePutString ("Bremse_3;3327\n", 14, fhdlOut);
            filePutString ("Bremse_3;BRK3;AliasName\n", 24, fhdlOut);    /* alias frame handle for Bremse_3 */
            filePutString ("Bremse_4;3583\n", 14, fhdlOut);
            filePutString ("Bremse_4;BRK4;AliasName\n", 24, fhdlOut);    /* alias frame handle for Bremse_4 */
            filePutString ("Bremse_5;3839\n", 14, fhdlOut);
            filePutString ("Bremse_5;BRK5;AliasName\n", 24, fhdlOut);    /* alias frame handle for Bremse_5 */
            filePutString ("Bremse_8;4095\n", 14, fhdlOut);
            filePutString ("Bremse_8;BRK8;AliasName\n", 24, fhdlOut);    /* alias frame handle for Bremse_8 */
            filePutString ("Clima_1;4351\n", 13, fhdlOut);
            filePutString ("Clima_1;Klima_1;AliasName\n", 26, fhdlOut);    /* alias frame handle for Clima_1 */
            filePutString ("Diagnose_1;4607\n", 16, fhdlOut);
            filePutString ("Diagnose_1;DIA1;AliasName\n", 26, fhdlOut);    /* alias frame handle for Diagnose_1 */
            filePutString ("EPB_1;4863\n", 11, fhdlOut);
            filePutString ("EPB_1;EPB1;AliasName\n", 21, fhdlOut);    /* alias frame handle for EPB_1 */
            filePutString ("EPB_2;5119\n", 11, fhdlOut);
            filePutString ("EPB_2;EPB2;AliasName\n", 21, fhdlOut);    /* alias frame handle for EPB_2 */
            filePutString ("GME;5375\n", 9, fhdlOut);
            filePutString ("GME;Getriebe_Motoreingriffe;AliasName\n", 38, fhdlOut);    /* alias frame handle for GME */
            filePutString ("GRA_Neu;5631\n", 13, fhdlOut);
            filePutString ("GRA_Neu;GRA_neu;AliasName\n", 26, fhdlOut);    /* alias frame handle for GRA_Neu */
            filePutString ("Gate_Komf_1;5887\n", 17, fhdlOut);
            filePutString ("Gate_Komf_1;Gateway_Komfort_1;AliasName\n", 40, fhdlOut);    /* alias frame handle for Gate_Komf_1 */
            filePutString ("Gate_Komf_2;6143\n", 17, fhdlOut);
            filePutString ("Gate_Komf_2;Gateway_Komfort_2;AliasName\n", 40, fhdlOut);    /* alias frame handle for Gate_Komf_2 */
            filePutString ("Gate_Komf_3;6399\n", 17, fhdlOut);
            filePutString ("Gate_Komf_3;Gateway_Komfort_3;AliasName\n", 40, fhdlOut);    /* alias frame handle for Gate_Komf_3 */
            filePutString ("Getriebe_1;6655\n", 16, fhdlOut);
            filePutString ("Getriebe_1;TSC1;AliasName\n", 26, fhdlOut);    /* alias frame handle for Getriebe_1 */
            filePutString ("Getriebe_2;6911\n", 16, fhdlOut);
            filePutString ("Getriebe_2;TSC2;AliasName\n", 26, fhdlOut);    /* alias frame handle for Getriebe_2 */
            filePutString ("Getriebe_3_Momente;7167\n", 24, fhdlOut);
            filePutString ("Getriebe_3_Momente;TSC3;AliasName\n", 34, fhdlOut);    /* alias frame handle for Getriebe_3_Momente */
            filePutString ("Getriebe_6;7423\n", 16, fhdlOut);
            filePutString ("Getriebe_6;TSC6;AliasName\n", 26, fhdlOut);    /* alias frame handle for Getriebe_6 */
            filePutString ("Getriebe_Hybrid_1;7679\n", 23, fhdlOut);
            filePutString ("Getriebe_Hybrid_1;TSCH1;AliasName\n", 34, fhdlOut);    /* alias frame handle for Getriebe_Hybrid_1 */
            filePutString ("Klima_5;7935\n", 13, fhdlOut);
            filePutString ("Klima_5;AC5;AliasName\n", 22, fhdlOut);    /* alias frame handle for Klima_5 */
            filePutString ("Kombi_1;8191\n", 13, fhdlOut);
            filePutString ("Kombi_1;DSP1;AliasName\n", 23, fhdlOut);    /* alias frame handle for Kombi_1 */
            filePutString ("Kombi_2;8447\n", 13, fhdlOut);
            filePutString ("Kombi_2;DSP2;AliasName\n", 23, fhdlOut);    /* alias frame handle for Kombi_2 */
            filePutString ("Kombi_3;8703\n", 13, fhdlOut);
            filePutString ("Kombi_3;DSP3;AliasName\n", 23, fhdlOut);    /* alias frame handle for Kombi_3 */
            filePutString ("LW_1;8959\n", 10, fhdlOut);
            filePutString ("LW_1;LWS1;AliasName\n", 20, fhdlOut);    /* alias frame handle for LW_1 */
            filePutString ("Lenkhilfe_3;9215\n", 17, fhdlOut);
            filePutString ("Lenkhilfe_3;LH3;AliasName\n", 26, fhdlOut);    /* alias frame handle for Lenkhilfe_3 */
            filePutString ("NMH_Gateway;9471\n", 17, fhdlOut);
            filePutString ("NMH_Gateway;NMH_Gateway;AliasName\n", 34, fhdlOut);    /* alias frame handle for NMH_Gateway */
            filePutString ("Niveau_1;9727\n", 14, fhdlOut);
            filePutString ("Niveau_1;LVL1;AliasName\n", 24, fhdlOut);    /* alias frame handle for Niveau_1 */
            filePutString ("OBD_Tankgeber_01;9983\n", 22, fhdlOut);
            filePutString ("OBD_Tankgeber_01;FLS01;AliasName\n", 33, fhdlOut);    /* alias frame handle for OBD_Tankgeber_01 */
            filePutString ("Parkhilfe_01;10239\n", 19, fhdlOut);
            filePutString ("Parkhilfe_01;PRKH01;AliasName\n", 30, fhdlOut);    /* alias frame handle for Parkhilfe_01 */
            filePutString ("Parkhilfe_1;10495\n", 18, fhdlOut);
            filePutString ("Parkhilfe_1;PRKH1;AliasName\n", 28, fhdlOut);    /* alias frame handle for Parkhilfe_1 */
            filePutString ("Remotestart_FFB;10751\n", 22, fhdlOut);
            filePutString ("Remotestart_FFB;RCS1;AliasName\n", 31, fhdlOut);    /* alias frame handle for Remotestart_FFB */
            filePutString ("Soll_Verbauliste_neu;11007\n", 27, fhdlOut);
            filePutString ("Soll_Verbauliste_neu;VL1;AliasName\n", 35, fhdlOut);    /* alias frame handle for Soll_Verbauliste_neu */
            filePutString ("Systeminfo_1;11263\n", 19, fhdlOut);
            filePutString ("Systeminfo_1;SYS1;AliasName\n", 28, fhdlOut);    /* alias frame handle for Systeminfo_1 */
            filePutString ("TOG;11519\n", 10, fhdlOut);
            filePutString ("TOG;TOS;AliasName\n", 18, fhdlOut);    /* alias frame handle for TOG */
            filePutString ("ZAS_1;11775\n", 12, fhdlOut);
            filePutString ("ZAS_1;STIGN1;AliasName\n", 23, fhdlOut);    /* alias frame handle for ZAS_1 */

            filePutString ("AWV1_Freigabe;0\n", 16, fhdlOut);
            filePutString ("AWV1_Freigabe/ACC_1;0\n", 22, fhdlOut);
            filePutString ("AWV1_Freigabe/ACC1_RX;0\n", 24, fhdlOut);
            filePutString ("AWV1_Parameter_HBA;1\n", 21, fhdlOut);
            filePutString ("AWV1_Parameter_HBA/ACC_1;1\n", 27, fhdlOut);
            filePutString ("AWV1_Parameter_HBA/ACC1_RX;1\n", 29, fhdlOut);
            filePutString ("AWV1_Parameter_Nachtreten_HBA;2\n", 32, fhdlOut);
            filePutString ("AWV1_Parameter_Nachtreten_HBA/ACC_1;2\n", 38, fhdlOut);
            filePutString ("AWV1_Parameter_Nachtreten_HBA/ACC1_RX;2\n", 40, fhdlOut);
            filePutString ("AWV1_Prefill;3\n", 15, fhdlOut);
            filePutString ("AWV1_Prefill/ACC_1;3\n", 21, fhdlOut);
            filePutString ("AWV1_Prefill/ACC1_RX;3\n", 23, fhdlOut);
            filePutString ("AWV2_Freigabe;4\n", 16, fhdlOut);
            filePutString ("AWV2_Freigabe/ACC_1;4\n", 22, fhdlOut);
            filePutString ("AWV2_Freigabe/ACC1_RX;4\n", 24, fhdlOut);
            filePutString ("AWV2_Priowarnung_LDW;5\n", 23, fhdlOut);
            filePutString ("AWV2_Priowarnung_LDW/ACC_1;5\n", 29, fhdlOut);
            filePutString ("AWV2_Priowarnung_LDW/ACC1_RX;5\n", 31, fhdlOut);
            filePutString ("AWV2_Ruckprofil;6\n", 18, fhdlOut);
            filePutString ("AWV2_Ruckprofil/ACC_1;6\n", 24, fhdlOut);
            filePutString ("AWV2_Ruckprofil/ACC1_RX;6\n", 26, fhdlOut);
            filePutString ("Anhalten;7\n", 11, fhdlOut);
            filePutString ("Anhalten/ACC_1;7\n", 17, fhdlOut);
            filePutString ("Anhalten/ACC1_RX;7\n", 19, fhdlOut);
            filePutString ("BZ_ACC1;8\n", 10, fhdlOut);
            filePutString ("BZ_ACC1/ACC_1;8\n", 16, fhdlOut);
            filePutString ("BZ_ACC1/ACC1_RX;8\n", 18, fhdlOut);
            filePutString ("CHK_ACC1;9\n", 11, fhdlOut);
            filePutString ("CHK_ACC1/ACC_1;9\n", 17, fhdlOut);
            filePutString ("CHK_ACC1/ACC1_RX;9\n", 19, fhdlOut);
            filePutString ("Dynamik_Bremsdruck;10\n", 22, fhdlOut);
            filePutString ("Dynamik_Bremsdruck/ACC_1;10\n", 28, fhdlOut);
            filePutString ("Dynamik_Bremsdruck/ACC1_RX;10\n", 30, fhdlOut);
            filePutString ("ESP_Beeinflussung_ACC;11\n", 25, fhdlOut);
            filePutString ("ESP_Beeinflussung_ACC/ACC_1;11\n", 31, fhdlOut);
            filePutString ("ESP_Beeinflussung_ACC/ACC1_RX;11\n", 33, fhdlOut);
            filePutString ("FSPE_ACC;12\n", 12, fhdlOut);
            filePutString ("FSPE_ACC/ACC_1;12\n", 18, fhdlOut);
            filePutString ("FSPE_ACC/ACC1_RX;12\n", 20, fhdlOut);
            filePutString ("Freigabe_Momenten_Anf;13\n", 25, fhdlOut);
            filePutString ("Freigabe_Momenten_Anf/ACC_1;13\n", 31, fhdlOut);
            filePutString ("Freigabe_Momenten_Anf/ACC1_RX;13\n", 33, fhdlOut);
            filePutString ("Freigabe_Verzoeg_Anf;14\n", 24, fhdlOut);
            filePutString ("Freigabe_Verzoeg_Anf/ACC_1;14\n", 30, fhdlOut);
            filePutString ("Freigabe_Verzoeg_Anf/ACC1_RX;14\n", 32, fhdlOut);
            filePutString ("Momenten_Anf_ACC;15\n", 20, fhdlOut);
            filePutString ("Momenten_Anf_ACC/ACC_1;15\n", 26, fhdlOut);
            filePutString ("Momenten_Anf_ACC/ACC1_RX;15\n", 28, fhdlOut);
            filePutString ("Sender_Info;16\n", 15, fhdlOut);
            filePutString ("Sender_Info/ACC_1;16\n", 21, fhdlOut);
            filePutString ("Sender_Info/ACC1_RX;16\n", 23, fhdlOut);
            filePutString ("Sollbeschl_Getr;17\n", 19, fhdlOut);
            filePutString ("Sollbeschl_Getr/ACC_1;17\n", 25, fhdlOut);
            filePutString ("Sollbeschl_Getr/ACC1_RX;17\n", 27, fhdlOut);
            filePutString ("Status_ACC;18\n", 14, fhdlOut);
            filePutString ("Status_ACC/ACC_1;18\n", 20, fhdlOut);
            filePutString ("Status_ACC/ACC1_RX;18\n", 22, fhdlOut);
            filePutString ("Verhinderung_SA;19\n", 19, fhdlOut);
            filePutString ("Verhinderung_SA/ACC_1;19\n", 25, fhdlOut);
            filePutString ("Verhinderung_SA/ACC1_RX;19\n", 27, fhdlOut);
            filePutString ("Verzoeg_Anf_ACC;20\n", 19, fhdlOut);
            filePutString ("Verzoeg_Anf_ACC/ACC_1;20\n", 25, fhdlOut);
            filePutString ("Verzoeg_Anf_ACC/ACC1_RX;20\n", 27, fhdlOut);
            filePutString ("Vorbefuellung_Bremsanlage;21\n", 29, fhdlOut);
            filePutString ("Vorbefuellung_Bremsanlage/ACC_1;21\n", 35, fhdlOut);
            filePutString ("Vorbefuellung_Bremsanlage/ACC1_RX;21\n", 37, fhdlOut);
            filePutString ("ACS_ADR_Schub;256\n", 18, fhdlOut);
            filePutString ("ACS_ADR_Schub/ACC_System;256\n", 29, fhdlOut);
            filePutString ("ACS_ADR_Schub/ACCA;256\n", 23, fhdlOut);
            filePutString ("ACS_Anhaltewunsch;257\n", 22, fhdlOut);
            filePutString ("ACS_Anhaltewunsch/ACC_System;257\n", 33, fhdlOut);
            filePutString ("ACS_Anhaltewunsch/ACCA;257\n", 27, fhdlOut);
            filePutString ("ACS_Checksum;258\n", 17, fhdlOut);
            filePutString ("ACS_Checksum/ACC_System;258\n", 28, fhdlOut);
            filePutString ("ACS_Checksum/ACCA;258\n", 22, fhdlOut);
            filePutString ("ACS_Fehler;259\n", 15, fhdlOut);
            filePutString ("ACS_Fehler/ACC_System;259\n", 26, fhdlOut);
            filePutString ("ACS_Fehler/ACCA;259\n", 20, fhdlOut);
            filePutString ("ACS_FreigSollB;260\n", 19, fhdlOut);
            filePutString ("ACS_FreigSollB/ACC_System;260\n", 30, fhdlOut);
            filePutString ("ACS_FreigSollB/ACCA;260\n", 24, fhdlOut);
            filePutString ("ACS_MomEingriff;261\n", 20, fhdlOut);
            filePutString ("ACS_MomEingriff/ACC_System;261\n", 31, fhdlOut);
            filePutString ("ACS_MomEingriff/ACCA;261\n", 25, fhdlOut);
            filePutString ("ACS_Schubabsch;262\n", 19, fhdlOut);
            filePutString ("ACS_Schubabsch/ACC_System;262\n", 30, fhdlOut);
            filePutString ("ACS_Schubabsch/ACCA;262\n", 24, fhdlOut);
            filePutString ("ACS_Sollbeschl;263\n", 19, fhdlOut);
            filePutString ("ACS_Sollbeschl/ACC_System;263\n", 30, fhdlOut);
            filePutString ("ACS_Sollbeschl/ACCA;263\n", 24, fhdlOut);
            filePutString ("ACS_StSt_Info;264\n", 18, fhdlOut);
            filePutString ("ACS_StSt_Info/ACC_System;264\n", 29, fhdlOut);
            filePutString ("ACS_StSt_Info/ACCA;264\n", 23, fhdlOut);
            filePutString ("ACS_Sta_ADR;265\n", 16, fhdlOut);
            filePutString ("ACS_Sta_ADR/ACC_System;265\n", 27, fhdlOut);
            filePutString ("ACS_Sta_ADR/ACCA;265\n", 21, fhdlOut);
            filePutString ("ACS_Typ_ACC;266\n", 16, fhdlOut);
            filePutString ("ACS_Typ_ACC/ACC_System;266\n", 27, fhdlOut);
            filePutString ("ACS_Typ_ACC/ACCA;266\n", 21, fhdlOut);
            filePutString ("ACS_Zaehler;267\n", 16, fhdlOut);
            filePutString ("ACS_Zaehler/ACC_System;267\n", 27, fhdlOut);
            filePutString ("ACS_Zaehler/ACCA;267\n", 21, fhdlOut);
            filePutString ("ACS_max_AendGrad;268\n", 21, fhdlOut);
            filePutString ("ACS_max_AendGrad/ACC_System;268\n", 32, fhdlOut);
            filePutString ("ACS_max_AendGrad/ACCA;268\n", 26, fhdlOut);
            filePutString ("ACS_res_21;269\n", 15, fhdlOut);
            filePutString ("ACS_res_21/ACC_System;269\n", 26, fhdlOut);
            filePutString ("ACS_res_21/ACCA;269\n", 20, fhdlOut);
            filePutString ("ACS_res_35;270\n", 15, fhdlOut);
            filePutString ("ACS_res_35/ACC_System;270\n", 26, fhdlOut);
            filePutString ("ACS_res_35/ACCA;270\n", 20, fhdlOut);
            filePutString ("ACS_res_36;271\n", 15, fhdlOut);
            filePutString ("ACS_res_36/ACC_System;271\n", 26, fhdlOut);
            filePutString ("ACS_res_36/ACCA;271\n", 20, fhdlOut);
            filePutString ("ACS_res_37;272\n", 15, fhdlOut);
            filePutString ("ACS_res_37/ACC_System;272\n", 26, fhdlOut);
            filePutString ("ACS_res_37/ACCA;272\n", 20, fhdlOut);
            filePutString ("ACS_res_56;273\n", 15, fhdlOut);
            filePutString ("ACS_res_56/ACC_System;273\n", 26, fhdlOut);
            filePutString ("ACS_res_56/ACCA;273\n", 20, fhdlOut);
            filePutString ("ACS_res_57;274\n", 15, fhdlOut);
            filePutString ("ACS_res_57/ACC_System;274\n", 26, fhdlOut);
            filePutString ("ACS_res_57/ACCA;274\n", 20, fhdlOut);
            filePutString ("ACS_res_58;275\n", 15, fhdlOut);
            filePutString ("ACS_res_58/ACC_System;275\n", 26, fhdlOut);
            filePutString ("ACS_res_58/ACCA;275\n", 20, fhdlOut);
            filePutString ("ACS_res_59;276\n", 15, fhdlOut);
            filePutString ("ACS_res_59/ACC_System;276\n", 26, fhdlOut);
            filePutString ("ACS_res_59/ACCA;276\n", 20, fhdlOut);
            filePutString ("ACS_res_60;277\n", 15, fhdlOut);
            filePutString ("ACS_res_60/ACC_System;277\n", 26, fhdlOut);
            filePutString ("ACS_res_60/ACCA;277\n", 20, fhdlOut);
            filePutString ("ACS_res_61;278\n", 15, fhdlOut);
            filePutString ("ACS_res_61/ACC_System;278\n", 26, fhdlOut);
            filePutString ("ACS_res_61/ACCA;278\n", 20, fhdlOut);
            filePutString ("ACS_res_62;279\n", 15, fhdlOut);
            filePutString ("ACS_res_62/ACC_System;279\n", 26, fhdlOut);
            filePutString ("ACS_res_62/ACCA;279\n", 20, fhdlOut);
            filePutString ("ACS_res_63;280\n", 15, fhdlOut);
            filePutString ("ACS_res_63/ACC_System;280\n", 26, fhdlOut);
            filePutString ("ACS_res_63/ACCA;280\n", 20, fhdlOut);
            filePutString ("ACS_zul_Regelabw;281\n", 21, fhdlOut);
            filePutString ("ACS_zul_Regelabw/ACC_System;281\n", 32, fhdlOut);
            filePutString ("ACS_zul_Regelabw/ACCA;281\n", 26, fhdlOut);
            filePutString ("AB1_BF_Warnung;512\n", 19, fhdlOut);
            filePutString ("AB1_BF_Warnung/Airbag_1;512\n", 28, fhdlOut);
            filePutString ("AB1_BF_Warnung/AIRBG1;512\n", 26, fhdlOut);
            filePutString ("AB1_Beifahrer;513\n", 18, fhdlOut);
            filePutString ("AB1_Beifahrer/Airbag_1;513\n", 27, fhdlOut);
            filePutString ("AB1_Beifahrer/AIRBG1;513\n", 25, fhdlOut);
            filePutString ("AB1_Bf_Seite;514\n", 17, fhdlOut);
            filePutString ("AB1_Bf_Seite/Airbag_1;514\n", 26, fhdlOut);
            filePutString ("AB1_Bf_Seite/AIRBG1;514\n", 24, fhdlOut);
            filePutString ("AB1_Checksumme;515\n", 19, fhdlOut);
            filePutString ("AB1_Checksumme/Airbag_1;515\n", 28, fhdlOut);
            filePutString ("AB1_Checksumme/AIRBG1;515\n", 26, fhdlOut);
            filePutString ("AB1_Diagnose;516\n", 17, fhdlOut);
            filePutString ("AB1_Diagnose/Airbag_1;516\n", 26, fhdlOut);
            filePutString ("AB1_Diagnose/AIRBG1;516\n", 24, fhdlOut);
            filePutString ("AB1_Fa_Seite;517\n", 17, fhdlOut);
            filePutString ("AB1_Fa_Seite/Airbag_1;517\n", 26, fhdlOut);
            filePutString ("AB1_Fa_Seite/AIRBG1;517\n", 24, fhdlOut);
            filePutString ("AB1_Fehlereintr;518\n", 20, fhdlOut);
            filePutString ("AB1_Fehlereintr/Airbag_1;518\n", 29, fhdlOut);
            filePutString ("AB1_Fehlereintr/AIRBG1;518\n", 27, fhdlOut);
            filePutString ("AB1_Front;519\n", 14, fhdlOut);
            filePutString ("AB1_Front/Airbag_1;519\n", 23, fhdlOut);
            filePutString ("AB1_Front/AIRBG1;519\n", 21, fhdlOut);
            filePutString ("AB1_Gurt_Bf;520\n", 16, fhdlOut);
            filePutString ("AB1_Gurt_Bf/Airbag_1;520\n", 25, fhdlOut);
            filePutString ("AB1_Gurt_Bf/AIRBG1;520\n", 23, fhdlOut);
            filePutString ("AB1_Gurt_Fa;521\n", 16, fhdlOut);
            filePutString ("AB1_Gurt_Fa/Airbag_1;521\n", 25, fhdlOut);
            filePutString ("AB1_Gurt_Fa/AIRBG1;521\n", 23, fhdlOut);
            filePutString ("AB1_Heck;522\n", 13, fhdlOut);
            filePutString ("AB1_Heck/Airbag_1;522\n", 22, fhdlOut);
            filePutString ("AB1_Heck/AIRBG1;522\n", 20, fhdlOut);
            filePutString ("AB1_Intens;523\n", 15, fhdlOut);
            filePutString ("AB1_Intens/Airbag_1;523\n", 24, fhdlOut);
            filePutString ("AB1_Intens/AIRBG1;523\n", 22, fhdlOut);
            filePutString ("AB1_Lampe;524\n", 14, fhdlOut);
            filePutString ("AB1_Lampe/Airbag_1;524\n", 23, fhdlOut);
            filePutString ("AB1_Lampe/AIRBG1;524\n", 21, fhdlOut);
            filePutString ("AB1_Rollover;525\n", 17, fhdlOut);
            filePutString ("AB1_Rollover/Airbag_1;525\n", 26, fhdlOut);
            filePutString ("AB1_Rollover/AIRBG1;525\n", 24, fhdlOut);
            filePutString ("AB1_Status;526\n", 15, fhdlOut);
            filePutString ("AB1_Status/Airbag_1;526\n", 24, fhdlOut);
            filePutString ("AB1_Status/AIRBG1;526\n", 22, fhdlOut);
            filePutString ("AB1_Stellglied;527\n", 19, fhdlOut);
            filePutString ("AB1_Stellglied/Airbag_1;527\n", 28, fhdlOut);
            filePutString ("AB1_Stellglied/AIRBG1;527\n", 26, fhdlOut);
            filePutString ("AB1_System;528\n", 15, fhdlOut);
            filePutString ("AB1_System/Airbag_1;528\n", 24, fhdlOut);
            filePutString ("AB1_System/AIRBG1;528\n", 22, fhdlOut);
            filePutString ("AB1_Zaehler;529\n", 16, fhdlOut);
            filePutString ("AB1_Zaehler/Airbag_1;529\n", 25, fhdlOut);
            filePutString ("AB1_Zaehler/AIRBG1;529\n", 23, fhdlOut);
            filePutString ("AL1_AnfVerteiler;768\n", 21, fhdlOut);
            filePutString ("AL1_AnfVerteiler/Allrad_1;768\n", 30, fhdlOut);
            filePutString ("AL1_AnfVerteiler/AWD1;768\n", 26, fhdlOut);
            filePutString ("AL1_Anz_blinken;769\n", 20, fhdlOut);
            filePutString ("AL1_Anz_blinken/Allrad_1;769\n", 29, fhdlOut);
            filePutString ("AL1_Anz_blinken/AWD1;769\n", 25, fhdlOut);
            filePutString ("AL1_Begrenzungsmo;770\n", 22, fhdlOut);
            filePutString ("AL1_Begrenzungsmo/Allrad_1;770\n", 31, fhdlOut);
            filePutString ("AL1_Begrenzungsmo/AWD1;770\n", 27, fhdlOut);
            filePutString ("AL1_Diff_Gong;771\n", 18, fhdlOut);
            filePutString ("AL1_Diff_Gong/Allrad_1;771\n", 27, fhdlOut);
            filePutString ("AL1_Diff_Gong/AWD1;771\n", 23, fhdlOut);
            filePutString ("AL1_Diff_Lampe;772\n", 19, fhdlOut);
            filePutString ("AL1_Diff_Lampe/Allrad_1;772\n", 28, fhdlOut);
            filePutString ("AL1_Diff_Lampe/AWD1;772\n", 24, fhdlOut);
            filePutString ("AL1_Diff_Verbau;773\n", 20, fhdlOut);
            filePutString ("AL1_Diff_Verbau/Allrad_1;773\n", 29, fhdlOut);
            filePutString ("AL1_Diff_Verbau/AWD1;773\n", 25, fhdlOut);
            filePutString ("AL1_Einheit;774\n", 16, fhdlOut);
            filePutString ("AL1_Einheit/Allrad_1;774\n", 25, fhdlOut);
            filePutString ("AL1_Einheit/AWD1;774\n", 21, fhdlOut);
            filePutString ("AL1_FaWu_HA;775\n", 16, fhdlOut);
            filePutString ("AL1_FaWu_HA/Allrad_1;775\n", 25, fhdlOut);
            filePutString ("AL1_FaWu_HA/AWD1;775\n", 21, fhdlOut);
            filePutString ("AL1_FaWu_Laengs;776\n", 20, fhdlOut);
            filePutString ("AL1_FaWu_Laengs/Allrad_1;776\n", 29, fhdlOut);
            filePutString ("AL1_FaWu_Laengs/AWD1;776\n", 25, fhdlOut);
            filePutString ("AL1_FaWu_VA;777\n", 16, fhdlOut);
            filePutString ("AL1_FaWu_VA/Allrad_1;777\n", 25, fhdlOut);
            filePutString ("AL1_FaWu_VA/AWD1;777\n", 21, fhdlOut);
            filePutString ("AL1_Fehler;778\n", 15, fhdlOut);
            filePutString ("AL1_Fehler/Allrad_1;778\n", 24, fhdlOut);
            filePutString ("AL1_Fehler/AWD1;778\n", 20, fhdlOut);
            filePutString ("AL1_Fehlereintr;779\n", 20, fhdlOut);
            filePutString ("AL1_Fehlereintr/Allrad_1;779\n", 29, fhdlOut);
            filePutString ("AL1_Fehlereintr/AWD1;779\n", 25, fhdlOut);
            filePutString ("AL1_Ist_Nm;780\n", 15, fhdlOut);
            filePutString ("AL1_Ist_Nm/Allrad_1;780\n", 24, fhdlOut);
            filePutString ("AL1_Ist_Nm/AWD1;780\n", 20, fhdlOut);
            filePutString ("AL1_Ist_Proz;781\n", 17, fhdlOut);
            filePutString ("AL1_Ist_Proz/Allrad_1;781\n", 26, fhdlOut);
            filePutString ("AL1_Ist_Proz/AWD1;781\n", 22, fhdlOut);
            filePutString ("AL1_KupSteifig_F;782\n", 21, fhdlOut);
            filePutString ("AL1_KupSteifig_F/Allrad_1;782\n", 30, fhdlOut);
            filePutString ("AL1_KupSteifig_F/AWD1;782\n", 26, fhdlOut);
            filePutString ("AL1_Kup_offen;783\n", 18, fhdlOut);
            filePutString ("AL1_Kup_offen/Allrad_1;783\n", 27, fhdlOut);
            filePutString ("AL1_Kup_offen/AWD1;783\n", 23, fhdlOut);
            filePutString ("AL1_Limit_maxkmh;784\n", 21, fhdlOut);
            filePutString ("AL1_Limit_maxkmh/Allrad_1;784\n", 30, fhdlOut);
            filePutString ("AL1_Limit_maxkmh/AWD1;784\n", 26, fhdlOut);
            filePutString ("AL1_Limiter;785\n", 16, fhdlOut);
            filePutString ("AL1_Limiter/Allrad_1;785\n", 25, fhdlOut);
            filePutString ("AL1_Limiter/AWD1;785\n", 21, fhdlOut);
            filePutString ("AL1_Notlauf;786\n", 16, fhdlOut);
            filePutString ("AL1_Notlauf/Allrad_1;786\n", 25, fhdlOut);
            filePutString ("AL1_Notlauf/AWD1;786\n", 21, fhdlOut);
            filePutString ("AL1_Quersp_Sta;787\n", 19, fhdlOut);
            filePutString ("AL1_Quersp_Sta/Allrad_1;787\n", 28, fhdlOut);
            filePutString ("AL1_Quersp_Sta/AWD1;787\n", 24, fhdlOut);
            filePutString ("AL1_Reserve2;788\n", 17, fhdlOut);
            filePutString ("AL1_Reserve2/Allrad_1;788\n", 26, fhdlOut);
            filePutString ("AL1_Reserve2/AWD1;788\n", 22, fhdlOut);
            filePutString ("AL1_Schalten;789\n", 17, fhdlOut);
            filePutString ("AL1_Schalten/Allrad_1;789\n", 26, fhdlOut);
            filePutString ("AL1_Schalten/AWD1;789\n", 22, fhdlOut);
            filePutString ("AL1_Sta_Kup;790\n", 16, fhdlOut);
            filePutString ("AL1_Sta_Kup/Allrad_1;790\n", 25, fhdlOut);
            filePutString ("AL1_Sta_Kup/AWD1;790\n", 21, fhdlOut);
            filePutString ("AL1_Sta_Laengssp;791\n", 21, fhdlOut);
            filePutString ("AL1_Sta_Laengssp/Allrad_1;791\n", 30, fhdlOut);
            filePutString ("AL1_Sta_Laengssp/AWD1;791\n", 26, fhdlOut);
            filePutString ("AL1_Sta_PNG;792\n", 16, fhdlOut);
            filePutString ("AL1_Sta_PNG/Allrad_1;792\n", 25, fhdlOut);
            filePutString ("AL1_Sta_PNG/AWD1;792\n", 21, fhdlOut);
            filePutString ("AL1_Sta_Quersp;793\n", 19, fhdlOut);
            filePutString ("AL1_Sta_Quersp/Allrad_1;793\n", 28, fhdlOut);
            filePutString ("AL1_Sta_Quersp/AWD1;793\n", 24, fhdlOut);
            filePutString ("AL1_Sta_VA;794\n", 15, fhdlOut);
            filePutString ("AL1_Sta_VA/Allrad_1;794\n", 24, fhdlOut);
            filePutString ("AL1_Sta_VA/AWD1;794\n", 20, fhdlOut);
            filePutString ("AL1_Stellung_Getr;795\n", 22, fhdlOut);
            filePutString ("AL1_Stellung_Getr/Allrad_1;795\n", 31, fhdlOut);
            filePutString ("AL1_Stellung_Getr/AWD1;795\n", 27, fhdlOut);
            filePutString ("AL1_Uebertemp;796\n", 18, fhdlOut);
            filePutString ("AL1_Uebertemp/Allrad_1;796\n", 27, fhdlOut);
            filePutString ("AL1_Uebertemp/AWD1;796\n", 23, fhdlOut);
            filePutString ("AL1_Vorwarnung;797\n", 19, fhdlOut);
            filePutString ("AL1_Vorwarnung/Allrad_1;797\n", 28, fhdlOut);
            filePutString ("AL1_Vorwarnung/AWD1;797\n", 24, fhdlOut);
            filePutString ("AL1_Warnlampe;798\n", 18, fhdlOut);
            filePutString ("AL1_Warnlampe/Allrad_1;798\n", 27, fhdlOut);
            filePutString ("AL1_Warnlampe/AWD1;798\n", 23, fhdlOut);
            filePutString ("AL1_Zaehler;799\n", 16, fhdlOut);
            filePutString ("AL1_Zaehler/Allrad_1;799\n", 25, fhdlOut);
            filePutString ("AL1_Zaehler/AWD1;799\n", 21, fhdlOut);
            filePutString ("Abschalt_Heizsysteme;1024\n", 26, fhdlOut);
            filePutString ("Abschalt_Heizsysteme/BEM_1;1024\n", 32, fhdlOut);
            filePutString ("Abschalt_Heizsysteme/BEM1;1024\n", 31, fhdlOut);
            filePutString ("Abschaltstufen;1025\n", 20, fhdlOut);
            filePutString ("Abschaltstufen/BEM_1;1025\n", 26, fhdlOut);
            filePutString ("Abschaltstufen/BEM1;1025\n", 25, fhdlOut);
            filePutString ("Anforderung_HSH;1026\n", 21, fhdlOut);
            filePutString ("Anforderung_HSH/BEM_1;1026\n", 27, fhdlOut);
            filePutString ("Anforderung_HSH/BEM1;1026\n", 26, fhdlOut);
            filePutString ("Anforderung_Kluefter_;1027\n", 27, fhdlOut);
            filePutString ("Anforderung_Kluefter_/BEM_1;1027\n", 33, fhdlOut);
            filePutString ("Anforderung_Kluefter_/BEM1;1027\n", 32, fhdlOut);
            filePutString ("BEM_Batteriespannung;1028\n", 26, fhdlOut);
            filePutString ("BEM_Batteriespannung/BEM_1;1028\n", 32, fhdlOut);
            filePutString ("BEM_Batteriespannung/BEM1;1028\n", 31, fhdlOut);
            filePutString ("BEM_StSt_Info;1029\n", 19, fhdlOut);
            filePutString ("BEM_StSt_Info/BEM_1;1029\n", 25, fhdlOut);
            filePutString ("BEM_StSt_Info/BEM1;1029\n", 24, fhdlOut);
            filePutString ("BZ_BEM1;1030\n", 13, fhdlOut);
            filePutString ("BZ_BEM1/BEM_1;1030\n", 19, fhdlOut);
            filePutString ("BZ_BEM1/BEM1;1030\n", 18, fhdlOut);
            filePutString ("CHK_BEM1;1031\n", 14, fhdlOut);
            filePutString ("CHK_BEM1/BEM_1;1031\n", 20, fhdlOut);
            filePutString ("CHK_BEM1/BEM1;1031\n", 19, fhdlOut);
            filePutString ("Einschaltung_PTC_Hzg;1032\n", 26, fhdlOut);
            filePutString ("Einschaltung_PTC_Hzg/BEM_1;1032\n", 32, fhdlOut);
            filePutString ("Einschaltung_PTC_Hzg/BEM1;1032\n", 31, fhdlOut);
            filePutString ("Generator_Lastmoment;1033\n", 26, fhdlOut);
            filePutString ("Generator_Lastmoment/BEM_1;1033\n", 32, fhdlOut);
            filePutString ("Generator_Lastmoment/BEM1;1033\n", 31, fhdlOut);
            filePutString ("Generator_Leistungsaufnahme;1034\n", 33, fhdlOut);
            filePutString ("Generator_Leistungsaufnahme/BEM_1;1034\n", 39, fhdlOut);
            filePutString ("Generator_Leistungsaufnahme/BEM1;1034\n", 38, fhdlOut);
            filePutString ("HL_Systeme_Status;1035\n", 23, fhdlOut);
            filePutString ("HL_Systeme_Status/BEM_1;1035\n", 29, fhdlOut);
            filePutString ("HL_Systeme_Status/BEM1;1035\n", 28, fhdlOut);
            filePutString ("HL_Systemregelung_Status;1036\n", 30, fhdlOut);
            filePutString ("HL_Systemregelung_Status/BEM_1;1036\n", 36, fhdlOut);
            filePutString ("HL_Systemregelung_Status/BEM1;1036\n", 35, fhdlOut);
            filePutString ("Lastabwurf_Rueckmeldung;1037\n", 29, fhdlOut);
            filePutString ("Lastabwurf_Rueckmeldung/BEM_1;1037\n", 35, fhdlOut);
            filePutString ("Lastabwurf_Rueckmeldung/BEM1;1037\n", 34, fhdlOut);
            filePutString ("Leerlaufdrehzahl_Erhoehung;1038\n", 32, fhdlOut);
            filePutString ("Leerlaufdrehzahl_Erhoehung/BEM_1;1038\n", 38, fhdlOut);
            filePutString ("Leerlaufdrehzahl_Erhoehung/BEM1;1038\n", 37, fhdlOut);
            filePutString ("Load_Response_Generator;1039\n", 29, fhdlOut);
            filePutString ("Load_Response_Generator/BEM_1;1039\n", 35, fhdlOut);
            filePutString ("Load_Response_Generator/BEM1;1039\n", 34, fhdlOut);
            filePutString ("Red_Innenraumgeblaese;1040\n", 27, fhdlOut);
            filePutString ("Red_Innenraumgeblaese/BEM_1;1040\n", 33, fhdlOut);
            filePutString ("Red_Innenraumgeblaese/BEM1;1040\n", 32, fhdlOut);
            filePutString ("Ruecknahme_HSH;1041\n", 20, fhdlOut);
            filePutString ("Ruecknahme_HSH/BEM_1;1041\n", 26, fhdlOut);
            filePutString ("Ruecknahme_HSH/BEM1;1041\n", 25, fhdlOut);
            filePutString ("BSL_Ab_Batterie;1280\n", 21, fhdlOut);
            filePutString ("BSL_Ab_Batterie/BSG_Last;1280\n", 30, fhdlOut);
            filePutString ("BSL_Ab_Batterie/ESCU;1280\n", 26, fhdlOut);
            filePutString ("BSL_Aussensp;1281\n", 18, fhdlOut);
            filePutString ("BSL_Aussensp/BSG_Last;1281\n", 27, fhdlOut);
            filePutString ("BSL_Aussensp/ESCU;1281\n", 23, fhdlOut);
            filePutString ("BSL_BSG_2_alt;1282\n", 19, fhdlOut);
            filePutString ("BSL_BSG_2_alt/BSG_Last;1282\n", 28, fhdlOut);
            filePutString ("BSL_BSG_2_alt/ESCU;1282\n", 24, fhdlOut);
            filePutString ("BSL_BSG_3_alt;1283\n", 19, fhdlOut);
            filePutString ("BSL_BSG_3_alt/BSG_Last;1283\n", 28, fhdlOut);
            filePutString ("BSL_BSG_3_alt/ESCU;1283\n", 24, fhdlOut);
            filePutString ("BSL_Clima;1284\n", 15, fhdlOut);
            filePutString ("BSL_Clima/BSG_Last;1284\n", 24, fhdlOut);
            filePutString ("BSL_Clima/ESCU;1284\n", 20, fhdlOut);
            filePutString ("BSL_DFM;1285\n", 13, fhdlOut);
            filePutString ("BSL_DFM/BSG_Last;1285\n", 22, fhdlOut);
            filePutString ("BSL_DFM/ESCU;1285\n", 18, fhdlOut);
            filePutString ("BSL_Fehlereintr;1286\n", 21, fhdlOut);
            filePutString ("BSL_Fehlereintr/BSG_Last;1286\n", 30, fhdlOut);
            filePutString ("BSL_Fehlereintr/ESCU;1286\n", 26, fhdlOut);
            filePutString ("BSL_Frontsch;1287\n", 18, fhdlOut);
            filePutString ("BSL_Frontsch/BSG_Last;1287\n", 27, fhdlOut);
            filePutString ("BSL_Frontsch/ESCU;1287\n", 23, fhdlOut);
            filePutString ("BSL_Hecksch;1288\n", 17, fhdlOut);
            filePutString ("BSL_Hecksch/BSG_Last;1288\n", 26, fhdlOut);
            filePutString ("BSL_Hecksch/ESCU;1288\n", 22, fhdlOut);
            filePutString ("BSL_Kl_15_Motor;1289\n", 21, fhdlOut);
            filePutString ("BSL_Kl_15_Motor/BSG_Last;1289\n", 30, fhdlOut);
            filePutString ("BSL_Kl_15_Motor/ESCU;1289\n", 26, fhdlOut);
            filePutString ("BSL_Kl_L;1290\n", 14, fhdlOut);
            filePutString ("BSL_Kl_L/BSG_Last;1290\n", 23, fhdlOut);
            filePutString ("BSL_Kl_L/ESCU;1290\n", 19, fhdlOut);
            filePutString ("BSL_Kuehlerlueft;1291\n", 22, fhdlOut);
            filePutString ("BSL_Kuehlerlueft/BSG_Last;1291\n", 31, fhdlOut);
            filePutString ("BSL_Kuehlerlueft/ESCU;1291\n", 27, fhdlOut);
            filePutString ("BSL_LL_Anheb;1292\n", 18, fhdlOut);
            filePutString ("BSL_LL_Anheb/BSG_Last;1292\n", 27, fhdlOut);
            filePutString ("BSL_LL_Anheb/ESCU;1292\n", 23, fhdlOut);
            filePutString ("BSL_LL_Anheb2;1293\n", 19, fhdlOut);
            filePutString ("BSL_LL_Anheb2/BSG_Last;1293\n", 28, fhdlOut);
            filePutString ("BSL_LL_Anheb2/ESCU;1293\n", 24, fhdlOut);
            filePutString ("BSL_Lenkradheiz;1294\n", 21, fhdlOut);
            filePutString ("BSL_Lenkradheiz/BSG_Last;1294\n", 30, fhdlOut);
            filePutString ("BSL_Lenkradheiz/ESCU;1294\n", 26, fhdlOut);
            filePutString ("BSL_Motor_Haube;1295\n", 21, fhdlOut);
            filePutString ("BSL_Motor_Haube/BSG_Last;1295\n", 30, fhdlOut);
            filePutString ("BSL_Motor_Haube/ESCU;1295\n", 26, fhdlOut);
            filePutString ("BSL_Parklicht;1296\n", 19, fhdlOut);
            filePutString ("BSL_Parklicht/BSG_Last;1296\n", 28, fhdlOut);
            filePutString ("BSL_Parklicht/ESCU;1296\n", 24, fhdlOut);
            filePutString ("BSL_Sitzbelueft;1297\n", 21, fhdlOut);
            filePutString ("BSL_Sitzbelueft/BSG_Last;1297\n", 30, fhdlOut);
            filePutString ("BSL_Sitzbelueft/ESCU;1297\n", 26, fhdlOut);
            filePutString ("BSL_Sitzheiz;1298\n", 18, fhdlOut);
            filePutString ("BSL_Sitzheiz/BSG_Last;1298\n", 27, fhdlOut);
            filePutString ("BSL_Sitzheiz/ESCU;1298\n", 23, fhdlOut);
            filePutString ("BSL_Sta_LWR;1299\n", 17, fhdlOut);
            filePutString ("BSL_Sta_LWR/BSG_Last;1299\n", 26, fhdlOut);
            filePutString ("BSL_Sta_LWR/ESCU;1299\n", 22, fhdlOut);
            filePutString ("BSL_Sta_StBat;1300\n", 19, fhdlOut);
            filePutString ("BSL_Sta_StBat/BSG_Last;1300\n", 28, fhdlOut);
            filePutString ("BSL_Sta_StBat/ESCU;1300\n", 24, fhdlOut);
            filePutString ("BSL_Sta_UBat;1301\n", 18, fhdlOut);
            filePutString ("BSL_Sta_UBat/BSG_Last;1301\n", 27, fhdlOut);
            filePutString ("BSL_Sta_UBat/ESCU;1301\n", 23, fhdlOut);
            filePutString ("BSL_Starterlaubnis;1302\n", 24, fhdlOut);
            filePutString ("BSL_Starterlaubnis/BSG_Last;1302\n", 33, fhdlOut);
            filePutString ("BSL_Starterlaubnis/ESCU;1302\n", 29, fhdlOut);
            filePutString ("BSL_UBat;1303\n", 14, fhdlOut);
            filePutString ("BSL_UBat/BSG_Last;1303\n", 23, fhdlOut);
            filePutString ("BSL_UBat/ESCU;1303\n", 19, fhdlOut);
            filePutString ("BSL_Wake_Up_ACAN;1304\n", 22, fhdlOut);
            filePutString ("BSL_Wake_Up_ACAN/BSG_Last;1304\n", 31, fhdlOut);
            filePutString ("BSL_Wake_Up_ACAN/ESCU;1304\n", 27, fhdlOut);
            filePutString ("BSL_Wasserheiz;1305\n", 20, fhdlOut);
            filePutString ("BSL_Wasserheiz/BSG_Last;1305\n", 29, fhdlOut);
            filePutString ("BSL_Wasserheiz/ESCU;1305\n", 25, fhdlOut);
            filePutString ("BSL_Weckursache_ACAN;1306\n", 26, fhdlOut);
            filePutString ("BSL_Weckursache_ACAN/BSG_Last;1306\n", 35, fhdlOut);
            filePutString ("BSL_Weckursache_ACAN/ESCU;1306\n", 31, fhdlOut);
            filePutString ("BSL_ZAS_Kl_15;1307\n", 19, fhdlOut);
            filePutString ("BSL_ZAS_Kl_15/BSG_Last;1307\n", 28, fhdlOut);
            filePutString ("BSL_ZAS_Kl_15/ESCU;1307\n", 24, fhdlOut);
            filePutString ("BSL_ZAS_Kl_50;1308\n", 19, fhdlOut);
            filePutString ("BSL_ZAS_Kl_50/BSG_Last;1308\n", 28, fhdlOut);
            filePutString ("BSL_ZAS_Kl_50/ESCU;1308\n", 24, fhdlOut);
            filePutString ("BSL_ZAS_Kl_S;1309\n", 18, fhdlOut);
            filePutString ("BSL_ZAS_Kl_S/BSG_Last;1309\n", 27, fhdlOut);
            filePutString ("BSL_ZAS_Kl_S/ESCU;1309\n", 23, fhdlOut);
            filePutString ("BSL_ZAS_Kl_X;1310\n", 18, fhdlOut);
            filePutString ("BSL_ZAS_Kl_X/BSG_Last;1310\n", 27, fhdlOut);
            filePutString ("BSL_ZAS_Kl_X/ESCU;1310\n", 23, fhdlOut);
            filePutString ("BEM_EM_LIN_ungueltig;1536\n", 26, fhdlOut);
            filePutString ("BEM_EM_LIN_ungueltig/Batman_1;1536\n", 35, fhdlOut);
            filePutString ("BEM_EM_LIN_ungueltig/BATMAN1;1536\n", 34, fhdlOut);
            filePutString ("BEM_P_Generator;1537\n", 21, fhdlOut);
            filePutString ("BEM_P_Generator/Batman_1;1537\n", 30, fhdlOut);
            filePutString ("BEM_P_Generator/BATMAN1;1537\n", 29, fhdlOut);
            filePutString ("BM1_BEM_Reku_Aktiv;1538\n", 24, fhdlOut);
            filePutString ("BM1_BEM_Reku_Aktiv/Batman_1;1538\n", 33, fhdlOut);
            filePutString ("BM1_BEM_Reku_Aktiv/BATMAN1;1538\n", 32, fhdlOut);
            filePutString ("BM1_DFM;1539\n", 13, fhdlOut);
            filePutString ("BM1_DFM/Batman_1;1539\n", 22, fhdlOut);
            filePutString ("BM1_DFM/BATMAN1;1539\n", 21, fhdlOut);
            filePutString ("BM1_Fehlereintr;1540\n", 21, fhdlOut);
            filePutString ("BM1_Fehlereintr/Batman_1;1540\n", 30, fhdlOut);
            filePutString ("BM1_Fehlereintr/BATMAN1;1540\n", 29, fhdlOut);
            filePutString ("BM1_Mess_Leitung;1541\n", 22, fhdlOut);
            filePutString ("BM1_Mess_Leitung/Batman_1;1541\n", 31, fhdlOut);
            filePutString ("BM1_Mess_Leitung/BATMAN1;1541\n", 30, fhdlOut);
            filePutString ("BM1_Relais;1542\n", 16, fhdlOut);
            filePutString ("BM1_Relais/Batman_1;1542\n", 25, fhdlOut);
            filePutString ("BM1_Relais/BATMAN1;1542\n", 24, fhdlOut);
            filePutString ("BM1_Sta_Leitung;1543\n", 21, fhdlOut);
            filePutString ("BM1_Sta_Leitung/Batman_1;1543\n", 30, fhdlOut);
            filePutString ("BM1_Sta_Leitung/BATMAN1;1543\n", 29, fhdlOut);
            filePutString ("BM1_Sta_Relais;1544\n", 20, fhdlOut);
            filePutString ("BM1_Sta_Relais/Batman_1;1544\n", 29, fhdlOut);
            filePutString ("BM1_Sta_Relais/BATMAN1;1544\n", 28, fhdlOut);
            filePutString ("BM1_Sta_StBat;1545\n", 19, fhdlOut);
            filePutString ("BM1_Sta_StBat/Batman_1;1545\n", 28, fhdlOut);
            filePutString ("BM1_Sta_StBat/BATMAN1;1545\n", 27, fhdlOut);
            filePutString ("BM1_Startmodus;1546\n", 20, fhdlOut);
            filePutString ("BM1_Startmodus/Batman_1;1546\n", 29, fhdlOut);
            filePutString ("BM1_Startmodus/BATMAN1;1546\n", 28, fhdlOut);
            filePutString ("BO1_AWV2_Bremsruck;1792\n", 24, fhdlOut);
            filePutString ("BO1_AWV2_Bremsruck/Booster_1;1792\n", 34, fhdlOut);
            filePutString ("BO1_AWV2_Bremsruck/BST1;1792\n", 29, fhdlOut);
            filePutString ("BO1_AWV2_Fehler;1793\n", 21, fhdlOut);
            filePutString ("BO1_AWV2_Fehler/Booster_1;1793\n", 31, fhdlOut);
            filePutString ("BO1_AWV2_Fehler/BST1;1793\n", 26, fhdlOut);
            filePutString ("BO1_Anf_EPB_Span;1794\n", 22, fhdlOut);
            filePutString ("BO1_Anf_EPB_Span/Booster_1;1794\n", 32, fhdlOut);
            filePutString ("BO1_Anf_EPB_Span/BST1;1794\n", 27, fhdlOut);
            filePutString ("BO1_Anf_EPB_aus;1795\n", 21, fhdlOut);
            filePutString ("BO1_Anf_EPB_aus/Booster_1;1795\n", 31, fhdlOut);
            filePutString ("BO1_Anf_EPB_aus/BST1;1795\n", 26, fhdlOut);
            filePutString ("BO1_Anf_EPB_ein;1796\n", 21, fhdlOut);
            filePutString ("BO1_Anf_EPB_ein/Booster_1;1796\n", 31, fhdlOut);
            filePutString ("BO1_Anf_EPB_ein/BST1;1796\n", 26, fhdlOut);
            filePutString ("BO1_Checksumme;1797\n", 20, fhdlOut);
            filePutString ("BO1_Checksumme/Booster_1;1797\n", 30, fhdlOut);
            filePutString ("BO1_Checksumme/BST1;1797\n", 25, fhdlOut);
            filePutString ("BO1_Fa_bremst;1798\n", 19, fhdlOut);
            filePutString ("BO1_Fa_bremst/Booster_1;1798\n", 29, fhdlOut);
            filePutString ("BO1_Fa_bremst/BST1;1798\n", 24, fhdlOut);
            filePutString ("BO1_Freigabe_EPB;1799\n", 22, fhdlOut);
            filePutString ("BO1_Freigabe_EPB/Booster_1;1799\n", 32, fhdlOut);
            filePutString ("BO1_Freigabe_EPB/BST1;1799\n", 27, fhdlOut);
            filePutString ("BO1_KD_Fehler;1800\n", 19, fhdlOut);
            filePutString ("BO1_KD_Fehler/Booster_1;1800\n", 29, fhdlOut);
            filePutString ("BO1_KD_Fehler/BST1;1800\n", 24, fhdlOut);
            filePutString ("BO1_Laengsbeschl;1801\n", 22, fhdlOut);
            filePutString ("BO1_Laengsbeschl/Booster_1;1801\n", 32, fhdlOut);
            filePutString ("BO1_Laengsbeschl/BST1;1801\n", 27, fhdlOut);
            filePutString ("BO1_StaBrSyst;1802\n", 19, fhdlOut);
            filePutString ("BO1_StaBrSyst/Booster_1;1802\n", 29, fhdlOut);
            filePutString ("BO1_StaBrSyst/BST1;1802\n", 24, fhdlOut);
            filePutString ("BO1_Sta_ACC_Anf;1803\n", 21, fhdlOut);
            filePutString ("BO1_Sta_ACC_Anf/Booster_1;1803\n", 31, fhdlOut);
            filePutString ("BO1_Sta_ACC_Anf/BST1;1803\n", 26, fhdlOut);
            filePutString ("BO1_Sta_ADR_BR;1804\n", 20, fhdlOut);
            filePutString ("BO1_Sta_ADR_BR/Booster_1;1804\n", 30, fhdlOut);
            filePutString ("BO1_Sta_ADR_BR/BST1;1804\n", 25, fhdlOut);
            filePutString ("BO1_Sta_BLS;1805\n", 17, fhdlOut);
            filePutString ("BO1_Sta_BLS/Booster_1;1805\n", 27, fhdlOut);
            filePutString ("BO1_Sta_BLS/BST1;1805\n", 22, fhdlOut);
            filePutString ("BO1_Sta_Br_Druck;1806\n", 22, fhdlOut);
            filePutString ("BO1_Sta_Br_Druck/Booster_1;1806\n", 32, fhdlOut);
            filePutString ("BO1_Sta_Br_Druck/BST1;1806\n", 27, fhdlOut);
            filePutString ("BO1_Sta_VerzReg;1807\n", 21, fhdlOut);
            filePutString ("BO1_Sta_VerzReg/Booster_1;1807\n", 31, fhdlOut);
            filePutString ("BO1_Sta_VerzReg/BST1;1807\n", 26, fhdlOut);
            filePutString ("BO1_Verz_EPB_akt;1808\n", 22, fhdlOut);
            filePutString ("BO1_Verz_EPB_akt/Booster_1;1808\n", 32, fhdlOut);
            filePutString ("BO1_Verz_EPB_akt/BST1;1808\n", 27, fhdlOut);
            filePutString ("BO1_Zaehler;1809\n", 17, fhdlOut);
            filePutString ("BO1_Zaehler/Booster_1;1809\n", 27, fhdlOut);
            filePutString ("BO1_Zaehler/BST1;1809\n", 22, fhdlOut);
            filePutString ("BO1_aktBrSyst;1810\n", 19, fhdlOut);
            filePutString ("BO1_aktBrSyst/Booster_1;1810\n", 29, fhdlOut);
            filePutString ("BO1_aktBrSyst/BST1;1810\n", 24, fhdlOut);
            filePutString ("BO1_res_14;1811\n", 16, fhdlOut);
            filePutString ("BO1_res_14/Booster_1;1811\n", 26, fhdlOut);
            filePutString ("BO1_res_14/BST1;1811\n", 21, fhdlOut);
            filePutString ("BO1_res_16;1812\n", 16, fhdlOut);
            filePutString ("BO1_res_16/Booster_1;1812\n", 26, fhdlOut);
            filePutString ("BO1_res_16/BST1;1812\n", 21, fhdlOut);
            filePutString ("BO1_res_17;1813\n", 16, fhdlOut);
            filePutString ("BO1_res_17/Booster_1;1813\n", 26, fhdlOut);
            filePutString ("BO1_res_17/BST1;1813\n", 21, fhdlOut);
            filePutString ("BO1_res_22;1814\n", 16, fhdlOut);
            filePutString ("BO1_res_22/Booster_1;1814\n", 26, fhdlOut);
            filePutString ("BO1_res_22/BST1;1814\n", 21, fhdlOut);
            filePutString ("BO1_res_25;1815\n", 16, fhdlOut);
            filePutString ("BO1_res_25/Booster_1;1815\n", 26, fhdlOut);
            filePutString ("BO1_res_25/BST1;1815\n", 21, fhdlOut);
            filePutString ("BO1_res_27;1816\n", 16, fhdlOut);
            filePutString ("BO1_res_27/Booster_1;1816\n", 26, fhdlOut);
            filePutString ("BO1_res_27/BST1;1816\n", 21, fhdlOut);
            filePutString ("BO1_res_28;1817\n", 16, fhdlOut);
            filePutString ("BO1_res_28/Booster_1;1817\n", 26, fhdlOut);
            filePutString ("BO1_res_28/BST1;1817\n", 21, fhdlOut);
            filePutString ("BO1_res_29;1818\n", 16, fhdlOut);
            filePutString ("BO1_res_29/Booster_1;1818\n", 26, fhdlOut);
            filePutString ("BO1_res_29/BST1;1818\n", 21, fhdlOut);
            filePutString ("BO1_res_30;1819\n", 16, fhdlOut);
            filePutString ("BO1_res_30/Booster_1;1819\n", 26, fhdlOut);
            filePutString ("BO1_res_30/BST1;1819\n", 21, fhdlOut);
            filePutString ("BO1_res_31;1820\n", 16, fhdlOut);
            filePutString ("BO1_res_31/Booster_1;1820\n", 26, fhdlOut);
            filePutString ("BO1_res_31/BST1;1820\n", 21, fhdlOut);
            filePutString ("BO1_res_32;1821\n", 16, fhdlOut);
            filePutString ("BO1_res_32/Booster_1;1821\n", 26, fhdlOut);
            filePutString ("BO1_res_32/BST1;1821\n", 21, fhdlOut);
            filePutString ("BO1_res_41;1822\n", 16, fhdlOut);
            filePutString ("BO1_res_41/Booster_1;1822\n", 26, fhdlOut);
            filePutString ("BO1_res_41/BST1;1822\n", 21, fhdlOut);
            filePutString ("BO1_res_42;1823\n", 16, fhdlOut);
            filePutString ("BO1_res_42/Booster_1;1823\n", 26, fhdlOut);
            filePutString ("BO1_res_42/BST1;1823\n", 21, fhdlOut);
            filePutString ("BO1_res_43;1824\n", 16, fhdlOut);
            filePutString ("BO1_res_43/Booster_1;1824\n", 26, fhdlOut);
            filePutString ("BO1_res_43/BST1;1824\n", 21, fhdlOut);
            filePutString ("BO1_res_44;1825\n", 16, fhdlOut);
            filePutString ("BO1_res_44/Booster_1;1825\n", 26, fhdlOut);
            filePutString ("BO1_res_44/BST1;1825\n", 21, fhdlOut);
            filePutString ("BO1_res_59;1826\n", 16, fhdlOut);
            filePutString ("BO1_res_59/Booster_1;1826\n", 26, fhdlOut);
            filePutString ("BO1_res_59/BST1;1826\n", 21, fhdlOut);
            filePutString ("BO1_res_62;1827\n", 16, fhdlOut);
            filePutString ("BO1_res_62/Booster_1;1827\n", 26, fhdlOut);
            filePutString ("BO1_res_62/BST1;1827\n", 21, fhdlOut);
            filePutString ("BO1_res_63;1828\n", 16, fhdlOut);
            filePutString ("BO1_res_63/Booster_1;1828\n", 26, fhdlOut);
            filePutString ("BO1_res_63/BST1;1828\n", 21, fhdlOut);
            filePutString ("BR1_ABS_Brems;2048\n", 19, fhdlOut);
            filePutString ("BR1_ABS_Brems/Bremse_1;2048\n", 28, fhdlOut);
            filePutString ("BR1_ABS_Brems/BRK1;2048\n", 24, fhdlOut);
            filePutString ("BR1_ASRMo_fa;2049\n", 18, fhdlOut);
            filePutString ("BR1_ASRMo_fa/Bremse_1;2049\n", 27, fhdlOut);
            filePutString ("BR1_ASRMo_fa/BRK1;2049\n", 23, fhdlOut);
            filePutString ("BR1_ASRMo_sl;2050\n", 18, fhdlOut);
            filePutString ("BR1_ASRMo_sl/Bremse_1;2050\n", 27, fhdlOut);
            filePutString ("BR1_ASRMo_sl/BRK1;2050\n", 23, fhdlOut);
            filePutString ("BR1_ASR_Anf;2051\n", 17, fhdlOut);
            filePutString ("BR1_ASR_Anf/Bremse_1;2051\n", 26, fhdlOut);
            filePutString ("BR1_ASR_Anf/BRK1;2051\n", 22, fhdlOut);
            filePutString ("BR1_ASR_ESP;2052\n", 17, fhdlOut);
            filePutString ("BR1_ASR_ESP/Bremse_1;2052\n", 26, fhdlOut);
            filePutString ("BR1_ASR_ESP/BRK1;2052\n", 22, fhdlOut);
            filePutString ("BR1_ASR_Eingr;2053\n", 19, fhdlOut);
            filePutString ("BR1_ASR_Eingr/Bremse_1;2053\n", 28, fhdlOut);
            filePutString ("BR1_ASR_Eingr/BRK1;2053\n", 24, fhdlOut);
            filePutString ("BR1_BKV_aktiv;2054\n", 19, fhdlOut);
            filePutString ("BR1_BKV_aktiv/Bremse_1;2054\n", 28, fhdlOut);
            filePutString ("BR1_BKV_aktiv/BRK1;2054\n", 24, fhdlOut);
            filePutString ("BR1_Diagnose;2055\n", 18, fhdlOut);
            filePutString ("BR1_Diagnose/Bremse_1;2055\n", 27, fhdlOut);
            filePutString ("BR1_Diagnose/BRK1;2055\n", 23, fhdlOut);
            filePutString ("BR1_EBV_Eingr;2056\n", 19, fhdlOut);
            filePutString ("BR1_EBV_Eingr/Bremse_1;2056\n", 28, fhdlOut);
            filePutString ("BR1_EBV_Eingr/BRK1;2056\n", 24, fhdlOut);
            filePutString ("BR1_EDS_Eingr;2057\n", 19, fhdlOut);
            filePutString ("BR1_EDS_Eingr/Bremse_1;2057\n", 28, fhdlOut);
            filePutString ("BR1_EDS_Eingr/BRK1;2057\n", 24, fhdlOut);
            filePutString ("BR1_ESPASR_passiv;2058\n", 23, fhdlOut);
            filePutString ("BR1_ESPASR_passiv/Bremse_1;2058\n", 32, fhdlOut);
            filePutString ("BR1_ESPASR_passiv/BRK1;2058\n", 28, fhdlOut);
            filePutString ("BR1_ESP_Eingr;2059\n", 19, fhdlOut);
            filePutString ("BR1_ESP_Eingr/Bremse_1;2059\n", 28, fhdlOut);
            filePutString ("BR1_ESP_Eingr/BRK1;2059\n", 24, fhdlOut);
            filePutString ("BR1_Ersatz_Kmh;2060\n", 20, fhdlOut);
            filePutString ("BR1_Ersatz_Kmh/Bremse_1;2060\n", 29, fhdlOut);
            filePutString ("BR1_Ersatz_Kmh/BRK1;2060\n", 25, fhdlOut);
            filePutString ("BR1_Lampe_ABS;2061\n", 19, fhdlOut);
            filePutString ("BR1_Lampe_ABS/Bremse_1;2061\n", 28, fhdlOut);
            filePutString ("BR1_Lampe_ABS/BRK1;2061\n", 24, fhdlOut);
            filePutString ("BR1_Lampe_ASR;2062\n", 19, fhdlOut);
            filePutString ("BR1_Lampe_ASR/Bremse_1;2062\n", 28, fhdlOut);
            filePutString ("BR1_Lampe_ASR/BRK1;2062\n", 24, fhdlOut);
            filePutString ("BR1_Lampe_BK;2063\n", 18, fhdlOut);
            filePutString ("BR1_Lampe_BK/Bremse_1;2063\n", 27, fhdlOut);
            filePutString ("BR1_Lampe_BK/BRK1;2063\n", 23, fhdlOut);
            filePutString ("BR1_Lichtschalt;2064\n", 21, fhdlOut);
            filePutString ("BR1_Lichtschalt/Bremse_1;2064\n", 30, fhdlOut);
            filePutString ("BR1_Lichtschalt/BRK1;2064\n", 26, fhdlOut);
            filePutString ("BR1_MAD;2065\n", 13, fhdlOut);
            filePutString ("BR1_MAD/Bremse_1;2065\n", 22, fhdlOut);
            filePutString ("BR1_MAD/BRK1;2065\n", 18, fhdlOut);
            filePutString ("BR1_MSR_Anf;2066\n", 17, fhdlOut);
            filePutString ("BR1_MSR_Anf/Bremse_1;2066\n", 26, fhdlOut);
            filePutString ("BR1_MSR_Anf/BRK1;2066\n", 22, fhdlOut);
            filePutString ("BR1_MSR_Mo;2067\n", 16, fhdlOut);
            filePutString ("BR1_MSR_Mo/Bremse_1;2067\n", 25, fhdlOut);
            filePutString ("BR1_MSR_Mo/BRK1;2067\n", 21, fhdlOut);
            filePutString ("BR1_MSR_Mo_inv;2068\n", 20, fhdlOut);
            filePutString ("BR1_MSR_Mo_inv/Bremse_1;2068\n", 29, fhdlOut);
            filePutString ("BR1_MSR_Mo_inv/BRK1;2068\n", 25, fhdlOut);
            filePutString ("BR1_Rad_kmh;2069\n", 17, fhdlOut);
            filePutString ("BR1_Rad_kmh/Bremse_1;2069\n", 26, fhdlOut);
            filePutString ("BR1_Rad_kmh/BRK1;2069\n", 22, fhdlOut);
            filePutString ("BR1_StaDruckschw;2070\n", 22, fhdlOut);
            filePutString ("BR1_StaDruckschw/Bremse_1;2070\n", 31, fhdlOut);
            filePutString ("BR1_StaDruckschw/BRK1;2070\n", 27, fhdlOut);
            filePutString ("BR1_Sta_ESP;2071\n", 17, fhdlOut);
            filePutString ("BR1_Sta_ESP/Bremse_1;2071\n", 26, fhdlOut);
            filePutString ("BR1_Sta_ESP/BRK1;2071\n", 22, fhdlOut);
            filePutString ("BR1_Sta_MAD;2072\n", 17, fhdlOut);
            filePutString ("BR1_Sta_MAD/Bremse_1;2072\n", 26, fhdlOut);
            filePutString ("BR1_Sta_MAD/BRK1;2072\n", 22, fhdlOut);
            filePutString ("BR1_Zaehler;2073\n", 17, fhdlOut);
            filePutString ("BR1_Zaehler/Bremse_1;2073\n", 26, fhdlOut);
            filePutString ("BR1_Zaehler/BRK1;2073\n", 22, fhdlOut);
            filePutString ("B10_Checksumme;2304\n", 20, fhdlOut);
            filePutString ("B10_Checksumme/Bremse_10;2304\n", 30, fhdlOut);
            filePutString ("B10_Checksumme/BRK10;2304\n", 26, fhdlOut);
            filePutString ("B10_Fahrtr_HL;2305\n", 19, fhdlOut);
            filePutString ("B10_Fahrtr_HL/Bremse_10;2305\n", 29, fhdlOut);
            filePutString ("B10_Fahrtr_HL/BRK10;2305\n", 25, fhdlOut);
            filePutString ("B10_Fahrtr_HR;2306\n", 19, fhdlOut);
            filePutString ("B10_Fahrtr_HR/Bremse_10;2306\n", 29, fhdlOut);
            filePutString ("B10_Fahrtr_HR/BRK10;2306\n", 25, fhdlOut);
            filePutString ("B10_Fahrtr_VL;2307\n", 19, fhdlOut);
            filePutString ("B10_Fahrtr_VL/Bremse_10;2307\n", 29, fhdlOut);
            filePutString ("B10_Fahrtr_VL/BRK10;2307\n", 25, fhdlOut);
            filePutString ("B10_Fahrtr_VR;2308\n", 19, fhdlOut);
            filePutString ("B10_Fahrtr_VR/Bremse_10;2308\n", 29, fhdlOut);
            filePutString ("B10_Fahrtr_VR/BRK10;2308\n", 25, fhdlOut);
            filePutString ("B10_QB_Fahrtr_HL;2309\n", 22, fhdlOut);
            filePutString ("B10_QB_Fahrtr_HL/Bremse_10;2309\n", 32, fhdlOut);
            filePutString ("B10_QB_Fahrtr_HL/BRK10;2309\n", 28, fhdlOut);
            filePutString ("B10_QB_Fahrtr_HR;2310\n", 22, fhdlOut);
            filePutString ("B10_QB_Fahrtr_HR/Bremse_10;2310\n", 32, fhdlOut);
            filePutString ("B10_QB_Fahrtr_HR/BRK10;2310\n", 28, fhdlOut);
            filePutString ("B10_QB_Fahrtr_VL;2311\n", 22, fhdlOut);
            filePutString ("B10_QB_Fahrtr_VL/Bremse_10;2311\n", 32, fhdlOut);
            filePutString ("B10_QB_Fahrtr_VL/BRK10;2311\n", 28, fhdlOut);
            filePutString ("B10_QB_Fahrtr_VR;2312\n", 22, fhdlOut);
            filePutString ("B10_QB_Fahrtr_VR/Bremse_10;2312\n", 32, fhdlOut);
            filePutString ("B10_QB_Fahrtr_VR/BRK10;2312\n", 28, fhdlOut);
            filePutString ("B10_QB_Wegimp_HL;2313\n", 22, fhdlOut);
            filePutString ("B10_QB_Wegimp_HL/Bremse_10;2313\n", 32, fhdlOut);
            filePutString ("B10_QB_Wegimp_HL/BRK10;2313\n", 28, fhdlOut);
            filePutString ("B10_QB_Wegimp_HR;2314\n", 22, fhdlOut);
            filePutString ("B10_QB_Wegimp_HR/Bremse_10;2314\n", 32, fhdlOut);
            filePutString ("B10_QB_Wegimp_HR/BRK10;2314\n", 28, fhdlOut);
            filePutString ("B10_QB_Wegimp_VL;2315\n", 22, fhdlOut);
            filePutString ("B10_QB_Wegimp_VL/Bremse_10;2315\n", 32, fhdlOut);
            filePutString ("B10_QB_Wegimp_VL/BRK10;2315\n", 28, fhdlOut);
            filePutString ("B10_QB_Wegimp_VR;2316\n", 22, fhdlOut);
            filePutString ("B10_QB_Wegimp_VR/Bremse_10;2316\n", 32, fhdlOut);
            filePutString ("B10_QB_Wegimp_VR/BRK10;2316\n", 28, fhdlOut);
            filePutString ("B10_Wegimp_HL;2317\n", 19, fhdlOut);
            filePutString ("B10_Wegimp_HL/Bremse_10;2317\n", 29, fhdlOut);
            filePutString ("B10_Wegimp_HL/BRK10;2317\n", 25, fhdlOut);
            filePutString ("B10_Wegimp_HR;2318\n", 19, fhdlOut);
            filePutString ("B10_Wegimp_HR/Bremse_10;2318\n", 29, fhdlOut);
            filePutString ("B10_Wegimp_HR/BRK10;2318\n", 25, fhdlOut);
            filePutString ("B10_Wegimp_VL;2319\n", 19, fhdlOut);
            filePutString ("B10_Wegimp_VL/Bremse_10;2319\n", 29, fhdlOut);
            filePutString ("B10_Wegimp_VL/BRK10;2319\n", 25, fhdlOut);
            filePutString ("B10_Wegimp_VR;2320\n", 19, fhdlOut);
            filePutString ("B10_Wegimp_VR/Bremse_10;2320\n", 29, fhdlOut);
            filePutString ("B10_Wegimp_VR/BRK10;2320\n", 25, fhdlOut);
            filePutString ("B10_Zaehler;2321\n", 17, fhdlOut);
            filePutString ("B10_Zaehler/Bremse_10;2321\n", 27, fhdlOut);
            filePutString ("B10_Zaehler/BRK10;2321\n", 23, fhdlOut);
            filePutString ("B11_Br_StSt_Info;2560\n", 22, fhdlOut);
            filePutString ("B11_Br_StSt_Info/Bremse_11;2560\n", 32, fhdlOut);
            filePutString ("B11_Br_StSt_Info/BRK11;2560\n", 28, fhdlOut);
            filePutString ("B11_EPB_Steller_akt;2561\n", 25, fhdlOut);
            filePutString ("B11_EPB_Steller_akt/Bremse_11;2561\n", 35, fhdlOut);
            filePutString ("B11_EPB_Steller_akt/BRK11;2561\n", 31, fhdlOut);
            filePutString ("B11_EPB_Steller_gue;2562\n", 25, fhdlOut);
            filePutString ("B11_EPB_Steller_gue/Bremse_11;2562\n", 35, fhdlOut);
            filePutString ("B11_EPB_Steller_gue/BRK11;2562\n", 31, fhdlOut);
            filePutString ("B11_HydHalten;2563\n", 19, fhdlOut);
            filePutString ("B11_HydHalten/Bremse_11;2563\n", 29, fhdlOut);
            filePutString ("B11_HydHalten/BRK11;2563\n", 25, fhdlOut);
            filePutString ("B11_OBD_Nib_HL;2564\n", 20, fhdlOut);
            filePutString ("B11_OBD_Nib_HL/Bremse_11;2564\n", 30, fhdlOut);
            filePutString ("B11_OBD_Nib_HL/BRK11;2564\n", 26, fhdlOut);
            filePutString ("B11_OBD_Nib_HR;2565\n", 20, fhdlOut);
            filePutString ("B11_OBD_Nib_HR/Bremse_11;2565\n", 30, fhdlOut);
            filePutString ("B11_OBD_Nib_HR/BRK11;2565\n", 26, fhdlOut);
            filePutString ("B11_OBD_Nib_VL;2566\n", 20, fhdlOut);
            filePutString ("B11_OBD_Nib_VL/Bremse_11;2566\n", 30, fhdlOut);
            filePutString ("B11_OBD_Nib_VL/BRK11;2566\n", 26, fhdlOut);
            filePutString ("B11_OBD_Nib_VR;2567\n", 20, fhdlOut);
            filePutString ("B11_OBD_Nib_VR/Bremse_11;2567\n", 30, fhdlOut);
            filePutString ("B11_OBD_Nib_VR/BRK11;2567\n", 26, fhdlOut);
            filePutString ("BR11_Checksumme;2568\n", 21, fhdlOut);
            filePutString ("BR11_Checksumme/Bremse_11;2568\n", 31, fhdlOut);
            filePutString ("BR11_Checksumme/BRK11;2568\n", 27, fhdlOut);
            filePutString ("BR11_Zaehler;2569\n", 18, fhdlOut);
            filePutString ("BR11_Zaehler/Bremse_11;2569\n", 28, fhdlOut);
            filePutString ("BR11_Zaehler/BRK11;2569\n", 24, fhdlOut);
            filePutString ("BR2_Aku_Warn;2816\n", 18, fhdlOut);
            filePutString ("BR2_Aku_Warn/Bremse_2;2816\n", 27, fhdlOut);
            filePutString ("BR2_Aku_Warn/BRK2;2816\n", 23, fhdlOut);
            filePutString ("BR2_Blinkmode;2817\n", 19, fhdlOut);
            filePutString ("BR2_Blinkmode/Bremse_2;2817\n", 28, fhdlOut);
            filePutString ("BR2_Blinkmode/BRK2;2817\n", 24, fhdlOut);
            filePutString ("BR2_Fehlereintr;2818\n", 21, fhdlOut);
            filePutString ("BR2_Fehlereintr/Bremse_2;2818\n", 30, fhdlOut);
            filePutString ("BR2_Fehlereintr/BRK2;2818\n", 26, fhdlOut);
            filePutString ("BR2_HDC_aktiv;2819\n", 19, fhdlOut);
            filePutString ("BR2_HDC_aktiv/Bremse_2;2819\n", 28, fhdlOut);
            filePutString ("BR2_HDC_aktiv/BRK2;2819\n", 24, fhdlOut);
            filePutString ("BR2_Impulszahl;2820\n", 20, fhdlOut);
            filePutString ("BR2_Impulszahl/Bremse_2;2820\n", 29, fhdlOut);
            filePutString ("BR2_Impulszahl/BRK2;2820\n", 25, fhdlOut);
            filePutString ("BR2_LampeHDC;2821\n", 18, fhdlOut);
            filePutString ("BR2_LampeHDC/Bremse_2;2821\n", 27, fhdlOut);
            filePutString ("BR2_LampeHDC/BRK2;2821\n", 23, fhdlOut);
            filePutString ("BR2_Lampe_ABS;2822\n", 19, fhdlOut);
            filePutString ("BR2_Lampe_ABS/Bremse_2;2822\n", 28, fhdlOut);
            filePutString ("BR2_Lampe_ABS/BRK2;2822\n", 24, fhdlOut);
            filePutString ("BR2_Lampe_ASR;2823\n", 19, fhdlOut);
            filePutString ("BR2_Lampe_ASR/Bremse_2;2823\n", 28, fhdlOut);
            filePutString ("BR2_Lampe_ASR/BRK2;2823\n", 24, fhdlOut);
            filePutString ("BR2_Lampe_BK;2824\n", 18, fhdlOut);
            filePutString ("BR2_Lampe_BK/Bremse_2;2824\n", 27, fhdlOut);
            filePutString ("BR2_Lampe_BK/BRK2;2824\n", 23, fhdlOut);
            filePutString ("BR2_Lampe_RKA;2825\n", 19, fhdlOut);
            filePutString ("BR2_Lampe_RKA/Bremse_2;2825\n", 28, fhdlOut);
            filePutString ("BR2_Lampe_RKA/BRK2;2825\n", 24, fhdlOut);
            filePutString ("BR2_QB_Querbeschl;2826\n", 23, fhdlOut);
            filePutString ("BR2_QB_Querbeschl/Bremse_2;2826\n", 32, fhdlOut);
            filePutString ("BR2_QB_Querbeschl/BRK2;2826\n", 28, fhdlOut);
            filePutString ("BR2_Querb_Zahn;2827\n", 20, fhdlOut);
            filePutString ("BR2_Querb_Zahn/Bremse_2;2827\n", 29, fhdlOut);
            filePutString ("BR2_Querb_Zahn/BRK2;2827\n", 25, fhdlOut);
            filePutString ("BR2_Querbeschl;2828\n", 20, fhdlOut);
            filePutString ("BR2_Querbeschl/Bremse_2;2828\n", 29, fhdlOut);
            filePutString ("BR2_Querbeschl/BRK2;2828\n", 25, fhdlOut);
            filePutString ("BR2_SleepInd;2829\n", 18, fhdlOut);
            filePutString ("BR2_SleepInd/Bremse_2;2829\n", 27, fhdlOut);
            filePutString ("BR2_SleepInd/BRK2;2829\n", 23, fhdlOut);
            filePutString ("BR2_Sta_Imp;2830\n", 17, fhdlOut);
            filePutString ("BR2_Sta_Imp/Bremse_2;2830\n", 26, fhdlOut);
            filePutString ("BR2_Sta_Imp/BRK2;2830\n", 22, fhdlOut);
            filePutString ("BR2_Sta_Quer;2831\n", 18, fhdlOut);
            filePutString ("BR2_Sta_Quer/Bremse_2;2831\n", 27, fhdlOut);
            filePutString ("BR2_Sta_Quer/BRK2;2831\n", 23, fhdlOut);
            filePutString ("BR2_Text;2832\n", 14, fhdlOut);
            filePutString ("BR2_Text/Bremse_2;2832\n", 23, fhdlOut);
            filePutString ("BR2_Text/BRK2;2832\n", 19, fhdlOut);
            filePutString ("BR2_Ueberl_Imp;2833\n", 20, fhdlOut);
            filePutString ("BR2_Ueberl_Imp/Bremse_2;2833\n", 29, fhdlOut);
            filePutString ("BR2_Ueberl_Imp/BRK2;2833\n", 25, fhdlOut);
            filePutString ("BR2_Wegimpulse;2834\n", 20, fhdlOut);
            filePutString ("BR2_Wegimpulse/Bremse_2;2834\n", 29, fhdlOut);
            filePutString ("BR2_Wegimpulse/BRK2;2834\n", 25, fhdlOut);
            filePutString ("BR2_Zaehler;2835\n", 17, fhdlOut);
            filePutString ("BR2_Zaehler/Bremse_2;2835\n", 26, fhdlOut);
            filePutString ("BR2_Zaehler/BRK2;2835\n", 22, fhdlOut);
            filePutString ("BR2_Zahnzahl;2836\n", 18, fhdlOut);
            filePutString ("BR2_Zahnzahl/Bremse_2;2836\n", 27, fhdlOut);
            filePutString ("BR2_Zahnzahl/BRK2;2836\n", 23, fhdlOut);
            filePutString ("BR2_mi_Radgeschw;2837\n", 22, fhdlOut);
            filePutString ("BR2_mi_Radgeschw/Bremse_2;2837\n", 31, fhdlOut);
            filePutString ("BR2_mi_Radgeschw/BRK2;2837\n", 27, fhdlOut);
            filePutString ("BR3_Fahrtr_HL;3072\n", 19, fhdlOut);
            filePutString ("BR3_Fahrtr_HL/Bremse_3;3072\n", 28, fhdlOut);
            filePutString ("BR3_Fahrtr_HL/BRK3;3072\n", 24, fhdlOut);
            filePutString ("BR3_Fahrtr_HR;3073\n", 19, fhdlOut);
            filePutString ("BR3_Fahrtr_HR/Bremse_3;3073\n", 28, fhdlOut);
            filePutString ("BR3_Fahrtr_HR/BRK3;3073\n", 24, fhdlOut);
            filePutString ("BR3_Fahrtr_VL;3074\n", 19, fhdlOut);
            filePutString ("BR3_Fahrtr_VL/Bremse_3;3074\n", 28, fhdlOut);
            filePutString ("BR3_Fahrtr_VL/BRK3;3074\n", 24, fhdlOut);
            filePutString ("BR3_Fahrtr_VR;3075\n", 19, fhdlOut);
            filePutString ("BR3_Fahrtr_VR/Bremse_3;3075\n", 28, fhdlOut);
            filePutString ("BR3_Fahrtr_VR/BRK3;3075\n", 24, fhdlOut);
            filePutString ("BR3_Rad_kmh_HL;3076\n", 20, fhdlOut);
            filePutString ("BR3_Rad_kmh_HL/Bremse_3;3076\n", 29, fhdlOut);
            filePutString ("BR3_Rad_kmh_HL/BRK3;3076\n", 25, fhdlOut);
            filePutString ("BR3_Rad_kmh_HR;3077\n", 20, fhdlOut);
            filePutString ("BR3_Rad_kmh_HR/Bremse_3;3077\n", 29, fhdlOut);
            filePutString ("BR3_Rad_kmh_HR/BRK3;3077\n", 25, fhdlOut);
            filePutString ("BR3_Rad_kmh_VL;3078\n", 20, fhdlOut);
            filePutString ("BR3_Rad_kmh_VL/Bremse_3;3078\n", 29, fhdlOut);
            filePutString ("BR3_Rad_kmh_VL/BRK3;3078\n", 25, fhdlOut);
            filePutString ("BR3_Rad_kmh_VR;3079\n", 20, fhdlOut);
            filePutString ("BR3_Rad_kmh_VR/Bremse_3;3079\n", 29, fhdlOut);
            filePutString ("BR3_Rad_kmh_VR/BRK3;3079\n", 25, fhdlOut);
            filePutString ("BR4_Abschaltung_HL;3328\n", 24, fhdlOut);
            filePutString ("BR4_Abschaltung_HL/Bremse_4;3328\n", 33, fhdlOut);
            filePutString ("BR4_Abschaltung_HL/BRK4;3328\n", 29, fhdlOut);
            filePutString ("BR4_Abschaltung_HR;3329\n", 24, fhdlOut);
            filePutString ("BR4_Abschaltung_HR/Bremse_4;3329\n", 33, fhdlOut);
            filePutString ("BR4_Abschaltung_HR/BRK4;3329\n", 29, fhdlOut);
            filePutString ("BR4_Abschaltung_VL;3330\n", 24, fhdlOut);
            filePutString ("BR4_Abschaltung_VL/Bremse_4;3330\n", 33, fhdlOut);
            filePutString ("BR4_Abschaltung_VL/BRK4;3330\n", 29, fhdlOut);
            filePutString ("BR4_Abschaltung_VR;3331\n", 24, fhdlOut);
            filePutString ("BR4_Abschaltung_VR/Bremse_4;3331\n", 33, fhdlOut);
            filePutString ("BR4_Abschaltung_VR/BRK4;3331\n", 29, fhdlOut);
            filePutString ("BR4_Checksum;3332\n", 18, fhdlOut);
            filePutString ("BR4_Checksum/Bremse_4;3332\n", 27, fhdlOut);
            filePutString ("BR4_Checksum/BRK4;3332\n", 23, fhdlOut);
            filePutString ("BR4_Einheit;3333\n", 17, fhdlOut);
            filePutString ("BR4_Einheit/Bremse_4;3333\n", 26, fhdlOut);
            filePutString ("BR4_Einheit/BRK4;3333\n", 22, fhdlOut);
            filePutString ("BR4_Lampe_RKA;3334\n", 19, fhdlOut);
            filePutString ("BR4_Lampe_RKA/Bremse_4;3334\n", 28, fhdlOut);
            filePutString ("BR4_Lampe_RKA/BRK4;3334\n", 24, fhdlOut);
            filePutString ("BR4_Reserve2;3335\n", 18, fhdlOut);
            filePutString ("BR4_Reserve2/Bremse_4;3335\n", 27, fhdlOut);
            filePutString ("BR4_Reserve2/BRK4;3335\n", 23, fhdlOut);
            filePutString ("BR4_Schwelle;3336\n", 18, fhdlOut);
            filePutString ("BR4_Schwelle/Bremse_4;3336\n", 27, fhdlOut);
            filePutString ("BR4_Schwelle/BRK4;3336\n", 23, fhdlOut);
            filePutString ("BR4_Status_ESP;3337\n", 20, fhdlOut);
            filePutString ("BR4_Status_ESP/Bremse_4;3337\n", 29, fhdlOut);
            filePutString ("BR4_Status_ESP/BRK4;3337\n", 25, fhdlOut);
            filePutString ("BR4_Summer_RKA;3338\n", 20, fhdlOut);
            filePutString ("BR4_Summer_RKA/Bremse_4;3338\n", 29, fhdlOut);
            filePutString ("BR4_Summer_RKA/BRK4;3338\n", 25, fhdlOut);
            filePutString ("BR4_Unterdruck;3339\n", 20, fhdlOut);
            filePutString ("BR4_Unterdruck/Bremse_4;3339\n", 29, fhdlOut);
            filePutString ("BR4_Unterdruck/BRK4;3339\n", 25, fhdlOut);
            filePutString ("BR4_Vorgabe_Hi;3340\n", 20, fhdlOut);
            filePutString ("BR4_Vorgabe_Hi/Bremse_4;3340\n", 29, fhdlOut);
            filePutString ("BR4_Vorgabe_Hi/BRK4;3340\n", 25, fhdlOut);
            filePutString ("BR4_Vorgabe_Max;3341\n", 21, fhdlOut);
            filePutString ("BR4_Vorgabe_Max/Bremse_4;3341\n", 30, fhdlOut);
            filePutString ("BR4_Vorgabe_Max/BRK4;3341\n", 26, fhdlOut);
            filePutString ("BR4_Vorgabe_Mi;3342\n", 20, fhdlOut);
            filePutString ("BR4_Vorgabe_Mi/Bremse_4;3342\n", 29, fhdlOut);
            filePutString ("BR4_Vorgabe_Mi/BRK4;3342\n", 25, fhdlOut);
            filePutString ("BR4_Vorgabe_Mi_;3343\n", 21, fhdlOut);
            filePutString ("BR4_Vorgabe_Mi_/Bremse_4;3343\n", 30, fhdlOut);
            filePutString ("BR4_Vorgabe_Mi_/BRK4;3343\n", 26, fhdlOut);
            filePutString ("BR4_Vorgabe_Min;3344\n", 21, fhdlOut);
            filePutString ("BR4_Vorgabe_Min/Bremse_4;3344\n", 30, fhdlOut);
            filePutString ("BR4_Vorgabe_Min/BRK4;3344\n", 26, fhdlOut);
            filePutString ("BR4_Zaehler;3345\n", 17, fhdlOut);
            filePutString ("BR4_Zaehler/Bremse_4;3345\n", 26, fhdlOut);
            filePutString ("BR4_Zaehler/BRK4;3345\n", 22, fhdlOut);
            filePutString ("BR4_res_42;3346\n", 16, fhdlOut);
            filePutString ("BR4_res_42/Bremse_4;3346\n", 25, fhdlOut);
            filePutString ("BR4_res_42/BRK4;3346\n", 21, fhdlOut);
            filePutString ("BR4_res_48;3347\n", 16, fhdlOut);
            filePutString ("BR4_res_48/Bremse_4;3347\n", 25, fhdlOut);
            filePutString ("BR4_res_48/BRK4;3347\n", 21, fhdlOut);
            filePutString ("Anfahrhilfe_aktiv;3584\n", 23, fhdlOut);
            filePutString ("Anfahrhilfe_aktiv/Bremse_5;3584\n", 32, fhdlOut);
            filePutString ("Anfahrhilfe_aktiv/BRK5;3584\n", 28, fhdlOut);
            filePutString ("BR5_AWV2_Bremsruck;3585\n", 24, fhdlOut);
            filePutString ("BR5_AWV2_Bremsruck/Bremse_5;3585\n", 33, fhdlOut);
            filePutString ("BR5_AWV2_Bremsruck/BRK5;3585\n", 29, fhdlOut);
            filePutString ("BR5_AWV2_Fehler;3586\n", 21, fhdlOut);
            filePutString ("BR5_AWV2_Fehler/Bremse_5;3586\n", 30, fhdlOut);
            filePutString ("BR5_AWV2_Fehler/BRK5;3586\n", 26, fhdlOut);
            filePutString ("BR5_AnhStabAktiv;3587\n", 22, fhdlOut);
            filePutString ("BR5_AnhStabAktiv/Bremse_5;3587\n", 31, fhdlOut);
            filePutString ("BR5_AnhStabAktiv/BRK5;3587\n", 27, fhdlOut);
            filePutString ("BR5_Anhi_Sta;3588\n", 18, fhdlOut);
            filePutString ("BR5_Anhi_Sta/Bremse_5;3588\n", 27, fhdlOut);
            filePutString ("BR5_Anhi_Sta/BRK5;3588\n", 23, fhdlOut);
            filePutString ("BR5_Anhi_akt;3589\n", 18, fhdlOut);
            filePutString ("BR5_Anhi_akt/Bremse_5;3589\n", 27, fhdlOut);
            filePutString ("BR5_Anhi_akt/BRK5;3589\n", 23, fhdlOut);
            filePutString ("BR5_Bremsdruck;3590\n", 20, fhdlOut);
            filePutString ("BR5_Bremsdruck/Bremse_5;3590\n", 29, fhdlOut);
            filePutString ("BR5_Bremsdruck/BRK5;3590\n", 25, fhdlOut);
            filePutString ("BR5_Checksumme;3591\n", 20, fhdlOut);
            filePutString ("BR5_Checksumme/Bremse_5;3591\n", 29, fhdlOut);
            filePutString ("BR5_Checksumme/BRK5;3591\n", 25, fhdlOut);
            filePutString ("BR5_Druckgueltig;3592\n", 22, fhdlOut);
            filePutString ("BR5_Druckgueltig/Bremse_5;3592\n", 31, fhdlOut);
            filePutString ("BR5_Druckgueltig/BRK5;3592\n", 27, fhdlOut);
            filePutString ("BR5_ECD_Lampe;3593\n", 19, fhdlOut);
            filePutString ("BR5_ECD_Lampe/Bremse_5;3593\n", 28, fhdlOut);
            filePutString ("BR5_ECD_Lampe/BRK5;3593\n", 24, fhdlOut);
            filePutString ("BR5_ECD_Rueckfall;3594\n", 23, fhdlOut);
            filePutString ("BR5_ECD_Rueckfall/Bremse_5;3594\n", 32, fhdlOut);
            filePutString ("BR5_ECD_Rueckfall/BRK5;3594\n", 28, fhdlOut);
            filePutString ("BR5_Giergeschw;3595\n", 20, fhdlOut);
            filePutString ("BR5_Giergeschw/Bremse_5;3595\n", 29, fhdlOut);
            filePutString ("BR5_Giergeschw/BRK5;3595\n", 25, fhdlOut);
            filePutString ("BR5_Notbremsung;3596\n", 21, fhdlOut);
            filePutString ("BR5_Notbremsung/Bremse_5;3596\n", 30, fhdlOut);
            filePutString ("BR5_Notbremsung/BRK5;3596\n", 26, fhdlOut);
            filePutString ("BR5_Sign_Druck;3597\n", 20, fhdlOut);
            filePutString ("BR5_Sign_Druck/Bremse_5;3597\n", 29, fhdlOut);
            filePutString ("BR5_Sign_Druck/BRK5;3597\n", 25, fhdlOut);
            filePutString ("BR5_Sta_Druck;3598\n", 19, fhdlOut);
            filePutString ("BR5_Sta_Druck/Bremse_5;3598\n", 28, fhdlOut);
            filePutString ("BR5_Sta_Druck/BRK5;3598\n", 24, fhdlOut);
            filePutString ("BR5_Sta_Gierrate;3599\n", 22, fhdlOut);
            filePutString ("BR5_Sta_Gierrate/Bremse_5;3599\n", 31, fhdlOut);
            filePutString ("BR5_Sta_Gierrate/BRK5;3599\n", 27, fhdlOut);
            filePutString ("BR5_Stillstand;3600\n", 20, fhdlOut);
            filePutString ("BR5_Stillstand/Bremse_5;3600\n", 29, fhdlOut);
            filePutString ("BR5_Stillstand/BRK5;3600\n", 25, fhdlOut);
            filePutString ("BR5_Temperatur;3601\n", 20, fhdlOut);
            filePutString ("BR5_Temperatur/Bremse_5;3601\n", 29, fhdlOut);
            filePutString ("BR5_Temperatur/BRK5;3601\n", 25, fhdlOut);
            filePutString ("BR5_TolAbgl_VR;3602\n", 20, fhdlOut);
            filePutString ("BR5_TolAbgl_VR/Bremse_5;3602\n", 29, fhdlOut);
            filePutString ("BR5_TolAbgl_VR/BRK5;3602\n", 25, fhdlOut);
            filePutString ("BR5_Vorzeichen;3603\n", 20, fhdlOut);
            filePutString ("BR5_Vorzeichen/Bremse_5;3603\n", 29, fhdlOut);
            filePutString ("BR5_Vorzeichen/BRK5;3603\n", 25, fhdlOut);
            filePutString ("BR5_Zaehler;3604\n", 17, fhdlOut);
            filePutString ("BR5_Zaehler/Bremse_5;3604\n", 26, fhdlOut);
            filePutString ("BR5_Zaehler/BRK5;3604\n", 22, fhdlOut);
            filePutString ("BR5_v_Ueberw;3605\n", 18, fhdlOut);
            filePutString ("BR5_v_Ueberw/Bremse_5;3605\n", 27, fhdlOut);
            filePutString ("BR5_v_Ueberw/BRK5;3605\n", 23, fhdlOut);
            filePutString ("FStatus_Anfahrhilfe;3606\n", 25, fhdlOut);
            filePutString ("FStatus_Anfahrhilfe/Bremse_5;3606\n", 34, fhdlOut);
            filePutString ("FStatus_Anfahrhilfe/BRK5;3606\n", 30, fhdlOut);
            filePutString ("BR8_AWV1_BasPar;3840\n", 21, fhdlOut);
            filePutString ("BR8_AWV1_BasPar/Bremse_8;3840\n", 30, fhdlOut);
            filePutString ("BR8_AWV1_BasPar/BRK8;3840\n", 26, fhdlOut);
            filePutString ("BR8_Check_EPB;3841\n", 19, fhdlOut);
            filePutString ("BR8_Check_EPB/Bremse_8;3841\n", 28, fhdlOut);
            filePutString ("BR8_Check_EPB/BRK8;3841\n", 24, fhdlOut);
            filePutString ("BR8_Checksumme;3842\n", 20, fhdlOut);
            filePutString ("BR8_Checksumme/Bremse_8;3842\n", 29, fhdlOut);
            filePutString ("BR8_Checksumme/BRK8;3842\n", 25, fhdlOut);
            filePutString ("BR8_Fa_bremst;3843\n", 19, fhdlOut);
            filePutString ("BR8_Fa_bremst/Bremse_8;3843\n", 28, fhdlOut);
            filePutString ("BR8_Fa_bremst/BRK8;3843\n", 24, fhdlOut);
            filePutString ("BR8_Istbeschl;3844\n", 19, fhdlOut);
            filePutString ("BR8_Istbeschl/Bremse_8;3844\n", 28, fhdlOut);
            filePutString ("BR8_Istbeschl/BRK8;3844\n", 24, fhdlOut);
            filePutString ("BR8_Laengsbeschl;3845\n", 22, fhdlOut);
            filePutString ("BR8_Laengsbeschl/Bremse_8;3845\n", 31, fhdlOut);
            filePutString ("BR8_Laengsbeschl/BRK8;3845\n", 27, fhdlOut);
            filePutString ("BR8_QB_LBeschl;3846\n", 20, fhdlOut);
            filePutString ("BR8_QB_LBeschl/Bremse_8;3846\n", 29, fhdlOut);
            filePutString ("BR8_QB_LBeschl/BRK8;3846\n", 25, fhdlOut);
            filePutString ("BR8_Quattro;3847\n", 17, fhdlOut);
            filePutString ("BR8_Quattro/Bremse_8;3847\n", 26, fhdlOut);
            filePutString ("BR8_Quattro/BRK8;3847\n", 22, fhdlOut);
            filePutString ("BR8_StaBrSyst;3848\n", 19, fhdlOut);
            filePutString ("BR8_StaBrSyst/Bremse_8;3848\n", 28, fhdlOut);
            filePutString ("BR8_StaBrSyst/BRK8;3848\n", 24, fhdlOut);
            filePutString ("BR8_Sta_ACC_Anf;3849\n", 21, fhdlOut);
            filePutString ("BR8_Sta_ACC_Anf/Bremse_8;3849\n", 30, fhdlOut);
            filePutString ("BR8_Sta_ACC_Anf/BRK8;3849\n", 26, fhdlOut);
            filePutString ("BR8_Sta_ADR_BR;3850\n", 20, fhdlOut);
            filePutString ("BR8_Sta_ADR_BR/Bremse_8;3850\n", 29, fhdlOut);
            filePutString ("BR8_Sta_ADR_BR/BRK8;3850\n", 25, fhdlOut);
            filePutString ("BR8_Sta_BLS;3851\n", 17, fhdlOut);
            filePutString ("BR8_Sta_BLS/Bremse_8;3851\n", 26, fhdlOut);
            filePutString ("BR8_Sta_BLS/BRK8;3851\n", 22, fhdlOut);
            filePutString ("BR8_Sta_Br_Druck;3852\n", 22, fhdlOut);
            filePutString ("BR8_Sta_Br_Druck/Bremse_8;3852\n", 31, fhdlOut);
            filePutString ("BR8_Sta_Br_Druck/BRK8;3852\n", 27, fhdlOut);
            filePutString ("BR8_Sta_Br_temp;3853\n", 21, fhdlOut);
            filePutString ("BR8_Sta_Br_temp/Bremse_8;3853\n", 30, fhdlOut);
            filePutString ("BR8_Sta_Br_temp/BRK8;3853\n", 26, fhdlOut);
            filePutString ("BR8_Sta_HW_BLS;3854\n", 20, fhdlOut);
            filePutString ("BR8_Sta_HW_BLS/Bremse_8;3854\n", 29, fhdlOut);
            filePutString ("BR8_Sta_HW_BLS/BRK8;3854\n", 25, fhdlOut);
            filePutString ("BR8_Sta_VerzReg;3855\n", 21, fhdlOut);
            filePutString ("BR8_Sta_VerzReg/Bremse_8;3855\n", 30, fhdlOut);
            filePutString ("BR8_Sta_VerzReg/BRK8;3855\n", 26, fhdlOut);
            filePutString ("BR8_TolAbgl_HL;3856\n", 20, fhdlOut);
            filePutString ("BR8_TolAbgl_HL/Bremse_8;3856\n", 29, fhdlOut);
            filePutString ("BR8_TolAbgl_HL/BRK8;3856\n", 25, fhdlOut);
            filePutString ("BR8_TolAbgl_HR;3857\n", 20, fhdlOut);
            filePutString ("BR8_TolAbgl_HR/Bremse_8;3857\n", 29, fhdlOut);
            filePutString ("BR8_TolAbgl_HR/BRK8;3857\n", 25, fhdlOut);
            filePutString ("BR8_Verz_EPB;3858\n", 18, fhdlOut);
            filePutString ("BR8_Verz_EPB/Bremse_8;3858\n", 27, fhdlOut);
            filePutString ("BR8_Verz_EPB/BRK8;3858\n", 23, fhdlOut);
            filePutString ("BR8_Verz_EPB_akt;3859\n", 22, fhdlOut);
            filePutString ("BR8_Verz_EPB_akt/Bremse_8;3859\n", 31, fhdlOut);
            filePutString ("BR8_Verz_EPB_akt/BRK8;3859\n", 27, fhdlOut);
            filePutString ("BR8_Zaehler;3860\n", 17, fhdlOut);
            filePutString ("BR8_Zaehler/Bremse_8;3860\n", 26, fhdlOut);
            filePutString ("BR8_Zaehler/BRK8;3860\n", 22, fhdlOut);
            filePutString ("BR8_aktBrSyst;3861\n", 19, fhdlOut);
            filePutString ("BR8_aktBrSyst/Bremse_8;3861\n", 28, fhdlOut);
            filePutString ("BR8_aktBrSyst/BRK8;3861\n", 24, fhdlOut);
            filePutString ("CL1_AC_Schalter;4096\n", 21, fhdlOut);
            filePutString ("CL1_AC_Schalter/Clima_1;4096\n", 29, fhdlOut);
            filePutString ("CL1_AC_Schalter/Klima_1;4096\n", 29, fhdlOut);
            filePutString ("CL1_Aussentemp;4097\n", 20, fhdlOut);
            filePutString ("CL1_Aussentemp/Clima_1;4097\n", 28, fhdlOut);
            filePutString ("CL1_Aussentemp/Klima_1;4097\n", 28, fhdlOut);
            filePutString ("CL1_Druck;4098\n", 15, fhdlOut);
            filePutString ("CL1_Druck/Clima_1;4098\n", 23, fhdlOut);
            filePutString ("CL1_Druck/Klima_1;4098\n", 23, fhdlOut);
            filePutString ("CL1_Einheit_Temp;4099\n", 22, fhdlOut);
            filePutString ("CL1_Einheit_Temp/Clima_1;4099\n", 30, fhdlOut);
            filePutString ("CL1_Einheit_Temp/Klima_1;4099\n", 30, fhdlOut);
            filePutString ("CL1_Fa_Zuheiz;4100\n", 19, fhdlOut);
            filePutString ("CL1_Fa_Zuheiz/Clima_1;4100\n", 27, fhdlOut);
            filePutString ("CL1_Fa_Zuheiz/Klima_1;4100\n", 27, fhdlOut);
            filePutString ("CL1_Fehlereintr;4101\n", 21, fhdlOut);
            filePutString ("CL1_Fehlereintr/Clima_1;4101\n", 29, fhdlOut);
            filePutString ("CL1_Fehlereintr/Klima_1;4101\n", 29, fhdlOut);
            filePutString ("CL1_Frontsch;4102\n", 18, fhdlOut);
            filePutString ("CL1_Frontsch/Clima_1;4102\n", 26, fhdlOut);
            filePutString ("CL1_Frontsch/Klima_1;4102\n", 26, fhdlOut);
            filePutString ("CL1_Gebl_last;4103\n", 19, fhdlOut);
            filePutString ("CL1_Gebl_last/Clima_1;4103\n", 27, fhdlOut);
            filePutString ("CL1_Gebl_last/Klima_1;4103\n", 27, fhdlOut);
            filePutString ("CL1_Hecksch;4104\n", 17, fhdlOut);
            filePutString ("CL1_Hecksch/Clima_1;4104\n", 25, fhdlOut);
            filePutString ("CL1_Hecksch/Klima_1;4104\n", 25, fhdlOut);
            filePutString ("CL1_Heizleist;4105\n", 19, fhdlOut);
            filePutString ("CL1_Heizleist/Clima_1;4105\n", 27, fhdlOut);
            filePutString ("CL1_Heizleist/Klima_1;4105\n", 27, fhdlOut);
            filePutString ("CL1_HzgWischer;4106\n", 20, fhdlOut);
            filePutString ("CL1_HzgWischer/Clima_1;4106\n", 28, fhdlOut);
            filePutString ("CL1_HzgWischer/Klima_1;4106\n", 28, fhdlOut);
            filePutString ("CL1_Kompr_Last;4107\n", 20, fhdlOut);
            filePutString ("CL1_Kompr_Last/Clima_1;4107\n", 28, fhdlOut);
            filePutString ("CL1_Kompr_Last/Klima_1;4107\n", 28, fhdlOut);
            filePutString ("CL1_Kompressor;4108\n", 20, fhdlOut);
            filePutString ("CL1_Kompressor/Clima_1;4108\n", 28, fhdlOut);
            filePutString ("CL1_Kompressor/Klima_1;4108\n", 28, fhdlOut);
            filePutString ("CL1_LL_Dz;4109\n", 15, fhdlOut);
            filePutString ("CL1_LL_Dz/Clima_1;4109\n", 23, fhdlOut);
            filePutString ("CL1_LL_Dz/Klima_1;4109\n", 23, fhdlOut);
            filePutString ("CL1_Luefter;4110\n", 17, fhdlOut);
            filePutString ("CL1_Luefter/Clima_1;4110\n", 25, fhdlOut);
            filePutString ("CL1_Luefter/Klima_1;4110\n", 25, fhdlOut);
            filePutString ("CL1_Restwaerme;4111\n", 20, fhdlOut);
            filePutString ("CL1_Restwaerme/Clima_1;4111\n", 28, fhdlOut);
            filePutString ("CL1_Restwaerme/Klima_1;4111\n", 28, fhdlOut);
            filePutString ("CL1_Sta_Druck;4112\n", 19, fhdlOut);
            filePutString ("CL1_Sta_Druck/Clima_1;4112\n", 27, fhdlOut);
            filePutString ("CL1_Sta_Druck/Klima_1;4112\n", 27, fhdlOut);
            filePutString ("CL1_Sta_Moment;4113\n", 20, fhdlOut);
            filePutString ("CL1_Sta_Moment/Clima_1;4113\n", 28, fhdlOut);
            filePutString ("CL1_Sta_Moment/Klima_1;4113\n", 28, fhdlOut);
            filePutString ("CL1_Temp_Stoss;4114\n", 20, fhdlOut);
            filePutString ("CL1_Temp_Stoss/Clima_1;4114\n", 28, fhdlOut);
            filePutString ("CL1_Temp_Stoss/Klima_1;4114\n", 28, fhdlOut);
            filePutString ("KL_4_Zonen;4115\n", 16, fhdlOut);
            filePutString ("KL_4_Zonen/Clima_1;4115\n", 24, fhdlOut);
            filePutString ("KL_4_Zonen/Klima_1;4115\n", 24, fhdlOut);
            filePutString ("KL_Thermomanagement;4116\n", 25, fhdlOut);
            filePutString ("KL_Thermomanagement/Clima_1;4116\n", 33, fhdlOut);
            filePutString ("KL_Thermomanagement/Klima_1;4116\n", 33, fhdlOut);
            filePutString ("SH_MVW;4117\n", 12, fhdlOut);
            filePutString ("SH_MVW/Clima_1;4117\n", 20, fhdlOut);
            filePutString ("SH_MVW/Klima_1;4117\n", 20, fhdlOut);
            filePutString ("SH_aktiv_Flag;4118\n", 19, fhdlOut);
            filePutString ("SH_aktiv_Flag/Clima_1;4118\n", 27, fhdlOut);
            filePutString ("SH_aktiv_Flag/Klima_1;4118\n", 27, fhdlOut);
            filePutString ("DI1_Jahr;4352\n", 14, fhdlOut);
            filePutString ("DI1_Jahr/Diagnose_1;4352\n", 25, fhdlOut);
            filePutString ("DI1_Jahr/DIA1;4352\n", 19, fhdlOut);
            filePutString ("DI1_KM_Stand_alt;4353\n", 22, fhdlOut);
            filePutString ("DI1_KM_Stand_alt/Diagnose_1;4353\n", 33, fhdlOut);
            filePutString ("DI1_KM_Stand_alt/DIA1;4353\n", 27, fhdlOut);
            filePutString ("DI1_Minute;4354\n", 16, fhdlOut);
            filePutString ("DI1_Minute/Diagnose_1;4354\n", 27, fhdlOut);
            filePutString ("DI1_Minute/DIA1;4354\n", 21, fhdlOut);
            filePutString ("DI1_Monat;4355\n", 15, fhdlOut);
            filePutString ("DI1_Monat/Diagnose_1;4355\n", 26, fhdlOut);
            filePutString ("DI1_Monat/DIA1;4355\n", 20, fhdlOut);
            filePutString ("DI1_Reserve1;4356\n", 18, fhdlOut);
            filePutString ("DI1_Reserve1/Diagnose_1;4356\n", 29, fhdlOut);
            filePutString ("DI1_Reserve1/DIA1;4356\n", 23, fhdlOut);
            filePutString ("DI1_Sekunde;4357\n", 17, fhdlOut);
            filePutString ("DI1_Sekunde/Diagnose_1;4357\n", 28, fhdlOut);
            filePutString ("DI1_Sekunde/DIA1;4357\n", 22, fhdlOut);
            filePutString ("DI1_Stunde;4358\n", 16, fhdlOut);
            filePutString ("DI1_Stunde/Diagnose_1;4358\n", 27, fhdlOut);
            filePutString ("DI1_Stunde/DIA1;4358\n", 21, fhdlOut);
            filePutString ("DI1_Tag;4359\n", 13, fhdlOut);
            filePutString ("DI1_Tag/Diagnose_1;4359\n", 24, fhdlOut);
            filePutString ("DI1_Tag/DIA1;4359\n", 18, fhdlOut);
            filePutString ("DI1_VerlernZaehl;4360\n", 22, fhdlOut);
            filePutString ("DI1_VerlernZaehl/Diagnose_1;4360\n", 33, fhdlOut);
            filePutString ("DI1_VerlernZaehl/DIA1;4360\n", 27, fhdlOut);
            filePutString ("DI1_Zeit_alt;4361\n", 18, fhdlOut);
            filePutString ("DI1_Zeit_alt/Diagnose_1;4361\n", 29, fhdlOut);
            filePutString ("DI1_Zeit_alt/DIA1;4361\n", 23, fhdlOut);
            filePutString ("DI1_km_Stand;4362\n", 18, fhdlOut);
            filePutString ("DI1_km_Stand/Diagnose_1;4362\n", 29, fhdlOut);
            filePutString ("DI1_km_Stand/DIA1;4362\n", 23, fhdlOut);
            filePutString ("EP1_AnfShLock;4608\n", 19, fhdlOut);
            filePutString ("EP1_AnfShLock/EPB_1;4608\n", 25, fhdlOut);
            filePutString ("EP1_AnfShLock/EPB1;4608\n", 24, fhdlOut);
            filePutString ("EP1_Auto_Schl_Oe;4609\n", 22, fhdlOut);
            filePutString ("EP1_Auto_Schl_Oe/EPB_1;4609\n", 28, fhdlOut);
            filePutString ("EP1_Auto_Schl_Oe/EPB1;4609\n", 27, fhdlOut);
            filePutString ("EP1_Bremslicht;4610\n", 20, fhdlOut);
            filePutString ("EP1_Bremslicht/EPB_1;4610\n", 26, fhdlOut);
            filePutString ("EP1_Bremslicht/EPB1;4610\n", 25, fhdlOut);
            filePutString ("EP1_Checksum;4611\n", 18, fhdlOut);
            filePutString ("EP1_Checksum/EPB_1;4611\n", 24, fhdlOut);
            filePutString ("EP1_Checksum/EPB1;4611\n", 23, fhdlOut);
            filePutString ("EP1_Fehler_BKL;4612\n", 20, fhdlOut);
            filePutString ("EP1_Fehler_BKL/EPB_1;4612\n", 26, fhdlOut);
            filePutString ("EP1_Fehler_BKL/EPB1;4612\n", 25, fhdlOut);
            filePutString ("EP1_Fehler_Sta;4613\n", 20, fhdlOut);
            filePutString ("EP1_Fehler_Sta/EPB_1;4613\n", 26, fhdlOut);
            filePutString ("EP1_Fehler_Sta/EPB1;4613\n", 25, fhdlOut);
            filePutString ("EP1_Fehler_gelb;4614\n", 21, fhdlOut);
            filePutString ("EP1_Fehler_gelb/EPB_1;4614\n", 27, fhdlOut);
            filePutString ("EP1_Fehler_gelb/EPB1;4614\n", 26, fhdlOut);
            filePutString ("EP1_Fehlereintr;4615\n", 21, fhdlOut);
            filePutString ("EP1_Fehlereintr/EPB_1;4615\n", 27, fhdlOut);
            filePutString ("EP1_Fehlereintr/EPB1;4615\n", 26, fhdlOut);
            filePutString ("EP1_Fkt_Lampe;4616\n", 19, fhdlOut);
            filePutString ("EP1_Fkt_Lampe/EPB_1;4616\n", 25, fhdlOut);
            filePutString ("EP1_Fkt_Lampe/EPB1;4616\n", 24, fhdlOut);
            filePutString ("EP1_Freigabe_Ver;4617\n", 22, fhdlOut);
            filePutString ("EP1_Freigabe_Ver/EPB_1;4617\n", 28, fhdlOut);
            filePutString ("EP1_Freigabe_Ver/EPB1;4617\n", 27, fhdlOut);
            filePutString ("EP1_HydrHalten;4618\n", 20, fhdlOut);
            filePutString ("EP1_HydrHalten/EPB_1;4618\n", 26, fhdlOut);
            filePutString ("EP1_HydrHalten/EPB1;4618\n", 25, fhdlOut);
            filePutString ("EP1_KuppModBer;4619\n", 20, fhdlOut);
            filePutString ("EP1_KuppModBer/EPB_1;4619\n", 26, fhdlOut);
            filePutString ("EP1_KuppModBer/EPB1;4619\n", 25, fhdlOut);
            filePutString ("EP1_Lampe_AutoP;4620\n", 21, fhdlOut);
            filePutString ("EP1_Lampe_AutoP/EPB_1;4620\n", 27, fhdlOut);
            filePutString ("EP1_Lampe_AutoP/EPB1;4620\n", 26, fhdlOut);
            filePutString ("EP1_Neig_winkel;4621\n", 21, fhdlOut);
            filePutString ("EP1_Neig_winkel/EPB_1;4621\n", 27, fhdlOut);
            filePutString ("EP1_Neig_winkel/EPB1;4621\n", 26, fhdlOut);
            filePutString ("EP1_QualNeigWi;4622\n", 20, fhdlOut);
            filePutString ("EP1_QualNeigWi/EPB_1;4622\n", 26, fhdlOut);
            filePutString ("EP1_QualNeigWi/EPB1;4622\n", 25, fhdlOut);
            filePutString ("EP1_Schalterinfo;4623\n", 22, fhdlOut);
            filePutString ("EP1_Schalterinfo/EPB_1;4623\n", 28, fhdlOut);
            filePutString ("EP1_Schalterinfo/EPB1;4623\n", 27, fhdlOut);
            filePutString ("EP1_SleepInd;4624\n", 18, fhdlOut);
            filePutString ("EP1_SleepInd/EPB_1;4624\n", 24, fhdlOut);
            filePutString ("EP1_SleepInd/EPB1;4624\n", 23, fhdlOut);
            filePutString ("EP1_Spannkraft;4625\n", 20, fhdlOut);
            filePutString ("EP1_Spannkraft/EPB_1;4625\n", 26, fhdlOut);
            filePutString ("EP1_Spannkraft/EPB1;4625\n", 25, fhdlOut);
            filePutString ("EP1_Sta_EPB;4626\n", 17, fhdlOut);
            filePutString ("EP1_Sta_EPB/EPB_1;4626\n", 23, fhdlOut);
            filePutString ("EP1_Sta_EPB/EPB1;4626\n", 22, fhdlOut);
            filePutString ("EP1_Sta_NWS;4627\n", 17, fhdlOut);
            filePutString ("EP1_Sta_NWS/EPB_1;4627\n", 23, fhdlOut);
            filePutString ("EP1_Sta_NWS/EPB1;4627\n", 22, fhdlOut);
            filePutString ("EP1_Sta_Schalter;4628\n", 22, fhdlOut);
            filePutString ("EP1_Sta_Schalter/EPB_1;4628\n", 28, fhdlOut);
            filePutString ("EP1_Sta_Schalter/EPB1;4628\n", 27, fhdlOut);
            filePutString ("EP1_Status_Kl_15;4629\n", 22, fhdlOut);
            filePutString ("EP1_Status_Kl_15/EPB_1;4629\n", 28, fhdlOut);
            filePutString ("EP1_Status_Kl_15/EPB1;4629\n", 27, fhdlOut);
            filePutString ("EP1_Verschleiss;4630\n", 21, fhdlOut);
            filePutString ("EP1_Verschleiss/EPB_1;4630\n", 27, fhdlOut);
            filePutString ("EP1_Verschleiss/EPB1;4630\n", 26, fhdlOut);
            filePutString ("EP1_Verzoegerung;4631\n", 22, fhdlOut);
            filePutString ("EP1_Verzoegerung/EPB_1;4631\n", 28, fhdlOut);
            filePutString ("EP1_Verzoegerung/EPB1;4631\n", 27, fhdlOut);
            filePutString ("EP1_Warnton;4632\n", 17, fhdlOut);
            filePutString ("EP1_Warnton/EPB_1;4632\n", 23, fhdlOut);
            filePutString ("EP1_Warnton/EPB1;4632\n", 22, fhdlOut);
            filePutString ("EP1_Warnton1;4633\n", 18, fhdlOut);
            filePutString ("EP1_Warnton1/EPB_1;4633\n", 24, fhdlOut);
            filePutString ("EP1_Warnton1/EPB1;4633\n", 23, fhdlOut);
            filePutString ("EP1_Warnton2;4634\n", 18, fhdlOut);
            filePutString ("EP1_Warnton2/EPB_1;4634\n", 24, fhdlOut);
            filePutString ("EP1_Warnton2/EPB1;4634\n", 23, fhdlOut);
            filePutString ("EP1_Zaehler;4635\n", 17, fhdlOut);
            filePutString ("EP1_Zaehler/EPB_1;4635\n", 23, fhdlOut);
            filePutString ("EP1_Zaehler/EPB1;4635\n", 22, fhdlOut);
            filePutString ("EP1__Text;4636\n", 15, fhdlOut);
            filePutString ("EP1__Text/EPB_1;4636\n", 21, fhdlOut);
            filePutString ("EP1__Text/EPB1;4636\n", 20, fhdlOut);
            filePutString ("BZ_EPB2;4864\n", 13, fhdlOut);
            filePutString ("BZ_EPB2/EPB_2;4864\n", 19, fhdlOut);
            filePutString ("BZ_EPB2/EPB2;4864\n", 18, fhdlOut);
            filePutString ("CHK_EPB2;4865\n", 14, fhdlOut);
            filePutString ("CHK_EPB2/EPB_2;4865\n", 20, fhdlOut);
            filePutString ("CHK_EPB2/EPB2;4865\n", 19, fhdlOut);
            filePutString ("EPB_Pedalweg_Kuppl;4866\n", 24, fhdlOut);
            filePutString ("EPB_Pedalweg_Kuppl/EPB_2;4866\n", 30, fhdlOut);
            filePutString ("EPB_Pedalweg_Kuppl/EPB2;4866\n", 29, fhdlOut);
            filePutString ("BZ_GME;5120\n", 12, fhdlOut);
            filePutString ("BZ_GME/GME;5120\n", 16, fhdlOut);
            filePutString ("BZ_GME/Getriebe_Motoreingriffe;5120\n", 36, fhdlOut);
            filePutString ("CHK_GME;5121\n", 13, fhdlOut);
            filePutString ("CHK_GME/GME;5121\n", 17, fhdlOut);
            filePutString ("CHK_GME/Getriebe_Motoreingriffe;5121\n", 37, fhdlOut);
            filePutString ("CVT_Anf_EPB;5122\n", 17, fhdlOut);
            filePutString ("CVT_Anf_EPB/GME;5122\n", 21, fhdlOut);
            filePutString ("CVT_Anf_EPB/Getriebe_Motoreingriffe;5122\n", 41, fhdlOut);
            filePutString ("CVT_Anf_EPB_gueltig;5123\n", 25, fhdlOut);
            filePutString ("CVT_Anf_EPB_gueltig/GME;5123\n", 29, fhdlOut);
            filePutString ("CVT_Anf_EPB_gueltig/Getriebe_Motoreingriffe;5123\n", 49, fhdlOut);
            filePutString ("Dynamischer_Eingriff;5124\n", 26, fhdlOut);
            filePutString ("Dynamischer_Eingriff/GME;5124\n", 30, fhdlOut);
            filePutString ("Dynamischer_Eingriff/Getriebe_Motoreingriffe;5124\n", 50, fhdlOut);
            filePutString ("GME_QB_UeFkt;5125\n", 18, fhdlOut);
            filePutString ("GME_QB_UeFkt/GME;5125\n", 22, fhdlOut);
            filePutString ("GME_QB_UeFkt/Getriebe_Motoreingriffe;5125\n", 42, fhdlOut);
            filePutString ("GME_Schaltung;5126\n", 19, fhdlOut);
            filePutString ("GME_Schaltung/GME;5126\n", 23, fhdlOut);
            filePutString ("GME_Schaltung/Getriebe_Motoreingriffe;5126\n", 43, fhdlOut);
            filePutString ("GME_UeFkt;5127\n", 15, fhdlOut);
            filePutString ("GME_UeFkt/GME;5127\n", 19, fhdlOut);
            filePutString ("GME_UeFkt/Getriebe_Motoreingriffe;5127\n", 39, fhdlOut);
            filePutString ("GME_Verlustmom;5128\n", 20, fhdlOut);
            filePutString ("GME_Verlustmom/GME;5128\n", 24, fhdlOut);
            filePutString ("GME_Verlustmom/Getriebe_Motoreingriffe;5128\n", 44, fhdlOut);
            filePutString ("Kuehlkreislaufventil_GME;5129\n", 30, fhdlOut);
            filePutString ("Kuehlkreislaufventil_GME/GME;5129\n", 34, fhdlOut);
            filePutString ("Kuehlkreislaufventil_GME/Getriebe_Motoreingriffe;5129\n", 54, fhdlOut);
            filePutString ("Langfristiger_Eingriff;5130\n", 28, fhdlOut);
            filePutString ("Langfristiger_Eingriff/GME;5130\n", 32, fhdlOut);
            filePutString ("Langfristiger_Eingriff/Getriebe_Motoreingriffe;5130\n", 52, fhdlOut);
            filePutString ("Status_Dyn_Eingriff;5131\n", 25, fhdlOut);
            filePutString ("Status_Dyn_Eingriff/GME;5131\n", 29, fhdlOut);
            filePutString ("Status_Dyn_Eingriff/Getriebe_Motoreingriffe;5131\n", 49, fhdlOut);
            filePutString ("Status_Langfr_Eingriff;5132\n", 28, fhdlOut);
            filePutString ("Status_Langfr_Eingriff/GME;5132\n", 32, fhdlOut);
            filePutString ("Status_Langfr_Eingriff/Getriebe_Motoreingriffe;5132\n", 52, fhdlOut);
            filePutString ("GRA_Abbrechen;5376\n", 19, fhdlOut);
            filePutString ("GRA_Abbrechen/GRA_Neu;5376\n", 27, fhdlOut);
            filePutString ("GRA_Abbrechen/GRA_neu;5376\n", 27, fhdlOut);
            filePutString ("GRA_Checksum;5377\n", 18, fhdlOut);
            filePutString ("GRA_Checksum/GRA_Neu;5377\n", 26, fhdlOut);
            filePutString ("GRA_Checksum/GRA_neu;5377\n", 26, fhdlOut);
            filePutString ("GRA_Down_kurz;5378\n", 19, fhdlOut);
            filePutString ("GRA_Down_kurz/GRA_Neu;5378\n", 27, fhdlOut);
            filePutString ("GRA_Down_kurz/GRA_neu;5378\n", 27, fhdlOut);
            filePutString ("GRA_Down_lang;5379\n", 19, fhdlOut);
            filePutString ("GRA_Down_lang/GRA_Neu;5379\n", 27, fhdlOut);
            filePutString ("GRA_Down_lang/GRA_neu;5379\n", 27, fhdlOut);
            filePutString ("GRA_Fehler_Bed;5380\n", 20, fhdlOut);
            filePutString ("GRA_Fehler_Bed/GRA_Neu;5380\n", 28, fhdlOut);
            filePutString ("GRA_Fehler_Bed/GRA_neu;5380\n", 28, fhdlOut);
            filePutString ("GRA_Fehler_Tip;5381\n", 20, fhdlOut);
            filePutString ("GRA_Fehler_Tip/GRA_Neu;5381\n", 28, fhdlOut);
            filePutString ("GRA_Fehler_Tip/GRA_neu;5381\n", 28, fhdlOut);
            filePutString ("GRA_Hauptschalt;5382\n", 21, fhdlOut);
            filePutString ("GRA_Hauptschalt/GRA_Neu;5382\n", 29, fhdlOut);
            filePutString ("GRA_Hauptschalt/GRA_neu;5382\n", 29, fhdlOut);
            filePutString ("GRA_Kodierinfo;5383\n", 20, fhdlOut);
            filePutString ("GRA_Kodierinfo/GRA_Neu;5383\n", 28, fhdlOut);
            filePutString ("GRA_Kodierinfo/GRA_neu;5383\n", 28, fhdlOut);
            filePutString ("GRA_Neu_Setzen;5384\n", 20, fhdlOut);
            filePutString ("GRA_Neu_Setzen/GRA_Neu;5384\n", 28, fhdlOut);
            filePutString ("GRA_Neu_Setzen/GRA_neu;5384\n", 28, fhdlOut);
            filePutString ("GRA_Neu_Zaehler;5385\n", 21, fhdlOut);
            filePutString ("GRA_Neu_Zaehler/GRA_Neu;5385\n", 29, fhdlOut);
            filePutString ("GRA_Neu_Zaehler/GRA_neu;5385\n", 29, fhdlOut);
            filePutString ("GRA_Recall;5386\n", 16, fhdlOut);
            filePutString ("GRA_Recall/GRA_Neu;5386\n", 24, fhdlOut);
            filePutString ("GRA_Recall/GRA_neu;5386\n", 24, fhdlOut);
            filePutString ("GRA_Sender;5387\n", 16, fhdlOut);
            filePutString ("GRA_Sender/GRA_Neu;5387\n", 24, fhdlOut);
            filePutString ("GRA_Sender/GRA_neu;5387\n", 24, fhdlOut);
            filePutString ("GRA_Sportschalter;5388\n", 23, fhdlOut);
            filePutString ("GRA_Sportschalter/GRA_Neu;5388\n", 31, fhdlOut);
            filePutString ("GRA_Sportschalter/GRA_neu;5388\n", 31, fhdlOut);
            filePutString ("GRA_Sta_Limiter;5389\n", 21, fhdlOut);
            filePutString ("GRA_Sta_Limiter/GRA_Neu;5389\n", 29, fhdlOut);
            filePutString ("GRA_Sta_Limiter/GRA_neu;5389\n", 29, fhdlOut);
            filePutString ("GRA_Tip_Down;5390\n", 18, fhdlOut);
            filePutString ("GRA_Tip_Down/GRA_Neu;5390\n", 26, fhdlOut);
            filePutString ("GRA_Tip_Down/GRA_neu;5390\n", 26, fhdlOut);
            filePutString ("GRA_Tip_Up;5391\n", 16, fhdlOut);
            filePutString ("GRA_Tip_Up/GRA_Neu;5391\n", 24, fhdlOut);
            filePutString ("GRA_Tip_Up/GRA_neu;5391\n", 24, fhdlOut);
            filePutString ("GRA_Typ_Hauptschalt;5392\n", 25, fhdlOut);
            filePutString ("GRA_Typ_Hauptschalt/GRA_Neu;5392\n", 33, fhdlOut);
            filePutString ("GRA_Typ_Hauptschalt/GRA_neu;5392\n", 33, fhdlOut);
            filePutString ("GRA_Up_kurz;5393\n", 17, fhdlOut);
            filePutString ("GRA_Up_kurz/GRA_Neu;5393\n", 25, fhdlOut);
            filePutString ("GRA_Up_kurz/GRA_neu;5393\n", 25, fhdlOut);
            filePutString ("GRA_Up_lang;5394\n", 17, fhdlOut);
            filePutString ("GRA_Up_lang/GRA_Neu;5394\n", 25, fhdlOut);
            filePutString ("GRA_Up_lang/GRA_neu;5394\n", 25, fhdlOut);
            filePutString ("GRA_Zeitluecke;5395\n", 20, fhdlOut);
            filePutString ("GRA_Zeitluecke/GRA_Neu;5395\n", 28, fhdlOut);
            filePutString ("GRA_Zeitluecke/GRA_neu;5395\n", 28, fhdlOut);
            filePutString ("BCM_Offroad_Taster;5632\n", 24, fhdlOut);
            filePutString ("BCM_Offroad_Taster/Gate_Komf_1;5632\n", 36, fhdlOut);
            filePutString ("BCM_Offroad_Taster/Gateway_Komfort_1;5632\n", 42, fhdlOut);
            filePutString ("BCM_Remotestart_Betrieb;5633\n", 29, fhdlOut);
            filePutString ("BCM_Remotestart_Betrieb/Gate_Komf_1;5633\n", 41, fhdlOut);
            filePutString ("BCM_Remotestart_Betrieb/Gateway_Komfort_1;5633\n", 47, fhdlOut);
            filePutString ("BSK_BT_geoeffnet;5634\n", 22, fhdlOut);
            filePutString ("BSK_BT_geoeffnet/Gate_Komf_1;5634\n", 34, fhdlOut);
            filePutString ("BSK_BT_geoeffnet/Gateway_Komfort_1;5634\n", 40, fhdlOut);
            filePutString ("BSK_HD_Hauptraste;5635\n", 23, fhdlOut);
            filePutString ("BSK_HD_Hauptraste/Gate_Komf_1;5635\n", 35, fhdlOut);
            filePutString ("BSK_HD_Hauptraste/Gateway_Komfort_1;5635\n", 41, fhdlOut);
            filePutString ("BSK_HL_geoeffnet;5636\n", 22, fhdlOut);
            filePutString ("BSK_HL_geoeffnet/Gate_Komf_1;5636\n", 34, fhdlOut);
            filePutString ("BSK_HL_geoeffnet/Gateway_Komfort_1;5636\n", 40, fhdlOut);
            filePutString ("BSK_HR_geoeffnet;5637\n", 22, fhdlOut);
            filePutString ("BSK_HR_geoeffnet/Gate_Komf_1;5637\n", 34, fhdlOut);
            filePutString ("BSK_HR_geoeffnet/Gateway_Komfort_1;5637\n", 40, fhdlOut);
            filePutString ("BSK_Tankklappe;5638\n", 20, fhdlOut);
            filePutString ("BSK_Tankklappe/Gate_Komf_1;5638\n", 32, fhdlOut);
            filePutString ("BSK_Tankklappe/Gateway_Komfort_1;5638\n", 38, fhdlOut);
            filePutString ("EV1_Anf_Klemme_50;5639\n", 23, fhdlOut);
            filePutString ("EV1_Anf_Klemme_50/Gate_Komf_1;5639\n", 35, fhdlOut);
            filePutString ("EV1_Anf_Klemme_50/Gateway_Komfort_1;5639\n", 41, fhdlOut);
            filePutString ("GK1_Abbl_VL_def;5640\n", 21, fhdlOut);
            filePutString ("GK1_Abbl_VL_def/Gate_Komf_1;5640\n", 33, fhdlOut);
            filePutString ("GK1_Abbl_VL_def/Gateway_Komfort_1;5640\n", 39, fhdlOut);
            filePutString ("GK1_Abbl_VR_def;5641\n", 21, fhdlOut);
            filePutString ("GK1_Abbl_VR_def/Gate_Komf_1;5641\n", 33, fhdlOut);
            filePutString ("GK1_Abbl_VR_def/Gateway_Komfort_1;5641\n", 39, fhdlOut);
            filePutString ("GK1_Abblendlicht;5642\n", 22, fhdlOut);
            filePutString ("GK1_Abblendlicht/Gate_Komf_1;5642\n", 34, fhdlOut);
            filePutString ("GK1_Abblendlicht/Gateway_Komfort_1;5642\n", 40, fhdlOut);
            filePutString ("GK1_AnhKonLamp;5643\n", 20, fhdlOut);
            filePutString ("GK1_AnhKonLamp/Gate_Komf_1;5643\n", 32, fhdlOut);
            filePutString ("GK1_AnhKonLamp/Gateway_Komfort_1;5643\n", 38, fhdlOut);
            filePutString ("GK1_Anh_abgesteckt;5644\n", 24, fhdlOut);
            filePutString ("GK1_Anh_abgesteckt/Gate_Komf_1;5644\n", 36, fhdlOut);
            filePutString ("GK1_Anh_abgesteckt/Gateway_Komfort_1;5644\n", 42, fhdlOut);
            filePutString ("GK1_Anhaenger;5645\n", 19, fhdlOut);
            filePutString ("GK1_Anhaenger/Gate_Komf_1;5645\n", 31, fhdlOut);
            filePutString ("GK1_Anhaenger/Gateway_Komfort_1;5645\n", 37, fhdlOut);
            filePutString ("GK1_BLS_AAG;5646\n", 17, fhdlOut);
            filePutString ("GK1_BLS_AAG/Gate_Komf_1;5646\n", 29, fhdlOut);
            filePutString ("GK1_BLS_AAG/Gateway_Komfort_1;5646\n", 35, fhdlOut);
            filePutString ("GK1_BLS_ILM;5647\n", 17, fhdlOut);
            filePutString ("GK1_BLS_ILM/Gate_Komf_1;5647\n", 29, fhdlOut);
            filePutString ("GK1_BLS_ILM/Gateway_Komfort_1;5647\n", 35, fhdlOut);
            filePutString ("GK1_Blink_Autob;5648\n", 21, fhdlOut);
            filePutString ("GK1_Blink_Autob/Gate_Komf_1;5648\n", 33, fhdlOut);
            filePutString ("GK1_Blink_Autob/Gateway_Komfort_1;5648\n", 39, fhdlOut);
            filePutString ("GK1_Blinker_li;5649\n", 20, fhdlOut);
            filePutString ("GK1_Blinker_li/Gate_Komf_1;5649\n", 32, fhdlOut);
            filePutString ("GK1_Blinker_li/Gateway_Komfort_1;5649\n", 38, fhdlOut);
            filePutString ("GK1_Blinker_re;5650\n", 20, fhdlOut);
            filePutString ("GK1_Blinker_re/Gate_Komf_1;5650\n", 32, fhdlOut);
            filePutString ("GK1_Blinker_re/Gateway_Komfort_1;5650\n", 38, fhdlOut);
            filePutString ("GK1_BrLi_Anhaen;5651\n", 21, fhdlOut);
            filePutString ("GK1_BrLi_Anhaen/Gate_Komf_1;5651\n", 33, fhdlOut);
            filePutString ("GK1_BrLi_Anhaen/Gateway_Komfort_1;5651\n", 39, fhdlOut);
            filePutString ("GK1_BrLi_links;5652\n", 20, fhdlOut);
            filePutString ("GK1_BrLi_links/Gate_Komf_1;5652\n", 32, fhdlOut);
            filePutString ("GK1_BrLi_links/Gateway_Komfort_1;5652\n", 38, fhdlOut);
            filePutString ("GK1_BrLi_mitte;5653\n", 20, fhdlOut);
            filePutString ("GK1_BrLi_mitte/Gate_Komf_1;5653\n", 32, fhdlOut);
            filePutString ("GK1_BrLi_mitte/Gateway_Komfort_1;5653\n", 38, fhdlOut);
            filePutString ("GK1_BrLi_rechts;5654\n", 21, fhdlOut);
            filePutString ("GK1_BrLi_rechts/Gate_Komf_1;5654\n", 33, fhdlOut);
            filePutString ("GK1_BrLi_rechts/Gateway_Komfort_1;5654\n", 39, fhdlOut);
            filePutString ("GK1_Bremslicht;5655\n", 20, fhdlOut);
            filePutString ("GK1_Bremslicht/Gate_Komf_1;5655\n", 32, fhdlOut);
            filePutString ("GK1_Bremslicht/Gateway_Komfort_1;5655\n", 38, fhdlOut);
            filePutString ("GK1_CharismaModus;5656\n", 23, fhdlOut);
            filePutString ("GK1_CharismaModus/Gate_Komf_1;5656\n", 35, fhdlOut);
            filePutString ("GK1_CharismaModus/Gateway_Komfort_1;5656\n", 41, fhdlOut);
            filePutString ("GK1_Count_Anhaen;5657\n", 22, fhdlOut);
            filePutString ("GK1_Count_Anhaen/Gate_Komf_1;5657\n", 34, fhdlOut);
            filePutString ("GK1_Count_Anhaen/Gateway_Komfort_1;5657\n", 40, fhdlOut);
            filePutString ("GK1_Count_Li_Hi;5658\n", 21, fhdlOut);
            filePutString ("GK1_Count_Li_Hi/Gate_Komf_1;5658\n", 33, fhdlOut);
            filePutString ("GK1_Count_Li_Hi/Gateway_Komfort_1;5658\n", 39, fhdlOut);
            filePutString ("GK1_EDC_AAG;5659\n", 17, fhdlOut);
            filePutString ("GK1_EDC_AAG/Gate_Komf_1;5659\n", 29, fhdlOut);
            filePutString ("GK1_EDC_AAG/Gateway_Komfort_1;5659\n", 35, fhdlOut);
            filePutString ("GK1_EDC_ILM;5660\n", 17, fhdlOut);
            filePutString ("GK1_EDC_ILM/Gate_Komf_1;5660\n", 29, fhdlOut);
            filePutString ("GK1_EDC_ILM/Gateway_Komfort_1;5660\n", 35, fhdlOut);
            filePutString ("GK1_ELV_verrieg;5661\n", 21, fhdlOut);
            filePutString ("GK1_ELV_verrieg/Gate_Komf_1;5661\n", 33, fhdlOut);
            filePutString ("GK1_ELV_verrieg/Gateway_Komfort_1;5661\n", 39, fhdlOut);
            filePutString ("GK1_Fa_Tuerkont;5662\n", 21, fhdlOut);
            filePutString ("GK1_Fa_Tuerkont/Gate_Komf_1;5662\n", 33, fhdlOut);
            filePutString ("GK1_Fa_Tuerkont/Gateway_Komfort_1;5662\n", 39, fhdlOut);
            filePutString ("GK1_Fernlicht;5663\n", 19, fhdlOut);
            filePutString ("GK1_Fernlicht/Gate_Komf_1;5663\n", 31, fhdlOut);
            filePutString ("GK1_Fernlicht/Gateway_Komfort_1;5663\n", 37, fhdlOut);
            filePutString ("GK1_KW_Warm;5664\n", 17, fhdlOut);
            filePutString ("GK1_KW_Warm/Gate_Komf_1;5664\n", 29, fhdlOut);
            filePutString ("GK1_KW_Warm/Gateway_Komfort_1;5664\n", 35, fhdlOut);
            filePutString ("GK1_Nebel_ein;5665\n", 19, fhdlOut);
            filePutString ("GK1_Nebel_ein/Gate_Komf_1;5665\n", 31, fhdlOut);
            filePutString ("GK1_Nebel_ein/Gateway_Komfort_1;5665\n", 37, fhdlOut);
            filePutString ("GK1_ParkFrontWi;5666\n", 21, fhdlOut);
            filePutString ("GK1_ParkFrontWi/Gate_Komf_1;5666\n", 33, fhdlOut);
            filePutString ("GK1_ParkFrontWi/Gateway_Komfort_1;5666\n", 39, fhdlOut);
            filePutString ("GK1_Reserve3;5667\n", 18, fhdlOut);
            filePutString ("GK1_Reserve3/Gate_Komf_1;5667\n", 30, fhdlOut);
            filePutString ("GK1_Reserve3/Gateway_Komfort_1;5667\n", 36, fhdlOut);
            filePutString ("GK1_Rueckfahr;5668\n", 19, fhdlOut);
            filePutString ("GK1_Rueckfahr/Gate_Komf_1;5668\n", 31, fhdlOut);
            filePutString ("GK1_Rueckfahr/Gateway_Komfort_1;5668\n", 37, fhdlOut);
            filePutString ("GK1_RueckfahrSch;5669\n", 22, fhdlOut);
            filePutString ("GK1_RueckfahrSch/Gate_Komf_1;5669\n", 34, fhdlOut);
            filePutString ("GK1_RueckfahrSch/Gateway_Komfort_1;5669\n", 40, fhdlOut);
            filePutString ("GK1_SH_Verbau;5670\n", 19, fhdlOut);
            filePutString ("GK1_SH_Verbau/Gate_Komf_1;5670\n", 31, fhdlOut);
            filePutString ("GK1_SH_Verbau/Gateway_Komfort_1;5670\n", 37, fhdlOut);
            filePutString ("GK1_SH_Zusatzfkt;5671\n", 22, fhdlOut);
            filePutString ("GK1_SH_Zusatzfkt/Gate_Komf_1;5671\n", 34, fhdlOut);
            filePutString ("GK1_SH_Zusatzfkt/Gateway_Komfort_1;5671\n", 40, fhdlOut);
            filePutString ("GK1_SH_laeuft;5672\n", 19, fhdlOut);
            filePutString ("GK1_SH_laeuft/Gate_Komf_1;5672\n", 31, fhdlOut);
            filePutString ("GK1_SH_laeuft/Gateway_Komfort_1;5672\n", 37, fhdlOut);
            filePutString ("GK1_SamFktNr;5673\n", 18, fhdlOut);
            filePutString ("GK1_SamFktNr/Gate_Komf_1;5673\n", 30, fhdlOut);
            filePutString ("GK1_SamFktNr/Gateway_Komfort_1;5673\n", 36, fhdlOut);
            filePutString ("GK1_SleepAckn;5674\n", 19, fhdlOut);
            filePutString ("GK1_SleepAckn/Gate_Komf_1;5674\n", 31, fhdlOut);
            filePutString ("GK1_SleepAckn/Gateway_Komfort_1;5674\n", 37, fhdlOut);
            filePutString ("GK1_Sta_Anhaen;5675\n", 20, fhdlOut);
            filePutString ("GK1_Sta_Anhaen/Gate_Komf_1;5675\n", 32, fhdlOut);
            filePutString ("GK1_Sta_Anhaen/Gateway_Komfort_1;5675\n", 38, fhdlOut);
            filePutString ("GK1_Sta_ILM_F_1;5676\n", 21, fhdlOut);
            filePutString ("GK1_Sta_ILM_F_1/Gate_Komf_1;5676\n", 33, fhdlOut);
            filePutString ("GK1_Sta_ILM_F_1/Gateway_Komfort_1;5676\n", 39, fhdlOut);
            filePutString ("GK1_Sta_Kessy_2;5677\n", 21, fhdlOut);
            filePutString ("GK1_Sta_Kessy_2/Gate_Komf_1;5677\n", 33, fhdlOut);
            filePutString ("GK1_Sta_Kessy_2/Gateway_Komfort_1;5677\n", 39, fhdlOut);
            filePutString ("GK1_Sta_LSM;5678\n", 17, fhdlOut);
            filePutString ("GK1_Sta_LSM/Gate_Komf_1;5678\n", 29, fhdlOut);
            filePutString ("GK1_Sta_LSM/Gateway_Komfort_1;5678\n", 35, fhdlOut);
            filePutString ("GK1_Sta_Li_vorn;5679\n", 21, fhdlOut);
            filePutString ("GK1_Sta_Li_vorn/Gate_Komf_1;5679\n", 33, fhdlOut);
            filePutString ("GK1_Sta_Li_vorn/Gateway_Komfort_1;5679\n", 39, fhdlOut);
            filePutString ("GK1_Sta_Licht1;5680\n", 20, fhdlOut);
            filePutString ("GK1_Sta_Licht1/Gate_Komf_1;5680\n", 32, fhdlOut);
            filePutString ("GK1_Sta_Licht1/Gateway_Komfort_1;5680\n", 38, fhdlOut);
            filePutString ("GK1_Sta_Licht2;5681\n", 20, fhdlOut);
            filePutString ("GK1_Sta_Licht2/Gate_Komf_1;5681\n", 32, fhdlOut);
            filePutString ("GK1_Sta_Licht2/Gateway_Komfort_1;5681\n", 38, fhdlOut);
            filePutString ("GK1_Sta_Licht3;5682\n", 20, fhdlOut);
            filePutString ("GK1_Sta_Licht3/Gate_Komf_1;5682\n", 32, fhdlOut);
            filePutString ("GK1_Sta_Licht3/Gateway_Komfort_1;5682\n", 38, fhdlOut);
            filePutString ("GK1_Sta_RDK_Warn;5683\n", 22, fhdlOut);
            filePutString ("GK1_Sta_RDK_Warn/Gate_Komf_1;5683\n", 34, fhdlOut);
            filePutString ("GK1_Sta_RDK_Warn/Gateway_Komfort_1;5683\n", 40, fhdlOut);
            filePutString ("GK1_Sta_Stdhzg;5684\n", 20, fhdlOut);
            filePutString ("GK1_Sta_Stdhzg/Gate_Komf_1;5684\n", 32, fhdlOut);
            filePutString ("GK1_Sta_Stdhzg/Gateway_Komfort_1;5684\n", 38, fhdlOut);
            filePutString ("GK1_Sta_Tuerkont;5685\n", 22, fhdlOut);
            filePutString ("GK1_Sta_Tuerkont/Gate_Komf_1;5685\n", 34, fhdlOut);
            filePutString ("GK1_Sta_Tuerkont/Gateway_Komfort_1;5685\n", 40, fhdlOut);
            filePutString ("GK1_Warnblk_Status;5686\n", 24, fhdlOut);
            filePutString ("GK1_Warnblk_Status/Gate_Komf_1;5686\n", 36, fhdlOut);
            filePutString ("GK1_Warnblk_Status/Gateway_Komfort_1;5686\n", 42, fhdlOut);
            filePutString ("GK1_Wischer_vorn;5687\n", 22, fhdlOut);
            filePutString ("GK1_Wischer_vorn/Gate_Komf_1;5687\n", 34, fhdlOut);
            filePutString ("GK1_Wischer_vorn/Gateway_Komfort_1;5687\n", 40, fhdlOut);
            filePutString ("GK1_def_P_verr;5688\n", 20, fhdlOut);
            filePutString ("GK1_def_P_verr/Gate_Komf_1;5688\n", 32, fhdlOut);
            filePutString ("GK1_def_P_verr/Gateway_Komfort_1;5688\n", 38, fhdlOut);
            filePutString ("GK1_res_06;5689\n", 16, fhdlOut);
            filePutString ("GK1_res_06/Gate_Komf_1;5689\n", 28, fhdlOut);
            filePutString ("GK1_res_06/Gateway_Komfort_1;5689\n", 34, fhdlOut);
            filePutString ("GK1_res_62;5690\n", 16, fhdlOut);
            filePutString ("GK1_res_62/Gate_Komf_1;5690\n", 28, fhdlOut);
            filePutString ("GK1_res_62/Gateway_Komfort_1;5690\n", 34, fhdlOut);
            filePutString ("KL_EKP_Anst;5691\n", 17, fhdlOut);
            filePutString ("KL_EKP_Anst/Gate_Komf_1;5691\n", 29, fhdlOut);
            filePutString ("KL_EKP_Anst/Gateway_Komfort_1;5691\n", 35, fhdlOut);
            filePutString ("KY2_StSt_Info;5692\n", 19, fhdlOut);
            filePutString ("KY2_StSt_Info/Gate_Komf_1;5692\n", 31, fhdlOut);
            filePutString ("KY2_StSt_Info/Gateway_Komfort_1;5692\n", 37, fhdlOut);
            filePutString ("Klima_5_D3_alt;5693\n", 20, fhdlOut);
            filePutString ("Klima_5_D3_alt/Gate_Komf_1;5693\n", 32, fhdlOut);
            filePutString ("Klima_5_D3_alt/Gateway_Komfort_1;5693\n", 38, fhdlOut);
            filePutString ("Motorhaubenkontakt_ein;5694\n", 28, fhdlOut);
            filePutString ("Motorhaubenkontakt_ein/Gate_Komf_1;5694\n", 40, fhdlOut);
            filePutString ("Motorhaubenkontakt_ein/Gateway_Komfort_1;5694\n", 46, fhdlOut);
            filePutString ("SH1_ein_Wasserpumpe;5695\n", 25, fhdlOut);
            filePutString ("SH1_ein_Wasserpumpe/Gate_Komf_1;5695\n", 37, fhdlOut);
            filePutString ("SH1_ein_Wasserpumpe/Gateway_Komfort_1;5695\n", 43, fhdlOut);
            filePutString ("mKessy2_alt;5696\n", 17, fhdlOut);
            filePutString ("mKessy2_alt/Gate_Komf_1;5696\n", 29, fhdlOut);
            filePutString ("mKessy2_alt/Gateway_Komfort_1;5696\n", 35, fhdlOut);
            filePutString ("BEM_Segel_Info;5888\n", 20, fhdlOut);
            filePutString ("BEM_Segel_Info/Gate_Komf_2;5888\n", 32, fhdlOut);
            filePutString ("BEM_Segel_Info/Gateway_Komfort_2;5888\n", 38, fhdlOut);
            filePutString ("GK2_BEM_DFM;5889\n", 17, fhdlOut);
            filePutString ("GK2_BEM_DFM/Gate_Komf_2;5889\n", 29, fhdlOut);
            filePutString ("GK2_BEM_DFM/Gateway_Komfort_2;5889\n", 35, fhdlOut);
            filePutString ("GK2_BEM_P_Generator;5890\n", 25, fhdlOut);
            filePutString ("GK2_BEM_P_Generator/Gate_Komf_2;5890\n", 37, fhdlOut);
            filePutString ("GK2_BEM_P_Generator/Gateway_Komfort_2;5890\n", 43, fhdlOut);
            filePutString ("GK2_BEM_StSt_Info;5891\n", 23, fhdlOut);
            filePutString ("GK2_BEM_StSt_Info/Gate_Komf_2;5891\n", 35, fhdlOut);
            filePutString ("GK2_BEM_StSt_Info/Gateway_Komfort_2;5891\n", 41, fhdlOut);
            filePutString ("GK2_BSG_StSt_Info;5892\n", 23, fhdlOut);
            filePutString ("GK2_BSG_StSt_Info/Gate_Komf_2;5892\n", 35, fhdlOut);
            filePutString ("GK2_BSG_StSt_Info/Gateway_Komfort_2;5892\n", 41, fhdlOut);
            filePutString ("GK2_Blk_L_Kontrolle;5893\n", 25, fhdlOut);
            filePutString ("GK2_Blk_L_Kontrolle/Gate_Komf_2;5893\n", 37, fhdlOut);
            filePutString ("GK2_Blk_L_Kontrolle/Gateway_Komfort_2;5893\n", 43, fhdlOut);
            filePutString ("GK2_Blk_R_Kontrolle;5894\n", 25, fhdlOut);
            filePutString ("GK2_Blk_R_Kontrolle/Gate_Komf_2;5894\n", 37, fhdlOut);
            filePutString ("GK2_Blk_R_Kontrolle/Gateway_Komfort_2;5894\n", 43, fhdlOut);
            filePutString ("GK2_EM_LIN_ungueltig;5895\n", 26, fhdlOut);
            filePutString ("GK2_EM_LIN_ungueltig/Gate_Komf_2;5895\n", 38, fhdlOut);
            filePutString ("GK2_EM_LIN_ungueltig/Gateway_Komfort_2;5895\n", 44, fhdlOut);
            filePutString ("GK2_Feh_VLR;5896\n", 17, fhdlOut);
            filePutString ("GK2_Feh_VLR/Gate_Komf_2;5896\n", 29, fhdlOut);
            filePutString ("GK2_Feh_VLR/Gateway_Komfort_2;5896\n", 35, fhdlOut);
            filePutString ("GK2_Hardtop;5897\n", 17, fhdlOut);
            filePutString ("GK2_Hardtop/Gate_Komf_2;5897\n", 29, fhdlOut);
            filePutString ("GK2_Hardtop/Gateway_Komfort_2;5897\n", 35, fhdlOut);
            filePutString ("GK2_Helligkeit;5898\n", 20, fhdlOut);
            filePutString ("GK2_Helligkeit/Gate_Komf_2;5898\n", 32, fhdlOut);
            filePutString ("GK2_Helligkeit/Gateway_Komfort_2;5898\n", 38, fhdlOut);
            filePutString ("GK2_Kessy_StSt_Info;5899\n", 25, fhdlOut);
            filePutString ("GK2_Kessy_StSt_Info/Gate_Komf_2;5899\n", 37, fhdlOut);
            filePutString ("GK2_Kessy_StSt_Info/Gateway_Komfort_2;5899\n", 43, fhdlOut);
            filePutString ("GK2_Kl_StSt_Info;5900\n", 22, fhdlOut);
            filePutString ("GK2_Kl_StSt_Info/Gate_Komf_2;5900\n", 34, fhdlOut);
            filePutString ("GK2_Kl_StSt_Info/Gateway_Komfort_2;5900\n", 40, fhdlOut);
            filePutString ("GK2_LS_KomFehler;5901\n", 22, fhdlOut);
            filePutString ("GK2_LS_KomFehler/Gate_Komf_2;5901\n", 34, fhdlOut);
            filePutString ("GK2_LS_KomFehler/Gateway_Komfort_2;5901\n", 40, fhdlOut);
            filePutString ("GK2_LS_def;5902\n", 16, fhdlOut);
            filePutString ("GK2_LS_def/Gate_Komf_2;5902\n", 28, fhdlOut);
            filePutString ("GK2_LS_def/Gateway_Komfort_2;5902\n", 34, fhdlOut);
            filePutString ("GK2_Profil;5903\n", 16, fhdlOut);
            filePutString ("GK2_Profil/Gate_Komf_2;5903\n", 28, fhdlOut);
            filePutString ("GK2_Profil/Gateway_Komfort_2;5903\n", 34, fhdlOut);
            filePutString ("GK2_Schluessel;5904\n", 20, fhdlOut);
            filePutString ("GK2_Schluessel/Gate_Komf_2;5904\n", 32, fhdlOut);
            filePutString ("GK2_Schluessel/Gateway_Komfort_2;5904\n", 38, fhdlOut);
            filePutString ("GK2_Sta_BSG4;5905\n", 18, fhdlOut);
            filePutString ("GK2_Sta_BSG4/Gate_Komf_2;5905\n", 30, fhdlOut);
            filePutString ("GK2_Sta_BSG4/Gateway_Komfort_2;5905\n", 36, fhdlOut);
            filePutString ("GK2_Sta_Clima2;5906\n", 20, fhdlOut);
            filePutString ("GK2_Sta_Clima2/Gate_Komf_2;5906\n", 32, fhdlOut);
            filePutString ("GK2_Sta_Clima2/Gateway_Komfort_2;5906\n", 38, fhdlOut);
            filePutString ("GK2_Sta_Kessy_4;5907\n", 21, fhdlOut);
            filePutString ("GK2_Sta_Kessy_4/Gate_Komf_2;5907\n", 33, fhdlOut);
            filePutString ("GK2_Sta_Kessy_4/Gateway_Komfort_2;5907\n", 39, fhdlOut);
            filePutString ("GK2_Sta_LSM;5908\n", 17, fhdlOut);
            filePutString ("GK2_Sta_LSM/Gate_Komf_2;5908\n", 29, fhdlOut);
            filePutString ("GK2_Sta_LSM/Gateway_Komfort_2;5908\n", 35, fhdlOut);
            filePutString ("GK2_Sta_Licht1;5909\n", 20, fhdlOut);
            filePutString ("GK2_Sta_Licht1/Gate_Komf_2;5909\n", 32, fhdlOut);
            filePutString ("GK2_Sta_Licht1/Gateway_Komfort_2;5909\n", 38, fhdlOut);
            filePutString ("GK2_Sta_Lichtsensor;5910\n", 25, fhdlOut);
            filePutString ("GK2_Sta_Lichtsensor/Gate_Komf_2;5910\n", 37, fhdlOut);
            filePutString ("GK2_Sta_Lichtsensor/Gateway_Komfort_2;5910\n", 43, fhdlOut);
            filePutString ("GK2_Sta_Profil;5911\n", 20, fhdlOut);
            filePutString ("GK2_Sta_Profil/Gate_Komf_2;5911\n", 32, fhdlOut);
            filePutString ("GK2_Sta_Profil/Gateway_Komfort_2;5911\n", 38, fhdlOut);
            filePutString ("GK2_Sta_Schluessel;5912\n", 24, fhdlOut);
            filePutString ("GK2_Sta_Schluessel/Gate_Komf_2;5912\n", 36, fhdlOut);
            filePutString ("GK2_Sta_Schluessel/Gateway_Komfort_2;5912\n", 42, fhdlOut);
            filePutString ("GK2_Sta_VSG;5913\n", 17, fhdlOut);
            filePutString ("GK2_Sta_VSG/Gate_Komf_2;5913\n", 29, fhdlOut);
            filePutString ("GK2_Sta_VSG/Gateway_Komfort_2;5913\n", 35, fhdlOut);
            filePutString ("GK2_VDKD_auf;5914\n", 18, fhdlOut);
            filePutString ("GK2_VDKD_auf/Gate_Komf_2;5914\n", 30, fhdlOut);
            filePutString ("GK2_VDKD_auf/Gateway_Komfort_2;5914\n", 36, fhdlOut);
            filePutString ("GK2_VD_entriegelt;5915\n", 23, fhdlOut);
            filePutString ("GK2_VD_entriegelt/Gate_Komf_2;5915\n", 35, fhdlOut);
            filePutString ("GK2_VD_entriegelt/Gateway_Komfort_2;5915\n", 41, fhdlOut);
            filePutString ("GK2_VD_offen_ver;5916\n", 22, fhdlOut);
            filePutString ("GK2_VD_offen_ver/Gate_Komf_2;5916\n", 34, fhdlOut);
            filePutString ("GK2_VD_offen_ver/Gateway_Komfort_2;5916\n", 40, fhdlOut);
            filePutString ("GK2_VD_zu_ver;5917\n", 19, fhdlOut);
            filePutString ("GK2_VD_zu_ver/Gate_Komf_2;5917\n", 31, fhdlOut);
            filePutString ("GK2_VD_zu_ver/Gateway_Komfort_2;5917\n", 37, fhdlOut);
            filePutString ("GK2_Verdeck_Anf;5918\n", 21, fhdlOut);
            filePutString ("GK2_Verdeck_Anf/Gate_Komf_2;5918\n", 33, fhdlOut);
            filePutString ("GK2_Verdeck_Anf/Gateway_Komfort_2;5918\n", 39, fhdlOut);
            filePutString ("GK2_res_09;5919\n", 16, fhdlOut);
            filePutString ("GK2_res_09/Gate_Komf_2;5919\n", 28, fhdlOut);
            filePutString ("GK2_res_09/Gateway_Komfort_2;5919\n", 34, fhdlOut);
            filePutString ("GK2_res_13;5920\n", 16, fhdlOut);
            filePutString ("GK2_res_13/Gate_Komf_2;5920\n", 28, fhdlOut);
            filePutString ("GK2_res_13/Gateway_Komfort_2;5920\n", 34, fhdlOut);
            filePutString ("GK2_res_29;5921\n", 16, fhdlOut);
            filePutString ("GK2_res_29/Gate_Komf_2;5921\n", 28, fhdlOut);
            filePutString ("GK2_res_29/Gateway_Komfort_2;5921\n", 34, fhdlOut);
            filePutString ("GK2_res_30;5922\n", 16, fhdlOut);
            filePutString ("GK2_res_30/Gate_Komf_2;5922\n", 28, fhdlOut);
            filePutString ("GK2_res_30/Gateway_Komfort_2;5922\n", 34, fhdlOut);
            filePutString ("BCM_Tankwunsch;6144\n", 20, fhdlOut);
            filePutString ("BCM_Tankwunsch/Gate_Komf_3;6144\n", 32, fhdlOut);
            filePutString ("BCM_Tankwunsch/Gateway_Komfort_3;6144\n", 38, fhdlOut);
            filePutString ("BK1_Anlern_Info;6145\n", 21, fhdlOut);
            filePutString ("BK1_Anlern_Info/Gate_Komf_3;6145\n", 33, fhdlOut);
            filePutString ("BK1_Anlern_Info/Gateway_Komfort_3;6145\n", 39, fhdlOut);
            filePutString ("BK1_IDGeber_1_Status;6146\n", 26, fhdlOut);
            filePutString ("BK1_IDGeber_1_Status/Gate_Komf_3;6146\n", 38, fhdlOut);
            filePutString ("BK1_IDGeber_1_Status/Gateway_Komfort_3;6146\n", 44, fhdlOut);
            filePutString ("BK1_IDGeber_2_Status;6147\n", 26, fhdlOut);
            filePutString ("BK1_IDGeber_2_Status/Gate_Komf_3;6147\n", 38, fhdlOut);
            filePutString ("BK1_IDGeber_2_Status/Gateway_Komfort_3;6147\n", 44, fhdlOut);
            filePutString ("BK1_IDGeber_3_Status;6148\n", 26, fhdlOut);
            filePutString ("BK1_IDGeber_3_Status/Gate_Komf_3;6148\n", 38, fhdlOut);
            filePutString ("BK1_IDGeber_3_Status/Gateway_Komfort_3;6148\n", 44, fhdlOut);
            filePutString ("BK1_IDGeber_4_Status;6149\n", 26, fhdlOut);
            filePutString ("BK1_IDGeber_4_Status/Gate_Komf_3;6149\n", 38, fhdlOut);
            filePutString ("BK1_IDGeber_4_Status/Gateway_Komfort_3;6149\n", 44, fhdlOut);
            filePutString ("CL3_SH_Wasserpumpe;6150\n", 24, fhdlOut);
            filePutString ("CL3_SH_Wasserpumpe/Gate_Komf_3;6150\n", 36, fhdlOut);
            filePutString ("CL3_SH_Wasserpumpe/Gateway_Komfort_3;6150\n", 42, fhdlOut);
            filePutString ("GK2_Sta_Kessy_4;6151\n", 21, fhdlOut);
            filePutString ("GK2_Sta_Kessy_4/Gate_Komf_3;6151\n", 33, fhdlOut);
            filePutString ("GK2_Sta_Kessy_4/Gateway_Komfort_3;6151\n", 39, fhdlOut);
            filePutString ("GK3_Sta_BCM_KY1;6152\n", 21, fhdlOut);
            filePutString ("GK3_Sta_BCM_KY1/Gate_Komf_3;6152\n", 33, fhdlOut);
            filePutString ("GK3_Sta_BCM_KY1/Gateway_Komfort_3;6152\n", 39, fhdlOut);
            filePutString ("GK3_Sta_BSG4;6153\n", 18, fhdlOut);
            filePutString ("GK3_Sta_BSG4/Gate_Komf_3;6153\n", 30, fhdlOut);
            filePutString ("GK3_Sta_BSG4/Gateway_Komfort_3;6153\n", 36, fhdlOut);
            filePutString ("GK3_Sta_Clima_3;6154\n", 21, fhdlOut);
            filePutString ("GK3_Sta_Clima_3/Gate_Komf_3;6154\n", 33, fhdlOut);
            filePutString ("GK3_Sta_Clima_3/Gateway_Komfort_3;6154\n", 39, fhdlOut);
            filePutString ("GK3_Sta_res_03;6155\n", 20, fhdlOut);
            filePutString ("GK3_Sta_res_03/Gate_Komf_3;6155\n", 32, fhdlOut);
            filePutString ("GK3_Sta_res_03/Gateway_Komfort_3;6155\n", 38, fhdlOut);
            filePutString ("GK3_Sta_res_04;6156\n", 20, fhdlOut);
            filePutString ("GK3_Sta_res_04/Gate_Komf_3;6156\n", 32, fhdlOut);
            filePutString ("GK3_Sta_res_04/Gateway_Komfort_3;6156\n", 38, fhdlOut);
            filePutString ("GK3_Sta_res_05;6157\n", 20, fhdlOut);
            filePutString ("GK3_Sta_res_05/Gate_Komf_3;6157\n", 32, fhdlOut);
            filePutString ("GK3_Sta_res_05/Gateway_Komfort_3;6157\n", 38, fhdlOut);
            filePutString ("GK3_Sta_res_06;6158\n", 20, fhdlOut);
            filePutString ("GK3_Sta_res_06/Gate_Komf_3;6158\n", 32, fhdlOut);
            filePutString ("GK3_Sta_res_06/Gateway_Komfort_3;6158\n", 38, fhdlOut);
            filePutString ("GK3_Sta_res_07;6159\n", 20, fhdlOut);
            filePutString ("GK3_Sta_res_07/Gate_Komf_3;6159\n", 32, fhdlOut);
            filePutString ("GK3_Sta_res_07/Gateway_Komfort_3;6159\n", 38, fhdlOut);
            filePutString ("KY4_Gong_600;6160\n", 18, fhdlOut);
            filePutString ("KY4_Gong_600/Gate_Komf_3;6160\n", 30, fhdlOut);
            filePutString ("KY4_Gong_600/Gateway_Komfort_3;6160\n", 36, fhdlOut);
            filePutString ("KY4_Meldungen;6161\n", 19, fhdlOut);
            filePutString ("KY4_Meldungen/Gate_Komf_3;6161\n", 31, fhdlOut);
            filePutString ("KY4_Meldungen/Gateway_Komfort_3;6161\n", 37, fhdlOut);
            filePutString ("KY4_Passiv_Autolock_Menue;6162\n", 31, fhdlOut);
            filePutString ("KY4_Passiv_Autolock_Menue/Gate_Komf_3;6162\n", 43, fhdlOut);
            filePutString ("KY4_Passiv_Autolock_Menue/Gateway_Komfort_3;6162\n", 49, fhdlOut);
            filePutString ("KY4_Passiv_Autolock_akt;6163\n", 29, fhdlOut);
            filePutString ("KY4_Passiv_Autolock_akt/Gate_Komf_3;6163\n", 41, fhdlOut);
            filePutString ("KY4_Passiv_Autolock_akt/Gateway_Komfort_3;6163\n", 47, fhdlOut);
            filePutString ("GE1_Code_MSG;6400\n", 18, fhdlOut);
            filePutString ("GE1_Code_MSG/Getriebe_1;6400\n", 29, fhdlOut);
            filePutString ("GE1_Code_MSG/TSC1;6400\n", 23, fhdlOut);
            filePutString ("GE1_EGS_Anf;6401\n", 17, fhdlOut);
            filePutString ("GE1_EGS_Anf/Getriebe_1;6401\n", 28, fhdlOut);
            filePutString ("GE1_EGS_Anf/TSC1;6401\n", 22, fhdlOut);
            filePutString ("GE1_Fahrwistd;6402\n", 19, fhdlOut);
            filePutString ("GE1_Fahrwistd/Getriebe_1;6402\n", 30, fhdlOut);
            filePutString ("GE1_Fahrwistd/TSC1;6402\n", 24, fhdlOut);
            filePutString ("GE1_Fehlereintr;6403\n", 21, fhdlOut);
            filePutString ("GE1_Fehlereintr/Getriebe_1;6403\n", 32, fhdlOut);
            filePutString ("GE1_Fehlereintr/TSC1;6403\n", 26, fhdlOut);
            filePutString ("GE1_Infobit;6404\n", 17, fhdlOut);
            filePutString ("GE1_Infobit/Getriebe_1;6404\n", 28, fhdlOut);
            filePutString ("GE1_Infobit/TSC1;6404\n", 22, fhdlOut);
            filePutString ("GE1_Klimakompr;6405\n", 20, fhdlOut);
            filePutString ("GE1_Klimakompr/Getriebe_1;6405\n", 31, fhdlOut);
            filePutString ("GE1_Klimakompr/TSC1;6405\n", 25, fhdlOut);
            filePutString ("GE1_Kuehlung;6406\n", 18, fhdlOut);
            filePutString ("GE1_Kuehlung/Getriebe_1;6406\n", 29, fhdlOut);
            filePutString ("GE1_Kuehlung/TSC1;6406\n", 23, fhdlOut);
            filePutString ("GE1_LaunchControl;6407\n", 23, fhdlOut);
            filePutString ("GE1_LaunchControl/Getriebe_1;6407\n", 34, fhdlOut);
            filePutString ("GE1_LaunchControl/TSC1;6407\n", 28, fhdlOut);
            filePutString ("GE1_Mrad_Mkurb;6408\n", 20, fhdlOut);
            filePutString ("GE1_Mrad_Mkurb/Getriebe_1;6408\n", 31, fhdlOut);
            filePutString ("GE1_Mrad_Mkurb/TSC1;6408\n", 25, fhdlOut);
            filePutString ("GE1_Notlauf;6409\n", 17, fhdlOut);
            filePutString ("GE1_Notlauf/Getriebe_1;6409\n", 28, fhdlOut);
            filePutString ("GE1_Notlauf/TSC1;6409\n", 22, fhdlOut);
            filePutString ("GE1_Schaltung;6410\n", 19, fhdlOut);
            filePutString ("GE1_Schaltung/Getriebe_1;6410\n", 30, fhdlOut);
            filePutString ("GE1_Schaltung/TSC1;6410\n", 24, fhdlOut);
            filePutString ("GE1_SleepInd;6411\n", 18, fhdlOut);
            filePutString ("GE1_SleepInd/Getriebe_1;6411\n", 29, fhdlOut);
            filePutString ("GE1_SleepInd/TSC1;6411\n", 23, fhdlOut);
            filePutString ("GE1_Soll_Mo;6412\n", 17, fhdlOut);
            filePutString ("GE1_Soll_Mo/Getriebe_1;6412\n", 28, fhdlOut);
            filePutString ("GE1_Soll_Mo/TSC1;6412\n", 22, fhdlOut);
            filePutString ("GE1_Sta_OBD;6413\n", 17, fhdlOut);
            filePutString ("GE1_Sta_OBD/Getriebe_1;6413\n", 28, fhdlOut);
            filePutString ("GE1_Sta_OBD/TSC1;6413\n", 22, fhdlOut);
            filePutString ("GE1_Sta_Schutz;6414\n", 20, fhdlOut);
            filePutString ("GE1_Sta_Schutz/Getriebe_1;6414\n", 31, fhdlOut);
            filePutString ("GE1_Sta_Schutz/TSC1;6414\n", 25, fhdlOut);
            filePutString ("GE1_Start_Stopp_Info;6415\n", 26, fhdlOut);
            filePutString ("GE1_Start_Stopp_Info/Getriebe_1;6415\n", 37, fhdlOut);
            filePutString ("GE1_Start_Stopp_Info/TSC1;6415\n", 31, fhdlOut);
            filePutString ("GE1_Startverbot;6416\n", 21, fhdlOut);
            filePutString ("GE1_Startverbot/Getriebe_1;6416\n", 32, fhdlOut);
            filePutString ("GE1_Startverbot/TSC1;6416\n", 26, fhdlOut);
            filePutString ("GE1_WK;6417\n", 12, fhdlOut);
            filePutString ("GE1_WK/Getriebe_1;6417\n", 23, fhdlOut);
            filePutString ("GE1_WK/TSC1;6417\n", 17, fhdlOut);
            filePutString ("GE1_WaVerl_Mo;6418\n", 19, fhdlOut);
            filePutString ("GE1_WaVerl_Mo/Getriebe_1;6418\n", 30, fhdlOut);
            filePutString ("GE1_WaVerl_Mo/TSC1;6418\n", 24, fhdlOut);
            filePutString ("GE1_Wahl_Pos;6419\n", 18, fhdlOut);
            filePutString ("GE1_Wahl_Pos/Getriebe_1;6419\n", 29, fhdlOut);
            filePutString ("GE1_Wahl_Pos/TSC1;6419\n", 23, fhdlOut);
            filePutString ("GE1_Zaehler;6420\n", 17, fhdlOut);
            filePutString ("GE1_Zaehler/Getriebe_1;6420\n", 28, fhdlOut);
            filePutString ("GE1_Zaehler/TSC1;6420\n", 22, fhdlOut);
            filePutString ("GE1_Zielgang;6421\n", 18, fhdlOut);
            filePutString ("GE1_Zielgang/Getriebe_1;6421\n", 29, fhdlOut);
            filePutString ("GE1_Zielgang/TSC1;6421\n", 23, fhdlOut);
            filePutString ("GE1_v_Umkehr;6422\n", 18, fhdlOut);
            filePutString ("GE1_v_Umkehr/Getriebe_1;6422\n", 29, fhdlOut);
            filePutString ("GE1_v_Umkehr/TSC1;6422\n", 23, fhdlOut);
            filePutString ("GE2_4Gang;6656\n", 15, fhdlOut);
            filePutString ("GE2_4Gang/Getriebe_2;6656\n", 26, fhdlOut);
            filePutString ("GE2_4Gang/TSC2;6656\n", 20, fhdlOut);
            filePutString ("GE2_5Gang;6657\n", 15, fhdlOut);
            filePutString ("GE2_5Gang/Getriebe_2;6657\n", 26, fhdlOut);
            filePutString ("GE2_5Gang/TSC2;6657\n", 20, fhdlOut);
            filePutString ("GE2_ASG;6658\n", 13, fhdlOut);
            filePutString ("GE2_ASG/Getriebe_2;6658\n", 24, fhdlOut);
            filePutString ("GE2_ASG/TSC2;6658\n", 18, fhdlOut);
            filePutString ("GE2_DZM_Daempf;6659\n", 20, fhdlOut);
            filePutString ("GE2_DZM_Daempf/Getriebe_2;6659\n", 31, fhdlOut);
            filePutString ("GE2_DZM_Daempf/TSC2;6659\n", 25, fhdlOut);
            filePutString ("GE2_Gong;6660\n", 14, fhdlOut);
            filePutString ("GE2_Gong/Getriebe_2;6660\n", 25, fhdlOut);
            filePutString ("GE2_Gong/TSC2;6660\n", 19, fhdlOut);
            filePutString ("GE2_Grad_begr;6661\n", 19, fhdlOut);
            filePutString ("GE2_Grad_begr/Getriebe_2;6661\n", 30, fhdlOut);
            filePutString ("GE2_Grad_begr/TSC2;6661\n", 24, fhdlOut);
            filePutString ("GE2_LFR_Adap;6662\n", 18, fhdlOut);
            filePutString ("GE2_LFR_Adap/Getriebe_2;6662\n", 29, fhdlOut);
            filePutString ("GE2_LFR_Adap/TSC2;6662\n", 23, fhdlOut);
            filePutString ("GE2_LL_Solldz;6663\n", 19, fhdlOut);
            filePutString ("GE2_LL_Solldz/Getriebe_2;6663\n", 30, fhdlOut);
            filePutString ("GE2_LL_Solldz/TSC2;6663\n", 24, fhdlOut);
            filePutString ("GE2_MSB_Sync;6664\n", 18, fhdlOut);
            filePutString ("GE2_MSB_Sync/Getriebe_2;6664\n", 29, fhdlOut);
            filePutString ("GE2_MSB_Sync/TSC2;6664\n", 23, fhdlOut);
            filePutString ("GE2_PRND;6665\n", 14, fhdlOut);
            filePutString ("GE2_PRND/Getriebe_2;6665\n", 25, fhdlOut);
            filePutString ("GE2_PRND/TSC2;6665\n", 19, fhdlOut);
            filePutString ("GE2_PRNDS;6666\n", 15, fhdlOut);
            filePutString ("GE2_PRNDS/Getriebe_2;6666\n", 26, fhdlOut);
            filePutString ("GE2_PRNDS/TSC2;6666\n", 20, fhdlOut);
            filePutString ("GE2_Segeln_aktiv;6667\n", 22, fhdlOut);
            filePutString ("GE2_Segeln_aktiv/Getriebe_2;6667\n", 33, fhdlOut);
            filePutString ("GE2_Segeln_aktiv/TSC2;6667\n", 27, fhdlOut);
            filePutString ("GE2_Selespeed;6668\n", 19, fhdlOut);
            filePutString ("GE2_Selespeed/Getriebe_2;6668\n", 30, fhdlOut);
            filePutString ("GE2_Selespeed/TSC2;6668\n", 24, fhdlOut);
            filePutString ("GE2_Senderkennung;6669\n", 23, fhdlOut);
            filePutString ("GE2_Senderkennung/Getriebe_2;6669\n", 34, fhdlOut);
            filePutString ("GE2_Senderkennung/TSC2;6669\n", 28, fhdlOut);
            filePutString ("GE2_Shift_Lock;6670\n", 20, fhdlOut);
            filePutString ("GE2_Shift_Lock/Getriebe_2;6670\n", 31, fhdlOut);
            filePutString ("GE2_Shift_Lock/TSC2;6670\n", 25, fhdlOut);
            filePutString ("GE2_SlipStDZEingr;6671\n", 23, fhdlOut);
            filePutString ("GE2_SlipStDZEingr/Getriebe_2;6671\n", 34, fhdlOut);
            filePutString ("GE2_SlipStDZEingr/TSC2;6671\n", 28, fhdlOut);
            filePutString ("GE2_Sta_SAS;6672\n", 17, fhdlOut);
            filePutString ("GE2_Sta_SAS/Getriebe_2;6672\n", 28, fhdlOut);
            filePutString ("GE2_Sta_SAS/TSC2;6672\n", 22, fhdlOut);
            filePutString ("GE2_Sta_ZwGas;6673\n", 19, fhdlOut);
            filePutString ("GE2_Sta_ZwGas/Getriebe_2;6673\n", 30, fhdlOut);
            filePutString ("GE2_Sta_ZwGas/TSC2;6673\n", 24, fhdlOut);
            filePutString ("GE2_Sync_Dz;6674\n", 17, fhdlOut);
            filePutString ("GE2_Sync_Dz/Getriebe_2;6674\n", 28, fhdlOut);
            filePutString ("GE2_Sync_Dz/TSC2;6674\n", 22, fhdlOut);
            filePutString ("GE2_Sync_Zeit;6675\n", 19, fhdlOut);
            filePutString ("GE2_Sync_Zeit/Getriebe_2;6675\n", 30, fhdlOut);
            filePutString ("GE2_Sync_Zeit/TSC2;6675\n", 24, fhdlOut);
            filePutString ("GE2_Tip4Gang;6676\n", 18, fhdlOut);
            filePutString ("GE2_Tip4Gang/Getriebe_2;6676\n", 29, fhdlOut);
            filePutString ("GE2_Tip4Gang/TSC2;6676\n", 23, fhdlOut);
            filePutString ("GE2_Tip5Gang;6677\n", 18, fhdlOut);
            filePutString ("GE2_Tip5Gang/Getriebe_2;6677\n", 29, fhdlOut);
            filePutString ("GE2_Tip5Gang/TSC2;6677\n", 23, fhdlOut);
            filePutString ("GE2_Tip6Gang;6678\n", 18, fhdlOut);
            filePutString ("GE2_Tip6Gang/Getriebe_2;6678\n", 29, fhdlOut);
            filePutString ("GE2_Tip6Gang/TSC2;6678\n", 23, fhdlOut);
            filePutString ("GE2_Tip7Gang;6679\n", 18, fhdlOut);
            filePutString ("GE2_Tip7Gang/Getriebe_2;6679\n", 29, fhdlOut);
            filePutString ("GE2_Tip7Gang/TSC2;6679\n", 23, fhdlOut);
            filePutString ("GE2_Variante;6680\n", 18, fhdlOut);
            filePutString ("GE2_Variante/Getriebe_2;6680\n", 29, fhdlOut);
            filePutString ("GE2_Variante/TSC2;6680\n", 23, fhdlOut);
            filePutString ("GE2_WBA_Blinken;6681\n", 21, fhdlOut);
            filePutString ("GE2_WBA_Blinken/Getriebe_2;6681\n", 32, fhdlOut);
            filePutString ("GE2_WBA_Blinken/TSC2;6681\n", 26, fhdlOut);
            filePutString ("GE2_Zaehler;6682\n", 17, fhdlOut);
            filePutString ("GE2_Zaehler/Getriebe_2;6682\n", 28, fhdlOut);
            filePutString ("GE2_Zaehler/TSC2;6682\n", 22, fhdlOut);
            filePutString ("GE2_akt_Gang;6683\n", 18, fhdlOut);
            filePutString ("GE2_akt_Gang/Getriebe_2;6683\n", 29, fhdlOut);
            filePutString ("GE2_akt_Gang/TSC2;6683\n", 23, fhdlOut);
            filePutString ("GE2_invMSB_Sync;6684\n", 21, fhdlOut);
            filePutString ("GE2_invMSB_Sync/Getriebe_2;6684\n", 32, fhdlOut);
            filePutString ("GE2_invMSB_Sync/TSC2;6684\n", 26, fhdlOut);
            filePutString ("GE2_invSync_Dz;6685\n", 20, fhdlOut);
            filePutString ("GE2_invSync_Dz/Getriebe_2;6685\n", 31, fhdlOut);
            filePutString ("GE2_invSync_Dz/TSC2;6685\n", 25, fhdlOut);
            filePutString ("GM3_Checksum;6912\n", 18, fhdlOut);
            filePutString ("GM3_Checksum/Getriebe_3_Momente;6912\n", 37, fhdlOut);
            filePutString ("GM3_Checksum/TSC3;6912\n", 23, fhdlOut);
            filePutString ("GM3_LangEingr;6913\n", 19, fhdlOut);
            filePutString ("GM3_LangEingr/Getriebe_3_Momente;6913\n", 38, fhdlOut);
            filePutString ("GM3_LangEingr/TSC3;6913\n", 24, fhdlOut);
            filePutString ("GM3_MoSoMom;6914\n", 17, fhdlOut);
            filePutString ("GM3_MoSoMom/Getriebe_3_Momente;6914\n", 36, fhdlOut);
            filePutString ("GM3_MoSoMom/TSC3;6914\n", 22, fhdlOut);
            filePutString ("GM3_MomEingr;6915\n", 18, fhdlOut);
            filePutString ("GM3_MomEingr/Getriebe_3_Momente;6915\n", 37, fhdlOut);
            filePutString ("GM3_MomEingr/TSC3;6915\n", 23, fhdlOut);
            filePutString ("GM3_MomID;6916\n", 15, fhdlOut);
            filePutString ("GM3_MomID/Getriebe_3_Momente;6916\n", 34, fhdlOut);
            filePutString ("GM3_MomID/TSC3;6916\n", 20, fhdlOut);
            filePutString ("GM3_Moment;6917\n", 16, fhdlOut);
            filePutString ("GM3_Moment/Getriebe_3_Momente;6917\n", 35, fhdlOut);
            filePutString ("GM3_Moment/TSC3;6917\n", 21, fhdlOut);
            filePutString ("GM3_QB_LangEingr;6918\n", 22, fhdlOut);
            filePutString ("GM3_QB_LangEingr/Getriebe_3_Momente;6918\n", 41, fhdlOut);
            filePutString ("GM3_QB_LangEingr/TSC3;6918\n", 27, fhdlOut);
            filePutString ("GM3_StaSoMom;6919\n", 18, fhdlOut);
            filePutString ("GM3_StaSoMom/Getriebe_3_Momente;6919\n", 37, fhdlOut);
            filePutString ("GM3_StaSoMom/TSC3;6919\n", 23, fhdlOut);
            filePutString ("GM3_Zaehler;6920\n", 17, fhdlOut);
            filePutString ("GM3_Zaehler/Getriebe_3_Momente;6920\n", 36, fhdlOut);
            filePutString ("GM3_Zaehler/TSC3;6920\n", 22, fhdlOut);
            filePutString ("GM3_Zeit;6921\n", 14, fhdlOut);
            filePutString ("GM3_Zeit/Getriebe_3_Momente;6921\n", 33, fhdlOut);
            filePutString ("GM3_Zeit/TSC3;6921\n", 19, fhdlOut);
            filePutString ("GM3_res_13;6922\n", 16, fhdlOut);
            filePutString ("GM3_res_13/Getriebe_3_Momente;6922\n", 35, fhdlOut);
            filePutString ("GM3_res_13/TSC3;6922\n", 21, fhdlOut);
            filePutString ("GM3_res_14;6923\n", 16, fhdlOut);
            filePutString ("GM3_res_14/Getriebe_3_Momente;6923\n", 35, fhdlOut);
            filePutString ("GM3_res_14/TSC3;6923\n", 21, fhdlOut);
            filePutString ("GM3_res_15;6924\n", 16, fhdlOut);
            filePutString ("GM3_res_15/Getriebe_3_Momente;6924\n", 35, fhdlOut);
            filePutString ("GM3_res_15/TSC3;6924\n", 21, fhdlOut);
            filePutString ("GM3_res_61;6925\n", 16, fhdlOut);
            filePutString ("GM3_res_61/Getriebe_3_Momente;6925\n", 35, fhdlOut);
            filePutString ("GM3_res_61/TSC3;6925\n", 21, fhdlOut);
            filePutString ("GM3_res_62;6926\n", 16, fhdlOut);
            filePutString ("GM3_res_62/Getriebe_3_Momente;6926\n", 35, fhdlOut);
            filePutString ("GM3_res_62/TSC3;6926\n", 21, fhdlOut);
            filePutString ("GM3_res_63;6927\n", 16, fhdlOut);
            filePutString ("GM3_res_63/Getriebe_3_Momente;6927\n", 35, fhdlOut);
            filePutString ("GM3_res_63/TSC3;6927\n", 21, fhdlOut);
            filePutString ("GE6_Checksum;7168\n", 18, fhdlOut);
            filePutString ("GE6_Checksum/Getriebe_6;7168\n", 29, fhdlOut);
            filePutString ("GE6_Checksum/TSC6;7168\n", 23, fhdlOut);
            filePutString ("GE6_Gangwechsel;7169\n", 21, fhdlOut);
            filePutString ("GE6_Gangwechsel/Getriebe_6;7169\n", 32, fhdlOut);
            filePutString ("GE6_Gangwechsel/TSC6;7169\n", 26, fhdlOut);
            filePutString ("GE6_OelTemp;7170\n", 17, fhdlOut);
            filePutString ("GE6_OelTemp/Getriebe_6;7170\n", 28, fhdlOut);
            filePutString ("GE6_OelTemp/TSC6;7170\n", 22, fhdlOut);
            filePutString ("GE6_QB_OelTemp;7171\n", 20, fhdlOut);
            filePutString ("GE6_QB_OelTemp/Getriebe_6;7171\n", 31, fhdlOut);
            filePutString ("GE6_QB_OelTemp/TSC6;7171\n", 25, fhdlOut);
            filePutString ("GE6_QmaxBeschl;7172\n", 20, fhdlOut);
            filePutString ("GE6_QmaxBeschl/Getriebe_6;7172\n", 31, fhdlOut);
            filePutString ("GE6_QmaxBeschl/TSC6;7172\n", 25, fhdlOut);
            filePutString ("GE6_Sta_Shift_Spontan;7173\n", 27, fhdlOut);
            filePutString ("GE6_Sta_Shift_Spontan/Getriebe_6;7173\n", 38, fhdlOut);
            filePutString ("GE6_Sta_Shift_Spontan/TSC6;7173\n", 32, fhdlOut);
            filePutString ("GE6_TurbDZ;7174\n", 16, fhdlOut);
            filePutString ("GE6_TurbDZ/Getriebe_6;7174\n", 27, fhdlOut);
            filePutString ("GE6_TurbDZ/TSC6;7174\n", 21, fhdlOut);
            filePutString ("GE6_Verlustmom;7175\n", 20, fhdlOut);
            filePutString ("GE6_Verlustmom/Getriebe_6;7175\n", 31, fhdlOut);
            filePutString ("GE6_Verlustmom/TSC6;7175\n", 25, fhdlOut);
            filePutString ("GE6_Zaehler;7176\n", 17, fhdlOut);
            filePutString ("GE6_Zaehler/Getriebe_6;7176\n", 28, fhdlOut);
            filePutString ("GE6_Zaehler/TSC6;7176\n", 22, fhdlOut);
            filePutString ("GE6_Zielgang_err;7177\n", 22, fhdlOut);
            filePutString ("GE6_Zielgang_err/Getriebe_6;7177\n", 33, fhdlOut);
            filePutString ("GE6_Zielgang_err/TSC6;7177\n", 27, fhdlOut);
            filePutString ("GE6_maxBeschl;7178\n", 19, fhdlOut);
            filePutString ("GE6_maxBeschl/Getriebe_6;7178\n", 30, fhdlOut);
            filePutString ("GE6_maxBeschl/TSC6;7178\n", 24, fhdlOut);
            filePutString ("GE_Heizwunsch;7179\n", 19, fhdlOut);
            filePutString ("GE_Heizwunsch/Getriebe_6;7179\n", 30, fhdlOut);
            filePutString ("GE_Heizwunsch/TSC6;7179\n", 24, fhdlOut);
            filePutString ("GE_StSt_Info;7180\n", 18, fhdlOut);
            filePutString ("GE_StSt_Info/Getriebe_6;7180\n", 29, fhdlOut);
            filePutString ("GE_StSt_Info/TSC6;7180\n", 23, fhdlOut);
            filePutString ("GH1_AnzeigeDZ;7424\n", 19, fhdlOut);
            filePutString ("GH1_AnzeigeDZ/Getriebe_Hybrid_1;7424\n", 37, fhdlOut);
            filePutString ("GH1_AnzeigeDZ/TSCH1;7424\n", 25, fhdlOut);
            filePutString ("GH1_FehlerstatusGSG;7425\n", 25, fhdlOut);
            filePutString ("GH1_FehlerstatusGSG/Getriebe_Hybrid_1;7425\n", 43, fhdlOut);
            filePutString ("GH1_FehlerstatusGSG/TSCH1;7425\n", 31, fhdlOut);
            filePutString ("GH1_Filt_MomAufbau;7426\n", 24, fhdlOut);
            filePutString ("GH1_Filt_MomAufbau/Getriebe_Hybrid_1;7426\n", 42, fhdlOut);
            filePutString ("GH1_Filt_MomAufbau/TSCH1;7426\n", 30, fhdlOut);
            filePutString ("GH1_Freig_LL_Reg;7427\n", 22, fhdlOut);
            filePutString ("GH1_Freig_LL_Reg/Getriebe_Hybrid_1;7427\n", 40, fhdlOut);
            filePutString ("GH1_Freig_LL_Reg/TSCH1;7427\n", 28, fhdlOut);
            filePutString ("GH1_FreigabeK0;7428\n", 20, fhdlOut);
            filePutString ("GH1_FreigabeK0/Getriebe_Hybrid_1;7428\n", 38, fhdlOut);
            filePutString ("GH1_FreigabeK0/TSCH1;7428\n", 26, fhdlOut);
            filePutString ("GH1_FreigabeSSK0;7429\n", 22, fhdlOut);
            filePutString ("GH1_FreigabeSSK0/Getriebe_Hybrid_1;7429\n", 40, fhdlOut);
            filePutString ("GH1_FreigabeSSK0/TSCH1;7429\n", 28, fhdlOut);
            filePutString ("GH1_FreigabeVMStop;7430\n", 24, fhdlOut);
            filePutString ("GH1_FreigabeVMStop/Getriebe_Hybrid_1;7430\n", 42, fhdlOut);
            filePutString ("GH1_FreigabeVMStop/TSCH1;7430\n", 30, fhdlOut);
            filePutString ("GH1_MomEingriff_EM;7431\n", 24, fhdlOut);
            filePutString ("GH1_MomEingriff_EM/Getriebe_Hybrid_1;7431\n", 42, fhdlOut);
            filePutString ("GH1_MomEingriff_EM/TSCH1;7431\n", 30, fhdlOut);
            filePutString ("GH1_Sportfaktor;7432\n", 21, fhdlOut);
            filePutString ("GH1_Sportfaktor/Getriebe_Hybrid_1;7432\n", 39, fhdlOut);
            filePutString ("GH1_Sportfaktor/TSCH1;7432\n", 27, fhdlOut);
            filePutString ("GH1_VKMstartanforderung;7433\n", 29, fhdlOut);
            filePutString ("GH1_VKMstartanforderung/Getriebe_Hybrid_1;7433\n", 47, fhdlOut);
            filePutString ("GH1_VKMstartanforderung/TSCH1;7433\n", 35, fhdlOut);
            filePutString ("GH1_VKMstartkontrolle;7434\n", 27, fhdlOut);
            filePutString ("GH1_VKMstartkontrolle/Getriebe_Hybrid_1;7434\n", 45, fhdlOut);
            filePutString ("GH1_VKMstartkontrolle/TSCH1;7434\n", 33, fhdlOut);
            filePutString ("GH1_VM_akt_halten;7435\n", 23, fhdlOut);
            filePutString ("GH1_VM_akt_halten/Getriebe_Hybrid_1;7435\n", 41, fhdlOut);
            filePutString ("GH1_VM_akt_halten/TSCH1;7435\n", 29, fhdlOut);
            filePutString ("GH1_VZMomEingriff;7436\n", 23, fhdlOut);
            filePutString ("GH1_VZMomEingriff/Getriebe_Hybrid_1;7436\n", 41, fhdlOut);
            filePutString ("GH1_VZMomEingriff/TSCH1;7436\n", 29, fhdlOut);
            filePutString ("GH1_Wiederstart;7437\n", 21, fhdlOut);
            filePutString ("GH1_Wiederstart/Getriebe_Hybrid_1;7437\n", 39, fhdlOut);
            filePutString ("GH1_Wiederstart/TSCH1;7437\n", 27, fhdlOut);
            filePutString ("GH1_Zaehler;7438\n", 17, fhdlOut);
            filePutString ("GH1_Zaehler/Getriebe_Hybrid_1;7438\n", 35, fhdlOut);
            filePutString ("GH1_Zaehler/TSCH1;7438\n", 23, fhdlOut);
            filePutString ("GH1_nK0;7439\n", 13, fhdlOut);
            filePutString ("GH1_nK0/Getriebe_Hybrid_1;7439\n", 31, fhdlOut);
            filePutString ("GH1_nK0/TSCH1;7439\n", 19, fhdlOut);
            filePutString ("HYB_Anf_E_Mode;7680\n", 20, fhdlOut);
            filePutString ("HYB_Anf_E_Mode/Klima_5;7680\n", 28, fhdlOut);
            filePutString ("HYB_Anf_E_Mode/AC5;7680\n", 24, fhdlOut);
            filePutString ("KL_Magnetventil;7681\n", 21, fhdlOut);
            filePutString ("KL_Magnetventil/Klima_5;7681\n", 29, fhdlOut);
            filePutString ("KL_Magnetventil/AC5;7681\n", 25, fhdlOut);
            filePutString ("KL_Schalter_StartStopp;7682\n", 28, fhdlOut);
            filePutString ("KL_Schalter_StartStopp/Klima_5;7682\n", 36, fhdlOut);
            filePutString ("KL_Schalter_StartStopp/AC5;7682\n", 32, fhdlOut);
            filePutString ("KL_Thermomanagement;7683\n", 25, fhdlOut);
            filePutString ("KL_Thermomanagement/Klima_5;7683\n", 33, fhdlOut);
            filePutString ("KL_Thermomanagement/AC5;7683\n", 29, fhdlOut);
            filePutString ("Klima_StSt_Info;7684\n", 21, fhdlOut);
            filePutString ("Klima_StSt_Info/Klima_5;7684\n", 29, fhdlOut);
            filePutString ("Klima_StSt_Info/AC5;7684\n", 25, fhdlOut);
            filePutString ("SH_Betriebsdauer;7685\n", 22, fhdlOut);
            filePutString ("SH_Betriebsdauer/Klima_5;7685\n", 30, fhdlOut);
            filePutString ("SH_Betriebsdauer/AC5;7685\n", 26, fhdlOut);
            filePutString ("SH_Monat;7686\n", 14, fhdlOut);
            filePutString ("SH_Monat/Klima_5;7686\n", 22, fhdlOut);
            filePutString ("SH_Monat/AC5;7686\n", 18, fhdlOut);
            filePutString ("SH_Offset_Jahr;7687\n", 20, fhdlOut);
            filePutString ("SH_Offset_Jahr/Klima_5;7687\n", 28, fhdlOut);
            filePutString ("SH_Offset_Jahr/AC5;7687\n", 24, fhdlOut);
            filePutString ("SH_Tag;7688\n", 12, fhdlOut);
            filePutString ("SH_Tag/Klima_5;7688\n", 20, fhdlOut);
            filePutString ("SH_Tag/AC5;7688\n", 16, fhdlOut);
            filePutString ("SH_Timer_aktiv;7689\n", 20, fhdlOut);
            filePutString ("SH_Timer_aktiv/Klima_5;7689\n", 28, fhdlOut);
            filePutString ("SH_Timer_aktiv/AC5;7689\n", 24, fhdlOut);
            filePutString ("SH_Timerstatus;7690\n", 20, fhdlOut);
            filePutString ("SH_Timerstatus/Klima_5;7690\n", 28, fhdlOut);
            filePutString ("SH_Timerstatus/AC5;7690\n", 24, fhdlOut);
            filePutString ("SH_WP_Fehler;7691\n", 18, fhdlOut);
            filePutString ("SH_WP_Fehler/Klima_5;7691\n", 26, fhdlOut);
            filePutString ("SH_WP_Fehler/AC5;7691\n", 22, fhdlOut);
            filePutString ("SH_Wochentag;7692\n", 18, fhdlOut);
            filePutString ("SH_Wochentag/Klima_5;7692\n", 26, fhdlOut);
            filePutString ("SH_Wochentag/AC5;7692\n", 22, fhdlOut);
            filePutString ("SH_h_Einschaltzeit;7693\n", 24, fhdlOut);
            filePutString ("SH_h_Einschaltzeit/Klima_5;7693\n", 32, fhdlOut);
            filePutString ("SH_h_Einschaltzeit/AC5;7693\n", 28, fhdlOut);
            filePutString ("SH_min_Einschaltzeit;7694\n", 26, fhdlOut);
            filePutString ("SH_min_Einschaltzeit/Klima_5;7694\n", 34, fhdlOut);
            filePutString ("SH_min_Einschaltzeit/AC5;7694\n", 30, fhdlOut);
            filePutString ("STH_Betriebsart;7695\n", 21, fhdlOut);
            filePutString ("STH_Betriebsart/Klima_5;7695\n", 29, fhdlOut);
            filePutString ("STH_Betriebsart/AC5;7695\n", 25, fhdlOut);
            filePutString ("KO1_ABS_Lampe;7936\n", 19, fhdlOut);
            filePutString ("KO1_ABS_Lampe/Kombi_1;7936\n", 27, fhdlOut);
            filePutString ("KO1_ABS_Lampe/DSP1;7936\n", 24, fhdlOut);
            filePutString ("KO1_ACC_AnzFhl;7937\n", 20, fhdlOut);
            filePutString ("KO1_ACC_AnzFhl/Kombi_1;7937\n", 28, fhdlOut);
            filePutString ("KO1_ACC_AnzFhl/DSP1;7937\n", 25, fhdlOut);
            filePutString ("KO1_ACC_Inkons;7938\n", 20, fhdlOut);
            filePutString ("KO1_ACC_Inkons/Kombi_1;7938\n", 28, fhdlOut);
            filePutString ("KO1_ACC_Inkons/DSP1;7938\n", 25, fhdlOut);
            filePutString ("KO1_ASRESP_Lampe;7939\n", 22, fhdlOut);
            filePutString ("KO1_ASRESP_Lampe/Kombi_1;7939\n", 30, fhdlOut);
            filePutString ("KO1_ASRESP_Lampe/DSP1;7939\n", 27, fhdlOut);
            filePutString ("KO1_Airbag_Lampe;7940\n", 22, fhdlOut);
            filePutString ("KO1_Airbag_Lampe/Kombi_1;7940\n", 30, fhdlOut);
            filePutString ("KO1_Airbag_Lampe/DSP1;7940\n", 27, fhdlOut);
            filePutString ("KO1_Brems_Lampe;7941\n", 21, fhdlOut);
            filePutString ("KO1_Brems_Lampe/Kombi_1;7941\n", 29, fhdlOut);
            filePutString ("KO1_Brems_Lampe/DSP1;7941\n", 26, fhdlOut);
            filePutString ("KO1_Bremsinfo;7942\n", 19, fhdlOut);
            filePutString ("KO1_Bremsinfo/Kombi_1;7942\n", 27, fhdlOut);
            filePutString ("KO1_Bremsinfo/DSP1;7942\n", 24, fhdlOut);
            filePutString ("KO1_Handbremse;7943\n", 20, fhdlOut);
            filePutString ("KO1_Handbremse/Kombi_1;7943\n", 28, fhdlOut);
            filePutString ("KO1_Handbremse/DSP1;7943\n", 25, fhdlOut);
            filePutString ("KO1_Kuehlmittel;7944\n", 21, fhdlOut);
            filePutString ("KO1_Kuehlmittel/Kombi_1;7944\n", 29, fhdlOut);
            filePutString ("KO1_Kuehlmittel/DSP1;7944\n", 26, fhdlOut);
            filePutString ("KO1_LDW_AnzFeh;7945\n", 20, fhdlOut);
            filePutString ("KO1_LDW_AnzFeh/Kombi_1;7945\n", 28, fhdlOut);
            filePutString ("KO1_LDW_AnzFeh/DSP1;7945\n", 25, fhdlOut);
            filePutString ("KO1_La_Ladekon;7946\n", 20, fhdlOut);
            filePutString ("KO1_La_Ladekon/Kombi_1;7946\n", 28, fhdlOut);
            filePutString ("KO1_La_Ladekon/DSP1;7946\n", 25, fhdlOut);
            filePutString ("KO1_Lenkh_Lampe;7947\n", 21, fhdlOut);
            filePutString ("KO1_Lenkh_Lampe/Kombi_1;7947\n", 29, fhdlOut);
            filePutString ("KO1_Lenkh_Lampe/DSP1;7947\n", 26, fhdlOut);
            filePutString ("KO1_OBD_Tank;7948\n", 18, fhdlOut);
            filePutString ("KO1_OBD_Tank/Kombi_1;7948\n", 26, fhdlOut);
            filePutString ("KO1_OBD_Tank/DSP1;7948\n", 23, fhdlOut);
            filePutString ("KO1_Oeldruck;7949\n", 18, fhdlOut);
            filePutString ("KO1_Oeldruck/Kombi_1;7949\n", 26, fhdlOut);
            filePutString ("KO1_Oeldruck/DSP1;7949\n", 23, fhdlOut);
            filePutString ("KO1_Quelle_kmh;7950\n", 20, fhdlOut);
            filePutString ("KO1_Quelle_kmh/Kombi_1;7950\n", 28, fhdlOut);
            filePutString ("KO1_Quelle_kmh/DSP1;7950\n", 25, fhdlOut);
            filePutString ("KO1_SILA_gueltig;7951\n", 22, fhdlOut);
            filePutString ("KO1_SILA_gueltig/Kombi_1;7951\n", 30, fhdlOut);
            filePutString ("KO1_SILA_gueltig/DSP1;7951\n", 27, fhdlOut);
            filePutString ("KO1_SleepInd;7952\n", 18, fhdlOut);
            filePutString ("KO1_SleepInd/Kombi_1;7952\n", 26, fhdlOut);
            filePutString ("KO1_SleepInd/DSP1;7952\n", 23, fhdlOut);
            filePutString ("KO1_Sta_Oeldr;7953\n", 19, fhdlOut);
            filePutString ("KO1_Sta_Oeldr/Kombi_1;7953\n", 27, fhdlOut);
            filePutString ("KO1_Sta_Oeldr/DSP1;7953\n", 24, fhdlOut);
            filePutString ("KO1_Sta_Tank;7954\n", 18, fhdlOut);
            filePutString ("KO1_Sta_Tank/Kombi_1;7954\n", 26, fhdlOut);
            filePutString ("KO1_Sta_Tank/DSP1;7954\n", 23, fhdlOut);
            filePutString ("KO1_Stellglieder;7955\n", 22, fhdlOut);
            filePutString ("KO1_Stellglieder/Kombi_1;7955\n", 30, fhdlOut);
            filePutString ("KO1_Stellglieder/DSP1;7955\n", 27, fhdlOut);
            filePutString ("KO1_Tankinhalt;7956\n", 20, fhdlOut);
            filePutString ("KO1_Tankinhalt/Kombi_1;7956\n", 28, fhdlOut);
            filePutString ("KO1_Tankinhalt/DSP1;7956\n", 25, fhdlOut);
            filePutString ("KO1_Tankstop;7957\n", 18, fhdlOut);
            filePutString ("KO1_Tankstop/Kombi_1;7957\n", 26, fhdlOut);
            filePutString ("KO1_Tankstop/DSP1;7957\n", 23, fhdlOut);
            filePutString ("KO1_Vorgluehen;7958\n", 20, fhdlOut);
            filePutString ("KO1_Vorgluehen/Kombi_1;7958\n", 28, fhdlOut);
            filePutString ("KO1_Vorgluehen/DSP1;7958\n", 25, fhdlOut);
            filePutString ("KO1_Wakeup_Komfort;7959\n", 24, fhdlOut);
            filePutString ("KO1_Wakeup_Komfort/Kombi_1;7959\n", 32, fhdlOut);
            filePutString ("KO1_Wakeup_Komfort/DSP1;7959\n", 29, fhdlOut);
            filePutString ("KO1_Warn_Tank;7960\n", 19, fhdlOut);
            filePutString ("KO1_Warn_Tank/Kombi_1;7960\n", 27, fhdlOut);
            filePutString ("KO1_Warn_Tank/DSP1;7960\n", 24, fhdlOut);
            filePutString ("KO1_Zaehler;7961\n", 17, fhdlOut);
            filePutString ("KO1_Zaehler/Kombi_1;7961\n", 25, fhdlOut);
            filePutString ("KO1_Zaehler/DSP1;7961\n", 22, fhdlOut);
            filePutString ("KO1_Zeitluecke;7962\n", 20, fhdlOut);
            filePutString ("KO1_Zeitluecke/Kombi_1;7962\n", 28, fhdlOut);
            filePutString ("KO1_Zeitluecke/DSP1;7962\n", 25, fhdlOut);
            filePutString ("KO1_angez_kmh;7963\n", 19, fhdlOut);
            filePutString ("KO1_angez_kmh/Kombi_1;7963\n", 27, fhdlOut);
            filePutString ("KO1_angez_kmh/DSP1;7963\n", 24, fhdlOut);
            filePutString ("KO1_kmh;7964\n", 13, fhdlOut);
            filePutString ("KO1_kmh/Kombi_1;7964\n", 21, fhdlOut);
            filePutString ("KO1_kmh/DSP1;7964\n", 18, fhdlOut);
            filePutString ("KO1_kmh_mph;7965\n", 17, fhdlOut);
            filePutString ("KO1_kmh_mph/Kombi_1;7965\n", 25, fhdlOut);
            filePutString ("KO1_kmh_mph/DSP1;7965\n", 22, fhdlOut);
            filePutString ("KO2_Aussen_T;8192\n", 18, fhdlOut);
            filePutString ("KO2_Aussen_T/Kombi_2;8192\n", 26, fhdlOut);
            filePutString ("KO2_Aussen_T/DSP2;8192\n", 23, fhdlOut);
            filePutString ("KO2_Bel_Displ;8193\n", 19, fhdlOut);
            filePutString ("KO2_Bel_Displ/Kombi_2;8193\n", 27, fhdlOut);
            filePutString ("KO2_Bel_Displ/DSP2;8193\n", 24, fhdlOut);
            filePutString ("KO2_Bel_Schalt;8194\n", 20, fhdlOut);
            filePutString ("KO2_Bel_Schalt/Kombi_2;8194\n", 28, fhdlOut);
            filePutString ("KO2_Bel_Schalt/DSP2;8194\n", 25, fhdlOut);
            filePutString ("KO2_Fehlereintr;8195\n", 21, fhdlOut);
            filePutString ("KO2_Fehlereintr/Kombi_2;8195\n", 29, fhdlOut);
            filePutString ("KO2_Fehlereintr/DSP2;8195\n", 26, fhdlOut);
            filePutString ("KO2_GRA_High;8196\n", 18, fhdlOut);
            filePutString ("KO2_GRA_High/Kombi_2;8196\n", 26, fhdlOut);
            filePutString ("KO2_GRA_High/DSP2;8196\n", 23, fhdlOut);
            filePutString ("KO2_MFA_v_Einheit;8197\n", 23, fhdlOut);
            filePutString ("KO2_MFA_v_Einheit/Kombi_2;8197\n", 31, fhdlOut);
            filePutString ("KO2_MFA_v_Einheit/DSP2;8197\n", 28, fhdlOut);
            filePutString ("KO2_OBD_Nib_Temp;8198\n", 22, fhdlOut);
            filePutString ("KO2_OBD_Nib_Temp/Kombi_2;8198\n", 30, fhdlOut);
            filePutString ("KO2_OBD_Nib_Temp/DSP2;8198\n", 27, fhdlOut);
            filePutString ("KO2_OelTemp;8199\n", 17, fhdlOut);
            filePutString ("KO2_OelTemp/Kombi_2;8199\n", 25, fhdlOut);
            filePutString ("KO2_OelTemp/DSP2;8199\n", 22, fhdlOut);
            filePutString ("KO2_Oelwarn;8200\n", 17, fhdlOut);
            filePutString ("KO2_Oelwarn/Kombi_2;8200\n", 25, fhdlOut);
            filePutString ("KO2_Oelwarn/DSP2;8200\n", 22, fhdlOut);
            filePutString ("KO2_PLA_Displaystatus;8201\n", 27, fhdlOut);
            filePutString ("KO2_PLA_Displaystatus/Kombi_2;8201\n", 35, fhdlOut);
            filePutString ("KO2_PLA_Displaystatus/DSP2;8201\n", 32, fhdlOut);
            filePutString ("KO2_Reserve4;8202\n", 18, fhdlOut);
            filePutString ("KO2_Reserve4/Kombi_2;8202\n", 26, fhdlOut);
            filePutString ("KO2_Reserve4/DSP2;8202\n", 23, fhdlOut);
            filePutString ("KO2_Reserve5;8203\n", 18, fhdlOut);
            filePutString ("KO2_Reserve5/Kombi_2;8203\n", 26, fhdlOut);
            filePutString ("KO2_Reserve5/DSP2;8203\n", 23, fhdlOut);
            filePutString ("KO2_Sta_Auss_T;8204\n", 20, fhdlOut);
            filePutString ("KO2_Sta_Auss_T/Kombi_2;8204\n", 28, fhdlOut);
            filePutString ("KO2_Sta_Auss_T/DSP2;8204\n", 25, fhdlOut);
            filePutString ("KO2_Sta_Displ;8205\n", 19, fhdlOut);
            filePutString ("KO2_Sta_Displ/Kombi_2;8205\n", 27, fhdlOut);
            filePutString ("KO2_Sta_Displ/DSP2;8205\n", 24, fhdlOut);
            filePutString ("KO2_Sta_Oel_T;8206\n", 19, fhdlOut);
            filePutString ("KO2_Sta_Oel_T/Kombi_2;8206\n", 27, fhdlOut);
            filePutString ("KO2_Sta_Oel_T/DSP2;8206\n", 24, fhdlOut);
            filePutString ("KO2_Sta_Schalt;8207\n", 20, fhdlOut);
            filePutString ("KO2_Sta_Schalt/Kombi_2;8207\n", 28, fhdlOut);
            filePutString ("KO2_Sta_Schalt/DSP2;8207\n", 25, fhdlOut);
            filePutString ("KO2_Temp_Einheit;8208\n", 22, fhdlOut);
            filePutString ("KO2_Temp_Einheit/Kombi_2;8208\n", 30, fhdlOut);
            filePutString ("KO2_Temp_Einheit/DSP2;8208\n", 27, fhdlOut);
            filePutString ("KO2_Verb_TOG;8209\n", 18, fhdlOut);
            filePutString ("KO2_Verb_TOG/Kombi_2;8209\n", 26, fhdlOut);
            filePutString ("KO2_Verb_TOG/DSP2;8209\n", 23, fhdlOut);
            filePutString ("KO2_Wischwasser;8210\n", 21, fhdlOut);
            filePutString ("KO2_Wischwasser/Kombi_2;8210\n", 29, fhdlOut);
            filePutString ("KO2_Wischwasser/DSP2;8210\n", 26, fhdlOut);
            filePutString ("KO2_gef_Auss_T;8211\n", 20, fhdlOut);
            filePutString ("KO2_gef_Auss_T/Kombi_2;8211\n", 28, fhdlOut);
            filePutString ("KO2_gef_Auss_T/DSP2;8211\n", 25, fhdlOut);
            filePutString ("MFA_Strecke_Einheit;8212\n", 25, fhdlOut);
            filePutString ("MFA_Strecke_Einheit/Kombi_2;8212\n", 33, fhdlOut);
            filePutString ("MFA_Strecke_Einheit/DSP2;8212\n", 30, fhdlOut);
            filePutString ("KBI_Oelwechsel_durchgefuehrt;8448\n", 34, fhdlOut);
            filePutString ("KBI_Oelwechsel_durchgefuehrt/Kombi_3;8448\n", 42, fhdlOut);
            filePutString ("KBI_Oelwechsel_durchgefuehrt/DSP3;8448\n", 39, fhdlOut);
            filePutString ("KO3_Baureihe;8449\n", 18, fhdlOut);
            filePutString ("KO3_Baureihe/Kombi_3;8449\n", 26, fhdlOut);
            filePutString ("KO3_Baureihe/DSP3;8449\n", 23, fhdlOut);
            filePutString ("KO3_Derivat;8450\n", 17, fhdlOut);
            filePutString ("KO3_Derivat/Kombi_3;8450\n", 25, fhdlOut);
            filePutString ("KO3_Derivat/DSP3;8450\n", 22, fhdlOut);
            filePutString ("KO3_Generation;8451\n", 20, fhdlOut);
            filePutString ("KO3_Generation/Kombi_3;8451\n", 28, fhdlOut);
            filePutString ("KO3_Generation/DSP3;8451\n", 25, fhdlOut);
            filePutString ("KO3_Kilometer;8452\n", 19, fhdlOut);
            filePutString ("KO3_Kilometer/Kombi_3;8452\n", 27, fhdlOut);
            filePutString ("KO3_Kilometer/DSP3;8452\n", 24, fhdlOut);
            filePutString ("KO3_Land;8453\n", 14, fhdlOut);
            filePutString ("KO3_Land/Kombi_3;8453\n", 22, fhdlOut);
            filePutString ("KO3_Land/DSP3;8453\n", 19, fhdlOut);
            filePutString ("KO3_Marke;8454\n", 15, fhdlOut);
            filePutString ("KO3_Marke/Kombi_3;8454\n", 23, fhdlOut);
            filePutString ("KO3_Marke/DSP3;8454\n", 20, fhdlOut);
            filePutString ("KO3_Mp_Code;8455\n", 17, fhdlOut);
            filePutString ("KO3_Mp_Code/Kombi_3;8455\n", 25, fhdlOut);
            filePutString ("KO3_Mp_Code/DSP3;8455\n", 22, fhdlOut);
            filePutString ("KO3_Radumfang;8456\n", 19, fhdlOut);
            filePutString ("KO3_Radumfang/Kombi_3;8456\n", 27, fhdlOut);
            filePutString ("KO3_Radumfang/DSP3;8456\n", 24, fhdlOut);
            filePutString ("KO3_Reserve1;8457\n", 18, fhdlOut);
            filePutString ("KO3_Reserve1/Kombi_3;8457\n", 26, fhdlOut);
            filePutString ("KO3_Reserve1/DSP3;8457\n", 23, fhdlOut);
            filePutString ("KO3_Reserve2;8458\n", 18, fhdlOut);
            filePutString ("KO3_Reserve2/Kombi_3;8458\n", 26, fhdlOut);
            filePutString ("KO3_Reserve2/DSP3;8458\n", 23, fhdlOut);
            filePutString ("KO3_SWA_AnzFeh;8459\n", 20, fhdlOut);
            filePutString ("KO3_SWA_AnzFeh/Kombi_3;8459\n", 28, fhdlOut);
            filePutString ("KO3_SWA_AnzFeh/DSP3;8459\n", 25, fhdlOut);
            filePutString ("KO3_Schluessel;8460\n", 20, fhdlOut);
            filePutString ("KO3_Schluessel/Kombi_3;8460\n", 28, fhdlOut);
            filePutString ("KO3_Schluessel/DSP3;8460\n", 25, fhdlOut);
            filePutString ("KO3_Sprache;8461\n", 17, fhdlOut);
            filePutString ("KO3_Sprache/Kombi_3;8461\n", 25, fhdlOut);
            filePutString ("KO3_Sprache/DSP3;8461\n", 22, fhdlOut);
            filePutString ("KO3_Sta_Standz;8462\n", 20, fhdlOut);
            filePutString ("KO3_Sta_Standz/Kombi_3;8462\n", 28, fhdlOut);
            filePutString ("KO3_Sta_Standz/DSP3;8462\n", 25, fhdlOut);
            filePutString ("KO3_Standzeit;8463\n", 19, fhdlOut);
            filePutString ("KO3_Standzeit/Kombi_3;8463\n", 27, fhdlOut);
            filePutString ("KO3_Standzeit/DSP3;8463\n", 24, fhdlOut);
            filePutString ("KO3_Verbau_ADR;8464\n", 20, fhdlOut);
            filePutString ("KO3_Verbau_ADR/Kombi_3;8464\n", 28, fhdlOut);
            filePutString ("KO3_Verbau_ADR/DSP3;8464\n", 25, fhdlOut);
            filePutString ("KO3_Verbau_Air;8465\n", 20, fhdlOut);
            filePutString ("KO3_Verbau_Air/Kombi_3;8465\n", 28, fhdlOut);
            filePutString ("KO3_Verbau_Air/DSP3;8465\n", 25, fhdlOut);
            filePutString ("KO3_Verbau_BN;8466\n", 19, fhdlOut);
            filePutString ("KO3_Verbau_BN/Kombi_3;8466\n", 27, fhdlOut);
            filePutString ("KO3_Verbau_BN/DSP3;8466\n", 24, fhdlOut);
            filePutString ("KO3_Verbau_Br;8467\n", 19, fhdlOut);
            filePutString ("KO3_Verbau_Br/Kombi_3;8467\n", 27, fhdlOut);
            filePutString ("KO3_Verbau_Br/DSP3;8467\n", 24, fhdlOut);
            filePutString ("KO3_Verbau_DP;8468\n", 19, fhdlOut);
            filePutString ("KO3_Verbau_DP/Kombi_3;8468\n", 27, fhdlOut);
            filePutString ("KO3_Verbau_DP/DSP3;8468\n", 24, fhdlOut);
            filePutString ("KO3_Verbau_Get;8469\n", 20, fhdlOut);
            filePutString ("KO3_Verbau_Get/Kombi_3;8469\n", 28, fhdlOut);
            filePutString ("KO3_Verbau_Get/DSP3;8469\n", 25, fhdlOut);
            filePutString ("KO3_Verbau_Kl;8470\n", 19, fhdlOut);
            filePutString ("KO3_Verbau_Kl/Kombi_3;8470\n", 27, fhdlOut);
            filePutString ("KO3_Verbau_Kl/DSP3;8470\n", 24, fhdlOut);
            filePutString ("KO3_Verbau_LH;8471\n", 19, fhdlOut);
            filePutString ("KO3_Verbau_LH/Kombi_3;8471\n", 27, fhdlOut);
            filePutString ("KO3_Verbau_LH/DSP3;8471\n", 24, fhdlOut);
            filePutString ("KO3_Verbau_LWS;8472\n", 20, fhdlOut);
            filePutString ("KO3_Verbau_LWS/Kombi_3;8472\n", 28, fhdlOut);
            filePutString ("KO3_Verbau_LWS/DSP3;8472\n", 25, fhdlOut);
            filePutString ("KO3_Verbau_Mot;8473\n", 20, fhdlOut);
            filePutString ("KO3_Verbau_Mot/Kombi_3;8473\n", 28, fhdlOut);
            filePutString ("KO3_Verbau_Mot/DSP3;8473\n", 25, fhdlOut);
            filePutString ("KO3_Verbau_Niveau;8474\n", 23, fhdlOut);
            filePutString ("KO3_Verbau_Niveau/Kombi_3;8474\n", 31, fhdlOut);
            filePutString ("KO3_Verbau_Niveau/DSP3;8474\n", 28, fhdlOut);
            filePutString ("KO3_Verbau_Syn;8475\n", 20, fhdlOut);
            filePutString ("KO3_Verbau_Syn/Kombi_3;8475\n", 28, fhdlOut);
            filePutString ("KO3_Verbau_Syn/DSP3;8475\n", 25, fhdlOut);
            filePutString ("LW1_CRC;8704\n", 13, fhdlOut);
            filePutString ("LW1_CRC/LW_1;8704\n", 18, fhdlOut);
            filePutString ("LW1_CRC/LWS1;8704\n", 18, fhdlOut);
            filePutString ("LW1_Gesch_Sign;8705\n", 20, fhdlOut);
            filePutString ("LW1_Gesch_Sign/LW_1;8705\n", 25, fhdlOut);
            filePutString ("LW1_Gesch_Sign/LWS1;8705\n", 25, fhdlOut);
            filePutString ("LW1_ID;8706\n", 12, fhdlOut);
            filePutString ("LW1_ID/LW_1;8706\n", 17, fhdlOut);
            filePutString ("LW1_ID/LWS1;8706\n", 17, fhdlOut);
            filePutString ("LW1_Initquelle;8707\n", 20, fhdlOut);
            filePutString ("LW1_Initquelle/LW_1;8707\n", 25, fhdlOut);
            filePutString ("LW1_Initquelle/LWS1;8707\n", 25, fhdlOut);
            filePutString ("LW1_Kodier;8708\n", 16, fhdlOut);
            filePutString ("LW1_Kodier/LW_1;8708\n", 21, fhdlOut);
            filePutString ("LW1_Kodier/LWS1;8708\n", 21, fhdlOut);
            filePutString ("LW1_LRW;8709\n", 13, fhdlOut);
            filePutString ("LW1_LRW/LW_1;8709\n", 18, fhdlOut);
            filePutString ("LW1_LRW/LWS1;8709\n", 18, fhdlOut);
            filePutString ("LW1_LRW_Sign;8710\n", 18, fhdlOut);
            filePutString ("LW1_LRW_Sign/LW_1;8710\n", 23, fhdlOut);
            filePutString ("LW1_LRW_Sign/LWS1;8710\n", 23, fhdlOut);
            filePutString ("LW1_Lenk_Gesch;8711\n", 20, fhdlOut);
            filePutString ("LW1_Lenk_Gesch/LW_1;8711\n", 25, fhdlOut);
            filePutString ("LW1_Lenk_Gesch/LWS1;8711\n", 25, fhdlOut);
            filePutString ("LW1_Sta_KL30;8712\n", 18, fhdlOut);
            filePutString ("LW1_Sta_KL30/LW_1;8712\n", 23, fhdlOut);
            filePutString ("LW1_Sta_KL30/LWS1;8712\n", 23, fhdlOut);
            filePutString ("LW1_Status;8713\n", 16, fhdlOut);
            filePutString ("LW1_Status/LW_1;8713\n", 21, fhdlOut);
            filePutString ("LW1_Status/LWS1;8713\n", 21, fhdlOut);
            filePutString ("LW1_Zaehler;8714\n", 17, fhdlOut);
            filePutString ("LW1_Zaehler/LW_1;8714\n", 22, fhdlOut);
            filePutString ("LW1_Zaehler/LWS1;8714\n", 22, fhdlOut);
            filePutString ("LH3_BLW;8960\n", 13, fhdlOut);
            filePutString ("LH3_BLW/Lenkhilfe_3;8960\n", 25, fhdlOut);
            filePutString ("LH3_BLW/LH3;8960\n", 17, fhdlOut);
            filePutString ("LH3_BLWSign;8961\n", 17, fhdlOut);
            filePutString ("LH3_BLWSign/Lenkhilfe_3;8961\n", 29, fhdlOut);
            filePutString ("LH3_BLWSign/LH3;8961\n", 21, fhdlOut);
            filePutString ("LH3_BLWValid;8962\n", 18, fhdlOut);
            filePutString ("LH3_BLWValid/Lenkhilfe_3;8962\n", 30, fhdlOut);
            filePutString ("LH3_BLWValid/LH3;8962\n", 22, fhdlOut);
            filePutString ("LH3_BS_Spiegel;8963\n", 20, fhdlOut);
            filePutString ("LH3_BS_Spiegel/Lenkhilfe_3;8963\n", 32, fhdlOut);
            filePutString ("LH3_BS_Spiegel/LH3;8963\n", 24, fhdlOut);
            filePutString ("LH3_Checksumme;8964\n", 20, fhdlOut);
            filePutString ("LH3_Checksumme/Lenkhilfe_3;8964\n", 32, fhdlOut);
            filePutString ("LH3_Checksumme/LH3;8964\n", 24, fhdlOut);
            filePutString ("LH3_LM;8965\n", 12, fhdlOut);
            filePutString ("LH3_LM/Lenkhilfe_3;8965\n", 24, fhdlOut);
            filePutString ("LH3_LM/LH3;8965\n", 16, fhdlOut);
            filePutString ("LH3_LMSign;8966\n", 16, fhdlOut);
            filePutString ("LH3_LMSign/Lenkhilfe_3;8966\n", 28, fhdlOut);
            filePutString ("LH3_LMSign/LH3;8966\n", 20, fhdlOut);
            filePutString ("LH3_LMValid;8967\n", 17, fhdlOut);
            filePutString ("LH3_LMValid/Lenkhilfe_3;8967\n", 29, fhdlOut);
            filePutString ("LH3_LMValid/LH3;8967\n", 21, fhdlOut);
            filePutString ("LH3_Lenkungstyp;8968\n", 21, fhdlOut);
            filePutString ("LH3_Lenkungstyp/Lenkhilfe_3;8968\n", 33, fhdlOut);
            filePutString ("LH3_Lenkungstyp/LH3;8968\n", 25, fhdlOut);
            filePutString ("LH3_Sta_DSR;8969\n", 17, fhdlOut);
            filePutString ("LH3_Sta_DSR/Lenkhilfe_3;8969\n", 29, fhdlOut);
            filePutString ("LH3_Sta_DSR/LH3;8969\n", 21, fhdlOut);
            filePutString ("LH3_Zaehler;8970\n", 17, fhdlOut);
            filePutString ("LH3_Zaehler/Lenkhilfe_3;8970\n", 29, fhdlOut);
            filePutString ("LH3_Zaehler/LH3;8970\n", 21, fhdlOut);
            filePutString ("NMH_GW_Abschaltstufe_aktiv;9216\n", 32, fhdlOut);
            filePutString ("NMH_GW_Abschaltstufe_aktiv/NMH_Gateway;9216\n", 44, fhdlOut);
            filePutString ("NMH_GW_Abschaltstufe_aktiv/NMH_Gateway;9216\n", 44, fhdlOut);
            filePutString ("NMH_GW_CAN_Diag_deaktiv;9217\n", 29, fhdlOut);
            filePutString ("NMH_GW_CAN_Diag_deaktiv/NMH_Gateway;9217\n", 41, fhdlOut);
            filePutString ("NMH_GW_CAN_Diag_deaktiv/NMH_Gateway;9217\n", 41, fhdlOut);
            filePutString ("NMH_GW_Car_WakeUp;9218\n", 23, fhdlOut);
            filePutString ("NMH_GW_Car_WakeUp/NMH_Gateway;9218\n", 35, fhdlOut);
            filePutString ("NMH_GW_Car_WakeUp/NMH_Gateway;9218\n", 35, fhdlOut);
            filePutString ("NMH_GW_Eindraht_Fehler;9219\n", 28, fhdlOut);
            filePutString ("NMH_GW_Eindraht_Fehler/NMH_Gateway;9219\n", 40, fhdlOut);
            filePutString ("NMH_GW_Eindraht_Fehler/NMH_Gateway;9219\n", 40, fhdlOut);
            filePutString ("NMH_GW_Fkt_WakeUp;9220\n", 23, fhdlOut);
            filePutString ("NMH_GW_Fkt_WakeUp/NMH_Gateway;9220\n", 35, fhdlOut);
            filePutString ("NMH_GW_Fkt_WakeUp/NMH_Gateway;9220\n", 35, fhdlOut);
            filePutString ("NMH_GW_KompSchutz;9221\n", 23, fhdlOut);
            filePutString ("NMH_GW_KompSchutz/NMH_Gateway;9221\n", 35, fhdlOut);
            filePutString ("NMH_GW_KompSchutz/NMH_Gateway;9221\n", 35, fhdlOut);
            filePutString ("NMH_GW_Mute_Mode;9222\n", 22, fhdlOut);
            filePutString ("NMH_GW_Mute_Mode/NMH_Gateway;9222\n", 34, fhdlOut);
            filePutString ("NMH_GW_Mute_Mode/NMH_Gateway;9222\n", 34, fhdlOut);
            filePutString ("NMH_GW_NL_0;9223\n", 17, fhdlOut);
            filePutString ("NMH_GW_NL_0/NMH_Gateway;9223\n", 29, fhdlOut);
            filePutString ("NMH_GW_NL_0/NMH_Gateway;9223\n", 29, fhdlOut);
            filePutString ("NMH_GW_NL_1;9224\n", 17, fhdlOut);
            filePutString ("NMH_GW_NL_1/NMH_Gateway;9224\n", 29, fhdlOut);
            filePutString ("NMH_GW_NL_1/NMH_Gateway;9224\n", 29, fhdlOut);
            filePutString ("NMH_GW_NL_2;9225\n", 17, fhdlOut);
            filePutString ("NMH_GW_NL_2/NMH_Gateway;9225\n", 29, fhdlOut);
            filePutString ("NMH_GW_NL_2/NMH_Gateway;9225\n", 29, fhdlOut);
            filePutString ("NMH_GW_NL_3;9226\n", 17, fhdlOut);
            filePutString ("NMH_GW_NL_3/NMH_Gateway;9226\n", 29, fhdlOut);
            filePutString ("NMH_GW_NL_3/NMH_Gateway;9226\n", 29, fhdlOut);
            filePutString ("NMH_GW_NL_4;9227\n", 17, fhdlOut);
            filePutString ("NMH_GW_NL_4/NMH_Gateway;9227\n", 29, fhdlOut);
            filePutString ("NMH_GW_NL_4/NMH_Gateway;9227\n", 29, fhdlOut);
            filePutString ("NMH_GW_NL_5;9228\n", 17, fhdlOut);
            filePutString ("NMH_GW_NL_5/NMH_Gateway;9228\n", 29, fhdlOut);
            filePutString ("NMH_GW_NL_5/NMH_Gateway;9228\n", 29, fhdlOut);
            filePutString ("NMH_GW_NL_6;9229\n", 17, fhdlOut);
            filePutString ("NMH_GW_NL_6/NMH_Gateway;9229\n", 29, fhdlOut);
            filePutString ("NMH_GW_NL_6/NMH_Gateway;9229\n", 29, fhdlOut);
            filePutString ("NMH_GW_NL_7;9230\n", 17, fhdlOut);
            filePutString ("NMH_GW_NL_7/NMH_Gateway;9230\n", 29, fhdlOut);
            filePutString ("NMH_GW_NL_7/NMH_Gateway;9230\n", 29, fhdlOut);
            filePutString ("NMH_GW_NL_aktiv_4;9231\n", 23, fhdlOut);
            filePutString ("NMH_GW_NL_aktiv_4/NMH_Gateway;9231\n", 35, fhdlOut);
            filePutString ("NMH_GW_NL_aktiv_4/NMH_Gateway;9231\n", 35, fhdlOut);
            filePutString ("NMH_GW_NL_aktiv_5;9232\n", 23, fhdlOut);
            filePutString ("NMH_GW_NL_aktiv_5/NMH_Gateway;9232\n", 35, fhdlOut);
            filePutString ("NMH_GW_NL_aktiv_5/NMH_Gateway;9232\n", 35, fhdlOut);
            filePutString ("NMH_GW_NL_aktiv_6;9233\n", 23, fhdlOut);
            filePutString ("NMH_GW_NL_aktiv_6/NMH_Gateway;9233\n", 35, fhdlOut);
            filePutString ("NMH_GW_NL_aktiv_6/NMH_Gateway;9233\n", 35, fhdlOut);
            filePutString ("NMH_GW_NL_aktiv_7;9234\n", 23, fhdlOut);
            filePutString ("NMH_GW_NL_aktiv_7/NMH_Gateway;9234\n", 35, fhdlOut);
            filePutString ("NMH_GW_NL_aktiv_7/NMH_Gateway;9234\n", 35, fhdlOut);
            filePutString ("NMH_GW_NL_aktiv_8;9235\n", 23, fhdlOut);
            filePutString ("NMH_GW_NL_aktiv_8/NMH_Gateway;9235\n", 35, fhdlOut);
            filePutString ("NMH_GW_NL_aktiv_8/NMH_Gateway;9235\n", 35, fhdlOut);
            filePutString ("NMH_GW_NM_aktiv_Diagnose;9236\n", 30, fhdlOut);
            filePutString ("NMH_GW_NM_aktiv_Diagnose/NMH_Gateway;9236\n", 42, fhdlOut);
            filePutString ("NMH_GW_NM_aktiv_Diagnose/NMH_Gateway;9236\n", 42, fhdlOut);
            filePutString ("NMH_GW_NM_aktiv_Klemme_15;9237\n", 31, fhdlOut);
            filePutString ("NMH_GW_NM_aktiv_Klemme_15/NMH_Gateway;9237\n", 43, fhdlOut);
            filePutString ("NMH_GW_NM_aktiv_Klemme_15/NMH_Gateway;9237\n", 43, fhdlOut);
            filePutString ("NMH_GW_NM_aktiv_Start;9238\n", 27, fhdlOut);
            filePutString ("NMH_GW_NM_aktiv_Start/NMH_Gateway;9238\n", 39, fhdlOut);
            filePutString ("NMH_GW_NM_aktiv_Start/NMH_Gateway;9238\n", 39, fhdlOut);
            filePutString ("NMH_GW_Normal_Mode_1;9239\n", 26, fhdlOut);
            filePutString ("NMH_GW_Normal_Mode_1/NMH_Gateway;9239\n", 38, fhdlOut);
            filePutString ("NMH_GW_Normal_Mode_1/NMH_Gateway;9239\n", 38, fhdlOut);
            filePutString ("NMH_GW_Normal_Mode_2;9240\n", 26, fhdlOut);
            filePutString ("NMH_GW_Normal_Mode_2/NMH_Gateway;9240\n", 38, fhdlOut);
            filePutString ("NMH_GW_Normal_Mode_2/NMH_Gateway;9240\n", 38, fhdlOut);
            filePutString ("NMH_GW_Per_WakeUp;9241\n", 23, fhdlOut);
            filePutString ("NMH_GW_Per_WakeUp/NMH_Gateway;9241\n", 35, fhdlOut);
            filePutString ("NMH_GW_Per_WakeUp/NMH_Gateway;9241\n", 35, fhdlOut);
            filePutString ("NMH_GW_Start_1;9242\n", 20, fhdlOut);
            filePutString ("NMH_GW_Start_1/NMH_Gateway;9242\n", 32, fhdlOut);
            filePutString ("NMH_GW_Start_1/NMH_Gateway;9242\n", 32, fhdlOut);
            filePutString ("NMH_GW_Start_2;9243\n", 20, fhdlOut);
            filePutString ("NMH_GW_Start_2/NMH_Gateway;9243\n", 32, fhdlOut);
            filePutString ("NMH_GW_Start_2/NMH_Gateway;9243\n", 32, fhdlOut);
            filePutString ("NMH_GW_TimeOut_Fehler;9244\n", 27, fhdlOut);
            filePutString ("NMH_GW_TimeOut_Fehler/NMH_Gateway;9244\n", 39, fhdlOut);
            filePutString ("NMH_GW_TimeOut_Fehler/NMH_Gateway;9244\n", 39, fhdlOut);
            filePutString ("NMH_GW_Transport_Mode;9245\n", 27, fhdlOut);
            filePutString ("NMH_GW_Transport_Mode/NMH_Gateway;9245\n", 39, fhdlOut);
            filePutString ("NMH_GW_Transport_Mode/NMH_Gateway;9245\n", 39, fhdlOut);
            filePutString ("Absenkung_Fahrzeug;9472\n", 24, fhdlOut);
            filePutString ("Absenkung_Fahrzeug/Niveau_1;9472\n", 33, fhdlOut);
            filePutString ("Absenkung_Fahrzeug/LVL1;9472\n", 29, fhdlOut);
            filePutString ("Anhebung_Fahrzeug;9473\n", 23, fhdlOut);
            filePutString ("Anhebung_Fahrzeug/Niveau_1;9473\n", 32, fhdlOut);
            filePutString ("Anhebung_Fahrzeug/LVL1;9473\n", 28, fhdlOut);
            filePutString ("Aufpruefbit_Warnlampe_Niveau;9474\n", 34, fhdlOut);
            filePutString ("Aufpruefbit_Warnlampe_Niveau/Niveau_1;9474\n", 43, fhdlOut);
            filePutString ("Aufpruefbit_Warnlampe_Niveau/LVL1;9474\n", 39, fhdlOut);
            filePutString ("Beladungszustand;9475\n", 22, fhdlOut);
            filePutString ("Beladungszustand/Niveau_1;9475\n", 31, fhdlOut);
            filePutString ("Beladungszustand/LVL1;9475\n", 27, fhdlOut);
            filePutString ("ESP_Beeinflussung;9476\n", 23, fhdlOut);
            filePutString ("ESP_Beeinflussung/Niveau_1;9476\n", 32, fhdlOut);
            filePutString ("ESP_Beeinflussung/LVL1;9476\n", 28, fhdlOut);
            filePutString ("FSPE_Niveau1;9477\n", 18, fhdlOut);
            filePutString ("FSPE_Niveau1/Niveau_1;9477\n", 27, fhdlOut);
            filePutString ("FSPE_Niveau1/LVL1;9477\n", 23, fhdlOut);
            filePutString ("Fehlerlampe_Niveau;9478\n", 24, fhdlOut);
            filePutString ("Fehlerlampe_Niveau/Niveau_1;9478\n", 33, fhdlOut);
            filePutString ("Fehlerlampe_Niveau/LVL1;9478\n", 29, fhdlOut);
            filePutString ("Kompressor_laeuft;9479\n", 23, fhdlOut);
            filePutString ("Kompressor_laeuft/Niveau_1;9479\n", 32, fhdlOut);
            filePutString ("Kompressor_laeuft/LVL1;9479\n", 28, fhdlOut);
            filePutString ("Kompressorlauf_in_Kuerze;9480\n", 30, fhdlOut);
            filePutString ("Kompressorlauf_in_Kuerze/Niveau_1;9480\n", 39, fhdlOut);
            filePutString ("Kompressorlauf_in_Kuerze/LVL1;9480\n", 35, fhdlOut);
            filePutString ("NI1_Checksum;9481\n", 18, fhdlOut);
            filePutString ("NI1_Checksum/Niveau_1;9481\n", 27, fhdlOut);
            filePutString ("NI1_Checksum/LVL1;9481\n", 23, fhdlOut);
            filePutString ("NI1_Fahrzeugart;9482\n", 21, fhdlOut);
            filePutString ("NI1_Fahrzeugart/Niveau_1;9482\n", 30, fhdlOut);
            filePutString ("NI1_Fahrzeugart/LVL1;9482\n", 26, fhdlOut);
            filePutString ("NI1_MSG_Eingriff;9483\n", 22, fhdlOut);
            filePutString ("NI1_MSG_Eingriff/Niveau_1;9483\n", 31, fhdlOut);
            filePutString ("NI1_MSG_Eingriff/LVL1;9483\n", 27, fhdlOut);
            filePutString ("NI1_Zaehler;9484\n", 17, fhdlOut);
            filePutString ("NI1_Zaehler/Niveau_1;9484\n", 26, fhdlOut);
            filePutString ("NI1_Zaehler/LVL1;9484\n", 22, fhdlOut);
            filePutString ("Niveaustati;9485\n", 17, fhdlOut);
            filePutString ("Niveaustati/Niveau_1;9485\n", 26, fhdlOut);
            filePutString ("Niveaustati/LVL1;9485\n", 22, fhdlOut);
            filePutString ("Parkniveau;9486\n", 16, fhdlOut);
            filePutString ("Parkniveau/Niveau_1;9486\n", 25, fhdlOut);
            filePutString ("Parkniveau/LVL1;9486\n", 21, fhdlOut);
            filePutString ("SIB_Niveau;9487\n", 16, fhdlOut);
            filePutString ("SIB_Niveau/Niveau_1;9487\n", 25, fhdlOut);
            filePutString ("SIB_Niveau/LVL1;9487\n", 21, fhdlOut);
            filePutString ("Stromaufnahme;9488\n", 19, fhdlOut);
            filePutString ("Stromaufnahme/Niveau_1;9488\n", 28, fhdlOut);
            filePutString ("Stromaufnahme/LVL1;9488\n", 24, fhdlOut);
            filePutString ("Systemstatus;9489\n", 18, fhdlOut);
            filePutString ("Systemstatus/Niveau_1;9489\n", 27, fhdlOut);
            filePutString ("Systemstatus/LVL1;9489\n", 23, fhdlOut);
            filePutString ("Taster_Niveau;9490\n", 19, fhdlOut);
            filePutString ("Taster_Niveau/Niveau_1;9490\n", 28, fhdlOut);
            filePutString ("Taster_Niveau/LVL1;9490\n", 24, fhdlOut);
            filePutString ("Textbits_Niveau;9491\n", 21, fhdlOut);
            filePutString ("Textbits_Niveau/Niveau_1;9491\n", 30, fhdlOut);
            filePutString ("Textbits_Niveau/LVL1;9491\n", 26, fhdlOut);
            filePutString ("Tiefniveaulampe;9492\n", 21, fhdlOut);
            filePutString ("Tiefniveaulampe/Niveau_1;9492\n", 30, fhdlOut);
            filePutString ("Tiefniveaulampe/LVL1;9492\n", 26, fhdlOut);
            filePutString ("Verstellung_HL;9493\n", 20, fhdlOut);
            filePutString ("Verstellung_HL/Niveau_1;9493\n", 29, fhdlOut);
            filePutString ("Verstellung_HL/LVL1;9493\n", 25, fhdlOut);
            filePutString ("Verstellung_HR;9494\n", 20, fhdlOut);
            filePutString ("Verstellung_HR/Niveau_1;9494\n", 29, fhdlOut);
            filePutString ("Verstellung_HR/LVL1;9494\n", 25, fhdlOut);
            filePutString ("Verstellung_VL;9495\n", 20, fhdlOut);
            filePutString ("Verstellung_VL/Niveau_1;9495\n", 29, fhdlOut);
            filePutString ("Verstellung_VL/LVL1;9495\n", 25, fhdlOut);
            filePutString ("Verstellung_VR;9496\n", 20, fhdlOut);
            filePutString ("Verstellung_VR/Niveau_1;9496\n", 29, fhdlOut);
            filePutString ("Verstellung_VR/LVL1;9496\n", 25, fhdlOut);
            filePutString ("Verstellung_aktiv;9497\n", 23, fhdlOut);
            filePutString ("Verstellung_aktiv/Niveau_1;9497\n", 32, fhdlOut);
            filePutString ("Verstellung_aktiv/LVL1;9497\n", 28, fhdlOut);
            filePutString ("Verstellung_in_Kuerze;9498\n", 27, fhdlOut);
            filePutString ("Verstellung_in_Kuerze/Niveau_1;9498\n", 36, fhdlOut);
            filePutString ("Verstellung_in_Kuerze/LVL1;9498\n", 32, fhdlOut);
            filePutString ("Warnlampe;9499\n", 15, fhdlOut);
            filePutString ("Warnlampe/Niveau_1;9499\n", 24, fhdlOut);
            filePutString ("Warnlampe/LVL1;9499\n", 20, fhdlOut);
            filePutString ("Zwischenniveau;9500\n", 20, fhdlOut);
            filePutString ("Zwischenniveau/Niveau_1;9500\n", 29, fhdlOut);
            filePutString ("Zwischenniveau/LVL1;9500\n", 25, fhdlOut);
            filePutString ("OBD_TG_F_Status_1;9728\n", 23, fhdlOut);
            filePutString ("OBD_TG_F_Status_1/OBD_Tankgeber_01;9728\n", 40, fhdlOut);
            filePutString ("OBD_TG_F_Status_1/FLS01;9728\n", 29, fhdlOut);
            filePutString ("OBD_TG_F_Status_2;9729\n", 23, fhdlOut);
            filePutString ("OBD_TG_F_Status_2/OBD_Tankgeber_01;9729\n", 40, fhdlOut);
            filePutString ("OBD_TG_F_Status_2/FLS01;9729\n", 29, fhdlOut);
            filePutString ("OBD_TG_F_Status_3;9730\n", 23, fhdlOut);
            filePutString ("OBD_TG_F_Status_3/OBD_Tankgeber_01;9730\n", 40, fhdlOut);
            filePutString ("OBD_TG_F_Status_3/FLS01;9730\n", 29, fhdlOut);
            filePutString ("OBD_TG_F_Status_4;9731\n", 23, fhdlOut);
            filePutString ("OBD_TG_F_Status_4/OBD_Tankgeber_01;9731\n", 40, fhdlOut);
            filePutString ("OBD_TG_F_Status_4/FLS01;9731\n", 29, fhdlOut);
            filePutString ("OBD_TG_Sens_Rohwert_1;9732\n", 27, fhdlOut);
            filePutString ("OBD_TG_Sens_Rohwert_1/OBD_Tankgeber_01;9732\n", 44, fhdlOut);
            filePutString ("OBD_TG_Sens_Rohwert_1/FLS01;9732\n", 33, fhdlOut);
            filePutString ("OBD_TG_Sens_Rohwert_2;9733\n", 27, fhdlOut);
            filePutString ("OBD_TG_Sens_Rohwert_2/OBD_Tankgeber_01;9733\n", 44, fhdlOut);
            filePutString ("OBD_TG_Sens_Rohwert_2/FLS01;9733\n", 33, fhdlOut);
            filePutString ("OBD_TG_Sens_Rohwert_3;9734\n", 27, fhdlOut);
            filePutString ("OBD_TG_Sens_Rohwert_3/OBD_Tankgeber_01;9734\n", 44, fhdlOut);
            filePutString ("OBD_TG_Sens_Rohwert_3/FLS01;9734\n", 33, fhdlOut);
            filePutString ("OBD_TG_Sens_Rohwert_4;9735\n", 27, fhdlOut);
            filePutString ("OBD_TG_Sens_Rohwert_4/OBD_Tankgeber_01;9735\n", 44, fhdlOut);
            filePutString ("OBD_TG_Sens_Rohwert_4/FLS01;9735\n", 33, fhdlOut);
            filePutString ("PH_Abschaltursache;9984\n", 24, fhdlOut);
            filePutString ("PH_Abschaltursache/Parkhilfe_01;9984\n", 37, fhdlOut);
            filePutString ("PH_Abschaltursache/PRKH01;9984\n", 31, fhdlOut);
            filePutString ("PH_Anf_Audioabsenkung;9985\n", 27, fhdlOut);
            filePutString ("PH_Anf_Audioabsenkung/Parkhilfe_01;9985\n", 40, fhdlOut);
            filePutString ("PH_Anf_Audioabsenkung/PRKH01;9985\n", 34, fhdlOut);
            filePutString ("PH_Aufbauten_erk;9986\n", 22, fhdlOut);
            filePutString ("PH_Aufbauten_erk/Parkhilfe_01;9986\n", 35, fhdlOut);
            filePutString ("PH_Aufbauten_erk/PRKH01;9986\n", 29, fhdlOut);
            filePutString ("PH_BerErk_hinten;9987\n", 22, fhdlOut);
            filePutString ("PH_BerErk_hinten/Parkhilfe_01;9987\n", 35, fhdlOut);
            filePutString ("PH_BerErk_hinten/PRKH01;9987\n", 29, fhdlOut);
            filePutString ("PH_BerErk_vorn;9988\n", 20, fhdlOut);
            filePutString ("PH_BerErk_vorn/Parkhilfe_01;9988\n", 33, fhdlOut);
            filePutString ("PH_BerErk_vorn/PRKH01;9988\n", 27, fhdlOut);
            filePutString ("PH_Display_Kundenwunsch;9989\n", 29, fhdlOut);
            filePutString ("PH_Display_Kundenwunsch/Parkhilfe_01;9989\n", 42, fhdlOut);
            filePutString ("PH_Display_Kundenwunsch/PRKH01;9989\n", 36, fhdlOut);
            filePutString ("PH_Frequenz_hinten;9990\n", 24, fhdlOut);
            filePutString ("PH_Frequenz_hinten/Parkhilfe_01;9990\n", 37, fhdlOut);
            filePutString ("PH_Frequenz_hinten/PRKH01;9990\n", 31, fhdlOut);
            filePutString ("PH_Frequenz_vorn;9991\n", 22, fhdlOut);
            filePutString ("PH_Frequenz_vorn/Parkhilfe_01;9991\n", 35, fhdlOut);
            filePutString ("PH_Frequenz_vorn/PRKH01;9991\n", 29, fhdlOut);
            filePutString ("PH_KD_Fehler;9992\n", 18, fhdlOut);
            filePutString ("PH_KD_Fehler/Parkhilfe_01;9992\n", 31, fhdlOut);
            filePutString ("PH_KD_Fehler/PRKH01;9992\n", 25, fhdlOut);
            filePutString ("PH_Lautstaerke_hinten;9993\n", 27, fhdlOut);
            filePutString ("PH_Lautstaerke_hinten/Parkhilfe_01;9993\n", 40, fhdlOut);
            filePutString ("PH_Lautstaerke_hinten/PRKH01;9993\n", 34, fhdlOut);
            filePutString ("PH_Lautstaerke_vorn;9994\n", 25, fhdlOut);
            filePutString ("PH_Lautstaerke_vorn/Parkhilfe_01;9994\n", 38, fhdlOut);
            filePutString ("PH_Lautstaerke_vorn/PRKH01;9994\n", 32, fhdlOut);
            filePutString ("PH_Opt_Anz_H_Hindernis;9995\n", 28, fhdlOut);
            filePutString ("PH_Opt_Anz_H_Hindernis/Parkhilfe_01;9995\n", 41, fhdlOut);
            filePutString ("PH_Opt_Anz_H_Hindernis/PRKH01;9995\n", 35, fhdlOut);
            filePutString ("PH_Opt_Anz_V_Hindernis;9996\n", 28, fhdlOut);
            filePutString ("PH_Opt_Anz_V_Hindernis/Parkhilfe_01;9996\n", 41, fhdlOut);
            filePutString ("PH_Opt_Anz_V_Hindernis/PRKH01;9996\n", 35, fhdlOut);
            filePutString ("PH_Opt_Anzeige_H_ein;9997\n", 26, fhdlOut);
            filePutString ("PH_Opt_Anzeige_H_ein/Parkhilfe_01;9997\n", 39, fhdlOut);
            filePutString ("PH_Opt_Anzeige_H_ein/PRKH01;9997\n", 33, fhdlOut);
            filePutString ("PH_Opt_Anzeige_V_ein;9998\n", 26, fhdlOut);
            filePutString ("PH_Opt_Anzeige_V_ein/Parkhilfe_01;9998\n", 39, fhdlOut);
            filePutString ("PH_Opt_Anzeige_V_ein/PRKH01;9998\n", 33, fhdlOut);
            filePutString ("PH_StartStopp_Info;9999\n", 24, fhdlOut);
            filePutString ("PH_StartStopp_Info/Parkhilfe_01;9999\n", 37, fhdlOut);
            filePutString ("PH_StartStopp_Info/PRKH01;9999\n", 31, fhdlOut);
            filePutString ("PH_Systemzustand;10000\n", 23, fhdlOut);
            filePutString ("PH_Systemzustand/Parkhilfe_01;10000\n", 36, fhdlOut);
            filePutString ("PH_Systemzustand/PRKH01;10000\n", 30, fhdlOut);
            filePutString ("PH_Tongeber_H_aktiv;10001\n", 26, fhdlOut);
            filePutString ("PH_Tongeber_H_aktiv/Parkhilfe_01;10001\n", 39, fhdlOut);
            filePutString ("PH_Tongeber_H_aktiv/PRKH01;10001\n", 33, fhdlOut);
            filePutString ("PH_Tongeber_V_aktiv;10002\n", 26, fhdlOut);
            filePutString ("PH_Tongeber_V_aktiv/Parkhilfe_01;10002\n", 39, fhdlOut);
            filePutString ("PH_Tongeber_V_aktiv/PRKH01;10002\n", 33, fhdlOut);
            filePutString ("PH_Tongeber_mute;10003\n", 23, fhdlOut);
            filePutString ("PH_Tongeber_mute/Parkhilfe_01;10003\n", 36, fhdlOut);
            filePutString ("PH_Tongeber_mute/PRKH01;10003\n", 30, fhdlOut);
            filePutString ("PH_defekt;10004\n", 16, fhdlOut);
            filePutString ("PH_defekt/Parkhilfe_01;10004\n", 29, fhdlOut);
            filePutString ("PH_defekt/PRKH01;10004\n", 23, fhdlOut);
            filePutString ("PH_gestoert;10005\n", 18, fhdlOut);
            filePutString ("PH_gestoert/Parkhilfe_01;10005\n", 31, fhdlOut);
            filePutString ("PH_gestoert/PRKH01;10005\n", 25, fhdlOut);
            filePutString ("PH_res_00;10006\n", 16, fhdlOut);
            filePutString ("PH_res_00/Parkhilfe_01;10006\n", 29, fhdlOut);
            filePutString ("PH_res_00/PRKH01;10006\n", 23, fhdlOut);
            filePutString ("PH_res_01;10007\n", 16, fhdlOut);
            filePutString ("PH_res_01/Parkhilfe_01;10007\n", 29, fhdlOut);
            filePutString ("PH_res_01/PRKH01;10007\n", 23, fhdlOut);
            filePutString ("PH_res_02;10008\n", 16, fhdlOut);
            filePutString ("PH_res_02/Parkhilfe_01;10008\n", 29, fhdlOut);
            filePutString ("PH_res_02/PRKH01;10008\n", 23, fhdlOut);
            filePutString ("PH_res_03;10009\n", 16, fhdlOut);
            filePutString ("PH_res_03/Parkhilfe_01;10009\n", 29, fhdlOut);
            filePutString ("PH_res_03/PRKH01;10009\n", 23, fhdlOut);
            filePutString ("PH_res_04;10010\n", 16, fhdlOut);
            filePutString ("PH_res_04/Parkhilfe_01;10010\n", 29, fhdlOut);
            filePutString ("PH_res_04/PRKH01;10010\n", 23, fhdlOut);
            filePutString ("PH_res_05;10011\n", 16, fhdlOut);
            filePutString ("PH_res_05/Parkhilfe_01;10011\n", 29, fhdlOut);
            filePutString ("PH_res_05/PRKH01;10011\n", 23, fhdlOut);
            filePutString ("PH_res_06;10012\n", 16, fhdlOut);
            filePutString ("PH_res_06/Parkhilfe_01;10012\n", 29, fhdlOut);
            filePutString ("PH_res_06/PRKH01;10012\n", 23, fhdlOut);
            filePutString ("PH_res_07;10013\n", 16, fhdlOut);
            filePutString ("PH_res_07/Parkhilfe_01;10013\n", 29, fhdlOut);
            filePutString ("PH_res_07/PRKH01;10013\n", 23, fhdlOut);
            filePutString ("PH_res_08;10014\n", 16, fhdlOut);
            filePutString ("PH_res_08/Parkhilfe_01;10014\n", 29, fhdlOut);
            filePutString ("PH_res_08/PRKH01;10014\n", 23, fhdlOut);
            filePutString ("PH_res_09;10015\n", 16, fhdlOut);
            filePutString ("PH_res_09/Parkhilfe_01;10015\n", 29, fhdlOut);
            filePutString ("PH_res_09/PRKH01;10015\n", 23, fhdlOut);
            filePutString ("PH_res_10;10016\n", 16, fhdlOut);
            filePutString ("PH_res_10/Parkhilfe_01;10016\n", 29, fhdlOut);
            filePutString ("PH_res_10/PRKH01;10016\n", 23, fhdlOut);
            filePutString ("PH_res_11;10017\n", 16, fhdlOut);
            filePutString ("PH_res_11/Parkhilfe_01;10017\n", 29, fhdlOut);
            filePutString ("PH_res_11/PRKH01;10017\n", 23, fhdlOut);
            filePutString ("PH_res_12;10018\n", 16, fhdlOut);
            filePutString ("PH_res_12/Parkhilfe_01;10018\n", 29, fhdlOut);
            filePutString ("PH_res_12/PRKH01;10018\n", 23, fhdlOut);
            filePutString ("PH_res_24;10019\n", 16, fhdlOut);
            filePutString ("PH_res_24/Parkhilfe_01;10019\n", 29, fhdlOut);
            filePutString ("PH_res_24/PRKH01;10019\n", 23, fhdlOut);
            filePutString ("PH_res_25;10020\n", 16, fhdlOut);
            filePutString ("PH_res_25/Parkhilfe_01;10020\n", 29, fhdlOut);
            filePutString ("PH_res_25/PRKH01;10020\n", 23, fhdlOut);
            filePutString ("PH_res_26;10021\n", 16, fhdlOut);
            filePutString ("PH_res_26/Parkhilfe_01;10021\n", 29, fhdlOut);
            filePutString ("PH_res_26/PRKH01;10021\n", 23, fhdlOut);
            filePutString ("PH_res_27;10022\n", 16, fhdlOut);
            filePutString ("PH_res_27/Parkhilfe_01;10022\n", 29, fhdlOut);
            filePutString ("PH_res_27/PRKH01;10022\n", 23, fhdlOut);
            filePutString ("PH_res_28;10023\n", 16, fhdlOut);
            filePutString ("PH_res_28/Parkhilfe_01;10023\n", 29, fhdlOut);
            filePutString ("PH_res_28/PRKH01;10023\n", 23, fhdlOut);
            filePutString ("PH_res_29;10024\n", 16, fhdlOut);
            filePutString ("PH_res_29/Parkhilfe_01;10024\n", 29, fhdlOut);
            filePutString ("PH_res_29/PRKH01;10024\n", 23, fhdlOut);
            filePutString ("PH_res_30;10025\n", 16, fhdlOut);
            filePutString ("PH_res_30/Parkhilfe_01;10025\n", 29, fhdlOut);
            filePutString ("PH_res_30/PRKH01;10025\n", 23, fhdlOut);
            filePutString ("PH_res_31;10026\n", 16, fhdlOut);
            filePutString ("PH_res_31/Parkhilfe_01;10026\n", 29, fhdlOut);
            filePutString ("PH_res_31/PRKH01;10026\n", 23, fhdlOut);
            filePutString ("PH_res_48;10027\n", 16, fhdlOut);
            filePutString ("PH_res_48/Parkhilfe_01;10027\n", 29, fhdlOut);
            filePutString ("PH_res_48/PRKH01;10027\n", 23, fhdlOut);
            filePutString ("APS_Frequenz_hinten;10240\n", 26, fhdlOut);
            filePutString ("APS_Frequenz_hinten/Parkhilfe_1;10240\n", 38, fhdlOut);
            filePutString ("APS_Frequenz_hinten/PRKH1;10240\n", 32, fhdlOut);
            filePutString ("APS_Frequenz_vorn;10241\n", 24, fhdlOut);
            filePutString ("APS_Frequenz_vorn/Parkhilfe_1;10241\n", 36, fhdlOut);
            filePutString ("APS_Frequenz_vorn/PRKH1;10241\n", 30, fhdlOut);
            filePutString ("APS_Lautstaerke_hinten;10242\n", 29, fhdlOut);
            filePutString ("APS_Lautstaerke_hinten/Parkhilfe_1;10242\n", 41, fhdlOut);
            filePutString ("APS_Lautstaerke_hinten/PRKH1;10242\n", 35, fhdlOut);
            filePutString ("APS_Lautstaerke_vorn;10243\n", 27, fhdlOut);
            filePutString ("APS_Lautstaerke_vorn/Parkhilfe_1;10243\n", 39, fhdlOut);
            filePutString ("APS_Lautstaerke_vorn/PRKH1;10243\n", 33, fhdlOut);
            filePutString ("Anlage_defekt;10244\n", 20, fhdlOut);
            filePutString ("Anlage_defekt/Parkhilfe_1;10244\n", 32, fhdlOut);
            filePutString ("Anlage_defekt/PRKH1;10244\n", 26, fhdlOut);
            filePutString ("Eis_aus;10245\n", 14, fhdlOut);
            filePutString ("Eis_aus/Parkhilfe_1;10245\n", 26, fhdlOut);
            filePutString ("Eis_aus/PRKH1;10245\n", 20, fhdlOut);
            filePutString ("Geschwindigkeit_aus;10246\n", 26, fhdlOut);
            filePutString ("Geschwindigkeit_aus/Parkhilfe_1;10246\n", 38, fhdlOut);
            filePutString ("Geschwindigkeit_aus/PRKH1;10246\n", 32, fhdlOut);
            filePutString ("KD_Fehler_Parkhilfe;10247\n", 26, fhdlOut);
            filePutString ("KD_Fehler_Parkhilfe/Parkhilfe_1;10247\n", 38, fhdlOut);
            filePutString ("KD_Fehler_Parkhilfe/PRKH1;10247\n", 32, fhdlOut);
            filePutString ("Optische_Anzeige_aktiv;10248\n", 29, fhdlOut);
            filePutString ("Optische_Anzeige_aktiv/Parkhilfe_1;10248\n", 41, fhdlOut);
            filePutString ("Optische_Anzeige_aktiv/PRKH1;10248\n", 35, fhdlOut);
            filePutString ("PH_StSt_Info;10249\n", 19, fhdlOut);
            filePutString ("PH_StSt_Info/Parkhilfe_1;10249\n", 31, fhdlOut);
            filePutString ("PH_StSt_Info/PRKH1;10249\n", 25, fhdlOut);
            filePutString ("Rueckwaertsgang_aktiviert;10250\n", 32, fhdlOut);
            filePutString ("Rueckwaertsgang_aktiviert/Parkhilfe_1;10250\n", 44, fhdlOut);
            filePutString ("Rueckwaertsgang_aktiviert/PRKH1;10250\n", 38, fhdlOut);
            filePutString ("Schlechtweg_aus;10251\n", 22, fhdlOut);
            filePutString ("Schlechtweg_aus/Parkhilfe_1;10251\n", 34, fhdlOut);
            filePutString ("Schlechtweg_aus/PRKH1;10251\n", 28, fhdlOut);
            filePutString ("Taster_aktiviert;10252\n", 23, fhdlOut);
            filePutString ("Taster_aktiviert/Parkhilfe_1;10252\n", 35, fhdlOut);
            filePutString ("Taster_aktiviert/PRKH1;10252\n", 29, fhdlOut);
            filePutString ("Tongeber_h_aktiv;10253\n", 23, fhdlOut);
            filePutString ("Tongeber_h_aktiv/Parkhilfe_1;10253\n", 35, fhdlOut);
            filePutString ("Tongeber_h_aktiv/PRKH1;10253\n", 29, fhdlOut);
            filePutString ("Tongeber_h_defekt;10254\n", 24, fhdlOut);
            filePutString ("Tongeber_h_defekt/Parkhilfe_1;10254\n", 36, fhdlOut);
            filePutString ("Tongeber_h_defekt/PRKH1;10254\n", 30, fhdlOut);
            filePutString ("Tongeber_v_aktiv;10255\n", 23, fhdlOut);
            filePutString ("Tongeber_v_aktiv/Parkhilfe_1;10255\n", 35, fhdlOut);
            filePutString ("Tongeber_v_aktiv/PRKH1;10255\n", 29, fhdlOut);
            filePutString ("Tongeber_v_defekt;10256\n", 24, fhdlOut);
            filePutString ("Tongeber_v_defekt/Parkhilfe_1;10256\n", 36, fhdlOut);
            filePutString ("Tongeber_v_defekt/PRKH1;10256\n", 30, fhdlOut);
            filePutString ("RSF_Tastencode_1;10496\n", 23, fhdlOut);
            filePutString ("RSF_Tastencode_1/Remotestart_FFB;10496\n", 39, fhdlOut);
            filePutString ("RSF_Tastencode_1/RCS1;10496\n", 28, fhdlOut);
            filePutString ("RSF_Tastencode_2;10497\n", 23, fhdlOut);
            filePutString ("RSF_Tastencode_2/Remotestart_FFB;10497\n", 39, fhdlOut);
            filePutString ("RSF_Tastencode_2/RCS1;10497\n", 28, fhdlOut);
            filePutString ("RSF_Tastencode_Maske;10498\n", 27, fhdlOut);
            filePutString ("RSF_Tastencode_Maske/Remotestart_FFB;10498\n", 43, fhdlOut);
            filePutString ("RSF_Tastencode_Maske/RCS1;10498\n", 32, fhdlOut);
            filePutString ("VL1_ABS;10752\n", 14, fhdlOut);
            filePutString ("VL1_ABS/Soll_Verbauliste_neu;10752\n", 35, fhdlOut);
            filePutString ("VL1_ABS/VL1;10752\n", 18, fhdlOut);
            filePutString ("VL1_ADR;10753\n", 14, fhdlOut);
            filePutString ("VL1_ADR/Soll_Verbauliste_neu;10753\n", 35, fhdlOut);
            filePutString ("VL1_ADR/VL1;10753\n", 18, fhdlOut);
            filePutString ("VL1_ADR_getrennt;10754\n", 23, fhdlOut);
            filePutString ("VL1_ADR_getrennt/Soll_Verbauliste_neu;10754\n", 44, fhdlOut);
            filePutString ("VL1_ADR_getrennt/VL1;10754\n", 27, fhdlOut);
            filePutString ("VL1_Airbag;10755\n", 17, fhdlOut);
            filePutString ("VL1_Airbag/Soll_Verbauliste_neu;10755\n", 38, fhdlOut);
            filePutString ("VL1_Airbag/VL1;10755\n", 21, fhdlOut);
            filePutString ("VL1_Allrad;10756\n", 17, fhdlOut);
            filePutString ("VL1_Allrad/Soll_Verbauliste_neu;10756\n", 38, fhdlOut);
            filePutString ("VL1_Allrad/VL1;10756\n", 21, fhdlOut);
            filePutString ("VL1_Anhaenger;10757\n", 20, fhdlOut);
            filePutString ("VL1_Anhaenger/Soll_Verbauliste_neu;10757\n", 41, fhdlOut);
            filePutString ("VL1_Anhaenger/VL1;10757\n", 24, fhdlOut);
            filePutString ("VL1_BSG_Komf;10758\n", 19, fhdlOut);
            filePutString ("VL1_BSG_Komf/Soll_Verbauliste_neu;10758\n", 40, fhdlOut);
            filePutString ("VL1_BSG_Komf/VL1;10758\n", 23, fhdlOut);
            filePutString ("VL1_Clima_Komf;10759\n", 21, fhdlOut);
            filePutString ("VL1_Clima_Komf/Soll_Verbauliste_neu;10759\n", 42, fhdlOut);
            filePutString ("VL1_Clima_Komf/VL1;10759\n", 25, fhdlOut);
            filePutString ("VL1_DAB;10760\n", 14, fhdlOut);
            filePutString ("VL1_DAB/Soll_Verbauliste_neu;10760\n", 35, fhdlOut);
            filePutString ("VL1_DAB/VL1;10760\n", 18, fhdlOut);
            filePutString ("VL1_DSP;10761\n", 14, fhdlOut);
            filePutString ("VL1_DSP/Soll_Verbauliste_neu;10761\n", 35, fhdlOut);
            filePutString ("VL1_DSP/VL1;10761\n", 18, fhdlOut);
            filePutString ("VL1_Daempfer;10762\n", 19, fhdlOut);
            filePutString ("VL1_Daempfer/Soll_Verbauliste_neu;10762\n", 40, fhdlOut);
            filePutString ("VL1_Daempfer/VL1;10762\n", 23, fhdlOut);
            filePutString ("VL1_EPB;10763\n", 14, fhdlOut);
            filePutString ("VL1_EPB/Soll_Verbauliste_neu;10763\n", 35, fhdlOut);
            filePutString ("VL1_EPB/VL1;10763\n", 18, fhdlOut);
            filePutString ("VL1_Easy_Entry_VB;10764\n", 24, fhdlOut);
            filePutString ("VL1_Easy_Entry_VB/Soll_Verbauliste_neu;10764\n", 45, fhdlOut);
            filePutString ("VL1_Easy_Entry_VB/VL1;10764\n", 28, fhdlOut);
            filePutString ("VL1_Easy_Entry_VF;10765\n", 24, fhdlOut);
            filePutString ("VL1_Easy_Entry_VF/Soll_Verbauliste_neu;10765\n", 45, fhdlOut);
            filePutString ("VL1_Easy_Entry_VF/VL1;10765\n", 28, fhdlOut);
            filePutString ("VL1_Einparkhilfe;10766\n", 23, fhdlOut);
            filePutString ("VL1_Einparkhilfe/Soll_Verbauliste_neu;10766\n", 44, fhdlOut);
            filePutString ("VL1_Einparkhilfe/VL1;10766\n", 27, fhdlOut);
            filePutString ("VL1_GSM_Pager;10767\n", 20, fhdlOut);
            filePutString ("VL1_GSM_Pager/Soll_Verbauliste_neu;10767\n", 41, fhdlOut);
            filePutString ("VL1_GSM_Pager/VL1;10767\n", 24, fhdlOut);
            filePutString ("VL1_Gateway;10768\n", 18, fhdlOut);
            filePutString ("VL1_Gateway/Soll_Verbauliste_neu;10768\n", 39, fhdlOut);
            filePutString ("VL1_Gateway/VL1;10768\n", 22, fhdlOut);
            filePutString ("VL1_Getr_SG;10769\n", 18, fhdlOut);
            filePutString ("VL1_Getr_SG/Soll_Verbauliste_neu;10769\n", 39, fhdlOut);
            filePutString ("VL1_Getr_SG/VL1;10769\n", 22, fhdlOut);
            filePutString ("VL1_HCA;10770\n", 14, fhdlOut);
            filePutString ("VL1_HCA/Soll_Verbauliste_neu;10770\n", 35, fhdlOut);
            filePutString ("VL1_HCA/VL1;10770\n", 18, fhdlOut);
            filePutString ("VL1_Heckdeckel;10771\n", 21, fhdlOut);
            filePutString ("VL1_Heckdeckel/Soll_Verbauliste_neu;10771\n", 42, fhdlOut);
            filePutString ("VL1_Heckdeckel/VL1;10771\n", 25, fhdlOut);
            filePutString ("VL1_InfoElektronik;10772\n", 25, fhdlOut);
            filePutString ("VL1_InfoElektronik/Soll_Verbauliste_neu;10772\n", 46, fhdlOut);
            filePutString ("VL1_InfoElektronik/VL1;10772\n", 29, fhdlOut);
            filePutString ("VL1_Kombi;10773\n", 16, fhdlOut);
            filePutString ("VL1_Kombi/Soll_Verbauliste_neu;10773\n", 37, fhdlOut);
            filePutString ("VL1_Kombi/VL1;10773\n", 20, fhdlOut);
            filePutString ("VL1_Kombi_KBI;10774\n", 20, fhdlOut);
            filePutString ("VL1_Kombi_KBI/Soll_Verbauliste_neu;10774\n", 41, fhdlOut);
            filePutString ("VL1_Kombi_KBI/VL1;10774\n", 24, fhdlOut);
            filePutString ("VL1_Kompass;10775\n", 18, fhdlOut);
            filePutString ("VL1_Kompass/Soll_Verbauliste_neu;10775\n", 39, fhdlOut);
            filePutString ("VL1_Kompass/VL1;10775\n", 22, fhdlOut);
            filePutString ("VL1_LSM;10776\n", 14, fhdlOut);
            filePutString ("VL1_LSM/Soll_Verbauliste_neu;10776\n", 35, fhdlOut);
            filePutString ("VL1_LSM/VL1;10776\n", 18, fhdlOut);
            filePutString ("VL1_Lenkhilfe;10777\n", 20, fhdlOut);
            filePutString ("VL1_Lenkhilfe/Soll_Verbauliste_neu;10777\n", 41, fhdlOut);
            filePutString ("VL1_Lenkhilfe/VL1;10777\n", 24, fhdlOut);
            filePutString ("VL1_Lenksaeule;10778\n", 21, fhdlOut);
            filePutString ("VL1_Lenksaeule/Soll_Verbauliste_neu;10778\n", 42, fhdlOut);
            filePutString ("VL1_Lenksaeule/VL1;10778\n", 25, fhdlOut);
            filePutString ("VL1_MDI_I;10779\n", 16, fhdlOut);
            filePutString ("VL1_MDI_I/Soll_Verbauliste_neu;10779\n", 37, fhdlOut);
            filePutString ("VL1_MDI_I/VL1;10779\n", 20, fhdlOut);
            filePutString ("VL1_Memory;10780\n", 17, fhdlOut);
            filePutString ("VL1_Memory/Soll_Verbauliste_neu;10780\n", 38, fhdlOut);
            filePutString ("VL1_Memory/VL1;10780\n", 21, fhdlOut);
            filePutString ("VL1_Memory_BF;10781\n", 20, fhdlOut);
            filePutString ("VL1_Memory_BF/Soll_Verbauliste_neu;10781\n", 41, fhdlOut);
            filePutString ("VL1_Memory_BF/VL1;10781\n", 24, fhdlOut);
            filePutString ("VL1_MotorSlave;10782\n", 21, fhdlOut);
            filePutString ("VL1_MotorSlave/Soll_Verbauliste_neu;10782\n", 42, fhdlOut);
            filePutString ("VL1_MotorSlave/VL1;10782\n", 25, fhdlOut);
            filePutString ("VL1_Motor_SG;10783\n", 19, fhdlOut);
            filePutString ("VL1_Motor_SG/Soll_Verbauliste_neu;10783\n", 40, fhdlOut);
            filePutString ("VL1_Motor_SG/VL1;10783\n", 23, fhdlOut);
            filePutString ("VL1_Navigation;10784\n", 21, fhdlOut);
            filePutString ("VL1_Navigation/Soll_Verbauliste_neu;10784\n", 42, fhdlOut);
            filePutString ("VL1_Navigation/VL1;10784\n", 25, fhdlOut);
            filePutString ("VL1_Neigungsmodul_I;10785\n", 26, fhdlOut);
            filePutString ("VL1_Neigungsmodul_I/Soll_Verbauliste_neu;10785\n", 47, fhdlOut);
            filePutString ("VL1_Neigungsmodul_I/VL1;10785\n", 30, fhdlOut);
            filePutString ("VL1_PLA;10786\n", 14, fhdlOut);
            filePutString ("VL1_PLA/Soll_Verbauliste_neu;10786\n", 35, fhdlOut);
            filePutString ("VL1_PLA/VL1;10786\n", 18, fhdlOut);
            filePutString ("VL1_PTC_Heizung;10787\n", 22, fhdlOut);
            filePutString ("VL1_PTC_Heizung/Soll_Verbauliste_neu;10787\n", 43, fhdlOut);
            filePutString ("VL1_PTC_Heizung/VL1;10787\n", 26, fhdlOut);
            filePutString ("VL1_Quersperre;10788\n", 21, fhdlOut);
            filePutString ("VL1_Quersperre/Soll_Verbauliste_neu;10788\n", 42, fhdlOut);
            filePutString ("VL1_Quersperre/VL1;10788\n", 25, fhdlOut);
            filePutString ("VL1_RDK;10789\n", 14, fhdlOut);
            filePutString ("VL1_RDK/Soll_Verbauliste_neu;10789\n", 35, fhdlOut);
            filePutString ("VL1_RDK/VL1;10789\n", 18, fhdlOut);
            filePutString ("VL1_RKA_Plus;10790\n", 19, fhdlOut);
            filePutString ("VL1_RKA_Plus/Soll_Verbauliste_neu;10790\n", 40, fhdlOut);
            filePutString ("VL1_RKA_Plus/VL1;10790\n", 23, fhdlOut);
            filePutString ("VL1_RSE_I;10791\n", 16, fhdlOut);
            filePutString ("VL1_RSE_I/Soll_Verbauliste_neu;10791\n", 37, fhdlOut);
            filePutString ("VL1_RSE_I/VL1;10791\n", 20, fhdlOut);
            filePutString ("VL1_Radio;10792\n", 16, fhdlOut);
            filePutString ("VL1_Radio/Soll_Verbauliste_neu;10792\n", 37, fhdlOut);
            filePutString ("VL1_Radio/VL1;10792\n", 20, fhdlOut);
            filePutString ("VL1_Rearview;10793\n", 19, fhdlOut);
            filePutString ("VL1_Rearview/Soll_Verbauliste_neu;10793\n", 40, fhdlOut);
            filePutString ("VL1_Rearview/VL1;10793\n", 23, fhdlOut);
            filePutString ("VL1_SWA;10794\n", 14, fhdlOut);
            filePutString ("VL1_SWA/Soll_Verbauliste_neu;10794\n", 35, fhdlOut);
            filePutString ("VL1_SWA/VL1;10794\n", 18, fhdlOut);
            filePutString ("VL1_Soll_eq_Ist;10795\n", 22, fhdlOut);
            filePutString ("VL1_Soll_eq_Ist/Soll_Verbauliste_neu;10795\n", 43, fhdlOut);
            filePutString ("VL1_Soll_eq_Ist/VL1;10795\n", 26, fhdlOut);
            filePutString ("VL1_Sonderfzg_SG;10796\n", 23, fhdlOut);
            filePutString ("VL1_Sonderfzg_SG/Soll_Verbauliste_neu;10796\n", 44, fhdlOut);
            filePutString ("VL1_Sonderfzg_SG/VL1;10796\n", 27, fhdlOut);
            filePutString ("VL1_Standheiz;10797\n", 20, fhdlOut);
            filePutString ("VL1_Standheiz/Soll_Verbauliste_neu;10797\n", 41, fhdlOut);
            filePutString ("VL1_Standheiz/VL1;10797\n", 24, fhdlOut);
            filePutString ("VL1_TSG_BT;10798\n", 17, fhdlOut);
            filePutString ("VL1_TSG_BT/Soll_Verbauliste_neu;10798\n", 38, fhdlOut);
            filePutString ("VL1_TSG_BT/VL1;10798\n", 21, fhdlOut);
            filePutString ("VL1_TSG_FT;10799\n", 17, fhdlOut);
            filePutString ("VL1_TSG_FT/Soll_Verbauliste_neu;10799\n", 38, fhdlOut);
            filePutString ("VL1_TSG_FT/VL1;10799\n", 21, fhdlOut);
            filePutString ("VL1_TSG_HL;10800\n", 17, fhdlOut);
            filePutString ("VL1_TSG_HL/Soll_Verbauliste_neu;10800\n", 38, fhdlOut);
            filePutString ("VL1_TSG_HL/VL1;10800\n", 21, fhdlOut);
            filePutString ("VL1_TSG_HR;10801\n", 17, fhdlOut);
            filePutString ("VL1_TSG_HR/Soll_Verbauliste_neu;10801\n", 38, fhdlOut);
            filePutString ("VL1_TSG_HR/VL1;10801\n", 21, fhdlOut);
            filePutString ("VL1_TV_Tuner;10802\n", 19, fhdlOut);
            filePutString ("VL1_TV_Tuner/Soll_Verbauliste_neu;10802\n", 40, fhdlOut);
            filePutString ("VL1_TV_Tuner/VL1;10802\n", 23, fhdlOut);
            filePutString ("VL1_Tastenmodul;10803\n", 22, fhdlOut);
            filePutString ("VL1_Tastenmodul/Soll_Verbauliste_neu;10803\n", 43, fhdlOut);
            filePutString ("VL1_Tastenmodul/VL1;10803\n", 26, fhdlOut);
            filePutString ("VL1_Telefon;10804\n", 18, fhdlOut);
            filePutString ("VL1_Telefon/Soll_Verbauliste_neu;10804\n", 39, fhdlOut);
            filePutString ("VL1_Telefon/VL1;10804\n", 22, fhdlOut);
            filePutString ("VL1_Telematik;10805\n", 20, fhdlOut);
            filePutString ("VL1_Telematik/Soll_Verbauliste_neu;10805\n", 41, fhdlOut);
            filePutString ("VL1_Telematik/VL1;10805\n", 24, fhdlOut);
            filePutString ("VL1_Verdeck;10806\n", 18, fhdlOut);
            filePutString ("VL1_Verdeck/Soll_Verbauliste_neu;10806\n", 39, fhdlOut);
            filePutString ("VL1_Verdeck/VL1;10806\n", 22, fhdlOut);
            filePutString ("VL1_WFS_K;10807\n", 16, fhdlOut);
            filePutString ("VL1_WFS_K/Soll_Verbauliste_neu;10807\n", 37, fhdlOut);
            filePutString ("VL1_WFS_K/VL1;10807\n", 20, fhdlOut);
            filePutString ("VL1_WFS_KBI;10808\n", 18, fhdlOut);
            filePutString ("VL1_WFS_KBI/Soll_Verbauliste_neu;10808\n", 39, fhdlOut);
            filePutString ("VL1_WFS_KBI/VL1;10808\n", 22, fhdlOut);
            filePutString ("VL1_ZKE;10809\n", 14, fhdlOut);
            filePutString ("VL1_ZKE/Soll_Verbauliste_neu;10809\n", 35, fhdlOut);
            filePutString ("VL1_ZKE/VL1;10809\n", 18, fhdlOut);
            filePutString ("VL1_Zentralelektrik_II;10810\n", 29, fhdlOut);
            filePutString ("VL1_Zentralelektrik_II/Soll_Verbauliste_neu;10810\n", 50, fhdlOut);
            filePutString ("VL1_Zentralelektrik_II/VL1;10810\n", 33, fhdlOut);
            filePutString ("VL1_dyn_LWR;10811\n", 18, fhdlOut);
            filePutString ("VL1_dyn_LWR/Soll_Verbauliste_neu;10811\n", 39, fhdlOut);
            filePutString ("VL1_dyn_LWR/VL1;10811\n", 22, fhdlOut);
            filePutString ("VL1_res_08;10812\n", 17, fhdlOut);
            filePutString ("VL1_res_08/Soll_Verbauliste_neu;10812\n", 38, fhdlOut);
            filePutString ("VL1_res_08/VL1;10812\n", 21, fhdlOut);
            filePutString ("VL1_res_13;10813\n", 17, fhdlOut);
            filePutString ("VL1_res_13/Soll_Verbauliste_neu;10813\n", 38, fhdlOut);
            filePutString ("VL1_res_13/VL1;10813\n", 21, fhdlOut);
            filePutString ("VL1_res_31;10814\n", 17, fhdlOut);
            filePutString ("VL1_res_31/Soll_Verbauliste_neu;10814\n", 38, fhdlOut);
            filePutString ("VL1_res_31/VL1;10814\n", 21, fhdlOut);
            filePutString ("VL1_res_42;10815\n", 17, fhdlOut);
            filePutString ("VL1_res_42/Soll_Verbauliste_neu;10815\n", 38, fhdlOut);
            filePutString ("VL1_res_42/VL1;10815\n", 21, fhdlOut);
            filePutString ("SY1_Ant_HV;11008\n", 17, fhdlOut);
            filePutString ("SY1_Ant_HV/Systeminfo_1;11008\n", 30, fhdlOut);
            filePutString ("SY1_Ant_HV/SYS1;11008\n", 22, fhdlOut);
            filePutString ("SY1_Ant_NV;11009\n", 17, fhdlOut);
            filePutString ("SY1_Ant_NV/Systeminfo_1;11009\n", 30, fhdlOut);
            filePutString ("SY1_Ant_NV/SYS1;11009\n", 22, fhdlOut);
            filePutString ("SY1_CAN_Info;11010\n", 19, fhdlOut);
            filePutString ("SY1_CAN_Info/Systeminfo_1;11010\n", 32, fhdlOut);
            filePutString ("SY1_CAN_Info/SYS1;11010\n", 24, fhdlOut);
            filePutString ("SY1_CAN_extern;11011\n", 21, fhdlOut);
            filePutString ("SY1_CAN_extern/Systeminfo_1;11011\n", 34, fhdlOut);
            filePutString ("SY1_CAN_extern/SYS1;11011\n", 26, fhdlOut);
            filePutString ("SY1_Diag_Ant;11012\n", 19, fhdlOut);
            filePutString ("SY1_Diag_Ant/Systeminfo_1;11012\n", 32, fhdlOut);
            filePutString ("SY1_Diag_Ant/SYS1;11012\n", 24, fhdlOut);
            filePutString ("SY1_Diag_Info;11013\n", 20, fhdlOut);
            filePutString ("SY1_Diag_Info/Systeminfo_1;11013\n", 33, fhdlOut);
            filePutString ("SY1_Diag_Info/SYS1;11013\n", 25, fhdlOut);
            filePutString ("SY1_Diag_Komf;11014\n", 20, fhdlOut);
            filePutString ("SY1_Diag_Komf/Systeminfo_1;11014\n", 33, fhdlOut);
            filePutString ("SY1_Diag_Komf/SYS1;11014\n", 25, fhdlOut);
            filePutString ("SY1_ELV_Lock_Supply;11015\n", 26, fhdlOut);
            filePutString ("SY1_ELV_Lock_Supply/Systeminfo_1;11015\n", 39, fhdlOut);
            filePutString ("SY1_ELV_Lock_Supply/SYS1;11015\n", 31, fhdlOut);
            filePutString ("SY1_Fehlereintr;11016\n", 22, fhdlOut);
            filePutString ("SY1_Fehlereintr/Systeminfo_1;11016\n", 35, fhdlOut);
            filePutString ("SY1_Fehlereintr/SYS1;11016\n", 27, fhdlOut);
            filePutString ("SY1_Fzg_Derivat;11017\n", 22, fhdlOut);
            filePutString ("SY1_Fzg_Derivat/Systeminfo_1;11017\n", 35, fhdlOut);
            filePutString ("SY1_Fzg_Derivat/SYS1;11017\n", 27, fhdlOut);
            filePutString ("SY1_Fzg_Gen;11018\n", 18, fhdlOut);
            filePutString ("SY1_Fzg_Gen/Systeminfo_1;11018\n", 31, fhdlOut);
            filePutString ("SY1_Fzg_Gen/SYS1;11018\n", 23, fhdlOut);
            filePutString ("SY1_Fzg_Index;11019\n", 20, fhdlOut);
            filePutString ("SY1_Fzg_Index/Systeminfo_1;11019\n", 33, fhdlOut);
            filePutString ("SY1_Fzg_Index/SYS1;11019\n", 25, fhdlOut);
            filePutString ("SY1_Fzg_Klasse;11020\n", 21, fhdlOut);
            filePutString ("SY1_Fzg_Klasse/Systeminfo_1;11020\n", 34, fhdlOut);
            filePutString ("SY1_Fzg_Klasse/SYS1;11020\n", 26, fhdlOut);
            filePutString ("SY1_Fzg_Marke;11021\n", 20, fhdlOut);
            filePutString ("SY1_Fzg_Marke/Systeminfo_1;11021\n", 33, fhdlOut);
            filePutString ("SY1_Fzg_Marke/SYS1;11021\n", 25, fhdlOut);
            filePutString ("SY1_Komf_HV;11022\n", 18, fhdlOut);
            filePutString ("SY1_Komf_HV/Systeminfo_1;11022\n", 31, fhdlOut);
            filePutString ("SY1_Komf_HV/SYS1;11022\n", 23, fhdlOut);
            filePutString ("SY1_Komf_NV;11023\n", 18, fhdlOut);
            filePutString ("SY1_Komf_NV/Systeminfo_1;11023\n", 31, fhdlOut);
            filePutString ("SY1_Komf_NV/SYS1;11023\n", 23, fhdlOut);
            filePutString ("SY1_Lenker;11024\n", 17, fhdlOut);
            filePutString ("SY1_Lenker/Systeminfo_1;11024\n", 30, fhdlOut);
            filePutString ("SY1_Lenker/SYS1;11024\n", 22, fhdlOut);
            filePutString ("SY1_NWDF;11025\n", 15, fhdlOut);
            filePutString ("SY1_NWDF/Systeminfo_1;11025\n", 28, fhdlOut);
            filePutString ("SY1_NWDF/SYS1;11025\n", 20, fhdlOut);
            filePutString ("SY1_NWDF_gueltig;11026\n", 23, fhdlOut);
            filePutString ("SY1_NWDF_gueltig/Systeminfo_1;11026\n", 36, fhdlOut);
            filePutString ("SY1_NWDF_gueltig/SYS1;11026\n", 28, fhdlOut);
            filePutString ("SY1_Notbrems_Status;11027\n", 26, fhdlOut);
            filePutString ("SY1_Notbrems_Status/Systeminfo_1;11027\n", 39, fhdlOut);
            filePutString ("SY1_Notbrems_Status/SYS1;11027\n", 31, fhdlOut);
            filePutString ("SY1_QRS_Messmodus;11028\n", 24, fhdlOut);
            filePutString ("SY1_QRS_Messmodus/Systeminfo_1;11028\n", 37, fhdlOut);
            filePutString ("SY1_QRS_Messmodus/SYS1;11028\n", 29, fhdlOut);
            filePutString ("SY1_Relais_FAS_Zweig;11029\n", 27, fhdlOut);
            filePutString ("SY1_Relais_FAS_Zweig/Systeminfo_1;11029\n", 40, fhdlOut);
            filePutString ("SY1_Relais_FAS_Zweig/SYS1;11029\n", 32, fhdlOut);
            filePutString ("SY1_Sleep_Info;11030\n", 21, fhdlOut);
            filePutString ("SY1_Sleep_Info/Systeminfo_1;11030\n", 34, fhdlOut);
            filePutString ("SY1_Sleep_Info/SYS1;11030\n", 26, fhdlOut);
            filePutString ("SY1_Sleep_Komf;11031\n", 21, fhdlOut);
            filePutString ("SY1_Sleep_Komf/Systeminfo_1;11031\n", 34, fhdlOut);
            filePutString ("SY1_Sleep_Komf/SYS1;11031\n", 26, fhdlOut);
            filePutString ("SY1_Transportmode;11032\n", 24, fhdlOut);
            filePutString ("SY1_Transportmode/Systeminfo_1;11032\n", 37, fhdlOut);
            filePutString ("SY1_Transportmode/SYS1;11032\n", 29, fhdlOut);
            filePutString ("SY1_Tueren;11033\n", 17, fhdlOut);
            filePutString ("SY1_Tueren/Systeminfo_1;11033\n", 30, fhdlOut);
            filePutString ("SY1_Tueren/SYS1;11033\n", 22, fhdlOut);
            filePutString ("SY1_Verbauinfo;11034\n", 21, fhdlOut);
            filePutString ("SY1_Verbauinfo/Systeminfo_1;11034\n", 34, fhdlOut);
            filePutString ("SY1_Verbauinfo/SYS1;11034\n", 26, fhdlOut);
            filePutString ("SY1_res52;11035\n", 16, fhdlOut);
            filePutString ("SY1_res52/Systeminfo_1;11035\n", 29, fhdlOut);
            filePutString ("SY1_res52/SYS1;11035\n", 21, fhdlOut);
            filePutString ("SY1_res53;11036\n", 16, fhdlOut);
            filePutString ("SY1_res53/Systeminfo_1;11036\n", 29, fhdlOut);
            filePutString ("SY1_res53/SYS1;11036\n", 21, fhdlOut);
            filePutString ("SY1_res54;11037\n", 16, fhdlOut);
            filePutString ("SY1_res54/Systeminfo_1;11037\n", 29, fhdlOut);
            filePutString ("SY1_res54/SYS1;11037\n", 21, fhdlOut);
            filePutString ("SY1_res55;11038\n", 16, fhdlOut);
            filePutString ("SY1_res55/Systeminfo_1;11038\n", 29, fhdlOut);
            filePutString ("SY1_res55/SYS1;11038\n", 21, fhdlOut);
            filePutString ("SY1_res57;11039\n", 16, fhdlOut);
            filePutString ("SY1_res57/Systeminfo_1;11039\n", 29, fhdlOut);
            filePutString ("SY1_res57/SYS1;11039\n", 21, fhdlOut);
            filePutString ("SY1_res58;11040\n", 16, fhdlOut);
            filePutString ("SY1_res58/Systeminfo_1;11040\n", 29, fhdlOut);
            filePutString ("SY1_res58/SYS1;11040\n", 21, fhdlOut);
            filePutString ("SY1_res59;11041\n", 16, fhdlOut);
            filePutString ("SY1_res59/Systeminfo_1;11041\n", 29, fhdlOut);
            filePutString ("SY1_res59/SYS1;11041\n", 21, fhdlOut);
            filePutString ("SY1_res60;11042\n", 16, fhdlOut);
            filePutString ("SY1_res60/Systeminfo_1;11042\n", 29, fhdlOut);
            filePutString ("SY1_res60/SYS1;11042\n", 21, fhdlOut);
            filePutString ("SY1_res61;11043\n", 16, fhdlOut);
            filePutString ("SY1_res61/Systeminfo_1;11043\n", 29, fhdlOut);
            filePutString ("SY1_res61/SYS1;11043\n", 21, fhdlOut);
            filePutString ("SY1_res62;11044\n", 16, fhdlOut);
            filePutString ("SY1_res62/Systeminfo_1;11044\n", 29, fhdlOut);
            filePutString ("SY1_res62/SYS1;11044\n", 21, fhdlOut);
            filePutString ("SY1_res63;11045\n", 16, fhdlOut);
            filePutString ("SY1_res63/Systeminfo_1;11045\n", 29, fhdlOut);
            filePutString ("SY1_res63/SYS1;11045\n", 21, fhdlOut);
            filePutString ("TOG_Fuellstand_1;11264\n", 23, fhdlOut);
            filePutString ("TOG_Fuellstand_1/TOG;11264\n", 27, fhdlOut);
            filePutString ("TOG_Fuellstand_1/TOS;11264\n", 27, fhdlOut);
            filePutString ("TOG_Fuellstand_2;11265\n", 23, fhdlOut);
            filePutString ("TOG_Fuellstand_2/TOG;11265\n", 27, fhdlOut);
            filePutString ("TOG_Fuellstand_2/TOS;11265\n", 27, fhdlOut);
            filePutString ("TOG_Fuellstand_3;11266\n", 23, fhdlOut);
            filePutString ("TOG_Fuellstand_3/TOG;11266\n", 27, fhdlOut);
            filePutString ("TOG_Fuellstand_3/TOS;11266\n", 27, fhdlOut);
            filePutString ("TOG_Fuellstand_4;11267\n", 23, fhdlOut);
            filePutString ("TOG_Fuellstand_4/TOG;11267\n", 27, fhdlOut);
            filePutString ("TOG_Fuellstand_4/TOS;11267\n", 27, fhdlOut);
            filePutString ("TOG_OelmaxUeber;11268\n", 22, fhdlOut);
            filePutString ("TOG_OelmaxUeber/TOG;11268\n", 26, fhdlOut);
            filePutString ("TOG_OelmaxUeber/TOS;11268\n", 26, fhdlOut);
            filePutString ("TOG_Oelmax_hoch;11269\n", 22, fhdlOut);
            filePutString ("TOG_Oelmax_hoch/TOG;11269\n", 26, fhdlOut);
            filePutString ("TOG_Oelmax_hoch/TOS;11269\n", 26, fhdlOut);
            filePutString ("TOG_Oeltempzeit;11270\n", 22, fhdlOut);
            filePutString ("TOG_Oeltempzeit/TOG;11270\n", 26, fhdlOut);
            filePutString ("TOG_Oeltempzeit/TOS;11270\n", 26, fhdlOut);
            filePutString ("TOG_OelwarnUeber;11271\n", 23, fhdlOut);
            filePutString ("TOG_OelwarnUeber/TOG;11271\n", 27, fhdlOut);
            filePutString ("TOG_OelwarnUeber/TOS;11271\n", 27, fhdlOut);
            filePutString ("TOG_Oelwarn_hoch;11272\n", 23, fhdlOut);
            filePutString ("TOG_Oelwarn_hoch/TOG;11272\n", 27, fhdlOut);
            filePutString ("TOG_Oelwarn_hoch/TOS;11272\n", 27, fhdlOut);
            filePutString ("TOG_Reserve1;11273\n", 19, fhdlOut);
            filePutString ("TOG_Reserve1/TOG;11273\n", 23, fhdlOut);
            filePutString ("TOG_Reserve1/TOS;11273\n", 23, fhdlOut);
            filePutString ("TOG_Sensorfehler;11274\n", 23, fhdlOut);
            filePutString ("TOG_Sensorfehler/TOG;11274\n", 27, fhdlOut);
            filePutString ("TOG_Sensorfehler/TOS;11274\n", 27, fhdlOut);
            filePutString ("TOG_Zaehler;11275\n", 18, fhdlOut);
            filePutString ("TOG_Zaehler/TOG;11275\n", 22, fhdlOut);
            filePutString ("TOG_Zaehler/TOS;11275\n", 22, fhdlOut);
            filePutString ("CHK_ZAS;11520\n", 14, fhdlOut);
            filePutString ("CHK_ZAS/ZAS_1;11520\n", 20, fhdlOut);
            filePutString ("CHK_ZAS/STIGN1;11520\n", 21, fhdlOut);
            filePutString ("ZA1_Klemme_15;11521\n", 20, fhdlOut);
            filePutString ("ZA1_Klemme_15/ZAS_1;11521\n", 26, fhdlOut);
            filePutString ("ZA1_Klemme_15/STIGN1;11521\n", 27, fhdlOut);
            filePutString ("ZA1_Klemme_50;11522\n", 20, fhdlOut);
            filePutString ("ZA1_Klemme_50/ZAS_1;11522\n", 26, fhdlOut);
            filePutString ("ZA1_Klemme_50/STIGN1;11522\n", 27, fhdlOut);
            filePutString ("ZA1_Klemme_P;11523\n", 19, fhdlOut);
            filePutString ("ZA1_Klemme_P/ZAS_1;11523\n", 25, fhdlOut);
            filePutString ("ZA1_Klemme_P/STIGN1;11523\n", 26, fhdlOut);
            filePutString ("ZA1_Klemme_SV;11524\n", 20, fhdlOut);
            filePutString ("ZA1_Klemme_SV/ZAS_1;11524\n", 26, fhdlOut);
            filePutString ("ZA1_Klemme_SV/STIGN1;11524\n", 27, fhdlOut);
            filePutString ("ZA1_Klemme_X;11525\n", 19, fhdlOut);
            filePutString ("ZA1_Klemme_X/ZAS_1;11525\n", 25, fhdlOut);
            filePutString ("ZA1_Klemme_X/STIGN1;11525\n", 26, fhdlOut);
            filePutString ("ZA1_Reserve1;11526\n", 19, fhdlOut);
            filePutString ("ZA1_Reserve1/ZAS_1;11526\n", 25, fhdlOut);
            filePutString ("ZA1_Reserve1/STIGN1;11526\n", 26, fhdlOut);
            filePutString ("ZA1_S_Kontakt;11527\n", 20, fhdlOut);
            filePutString ("ZA1_S_Kontakt/ZAS_1;11527\n", 26, fhdlOut);
            filePutString ("ZA1_S_Kontakt/STIGN1;11527\n", 27, fhdlOut);
            filePutString ("ZA1_res07;11528\n", 16, fhdlOut);
            filePutString ("ZA1_res07/ZAS_1;11528\n", 22, fhdlOut);
            filePutString ("ZA1_res07/STIGN1;11528\n", 23, fhdlOut);
            filePutString ("Zaehler_ZAS;11529\n", 18, fhdlOut);
            filePutString ("Zaehler_ZAS/ZAS_1;11529\n", 24, fhdlOut);
            filePutString ("Zaehler_ZAS/STIGN1;11529\n", 25, fhdlOut);

            fileClose(fhdlOut);
        }
    }

    /* ------------------------------------------------------------------------------------------ */
    /*  END frame and signal handle export for remote control of CAPL by Perl script              */
    /* ------------------------------------------------------------------------------------------ */
}
/*@@end*/

/*@@startStart:Start:*/
on start
{
    int FrmIdx;
    int LoopCnt;

    /* start 10ms timer */
    setTimer(Timer_10ms,TIMER_DURATION_10MS);

    for (FrmIdx = 0; FrmIdx < FRM_NUM_MAX; FrmIdx++)
    {
        /* init frame schedule timer */
        FrmSched_SchedTmr[FrmIdx] = 0;
        
        /* enable scheduler for all frames */
        FrmSched_FrmEna[FrmIdx] = 1;

        /* init message counter values */
        Frm_MsgCounter[FrmIdx] = 0;

        /* enable message counter increment */
        Frm_MsgCounterEna[FrmIdx] = 1;

        /* enable checksum calculation */
        Frm_MsgChksmEna[FrmIdx] = 1;

        /* init DLC error status to OK */
        Frm_DLCOk[FrmIdx] = 1;
    }

    
    /* init CAPL control related variables */
    for (LoopCnt = 0; LoopCnt < CAPLCTRL_INPUTBUF_LEN; LoopCnt ++)
    {
        CaplCtrl_InputBuf[LoopCnt] = 0;
    }

    /* ------------------------------------------------------------------------------------------ */
    /*  BEGIN variable initialization                                                             */
    /* ------------------------------------------------------------------------------------------ */

    FrmSched_CycleTime[FRM_HANDLE_ACC_1] = 20;
    FrmSched_CycleTime[FRM_HANDLE_ACC_System] = 20;
    FrmSched_CycleTime[FRM_HANDLE_Airbag_1] = 20;
    FrmSched_CycleTime[FRM_HANDLE_Allrad_1] = 10;
    FrmSched_CycleTime[FRM_HANDLE_BEM_1] = 50;
    FrmSched_CycleTime[FRM_HANDLE_BSG_Last] = 100;
    FrmSched_CycleTime[FRM_HANDLE_Batman_1] = 100;
    FrmSched_CycleTime[FRM_HANDLE_Booster_1] = 20;
    FrmSched_CycleTime[FRM_HANDLE_Bremse_1] = 20;
    FrmSched_CycleTime[FRM_HANDLE_Bremse_10] = 20;
    FrmSched_CycleTime[FRM_HANDLE_Bremse_11] = 100;
    FrmSched_CycleTime[FRM_HANDLE_Bremse_2] = 20;
    FrmSched_CycleTime[FRM_HANDLE_Bremse_3] = 20;
    FrmSched_CycleTime[FRM_HANDLE_Bremse_4] = 10;
    FrmSched_CycleTime[FRM_HANDLE_Bremse_5] = 20;
    FrmSched_CycleTime[FRM_HANDLE_Bremse_8] = 20;
    FrmSched_CycleTime[FRM_HANDLE_Clima_1] = 100;
    FrmSched_CycleTime[FRM_HANDLE_Diagnose_1] = 1000;
    FrmSched_CycleTime[FRM_HANDLE_EPB_1] = 20;
    FrmSched_CycleTime[FRM_HANDLE_EPB_2] = 20;
    FrmSched_CycleTime[FRM_HANDLE_GME] = 10;
    FrmSched_CycleTime[FRM_HANDLE_GRA_Neu] = 20;
    FrmSched_CycleTime[FRM_HANDLE_Gate_Komf_1] = 100;
    FrmSched_CycleTime[FRM_HANDLE_Gate_Komf_2] = 100;
    FrmSched_CycleTime[FRM_HANDLE_Gate_Komf_3] = 200;
    FrmSched_CycleTime[FRM_HANDLE_Getriebe_1] = 10;
    FrmSched_CycleTime[FRM_HANDLE_Getriebe_2] = 10;
    FrmSched_CycleTime[FRM_HANDLE_Getriebe_3_Momente] = 10;
    FrmSched_CycleTime[FRM_HANDLE_Getriebe_6] = 20;
    FrmSched_CycleTime[FRM_HANDLE_Getriebe_Hybrid_1] = 10;
    FrmSched_CycleTime[FRM_HANDLE_Klima_5] = 1000;
    FrmSched_CycleTime[FRM_HANDLE_Kombi_1] = 20;
    FrmSched_CycleTime[FRM_HANDLE_Kombi_2] = 200;
    FrmSched_CycleTime[FRM_HANDLE_Kombi_3] = 200;
    FrmSched_CycleTime[FRM_HANDLE_LW_1] = 10;
    FrmSched_CycleTime[FRM_HANDLE_Lenkhilfe_3] = 10;
    FrmSched_CycleTime[FRM_HANDLE_NMH_Gateway] = 200;
    FrmSched_CycleTime[FRM_HANDLE_Niveau_1] = 48;
    FrmSched_CycleTime[FRM_HANDLE_OBD_Tankgeber_01] = 100;
    FrmSched_CycleTime[FRM_HANDLE_Parkhilfe_01] = 100;
    FrmSched_CycleTime[FRM_HANDLE_Parkhilfe_1] = 1000;
    FrmSched_CycleTime[FRM_HANDLE_Remotestart_FFB] = 500;
    FrmSched_CycleTime[FRM_HANDLE_Soll_Verbauliste_neu] = 100;
    FrmSched_CycleTime[FRM_HANDLE_Systeminfo_1] = 100;
    FrmSched_CycleTime[FRM_HANDLE_TOG] = 500;
    FrmSched_CycleTime[FRM_HANDLE_ZAS_1] = 100;

    Frm_DLC[FRM_HANDLE_ACC_1] = 8;
    Frm_DLC[FRM_HANDLE_ACC_System] = 8;
    Frm_DLC[FRM_HANDLE_Airbag_1] = 4;
    Frm_DLC[FRM_HANDLE_Allrad_1] = 8;
    Frm_DLC[FRM_HANDLE_BEM_1] = 8;
    Frm_DLC[FRM_HANDLE_BSG_Last] = 7;
    Frm_DLC[FRM_HANDLE_Batman_1] = 5;
    Frm_DLC[FRM_HANDLE_Booster_1] = 8;
    Frm_DLC[FRM_HANDLE_Bremse_1] = 8;
    Frm_DLC[FRM_HANDLE_Bremse_10] = 8;
    Frm_DLC[FRM_HANDLE_Bremse_11] = 8;
    Frm_DLC[FRM_HANDLE_Bremse_2] = 8;
    Frm_DLC[FRM_HANDLE_Bremse_3] = 8;
    Frm_DLC[FRM_HANDLE_Bremse_4] = 8;
    Frm_DLC[FRM_HANDLE_Bremse_5] = 8;
    Frm_DLC[FRM_HANDLE_Bremse_8] = 8;
    Frm_DLC[FRM_HANDLE_Clima_1] = 8;
    Frm_DLC[FRM_HANDLE_Diagnose_1] = 8;
    Frm_DLC[FRM_HANDLE_EPB_1] = 8;
    Frm_DLC[FRM_HANDLE_EPB_2] = 8;
    Frm_DLC[FRM_HANDLE_GME] = 8;
    Frm_DLC[FRM_HANDLE_GRA_Neu] = 4;
    Frm_DLC[FRM_HANDLE_Gate_Komf_1] = 8;
    Frm_DLC[FRM_HANDLE_Gate_Komf_2] = 8;
    Frm_DLC[FRM_HANDLE_Gate_Komf_3] = 8;
    Frm_DLC[FRM_HANDLE_Getriebe_1] = 8;
    Frm_DLC[FRM_HANDLE_Getriebe_2] = 8;
    Frm_DLC[FRM_HANDLE_Getriebe_3_Momente] = 8;
    Frm_DLC[FRM_HANDLE_Getriebe_6] = 8;
    Frm_DLC[FRM_HANDLE_Getriebe_Hybrid_1] = 6;
    Frm_DLC[FRM_HANDLE_Klima_5] = 7;
    Frm_DLC[FRM_HANDLE_Kombi_1] = 8;
    Frm_DLC[FRM_HANDLE_Kombi_2] = 8;
    Frm_DLC[FRM_HANDLE_Kombi_3] = 8;
    Frm_DLC[FRM_HANDLE_LW_1] = 8;
    Frm_DLC[FRM_HANDLE_Lenkhilfe_3] = 6;
    Frm_DLC[FRM_HANDLE_NMH_Gateway] = 7;
    Frm_DLC[FRM_HANDLE_Niveau_1] = 8;
    Frm_DLC[FRM_HANDLE_OBD_Tankgeber_01] = 8;
    Frm_DLC[FRM_HANDLE_Parkhilfe_01] = 8;
    Frm_DLC[FRM_HANDLE_Parkhilfe_1] = 4;
    Frm_DLC[FRM_HANDLE_Remotestart_FFB] = 8;
    Frm_DLC[FRM_HANDLE_Soll_Verbauliste_neu] = 8;
    Frm_DLC[FRM_HANDLE_Systeminfo_1] = 8;
    Frm_DLC[FRM_HANDLE_TOG] = 8;
    Frm_DLC[FRM_HANDLE_ZAS_1] = 4;


    /* ------------------------------------------------------------------------------------------ */
    /*  END variable initialization                                                               */
    /* ------------------------------------------------------------------------------------------ */


    /* ------------------------------------------------------------------------------------------ */
    /*  BEGIN OnStart                                                                             */
    /* ------------------------------------------------------------------------------------------ */

    write("");
    write("#===================================================================");
    write("# CAPL program can_db_v4x.can");
    write("# Generated by:  dbc2capl.pl v1.4.6 (dbcparser.pm 1.3.0)");
    write("# CAPL template: dbc2capl_template.can v1.0.2");
    write("# Generated on:  27.10.2011 16:48:21");
    write("# DBC file:      can_db_v4x.dbc");
    write("#===================================================================");
    write("");


    /* ------------------------------------------------------------------------------------------ */
    /*  END OnStart                                                                               */
    /* ------------------------------------------------------------------------------------------ */

    /* HelpFrameList(); */

    write("Hit '?' to get list of all available frames ...");
    ShowPrompt();
}
/*@@end*/

/*@@key:*:*/
on key *
{
    long InputVal = 0;
    int LevelActvOld;
    char CharBufTmp[CAPLCTRL_CHARBUF_LEN];
    
    /* store current input level to be able to check for level change */
    LevelActvOld = CaplCtrl_LevelActv;

    /* empty string */
    CharBufTmp[0] = 0;


    switch (this)
    {
        /* --- numeric input -------------------------------------------------------------------- */
        case '0':
        case '1':
        case '2':
        case '3':
        case '4':
        case '5':
        case '6':
        case '7':
        case '8':
        case '9':
        {
            /* copy input to input buffer */
            CaplCtrl_InputBuf[CaplCtrl_InputIdx] = this;
            
            /* increment to next buffer value */
            CaplCtrl_InputIdx ++;

            /* limit input to buffer length */
            if (CaplCtrl_InputIdx >= CAPLCTRL_INPUTBUF_LEN)
            {
                CaplCtrl_InputIdx = CAPLCTRL_INPUTBUF_LEN - 1;
            }

            /* make sure that string is terminated properly */
            CaplCtrl_InputBuf[CaplCtrl_InputIdx] = 0;
        }
        break;

        /* --- numeric input -------------------------------------------------------------------- */
        case KEY_ENTER:
        {
            if (CaplCtrl_InputIdx > 0)
            {
                InputVal = atol(CaplCtrl_InputBuf);
            
                /* reset input variables */
                CaplCtrl_InputIdx = 0;
                CaplCtrl_InputBuf[0] = 0;

                switch (CaplCtrl_LevelActv)
                {
                    /* currently no level selected */
                    case CAPLCTRL_LEVEL_NOSEL:
                    {
                        /* select frame only if selection was valid */
                        if (InputVal < FRM_NUM_MAX)
                        {
                            /* switch to next level */
                            CaplCtrl_LevelActv = CAPLCTRL_LEVEL_FRAME;

                            /* select frame */
                            CaplCtrl_FrameActv = InputVal;
                        }
                        break;
                    }

                    case CAPLCTRL_LEVEL_FRAME:
                    {
                        /* switch to next level */
                        CaplCtrl_LevelActv = CAPLCTRL_LEVEL_SIGNAL;
                
                        /* select signal */
                        CaplCtrl_SignalActv = InputVal;
                        break;
                    }
            
                    case CAPLCTRL_LEVEL_SIGNAL:
                    {
                        /* set signal to input value */
                        CaplCtrl_InputValue = InputVal;
                        Frm_SetSignal(CaplCtrl_FrameActv, CaplCtrl_SignalActv, CaplCtrl_InputValue);
                        break;
                    }
                }
            }
        }
        break;

        case KEY_LEVEL_DOWN:
        {
            switch (CaplCtrl_LevelActv)
            {
                /* currently no level selected */
                case CAPLCTRL_LEVEL_NOSEL:
                {
                    /* keep level, do nothing */
                    break;
                }

                case CAPLCTRL_LEVEL_FRAME:
                {
                    /* switch back to above level */
                    CaplCtrl_LevelActv = CAPLCTRL_LEVEL_NOSEL;
                    break;
                }
        
                case CAPLCTRL_LEVEL_SIGNAL:
                {
                    /* switch back to above level */
                    CaplCtrl_LevelActv = CAPLCTRL_LEVEL_FRAME;
                    break;
                }
            }
        }
        break;

        case KEY_BACKSPACE:
        {
            /* update index */
            if (CaplCtrl_InputIdx > 0)
            {
                CaplCtrl_InputIdx --;
            }
            else
            {
                CaplCtrl_InputIdx = 0;
            }

            /* remove last character */
            CaplCtrl_InputBuf[CaplCtrl_InputIdx] = 0;
        }
        break;

        case KEY_TIMEOUT:
        {
            switch (CaplCtrl_LevelActv)
            {
                /* currently no level selected */
                case CAPLCTRL_LEVEL_NOSEL:
                {
                    /* enable/disable all frames */
                    if (FrmSched_FrmEna[0] != 0)
                    {
                        FrmSch_DisableAllFrames();
                        snprintf(CaplCtrl_CharBuf,
                                 CAPLCTRL_CHARBUF_LEN,
                                 "all frames disabled!");
                    }
                    else
                    {
                        FrmSch_EnableAllFrames();
                        snprintf(CaplCtrl_CharBuf,
                                 CAPLCTRL_CHARBUF_LEN,
                                 "all frames enabled!");
                    }
                    CaplCtrl_PromptMode = CAPLCTRL_PROMPTMODE_CHAR;
                    break;
                }

                case CAPLCTRL_LEVEL_FRAME:
                case CAPLCTRL_LEVEL_SIGNAL:
                {
                    /* toggle timeout status for selected frame */
                    FrmSched_FrmEna[CaplCtrl_FrameActv] ^= 1;
                    
                    /* get current frame status */
                    snprintf(CharBufTmp,
                             CAPLCTRL_CHARBUF_LEN,
                             "[tx=%d dlc=%d cs=%d cnt=%d]",
                             FrmSched_FrmEna[CaplCtrl_FrameActv],
                             Frm_DLCOk[CaplCtrl_FrameActv],
                             Frm_MsgChksmEna[CaplCtrl_FrameActv],
                             Frm_MsgCounterEna[CaplCtrl_FrameActv]);

                    if (FrmSched_FrmEna[CaplCtrl_FrameActv] != 0)
                    {
                        snprintf(CaplCtrl_CharBuf,
                                 CAPLCTRL_CHARBUF_LEN,
                                 "%s TX enabled!",
                                 CharBufTmp);
                    }
                    else
                    {
                        snprintf(CaplCtrl_CharBuf,
                                 CAPLCTRL_CHARBUF_LEN,
                                 "%s TX disabled!",
                                 CharBufTmp);
                    }

                    CaplCtrl_PromptMode = CAPLCTRL_PROMPTMODE_CHAR;
                    break;
                }
            }
            break;
        }

        case KEY_MSGCNT:
        {
            switch (CaplCtrl_LevelActv)
            {
                /* currently no level selected */
                case CAPLCTRL_LEVEL_NOSEL:
                {
                    /* keep level, do nothing */
                    break;
                }

                case CAPLCTRL_LEVEL_FRAME:
                case CAPLCTRL_LEVEL_SIGNAL:
                {
                    /* toggle message counter enable status */
                    Frm_MsgCounterEna[CaplCtrl_FrameActv] ^= 1;

                    /* get current frame status */
                    snprintf(CharBufTmp,
                             CAPLCTRL_CHARBUF_LEN,
                             "[tx=%d dlc=%d cs=%d cnt=%d]",
                             FrmSched_FrmEna[CaplCtrl_FrameActv],
                             Frm_DLCOk[CaplCtrl_FrameActv],
                             Frm_MsgChksmEna[CaplCtrl_FrameActv],
                             Frm_MsgCounterEna[CaplCtrl_FrameActv]);

                    if (Frm_MsgCounterEna[CaplCtrl_FrameActv] != 0)
                    {
                        snprintf(CaplCtrl_CharBuf,
                                 CAPLCTRL_CHARBUF_LEN,
                                 "%s Message counter running!",
                                 CharBufTmp);
                    }
                    else
                    {
                        snprintf(CaplCtrl_CharBuf,
                                 CAPLCTRL_CHARBUF_LEN,
                                 "%s Message counter stopped!",
                                 CharBufTmp);
                    }

                    CaplCtrl_PromptMode = CAPLCTRL_PROMPTMODE_CHAR;
                    break;
                }
            }
            break;
        }

        case KEY_CHKSM:
        {
            switch (CaplCtrl_LevelActv)
            {
                /* currently no level selected */
                case CAPLCTRL_LEVEL_NOSEL:
                {
                    /* keep level, do nothing */
                    break;
                }

                case CAPLCTRL_LEVEL_FRAME:
                case CAPLCTRL_LEVEL_SIGNAL:
                {
                    /* toggle checksum enable status */
                    Frm_MsgChksmEna[CaplCtrl_FrameActv] ^= 1;

                    /* get current frame status */
                    snprintf(CharBufTmp,
                             CAPLCTRL_CHARBUF_LEN,
                             "[tx=%d dlc=%d cs=%d cnt=%d]",
                             FrmSched_FrmEna[CaplCtrl_FrameActv],
                             Frm_DLCOk[CaplCtrl_FrameActv],
                             Frm_MsgChksmEna[CaplCtrl_FrameActv],
                             Frm_MsgCounterEna[CaplCtrl_FrameActv]);

                    if (Frm_MsgChksmEna[CaplCtrl_FrameActv] != 0)
                    {
                        snprintf(CaplCtrl_CharBuf,
                                 CAPLCTRL_CHARBUF_LEN,
                                 "%s Checksum calculation enabled!",
                                 CharBufTmp);
                    }
                    else
                    {
                        snprintf(CaplCtrl_CharBuf,
                                 CAPLCTRL_CHARBUF_LEN,
                                 "%s Checksum calculation disabled!",
                                 CharBufTmp);
                    }

                    CaplCtrl_PromptMode = CAPLCTRL_PROMPTMODE_CHAR;
                    break;
                }
            }
            break;
        }

        case KEY_DLC:
        {
            switch (CaplCtrl_LevelActv)
            {
                /* currently no level selected */
                case CAPLCTRL_LEVEL_NOSEL:
                {
                    /* keep level, do nothing */
                    break;
                }

                case CAPLCTRL_LEVEL_FRAME:
                case CAPLCTRL_LEVEL_SIGNAL:
                {
                    /* toggle DLC ok status */
                    Frm_DLCOk[CaplCtrl_FrameActv] ^= 1;

                    /* get current frame status */
                    snprintf(CharBufTmp,
                             CAPLCTRL_CHARBUF_LEN,
                             "[tx=%d dlc=%d cs=%d cnt=%d]",
                             FrmSched_FrmEna[CaplCtrl_FrameActv],
                             Frm_DLCOk[CaplCtrl_FrameActv],
                             Frm_MsgChksmEna[CaplCtrl_FrameActv],
                             Frm_MsgCounterEna[CaplCtrl_FrameActv]);

                    if (Frm_DLCOk[CaplCtrl_FrameActv] != 0)
                    {
                        snprintf(CaplCtrl_CharBuf,
                                 CAPLCTRL_CHARBUF_LEN,
                                 "%s correct DLC!",
                                 CharBufTmp);

                        Frm_SetDLC (CaplCtrl_FrameActv, Frm_DLC[CaplCtrl_FrameActv]);
                    }
                    else
                    {
                        snprintf(CaplCtrl_CharBuf,
                                 CAPLCTRL_CHARBUF_LEN,
                                 "%s incorrect DLC!",
                                 CharBufTmp);

                        Frm_SetDLC (CaplCtrl_FrameActv, 0);
                    }


                    CaplCtrl_PromptMode = CAPLCTRL_PROMPTMODE_CHAR;
                    break;
                }
            }
            break;
        }
        
        case KEY_HELP:
        {
            CaplCtrl_LevelChanged();
            break;
        }

        default:
        {
            break;
        }
    }

    if (LevelActvOld != CaplCtrl_LevelActv)
    {
        //CaplCtrl_LevelChanged();
    }

    ShowPrompt();
    CaplCtrl_PromptMode = CAPLCTRL_PROMPTMODE_NUM;
}
/*@@end*/

/*@@caplFunc:CaplCtrl_LevelChanged():*/
CaplCtrl_LevelChanged ()
{
    switch(CaplCtrl_LevelActv)
    {
        case CAPLCTRL_LEVEL_NOSEL:
        {
           HelpFrameList();
        }
        break;

        case CAPLCTRL_LEVEL_FRAME:
        {
            HelpSignalList();
        }
        break;

        case CAPLCTRL_LEVEL_SIGNAL:
        {
           
        }
        break;
    }
}
/*@@end*/

/*@@msg:*:*/
on message *
{
   output(this);
}
/*@@end*/

/*@@caplFunc:FrmSched_SendFrame(int):*/
FrmSched_SendFrame (int FrmIdx)
{
    switch (FrmIdx)
    {
        case FRM_HANDLE_ACC_1:
            MsgObj_ACC_1.BZ_ACC1 = Frm_CalcMsgCounter(FRM_HANDLE_ACC_1);
            MsgObj_ACC_1.CHK_ACC1 = Frm_CalcChecksumXOR(FRM_HANDLE_ACC_1, MsgObj_ACC_1, 7);
            output(MsgObj_ACC_1);
            break;
        case FRM_HANDLE_ACC_System:
            MsgObj_ACC_System.ACS_Zaehler = Frm_CalcMsgCounter(FRM_HANDLE_ACC_System);
            MsgObj_ACC_System.ACS_Checksum = Frm_CalcChecksumXOR(FRM_HANDLE_ACC_System, MsgObj_ACC_System, 0);
            output(MsgObj_ACC_System);
            break;
        case FRM_HANDLE_Airbag_1:
            MsgObj_Airbag_1.AB1_Zaehler = Frm_CalcMsgCounter(FRM_HANDLE_Airbag_1);
            MsgObj_Airbag_1.AB1_Checksumme = Frm_CalcChecksumXOR(FRM_HANDLE_Airbag_1, MsgObj_Airbag_1, 3);
            output(MsgObj_Airbag_1);
            break;
        case FRM_HANDLE_Allrad_1:
            MsgObj_Allrad_1.AL1_Zaehler = Frm_CalcMsgCounter(FRM_HANDLE_Allrad_1);
            output(MsgObj_Allrad_1);
            break;
        case FRM_HANDLE_BEM_1:
            MsgObj_BEM_1.BZ_BEM1 = Frm_CalcMsgCounter(FRM_HANDLE_BEM_1);
            MsgObj_BEM_1.CHK_BEM1 = Frm_CalcChecksumXOR(FRM_HANDLE_BEM_1, MsgObj_BEM_1, 7);
            output(MsgObj_BEM_1);
            break;
        case FRM_HANDLE_BSG_Last:
            output(MsgObj_BSG_Last);
            break;
        case FRM_HANDLE_Batman_1:
            output(MsgObj_Batman_1);
            break;
        case FRM_HANDLE_Booster_1:
            MsgObj_Booster_1.BO1_Zaehler = Frm_CalcMsgCounter(FRM_HANDLE_Booster_1);
            MsgObj_Booster_1.BO1_Checksumme = Frm_CalcChecksumXOR(FRM_HANDLE_Booster_1, MsgObj_Booster_1, 0);
            output(MsgObj_Booster_1);
            break;
        case FRM_HANDLE_Bremse_1:
            MsgObj_Bremse_1.BR1_Zaehler = Frm_CalcMsgCounter(FRM_HANDLE_Bremse_1);
            output(MsgObj_Bremse_1);
            break;
        case FRM_HANDLE_Bremse_10:
            MsgObj_Bremse_10.B10_Zaehler = Frm_CalcMsgCounter(FRM_HANDLE_Bremse_10);
            MsgObj_Bremse_10.B10_Checksumme = Frm_CalcChecksumXOR(FRM_HANDLE_Bremse_10, MsgObj_Bremse_10, 0);
            output(MsgObj_Bremse_10);
            break;
        case FRM_HANDLE_Bremse_11:
            MsgObj_Bremse_11.BR11_Zaehler = Frm_CalcMsgCounter(FRM_HANDLE_Bremse_11);
            MsgObj_Bremse_11.BR11_Checksumme = Frm_CalcChecksumXOR(FRM_HANDLE_Bremse_11, MsgObj_Bremse_11, 0);
            output(MsgObj_Bremse_11);
            break;
        case FRM_HANDLE_Bremse_2:
            MsgObj_Bremse_2.BR2_Zaehler = Frm_CalcMsgCounter(FRM_HANDLE_Bremse_2);
            output(MsgObj_Bremse_2);
            break;
        case FRM_HANDLE_Bremse_3:
            output(MsgObj_Bremse_3);
            break;
        case FRM_HANDLE_Bremse_4:
            MsgObj_Bremse_4.BR4_Zaehler = Frm_CalcMsgCounter(FRM_HANDLE_Bremse_4);
            MsgObj_Bremse_4.BR4_Checksum = Frm_CalcChecksumXOR(FRM_HANDLE_Bremse_4, MsgObj_Bremse_4, 7);
            output(MsgObj_Bremse_4);
            break;
        case FRM_HANDLE_Bremse_5:
            MsgObj_Bremse_5.BR5_Zaehler = Frm_CalcMsgCounter(FRM_HANDLE_Bremse_5);
            MsgObj_Bremse_5.BR5_Checksumme = Frm_CalcChecksumXOR(FRM_HANDLE_Bremse_5, MsgObj_Bremse_5, 7);
            output(MsgObj_Bremse_5);
            break;
        case FRM_HANDLE_Bremse_8:
            MsgObj_Bremse_8.BR8_Zaehler = Frm_CalcMsgCounter(FRM_HANDLE_Bremse_8);
            MsgObj_Bremse_8.BR8_Checksumme = Frm_CalcChecksumXOR(FRM_HANDLE_Bremse_8, MsgObj_Bremse_8, 0);
            output(MsgObj_Bremse_8);
            break;
        case FRM_HANDLE_Clima_1:
            output(MsgObj_Clima_1);
            break;
        case FRM_HANDLE_Diagnose_1:
            output(MsgObj_Diagnose_1);
            break;
        case FRM_HANDLE_EPB_1:
            MsgObj_EPB_1.EP1_Zaehler = Frm_CalcMsgCounter(FRM_HANDLE_EPB_1);
            MsgObj_EPB_1.EP1_Checksum = Frm_CalcChecksumXOR(FRM_HANDLE_EPB_1, MsgObj_EPB_1, 7);
            output(MsgObj_EPB_1);
            break;
        case FRM_HANDLE_EPB_2:
            MsgObj_EPB_2.BZ_EPB2 = Frm_CalcMsgCounter(FRM_HANDLE_EPB_2);
            MsgObj_EPB_2.CHK_EPB2 = Frm_CalcChecksumXOR(FRM_HANDLE_EPB_2, MsgObj_EPB_2, 0);
            output(MsgObj_EPB_2);
            break;
        case FRM_HANDLE_GME:
            MsgObj_GME.BZ_GME = Frm_CalcMsgCounter(FRM_HANDLE_GME);
            MsgObj_GME.CHK_GME = Frm_CalcChecksumXOR(FRM_HANDLE_GME, MsgObj_GME, 0);
            output(MsgObj_GME);
            break;
        case FRM_HANDLE_GRA_Neu:
            MsgObj_GRA_Neu.GRA_Neu_Zaehler = Frm_CalcMsgCounter(FRM_HANDLE_GRA_Neu);
            MsgObj_GRA_Neu.GRA_Checksum = Frm_CalcChecksumXOR(FRM_HANDLE_GRA_Neu, MsgObj_GRA_Neu, 0);
            output(MsgObj_GRA_Neu);
            break;
        case FRM_HANDLE_Gate_Komf_1:
            output(MsgObj_Gate_Komf_1);
            break;
        case FRM_HANDLE_Gate_Komf_2:
            output(MsgObj_Gate_Komf_2);
            break;
        case FRM_HANDLE_Gate_Komf_3:
            output(MsgObj_Gate_Komf_3);
            break;
        case FRM_HANDLE_Getriebe_1:
            MsgObj_Getriebe_1.GE1_Zaehler = Frm_CalcMsgCounter(FRM_HANDLE_Getriebe_1);
            output(MsgObj_Getriebe_1);
            break;
        case FRM_HANDLE_Getriebe_2:
            MsgObj_Getriebe_2.GE2_Zaehler = Frm_CalcMsgCounter(FRM_HANDLE_Getriebe_2);
            output(MsgObj_Getriebe_2);
            break;
        case FRM_HANDLE_Getriebe_3_Momente:
            MsgObj_Getriebe_3_Momente.GM3_Zaehler = Frm_CalcMsgCounter(FRM_HANDLE_Getriebe_3_Momente);
            MsgObj_Getriebe_3_Momente.GM3_Checksum = Frm_CalcChecksumXOR(FRM_HANDLE_Getriebe_3_Momente, MsgObj_Getriebe_3_Momente, 0);
            output(MsgObj_Getriebe_3_Momente);
            break;
        case FRM_HANDLE_Getriebe_6:
            MsgObj_Getriebe_6.GE6_Zaehler = Frm_CalcMsgCounter(FRM_HANDLE_Getriebe_6);
            MsgObj_Getriebe_6.GE6_Checksum = Frm_CalcChecksumXOR(FRM_HANDLE_Getriebe_6, MsgObj_Getriebe_6, 0);
            output(MsgObj_Getriebe_6);
            break;
        case FRM_HANDLE_Getriebe_Hybrid_1:
            MsgObj_Getriebe_Hybrid_1.GH1_Zaehler = Frm_CalcMsgCounter(FRM_HANDLE_Getriebe_Hybrid_1);
            output(MsgObj_Getriebe_Hybrid_1);
            break;
        case FRM_HANDLE_Klima_5:
            output(MsgObj_Klima_5);
            break;
        case FRM_HANDLE_Kombi_1:
            MsgObj_Kombi_1.KO1_Zaehler = Frm_CalcMsgCounter(FRM_HANDLE_Kombi_1);
            output(MsgObj_Kombi_1);
            break;
        case FRM_HANDLE_Kombi_2:
            output(MsgObj_Kombi_2);
            break;
        case FRM_HANDLE_Kombi_3:
            output(MsgObj_Kombi_3);
            break;
        case FRM_HANDLE_LW_1:
            MsgObj_LW_1.LW1_Zaehler = Frm_CalcMsgCounter(FRM_HANDLE_LW_1);
            MsgObj_LW_1.LW1_CRC = Frm_CalcChecksumLW1(FRM_HANDLE_LW_1, MsgObj_LW_1, 7);
            output(MsgObj_LW_1);
            break;
        case FRM_HANDLE_Lenkhilfe_3:
            MsgObj_Lenkhilfe_3.LH3_Zaehler = Frm_CalcMsgCounter(FRM_HANDLE_Lenkhilfe_3);
            MsgObj_Lenkhilfe_3.LH3_Checksumme = Frm_CalcChecksumXOR(FRM_HANDLE_Lenkhilfe_3, MsgObj_Lenkhilfe_3, 0);
            output(MsgObj_Lenkhilfe_3);
            break;
        case FRM_HANDLE_NMH_Gateway:
            output(MsgObj_NMH_Gateway);
            break;
        case FRM_HANDLE_Niveau_1:
            MsgObj_Niveau_1.NI1_Zaehler = Frm_CalcMsgCounter(FRM_HANDLE_Niveau_1);
            MsgObj_Niveau_1.NI1_Checksum = Frm_CalcChecksumXOR(FRM_HANDLE_Niveau_1, MsgObj_Niveau_1, 0);
            output(MsgObj_Niveau_1);
            break;
        case FRM_HANDLE_OBD_Tankgeber_01:
            output(MsgObj_OBD_Tankgeber_01);
            break;
        case FRM_HANDLE_Parkhilfe_01:
            output(MsgObj_Parkhilfe_01);
            break;
        case FRM_HANDLE_Parkhilfe_1:
            output(MsgObj_Parkhilfe_1);
            break;
        case FRM_HANDLE_Remotestart_FFB:
            output(MsgObj_Remotestart_FFB);
            break;
        case FRM_HANDLE_Soll_Verbauliste_neu:
            output(MsgObj_Soll_Verbauliste_neu);
            break;
        case FRM_HANDLE_Systeminfo_1:
            output(MsgObj_Systeminfo_1);
            break;
        case FRM_HANDLE_TOG:
            MsgObj_TOG.TOG_Zaehler = Frm_CalcMsgCounter(FRM_HANDLE_TOG);
            output(MsgObj_TOG);
            break;
        case FRM_HANDLE_ZAS_1:
            MsgObj_ZAS_1.Zaehler_ZAS = Frm_CalcMsgCounter(FRM_HANDLE_ZAS_1);
            MsgObj_ZAS_1.CHK_ZAS = Frm_CalcChecksumXOR(FRM_HANDLE_ZAS_1, MsgObj_ZAS_1, 3);
            output(MsgObj_ZAS_1);
            break;
    }
}
/*@@end*/

/*@@caplFunc:Frm_SetDLC(long, long):*/
Frm_SetDLC (long FrmIdx, long FrmDLC)
{
    switch (FrmIdx)
    {
        case FRM_HANDLE_ACC_1:
            MsgObj_ACC_1.DLC = FrmDLC;
            break;
        case FRM_HANDLE_ACC_System:
            MsgObj_ACC_System.DLC = FrmDLC;
            break;
        case FRM_HANDLE_Airbag_1:
            MsgObj_Airbag_1.DLC = FrmDLC;
            break;
        case FRM_HANDLE_Allrad_1:
            MsgObj_Allrad_1.DLC = FrmDLC;
            break;
        case FRM_HANDLE_BEM_1:
            MsgObj_BEM_1.DLC = FrmDLC;
            break;
        case FRM_HANDLE_BSG_Last:
            MsgObj_BSG_Last.DLC = FrmDLC;
            break;
        case FRM_HANDLE_Batman_1:
            MsgObj_Batman_1.DLC = FrmDLC;
            break;
        case FRM_HANDLE_Booster_1:
            MsgObj_Booster_1.DLC = FrmDLC;
            break;
        case FRM_HANDLE_Bremse_1:
            MsgObj_Bremse_1.DLC = FrmDLC;
            break;
        case FRM_HANDLE_Bremse_10:
            MsgObj_Bremse_10.DLC = FrmDLC;
            break;
        case FRM_HANDLE_Bremse_11:
            MsgObj_Bremse_11.DLC = FrmDLC;
            break;
        case FRM_HANDLE_Bremse_2:
            MsgObj_Bremse_2.DLC = FrmDLC;
            break;
        case FRM_HANDLE_Bremse_3:
            MsgObj_Bremse_3.DLC = FrmDLC;
            break;
        case FRM_HANDLE_Bremse_4:
            MsgObj_Bremse_4.DLC = FrmDLC;
            break;
        case FRM_HANDLE_Bremse_5:
            MsgObj_Bremse_5.DLC = FrmDLC;
            break;
        case FRM_HANDLE_Bremse_8:
            MsgObj_Bremse_8.DLC = FrmDLC;
            break;
        case FRM_HANDLE_Clima_1:
            MsgObj_Clima_1.DLC = FrmDLC;
            break;
        case FRM_HANDLE_Diagnose_1:
            MsgObj_Diagnose_1.DLC = FrmDLC;
            break;
        case FRM_HANDLE_EPB_1:
            MsgObj_EPB_1.DLC = FrmDLC;
            break;
        case FRM_HANDLE_EPB_2:
            MsgObj_EPB_2.DLC = FrmDLC;
            break;
        case FRM_HANDLE_GME:
            MsgObj_GME.DLC = FrmDLC;
            break;
        case FRM_HANDLE_GRA_Neu:
            MsgObj_GRA_Neu.DLC = FrmDLC;
            break;
        case FRM_HANDLE_Gate_Komf_1:
            MsgObj_Gate_Komf_1.DLC = FrmDLC;
            break;
        case FRM_HANDLE_Gate_Komf_2:
            MsgObj_Gate_Komf_2.DLC = FrmDLC;
            break;
        case FRM_HANDLE_Gate_Komf_3:
            MsgObj_Gate_Komf_3.DLC = FrmDLC;
            break;
        case FRM_HANDLE_Getriebe_1:
            MsgObj_Getriebe_1.DLC = FrmDLC;
            break;
        case FRM_HANDLE_Getriebe_2:
            MsgObj_Getriebe_2.DLC = FrmDLC;
            break;
        case FRM_HANDLE_Getriebe_3_Momente:
            MsgObj_Getriebe_3_Momente.DLC = FrmDLC;
            break;
        case FRM_HANDLE_Getriebe_6:
            MsgObj_Getriebe_6.DLC = FrmDLC;
            break;
        case FRM_HANDLE_Getriebe_Hybrid_1:
            MsgObj_Getriebe_Hybrid_1.DLC = FrmDLC;
            break;
        case FRM_HANDLE_Klima_5:
            MsgObj_Klima_5.DLC = FrmDLC;
            break;
        case FRM_HANDLE_Kombi_1:
            MsgObj_Kombi_1.DLC = FrmDLC;
            break;
        case FRM_HANDLE_Kombi_2:
            MsgObj_Kombi_2.DLC = FrmDLC;
            break;
        case FRM_HANDLE_Kombi_3:
            MsgObj_Kombi_3.DLC = FrmDLC;
            break;
        case FRM_HANDLE_LW_1:
            MsgObj_LW_1.DLC = FrmDLC;
            break;
        case FRM_HANDLE_Lenkhilfe_3:
            MsgObj_Lenkhilfe_3.DLC = FrmDLC;
            break;
        case FRM_HANDLE_NMH_Gateway:
            MsgObj_NMH_Gateway.DLC = FrmDLC;
            break;
        case FRM_HANDLE_Niveau_1:
            MsgObj_Niveau_1.DLC = FrmDLC;
            break;
        case FRM_HANDLE_OBD_Tankgeber_01:
            MsgObj_OBD_Tankgeber_01.DLC = FrmDLC;
            break;
        case FRM_HANDLE_Parkhilfe_01:
            MsgObj_Parkhilfe_01.DLC = FrmDLC;
            break;
        case FRM_HANDLE_Parkhilfe_1:
            MsgObj_Parkhilfe_1.DLC = FrmDLC;
            break;
        case FRM_HANDLE_Remotestart_FFB:
            MsgObj_Remotestart_FFB.DLC = FrmDLC;
            break;
        case FRM_HANDLE_Soll_Verbauliste_neu:
            MsgObj_Soll_Verbauliste_neu.DLC = FrmDLC;
            break;
        case FRM_HANDLE_Systeminfo_1:
            MsgObj_Systeminfo_1.DLC = FrmDLC;
            break;
        case FRM_HANDLE_TOG:
            MsgObj_TOG.DLC = FrmDLC;
            break;
        case FRM_HANDLE_ZAS_1:
            MsgObj_ZAS_1.DLC = FrmDLC;
            break;
    }
}
/*@@end*/

/*@@busOff:BusOff:*/
on busOff
{
    resetCan();
}
/*@@end*/

/*@@caplFunc:HelpCommands():*/
HelpCommands ()
{
    write("-------------------------------------------");
    write("Supported commands:");
    write("[a] ... toggle timeout error status");
    write("[b] ... toggle message counter error status");
    write("[c] ... toggle checksumm error status");
    write("[d] ... toggle DLC error status");
    write("[.] ... one level up in command prompt");
    write("-------------------------------------------");
}

/*@@caplFunc:HelpFrameList():*/
HelpFrameList ()
{
    HelpCommands();

    write("[0] ... ACC_1");
    write("[1] ... ACC_System");
    write("[2] ... Airbag_1");
    write("[3] ... Allrad_1");
    write("[4] ... BEM_1");
    write("[5] ... BSG_Last");
    write("[6] ... Batman_1");
    write("[7] ... Booster_1");
    write("[8] ... Bremse_1");
    write("[9] ... Bremse_10");
    write("[10] ... Bremse_11");
    write("[11] ... Bremse_2");
    write("[12] ... Bremse_3");
    write("[13] ... Bremse_4");
    write("[14] ... Bremse_5");
    write("[15] ... Bremse_8");
    write("[16] ... Clima_1");
    write("[17] ... Diagnose_1");
    write("[18] ... EPB_1");
    write("[19] ... EPB_2");
    write("[20] ... GME");
    write("[21] ... GRA_Neu");
    write("[22] ... Gate_Komf_1");
    write("[23] ... Gate_Komf_2");
    write("[24] ... Gate_Komf_3");
    write("[25] ... Getriebe_1");
    write("[26] ... Getriebe_2");
    write("[27] ... Getriebe_3_Momente");
    write("[28] ... Getriebe_6");
    write("[29] ... Getriebe_Hybrid_1");
    write("[30] ... Klima_5");
    write("[31] ... Kombi_1");
    write("[32] ... Kombi_2");
    write("[33] ... Kombi_3");
    write("[34] ... LW_1");
    write("[35] ... Lenkhilfe_3");
    write("[36] ... NMH_Gateway");
    write("[37] ... Niveau_1");
    write("[38] ... OBD_Tankgeber_01");
    write("[39] ... Parkhilfe_01");
    write("[40] ... Parkhilfe_1");
    write("[41] ... Remotestart_FFB");
    write("[42] ... Soll_Verbauliste_neu");
    write("[43] ... Systeminfo_1");
    write("[44] ... TOG");
    write("[45] ... ZAS_1");

}

/*@@caplFunc:HelpSignalList():*/
HelpSignalList ()
{
    HelpCommands();

    switch(CaplCtrl_FrameActv)
    {
        case FRM_HANDLE_ACC_1:
        {
            write("[0] ... AWV1_Freigabe");
            write("[1] ... AWV1_Parameter_HBA");
            write("[2] ... AWV1_Parameter_Nachtreten_HBA");
            write("[3] ... AWV1_Prefill");
            write("[4] ... AWV2_Freigabe");
            write("[5] ... AWV2_Priowarnung_LDW");
            write("[6] ... AWV2_Ruckprofil");
            write("[7] ... Anhalten");
            write("[8] ... BZ_ACC1");
            write("[9] ... CHK_ACC1");
            write("[10] ... Dynamik_Bremsdruck");
            write("[11] ... ESP_Beeinflussung_ACC");
            write("[12] ... FSPE_ACC");
            write("[13] ... Freigabe_Momenten_Anf");
            write("[14] ... Freigabe_Verzoeg_Anf");
            write("[15] ... Momenten_Anf_ACC");
            write("[16] ... Sender_Info");
            write("[17] ... Sollbeschl_Getr");
            write("[18] ... Status_ACC");
            write("[19] ... Verhinderung_SA");
            write("[20] ... Verzoeg_Anf_ACC");
            write("[21] ... Vorbefuellung_Bremsanlage");
        }
        break;
        case FRM_HANDLE_ACC_System:
        {
            write("[0] ... ACS_ADR_Schub");
            write("[1] ... ACS_Anhaltewunsch");
            write("[2] ... ACS_Checksum");
            write("[3] ... ACS_Fehler");
            write("[4] ... ACS_FreigSollB");
            write("[5] ... ACS_MomEingriff");
            write("[6] ... ACS_Schubabsch");
            write("[7] ... ACS_Sollbeschl");
            write("[8] ... ACS_StSt_Info");
            write("[9] ... ACS_Sta_ADR");
            write("[10] ... ACS_Typ_ACC");
            write("[11] ... ACS_Zaehler");
            write("[12] ... ACS_max_AendGrad");
            write("[13] ... ACS_res_21");
            write("[14] ... ACS_res_35");
            write("[15] ... ACS_res_36");
            write("[16] ... ACS_res_37");
            write("[17] ... ACS_res_56");
            write("[18] ... ACS_res_57");
            write("[19] ... ACS_res_58");
            write("[20] ... ACS_res_59");
            write("[21] ... ACS_res_60");
            write("[22] ... ACS_res_61");
            write("[23] ... ACS_res_62");
            write("[24] ... ACS_res_63");
            write("[25] ... ACS_zul_Regelabw");
        }
        break;
        case FRM_HANDLE_Airbag_1:
        {
            write("[0] ... AB1_BF_Warnung");
            write("[1] ... AB1_Beifahrer");
            write("[2] ... AB1_Bf_Seite");
            write("[3] ... AB1_Checksumme");
            write("[4] ... AB1_Diagnose");
            write("[5] ... AB1_Fa_Seite");
            write("[6] ... AB1_Fehlereintr");
            write("[7] ... AB1_Front");
            write("[8] ... AB1_Gurt_Bf");
            write("[9] ... AB1_Gurt_Fa");
            write("[10] ... AB1_Heck");
            write("[11] ... AB1_Intens");
            write("[12] ... AB1_Lampe");
            write("[13] ... AB1_Rollover");
            write("[14] ... AB1_Status");
            write("[15] ... AB1_Stellglied");
            write("[16] ... AB1_System");
            write("[17] ... AB1_Zaehler");
        }
        break;
        case FRM_HANDLE_Allrad_1:
        {
            write("[0] ... AL1_AnfVerteiler");
            write("[1] ... AL1_Anz_blinken");
            write("[2] ... AL1_Begrenzungsmo");
            write("[3] ... AL1_Diff_Gong");
            write("[4] ... AL1_Diff_Lampe");
            write("[5] ... AL1_Diff_Verbau");
            write("[6] ... AL1_Einheit");
            write("[7] ... AL1_FaWu_HA");
            write("[8] ... AL1_FaWu_Laengs");
            write("[9] ... AL1_FaWu_VA");
            write("[10] ... AL1_Fehler");
            write("[11] ... AL1_Fehlereintr");
            write("[12] ... AL1_Ist_Nm");
            write("[13] ... AL1_Ist_Proz");
            write("[14] ... AL1_KupSteifig_F");
            write("[15] ... AL1_Kup_offen");
            write("[16] ... AL1_Limit_maxkmh");
            write("[17] ... AL1_Limiter");
            write("[18] ... AL1_Notlauf");
            write("[19] ... AL1_Quersp_Sta");
            write("[20] ... AL1_Reserve2");
            write("[21] ... AL1_Schalten");
            write("[22] ... AL1_Sta_Kup");
            write("[23] ... AL1_Sta_Laengssp");
            write("[24] ... AL1_Sta_PNG");
            write("[25] ... AL1_Sta_Quersp");
            write("[26] ... AL1_Sta_VA");
            write("[27] ... AL1_Stellung_Getr");
            write("[28] ... AL1_Uebertemp");
            write("[29] ... AL1_Vorwarnung");
            write("[30] ... AL1_Warnlampe");
            write("[31] ... AL1_Zaehler");
        }
        break;
        case FRM_HANDLE_BEM_1:
        {
            write("[0] ... Abschalt_Heizsysteme");
            write("[1] ... Abschaltstufen");
            write("[2] ... Anforderung_HSH");
            write("[3] ... Anforderung_Kluefter_");
            write("[4] ... BEM_Batteriespannung");
            write("[5] ... BEM_StSt_Info");
            write("[6] ... BZ_BEM1");
            write("[7] ... CHK_BEM1");
            write("[8] ... Einschaltung_PTC_Hzg");
            write("[9] ... Generator_Lastmoment");
            write("[10] ... Generator_Leistungsaufnahme");
            write("[11] ... HL_Systeme_Status");
            write("[12] ... HL_Systemregelung_Status");
            write("[13] ... Lastabwurf_Rueckmeldung");
            write("[14] ... Leerlaufdrehzahl_Erhoehung");
            write("[15] ... Load_Response_Generator");
            write("[16] ... Red_Innenraumgeblaese");
            write("[17] ... Ruecknahme_HSH");
        }
        break;
        case FRM_HANDLE_BSG_Last:
        {
            write("[0] ... BSL_Ab_Batterie");
            write("[1] ... BSL_Aussensp");
            write("[2] ... BSL_BSG_2_alt");
            write("[3] ... BSL_BSG_3_alt");
            write("[4] ... BSL_Clima");
            write("[5] ... BSL_DFM");
            write("[6] ... BSL_Fehlereintr");
            write("[7] ... BSL_Frontsch");
            write("[8] ... BSL_Hecksch");
            write("[9] ... BSL_Kl_15_Motor");
            write("[10] ... BSL_Kl_L");
            write("[11] ... BSL_Kuehlerlueft");
            write("[12] ... BSL_LL_Anheb");
            write("[13] ... BSL_LL_Anheb2");
            write("[14] ... BSL_Lenkradheiz");
            write("[15] ... BSL_Motor_Haube");
            write("[16] ... BSL_Parklicht");
            write("[17] ... BSL_Sitzbelueft");
            write("[18] ... BSL_Sitzheiz");
            write("[19] ... BSL_Sta_LWR");
            write("[20] ... BSL_Sta_StBat");
            write("[21] ... BSL_Sta_UBat");
            write("[22] ... BSL_Starterlaubnis");
            write("[23] ... BSL_UBat");
            write("[24] ... BSL_Wake_Up_ACAN");
            write("[25] ... BSL_Wasserheiz");
            write("[26] ... BSL_Weckursache_ACAN");
            write("[27] ... BSL_ZAS_Kl_15");
            write("[28] ... BSL_ZAS_Kl_50");
            write("[29] ... BSL_ZAS_Kl_S");
            write("[30] ... BSL_ZAS_Kl_X");
        }
        break;
        case FRM_HANDLE_Batman_1:
        {
            write("[0] ... BEM_EM_LIN_ungueltig");
            write("[1] ... BEM_P_Generator");
            write("[2] ... BM1_BEM_Reku_Aktiv");
            write("[3] ... BM1_DFM");
            write("[4] ... BM1_Fehlereintr");
            write("[5] ... BM1_Mess_Leitung");
            write("[6] ... BM1_Relais");
            write("[7] ... BM1_Sta_Leitung");
            write("[8] ... BM1_Sta_Relais");
            write("[9] ... BM1_Sta_StBat");
            write("[10] ... BM1_Startmodus");
        }
        break;
        case FRM_HANDLE_Booster_1:
        {
            write("[0] ... BO1_AWV2_Bremsruck");
            write("[1] ... BO1_AWV2_Fehler");
            write("[2] ... BO1_Anf_EPB_Span");
            write("[3] ... BO1_Anf_EPB_aus");
            write("[4] ... BO1_Anf_EPB_ein");
            write("[5] ... BO1_Checksumme");
            write("[6] ... BO1_Fa_bremst");
            write("[7] ... BO1_Freigabe_EPB");
            write("[8] ... BO1_KD_Fehler");
            write("[9] ... BO1_Laengsbeschl");
            write("[10] ... BO1_StaBrSyst");
            write("[11] ... BO1_Sta_ACC_Anf");
            write("[12] ... BO1_Sta_ADR_BR");
            write("[13] ... BO1_Sta_BLS");
            write("[14] ... BO1_Sta_Br_Druck");
            write("[15] ... BO1_Sta_VerzReg");
            write("[16] ... BO1_Verz_EPB_akt");
            write("[17] ... BO1_Zaehler");
            write("[18] ... BO1_aktBrSyst");
            write("[19] ... BO1_res_14");
            write("[20] ... BO1_res_16");
            write("[21] ... BO1_res_17");
            write("[22] ... BO1_res_22");
            write("[23] ... BO1_res_25");
            write("[24] ... BO1_res_27");
            write("[25] ... BO1_res_28");
            write("[26] ... BO1_res_29");
            write("[27] ... BO1_res_30");
            write("[28] ... BO1_res_31");
            write("[29] ... BO1_res_32");
            write("[30] ... BO1_res_41");
            write("[31] ... BO1_res_42");
            write("[32] ... BO1_res_43");
            write("[33] ... BO1_res_44");
            write("[34] ... BO1_res_59");
            write("[35] ... BO1_res_62");
            write("[36] ... BO1_res_63");
        }
        break;
        case FRM_HANDLE_Bremse_1:
        {
            write("[0] ... BR1_ABS_Brems");
            write("[1] ... BR1_ASRMo_fa");
            write("[2] ... BR1_ASRMo_sl");
            write("[3] ... BR1_ASR_Anf");
            write("[4] ... BR1_ASR_ESP");
            write("[5] ... BR1_ASR_Eingr");
            write("[6] ... BR1_BKV_aktiv");
            write("[7] ... BR1_Diagnose");
            write("[8] ... BR1_EBV_Eingr");
            write("[9] ... BR1_EDS_Eingr");
            write("[10] ... BR1_ESPASR_passiv");
            write("[11] ... BR1_ESP_Eingr");
            write("[12] ... BR1_Ersatz_Kmh");
            write("[13] ... BR1_Lampe_ABS");
            write("[14] ... BR1_Lampe_ASR");
            write("[15] ... BR1_Lampe_BK");
            write("[16] ... BR1_Lichtschalt");
            write("[17] ... BR1_MAD");
            write("[18] ... BR1_MSR_Anf");
            write("[19] ... BR1_MSR_Mo");
            write("[20] ... BR1_MSR_Mo_inv");
            write("[21] ... BR1_Rad_kmh");
            write("[22] ... BR1_StaDruckschw");
            write("[23] ... BR1_Sta_ESP");
            write("[24] ... BR1_Sta_MAD");
            write("[25] ... BR1_Zaehler");
        }
        break;
        case FRM_HANDLE_Bremse_10:
        {
            write("[0] ... B10_Checksumme");
            write("[1] ... B10_Fahrtr_HL");
            write("[2] ... B10_Fahrtr_HR");
            write("[3] ... B10_Fahrtr_VL");
            write("[4] ... B10_Fahrtr_VR");
            write("[5] ... B10_QB_Fahrtr_HL");
            write("[6] ... B10_QB_Fahrtr_HR");
            write("[7] ... B10_QB_Fahrtr_VL");
            write("[8] ... B10_QB_Fahrtr_VR");
            write("[9] ... B10_QB_Wegimp_HL");
            write("[10] ... B10_QB_Wegimp_HR");
            write("[11] ... B10_QB_Wegimp_VL");
            write("[12] ... B10_QB_Wegimp_VR");
            write("[13] ... B10_Wegimp_HL");
            write("[14] ... B10_Wegimp_HR");
            write("[15] ... B10_Wegimp_VL");
            write("[16] ... B10_Wegimp_VR");
            write("[17] ... B10_Zaehler");
        }
        break;
        case FRM_HANDLE_Bremse_11:
        {
            write("[0] ... B11_Br_StSt_Info");
            write("[1] ... B11_EPB_Steller_akt");
            write("[2] ... B11_EPB_Steller_gue");
            write("[3] ... B11_HydHalten");
            write("[4] ... B11_OBD_Nib_HL");
            write("[5] ... B11_OBD_Nib_HR");
            write("[6] ... B11_OBD_Nib_VL");
            write("[7] ... B11_OBD_Nib_VR");
            write("[8] ... BR11_Checksumme");
            write("[9] ... BR11_Zaehler");
        }
        break;
        case FRM_HANDLE_Bremse_2:
        {
            write("[0] ... BR2_Aku_Warn");
            write("[1] ... BR2_Blinkmode");
            write("[2] ... BR2_Fehlereintr");
            write("[3] ... BR2_HDC_aktiv");
            write("[4] ... BR2_Impulszahl");
            write("[5] ... BR2_LampeHDC");
            write("[6] ... BR2_Lampe_ABS");
            write("[7] ... BR2_Lampe_ASR");
            write("[8] ... BR2_Lampe_BK");
            write("[9] ... BR2_Lampe_RKA");
            write("[10] ... BR2_QB_Querbeschl");
            write("[11] ... BR2_Querb_Zahn");
            write("[12] ... BR2_Querbeschl");
            write("[13] ... BR2_SleepInd");
            write("[14] ... BR2_Sta_Imp");
            write("[15] ... BR2_Sta_Quer");
            write("[16] ... BR2_Text");
            write("[17] ... BR2_Ueberl_Imp");
            write("[18] ... BR2_Wegimpulse");
            write("[19] ... BR2_Zaehler");
            write("[20] ... BR2_Zahnzahl");
            write("[21] ... BR2_mi_Radgeschw");
        }
        break;
        case FRM_HANDLE_Bremse_3:
        {
            write("[0] ... BR3_Fahrtr_HL");
            write("[1] ... BR3_Fahrtr_HR");
            write("[2] ... BR3_Fahrtr_VL");
            write("[3] ... BR3_Fahrtr_VR");
            write("[4] ... BR3_Rad_kmh_HL");
            write("[5] ... BR3_Rad_kmh_HR");
            write("[6] ... BR3_Rad_kmh_VL");
            write("[7] ... BR3_Rad_kmh_VR");
        }
        break;
        case FRM_HANDLE_Bremse_4:
        {
            write("[0] ... BR4_Abschaltung_HL");
            write("[1] ... BR4_Abschaltung_HR");
            write("[2] ... BR4_Abschaltung_VL");
            write("[3] ... BR4_Abschaltung_VR");
            write("[4] ... BR4_Checksum");
            write("[5] ... BR4_Einheit");
            write("[6] ... BR4_Lampe_RKA");
            write("[7] ... BR4_Reserve2");
            write("[8] ... BR4_Schwelle");
            write("[9] ... BR4_Status_ESP");
            write("[10] ... BR4_Summer_RKA");
            write("[11] ... BR4_Unterdruck");
            write("[12] ... BR4_Vorgabe_Hi");
            write("[13] ... BR4_Vorgabe_Max");
            write("[14] ... BR4_Vorgabe_Mi");
            write("[15] ... BR4_Vorgabe_Mi_");
            write("[16] ... BR4_Vorgabe_Min");
            write("[17] ... BR4_Zaehler");
            write("[18] ... BR4_res_42");
            write("[19] ... BR4_res_48");
        }
        break;
        case FRM_HANDLE_Bremse_5:
        {
            write("[0] ... Anfahrhilfe_aktiv");
            write("[1] ... BR5_AWV2_Bremsruck");
            write("[2] ... BR5_AWV2_Fehler");
            write("[3] ... BR5_AnhStabAktiv");
            write("[4] ... BR5_Anhi_Sta");
            write("[5] ... BR5_Anhi_akt");
            write("[6] ... BR5_Bremsdruck");
            write("[7] ... BR5_Checksumme");
            write("[8] ... BR5_Druckgueltig");
            write("[9] ... BR5_ECD_Lampe");
            write("[10] ... BR5_ECD_Rueckfall");
            write("[11] ... BR5_Giergeschw");
            write("[12] ... BR5_Notbremsung");
            write("[13] ... BR5_Sign_Druck");
            write("[14] ... BR5_Sta_Druck");
            write("[15] ... BR5_Sta_Gierrate");
            write("[16] ... BR5_Stillstand");
            write("[17] ... BR5_Temperatur");
            write("[18] ... BR5_TolAbgl_VR");
            write("[19] ... BR5_Vorzeichen");
            write("[20] ... BR5_Zaehler");
            write("[21] ... BR5_v_Ueberw");
            write("[22] ... FStatus_Anfahrhilfe");
        }
        break;
        case FRM_HANDLE_Bremse_8:
        {
            write("[0] ... BR8_AWV1_BasPar");
            write("[1] ... BR8_Check_EPB");
            write("[2] ... BR8_Checksumme");
            write("[3] ... BR8_Fa_bremst");
            write("[4] ... BR8_Istbeschl");
            write("[5] ... BR8_Laengsbeschl");
            write("[6] ... BR8_QB_LBeschl");
            write("[7] ... BR8_Quattro");
            write("[8] ... BR8_StaBrSyst");
            write("[9] ... BR8_Sta_ACC_Anf");
            write("[10] ... BR8_Sta_ADR_BR");
            write("[11] ... BR8_Sta_BLS");
            write("[12] ... BR8_Sta_Br_Druck");
            write("[13] ... BR8_Sta_Br_temp");
            write("[14] ... BR8_Sta_HW_BLS");
            write("[15] ... BR8_Sta_VerzReg");
            write("[16] ... BR8_TolAbgl_HL");
            write("[17] ... BR8_TolAbgl_HR");
            write("[18] ... BR8_Verz_EPB");
            write("[19] ... BR8_Verz_EPB_akt");
            write("[20] ... BR8_Zaehler");
            write("[21] ... BR8_aktBrSyst");
        }
        break;
        case FRM_HANDLE_Clima_1:
        {
            write("[0] ... CL1_AC_Schalter");
            write("[1] ... CL1_Aussentemp");
            write("[2] ... CL1_Druck");
            write("[3] ... CL1_Einheit_Temp");
            write("[4] ... CL1_Fa_Zuheiz");
            write("[5] ... CL1_Fehlereintr");
            write("[6] ... CL1_Frontsch");
            write("[7] ... CL1_Gebl_last");
            write("[8] ... CL1_Hecksch");
            write("[9] ... CL1_Heizleist");
            write("[10] ... CL1_HzgWischer");
            write("[11] ... CL1_Kompr_Last");
            write("[12] ... CL1_Kompressor");
            write("[13] ... CL1_LL_Dz");
            write("[14] ... CL1_Luefter");
            write("[15] ... CL1_Restwaerme");
            write("[16] ... CL1_Sta_Druck");
            write("[17] ... CL1_Sta_Moment");
            write("[18] ... CL1_Temp_Stoss");
            write("[19] ... KL_4_Zonen");
            write("[20] ... KL_Thermomanagement");
            write("[21] ... SH_MVW");
            write("[22] ... SH_aktiv_Flag");
        }
        break;
        case FRM_HANDLE_Diagnose_1:
        {
            write("[0] ... DI1_Jahr");
            write("[1] ... DI1_KM_Stand_alt");
            write("[2] ... DI1_Minute");
            write("[3] ... DI1_Monat");
            write("[4] ... DI1_Reserve1");
            write("[5] ... DI1_Sekunde");
            write("[6] ... DI1_Stunde");
            write("[7] ... DI1_Tag");
            write("[8] ... DI1_VerlernZaehl");
            write("[9] ... DI1_Zeit_alt");
            write("[10] ... DI1_km_Stand");
        }
        break;
        case FRM_HANDLE_EPB_1:
        {
            write("[0] ... EP1_AnfShLock");
            write("[1] ... EP1_Auto_Schl_Oe");
            write("[2] ... EP1_Bremslicht");
            write("[3] ... EP1_Checksum");
            write("[4] ... EP1_Fehler_BKL");
            write("[5] ... EP1_Fehler_Sta");
            write("[6] ... EP1_Fehler_gelb");
            write("[7] ... EP1_Fehlereintr");
            write("[8] ... EP1_Fkt_Lampe");
            write("[9] ... EP1_Freigabe_Ver");
            write("[10] ... EP1_HydrHalten");
            write("[11] ... EP1_KuppModBer");
            write("[12] ... EP1_Lampe_AutoP");
            write("[13] ... EP1_Neig_winkel");
            write("[14] ... EP1_QualNeigWi");
            write("[15] ... EP1_Schalterinfo");
            write("[16] ... EP1_SleepInd");
            write("[17] ... EP1_Spannkraft");
            write("[18] ... EP1_Sta_EPB");
            write("[19] ... EP1_Sta_NWS");
            write("[20] ... EP1_Sta_Schalter");
            write("[21] ... EP1_Status_Kl_15");
            write("[22] ... EP1_Verschleiss");
            write("[23] ... EP1_Verzoegerung");
            write("[24] ... EP1_Warnton");
            write("[25] ... EP1_Warnton1");
            write("[26] ... EP1_Warnton2");
            write("[27] ... EP1_Zaehler");
            write("[28] ... EP1__Text");
        }
        break;
        case FRM_HANDLE_EPB_2:
        {
            write("[0] ... BZ_EPB2");
            write("[1] ... CHK_EPB2");
            write("[2] ... EPB_Pedalweg_Kuppl");
        }
        break;
        case FRM_HANDLE_GME:
        {
            write("[0] ... BZ_GME");
            write("[1] ... CHK_GME");
            write("[2] ... CVT_Anf_EPB");
            write("[3] ... CVT_Anf_EPB_gueltig");
            write("[4] ... Dynamischer_Eingriff");
            write("[5] ... GME_QB_UeFkt");
            write("[6] ... GME_Schaltung");
            write("[7] ... GME_UeFkt");
            write("[8] ... GME_Verlustmom");
            write("[9] ... Kuehlkreislaufventil_GME");
            write("[10] ... Langfristiger_Eingriff");
            write("[11] ... Status_Dyn_Eingriff");
            write("[12] ... Status_Langfr_Eingriff");
        }
        break;
        case FRM_HANDLE_GRA_Neu:
        {
            write("[0] ... GRA_Abbrechen");
            write("[1] ... GRA_Checksum");
            write("[2] ... GRA_Down_kurz");
            write("[3] ... GRA_Down_lang");
            write("[4] ... GRA_Fehler_Bed");
            write("[5] ... GRA_Fehler_Tip");
            write("[6] ... GRA_Hauptschalt");
            write("[7] ... GRA_Kodierinfo");
            write("[8] ... GRA_Neu_Setzen");
            write("[9] ... GRA_Neu_Zaehler");
            write("[10] ... GRA_Recall");
            write("[11] ... GRA_Sender");
            write("[12] ... GRA_Sportschalter");
            write("[13] ... GRA_Sta_Limiter");
            write("[14] ... GRA_Tip_Down");
            write("[15] ... GRA_Tip_Up");
            write("[16] ... GRA_Typ_Hauptschalt");
            write("[17] ... GRA_Up_kurz");
            write("[18] ... GRA_Up_lang");
            write("[19] ... GRA_Zeitluecke");
        }
        break;
        case FRM_HANDLE_Gate_Komf_1:
        {
            write("[0] ... BCM_Offroad_Taster");
            write("[1] ... BCM_Remotestart_Betrieb");
            write("[2] ... BSK_BT_geoeffnet");
            write("[3] ... BSK_HD_Hauptraste");
            write("[4] ... BSK_HL_geoeffnet");
            write("[5] ... BSK_HR_geoeffnet");
            write("[6] ... BSK_Tankklappe");
            write("[7] ... EV1_Anf_Klemme_50");
            write("[8] ... GK1_Abbl_VL_def");
            write("[9] ... GK1_Abbl_VR_def");
            write("[10] ... GK1_Abblendlicht");
            write("[11] ... GK1_AnhKonLamp");
            write("[12] ... GK1_Anh_abgesteckt");
            write("[13] ... GK1_Anhaenger");
            write("[14] ... GK1_BLS_AAG");
            write("[15] ... GK1_BLS_ILM");
            write("[16] ... GK1_Blink_Autob");
            write("[17] ... GK1_Blinker_li");
            write("[18] ... GK1_Blinker_re");
            write("[19] ... GK1_BrLi_Anhaen");
            write("[20] ... GK1_BrLi_links");
            write("[21] ... GK1_BrLi_mitte");
            write("[22] ... GK1_BrLi_rechts");
            write("[23] ... GK1_Bremslicht");
            write("[24] ... GK1_CharismaModus");
            write("[25] ... GK1_Count_Anhaen");
            write("[26] ... GK1_Count_Li_Hi");
            write("[27] ... GK1_EDC_AAG");
            write("[28] ... GK1_EDC_ILM");
            write("[29] ... GK1_ELV_verrieg");
            write("[30] ... GK1_Fa_Tuerkont");
            write("[31] ... GK1_Fernlicht");
            write("[32] ... GK1_KW_Warm");
            write("[33] ... GK1_Nebel_ein");
            write("[34] ... GK1_ParkFrontWi");
            write("[35] ... GK1_Reserve3");
            write("[36] ... GK1_Rueckfahr");
            write("[37] ... GK1_RueckfahrSch");
            write("[38] ... GK1_SH_Verbau");
            write("[39] ... GK1_SH_Zusatzfkt");
            write("[40] ... GK1_SH_laeuft");
            write("[41] ... GK1_SamFktNr");
            write("[42] ... GK1_SleepAckn");
            write("[43] ... GK1_Sta_Anhaen");
            write("[44] ... GK1_Sta_ILM_F_1");
            write("[45] ... GK1_Sta_Kessy_2");
            write("[46] ... GK1_Sta_LSM");
            write("[47] ... GK1_Sta_Li_vorn");
            write("[48] ... GK1_Sta_Licht1");
            write("[49] ... GK1_Sta_Licht2");
            write("[50] ... GK1_Sta_Licht3");
            write("[51] ... GK1_Sta_RDK_Warn");
            write("[52] ... GK1_Sta_Stdhzg");
            write("[53] ... GK1_Sta_Tuerkont");
            write("[54] ... GK1_Warnblk_Status");
            write("[55] ... GK1_Wischer_vorn");
            write("[56] ... GK1_def_P_verr");
            write("[57] ... GK1_res_06");
            write("[58] ... GK1_res_62");
            write("[59] ... KL_EKP_Anst");
            write("[60] ... KY2_StSt_Info");
            write("[61] ... Klima_5_D3_alt");
            write("[62] ... Motorhaubenkontakt_ein");
            write("[63] ... SH1_ein_Wasserpumpe");
            write("[64] ... mKessy2_alt");
        }
        break;
        case FRM_HANDLE_Gate_Komf_2:
        {
            write("[0] ... BEM_Segel_Info");
            write("[1] ... GK2_BEM_DFM");
            write("[2] ... GK2_BEM_P_Generator");
            write("[3] ... GK2_BEM_StSt_Info");
            write("[4] ... GK2_BSG_StSt_Info");
            write("[5] ... GK2_Blk_L_Kontrolle");
            write("[6] ... GK2_Blk_R_Kontrolle");
            write("[7] ... GK2_EM_LIN_ungueltig");
            write("[8] ... GK2_Feh_VLR");
            write("[9] ... GK2_Hardtop");
            write("[10] ... GK2_Helligkeit");
            write("[11] ... GK2_Kessy_StSt_Info");
            write("[12] ... GK2_Kl_StSt_Info");
            write("[13] ... GK2_LS_KomFehler");
            write("[14] ... GK2_LS_def");
            write("[15] ... GK2_Profil");
            write("[16] ... GK2_Schluessel");
            write("[17] ... GK2_Sta_BSG4");
            write("[18] ... GK2_Sta_Clima2");
            write("[19] ... GK2_Sta_Kessy_4");
            write("[20] ... GK2_Sta_LSM");
            write("[21] ... GK2_Sta_Licht1");
            write("[22] ... GK2_Sta_Lichtsensor");
            write("[23] ... GK2_Sta_Profil");
            write("[24] ... GK2_Sta_Schluessel");
            write("[25] ... GK2_Sta_VSG");
            write("[26] ... GK2_VDKD_auf");
            write("[27] ... GK2_VD_entriegelt");
            write("[28] ... GK2_VD_offen_ver");
            write("[29] ... GK2_VD_zu_ver");
            write("[30] ... GK2_Verdeck_Anf");
            write("[31] ... GK2_res_09");
            write("[32] ... GK2_res_13");
            write("[33] ... GK2_res_29");
            write("[34] ... GK2_res_30");
        }
        break;
        case FRM_HANDLE_Gate_Komf_3:
        {
            write("[0] ... BCM_Tankwunsch");
            write("[1] ... BK1_Anlern_Info");
            write("[2] ... BK1_IDGeber_1_Status");
            write("[3] ... BK1_IDGeber_2_Status");
            write("[4] ... BK1_IDGeber_3_Status");
            write("[5] ... BK1_IDGeber_4_Status");
            write("[6] ... CL3_SH_Wasserpumpe");
            write("[7] ... GK2_Sta_Kessy_4");
            write("[8] ... GK3_Sta_BCM_KY1");
            write("[9] ... GK3_Sta_BSG4");
            write("[10] ... GK3_Sta_Clima_3");
            write("[11] ... GK3_Sta_res_03");
            write("[12] ... GK3_Sta_res_04");
            write("[13] ... GK3_Sta_res_05");
            write("[14] ... GK3_Sta_res_06");
            write("[15] ... GK3_Sta_res_07");
            write("[16] ... KY4_Gong_600");
            write("[17] ... KY4_Meldungen");
            write("[18] ... KY4_Passiv_Autolock_Menue");
            write("[19] ... KY4_Passiv_Autolock_akt");
        }
        break;
        case FRM_HANDLE_Getriebe_1:
        {
            write("[0] ... GE1_Code_MSG");
            write("[1] ... GE1_EGS_Anf");
            write("[2] ... GE1_Fahrwistd");
            write("[3] ... GE1_Fehlereintr");
            write("[4] ... GE1_Infobit");
            write("[5] ... GE1_Klimakompr");
            write("[6] ... GE1_Kuehlung");
            write("[7] ... GE1_LaunchControl");
            write("[8] ... GE1_Mrad_Mkurb");
            write("[9] ... GE1_Notlauf");
            write("[10] ... GE1_Schaltung");
            write("[11] ... GE1_SleepInd");
            write("[12] ... GE1_Soll_Mo");
            write("[13] ... GE1_Sta_OBD");
            write("[14] ... GE1_Sta_Schutz");
            write("[15] ... GE1_Start_Stopp_Info");
            write("[16] ... GE1_Startverbot");
            write("[17] ... GE1_WK");
            write("[18] ... GE1_WaVerl_Mo");
            write("[19] ... GE1_Wahl_Pos");
            write("[20] ... GE1_Zaehler");
            write("[21] ... GE1_Zielgang");
            write("[22] ... GE1_v_Umkehr");
        }
        break;
        case FRM_HANDLE_Getriebe_2:
        {
            write("[0] ... GE2_4Gang");
            write("[1] ... GE2_5Gang");
            write("[2] ... GE2_ASG");
            write("[3] ... GE2_DZM_Daempf");
            write("[4] ... GE2_Gong");
            write("[5] ... GE2_Grad_begr");
            write("[6] ... GE2_LFR_Adap");
            write("[7] ... GE2_LL_Solldz");
            write("[8] ... GE2_MSB_Sync");
            write("[9] ... GE2_PRND");
            write("[10] ... GE2_PRNDS");
            write("[11] ... GE2_Segeln_aktiv");
            write("[12] ... GE2_Selespeed");
            write("[13] ... GE2_Senderkennung");
            write("[14] ... GE2_Shift_Lock");
            write("[15] ... GE2_SlipStDZEingr");
            write("[16] ... GE2_Sta_SAS");
            write("[17] ... GE2_Sta_ZwGas");
            write("[18] ... GE2_Sync_Dz");
            write("[19] ... GE2_Sync_Zeit");
            write("[20] ... GE2_Tip4Gang");
            write("[21] ... GE2_Tip5Gang");
            write("[22] ... GE2_Tip6Gang");
            write("[23] ... GE2_Tip7Gang");
            write("[24] ... GE2_Variante");
            write("[25] ... GE2_WBA_Blinken");
            write("[26] ... GE2_Zaehler");
            write("[27] ... GE2_akt_Gang");
            write("[28] ... GE2_invMSB_Sync");
            write("[29] ... GE2_invSync_Dz");
        }
        break;
        case FRM_HANDLE_Getriebe_3_Momente:
        {
            write("[0] ... GM3_Checksum");
            write("[1] ... GM3_LangEingr");
            write("[2] ... GM3_MoSoMom");
            write("[3] ... GM3_MomEingr");
            write("[4] ... GM3_MomID");
            write("[5] ... GM3_Moment");
            write("[6] ... GM3_QB_LangEingr");
            write("[7] ... GM3_StaSoMom");
            write("[8] ... GM3_Zaehler");
            write("[9] ... GM3_Zeit");
            write("[10] ... GM3_res_13");
            write("[11] ... GM3_res_14");
            write("[12] ... GM3_res_15");
            write("[13] ... GM3_res_61");
            write("[14] ... GM3_res_62");
            write("[15] ... GM3_res_63");
        }
        break;
        case FRM_HANDLE_Getriebe_6:
        {
            write("[0] ... GE6_Checksum");
            write("[1] ... GE6_Gangwechsel");
            write("[2] ... GE6_OelTemp");
            write("[3] ... GE6_QB_OelTemp");
            write("[4] ... GE6_QmaxBeschl");
            write("[5] ... GE6_Sta_Shift_Spontan");
            write("[6] ... GE6_TurbDZ");
            write("[7] ... GE6_Verlustmom");
            write("[8] ... GE6_Zaehler");
            write("[9] ... GE6_Zielgang_err");
            write("[10] ... GE6_maxBeschl");
            write("[11] ... GE_Heizwunsch");
            write("[12] ... GE_StSt_Info");
        }
        break;
        case FRM_HANDLE_Getriebe_Hybrid_1:
        {
            write("[0] ... GH1_AnzeigeDZ");
            write("[1] ... GH1_FehlerstatusGSG");
            write("[2] ... GH1_Filt_MomAufbau");
            write("[3] ... GH1_Freig_LL_Reg");
            write("[4] ... GH1_FreigabeK0");
            write("[5] ... GH1_FreigabeSSK0");
            write("[6] ... GH1_FreigabeVMStop");
            write("[7] ... GH1_MomEingriff_EM");
            write("[8] ... GH1_Sportfaktor");
            write("[9] ... GH1_VKMstartanforderung");
            write("[10] ... GH1_VKMstartkontrolle");
            write("[11] ... GH1_VM_akt_halten");
            write("[12] ... GH1_VZMomEingriff");
            write("[13] ... GH1_Wiederstart");
            write("[14] ... GH1_Zaehler");
            write("[15] ... GH1_nK0");
        }
        break;
        case FRM_HANDLE_Klima_5:
        {
            write("[0] ... HYB_Anf_E_Mode");
            write("[1] ... KL_Magnetventil");
            write("[2] ... KL_Schalter_StartStopp");
            write("[3] ... KL_Thermomanagement");
            write("[4] ... Klima_StSt_Info");
            write("[5] ... SH_Betriebsdauer");
            write("[6] ... SH_Monat");
            write("[7] ... SH_Offset_Jahr");
            write("[8] ... SH_Tag");
            write("[9] ... SH_Timer_aktiv");
            write("[10] ... SH_Timerstatus");
            write("[11] ... SH_WP_Fehler");
            write("[12] ... SH_Wochentag");
            write("[13] ... SH_h_Einschaltzeit");
            write("[14] ... SH_min_Einschaltzeit");
            write("[15] ... STH_Betriebsart");
        }
        break;
        case FRM_HANDLE_Kombi_1:
        {
            write("[0] ... KO1_ABS_Lampe");
            write("[1] ... KO1_ACC_AnzFhl");
            write("[2] ... KO1_ACC_Inkons");
            write("[3] ... KO1_ASRESP_Lampe");
            write("[4] ... KO1_Airbag_Lampe");
            write("[5] ... KO1_Brems_Lampe");
            write("[6] ... KO1_Bremsinfo");
            write("[7] ... KO1_Handbremse");
            write("[8] ... KO1_Kuehlmittel");
            write("[9] ... KO1_LDW_AnzFeh");
            write("[10] ... KO1_La_Ladekon");
            write("[11] ... KO1_Lenkh_Lampe");
            write("[12] ... KO1_OBD_Tank");
            write("[13] ... KO1_Oeldruck");
            write("[14] ... KO1_Quelle_kmh");
            write("[15] ... KO1_SILA_gueltig");
            write("[16] ... KO1_SleepInd");
            write("[17] ... KO1_Sta_Oeldr");
            write("[18] ... KO1_Sta_Tank");
            write("[19] ... KO1_Stellglieder");
            write("[20] ... KO1_Tankinhalt");
            write("[21] ... KO1_Tankstop");
            write("[22] ... KO1_Vorgluehen");
            write("[23] ... KO1_Wakeup_Komfort");
            write("[24] ... KO1_Warn_Tank");
            write("[25] ... KO1_Zaehler");
            write("[26] ... KO1_Zeitluecke");
            write("[27] ... KO1_angez_kmh");
            write("[28] ... KO1_kmh");
            write("[29] ... KO1_kmh_mph");
        }
        break;
        case FRM_HANDLE_Kombi_2:
        {
            write("[0] ... KO2_Aussen_T");
            write("[1] ... KO2_Bel_Displ");
            write("[2] ... KO2_Bel_Schalt");
            write("[3] ... KO2_Fehlereintr");
            write("[4] ... KO2_GRA_High");
            write("[5] ... KO2_MFA_v_Einheit");
            write("[6] ... KO2_OBD_Nib_Temp");
            write("[7] ... KO2_OelTemp");
            write("[8] ... KO2_Oelwarn");
            write("[9] ... KO2_PLA_Displaystatus");
            write("[10] ... KO2_Reserve4");
            write("[11] ... KO2_Reserve5");
            write("[12] ... KO2_Sta_Auss_T");
            write("[13] ... KO2_Sta_Displ");
            write("[14] ... KO2_Sta_Oel_T");
            write("[15] ... KO2_Sta_Schalt");
            write("[16] ... KO2_Temp_Einheit");
            write("[17] ... KO2_Verb_TOG");
            write("[18] ... KO2_Wischwasser");
            write("[19] ... KO2_gef_Auss_T");
            write("[20] ... MFA_Strecke_Einheit");
        }
        break;
        case FRM_HANDLE_Kombi_3:
        {
            write("[0] ... KBI_Oelwechsel_durchgefuehrt");
            write("[1] ... KO3_Baureihe");
            write("[2] ... KO3_Derivat");
            write("[3] ... KO3_Generation");
            write("[4] ... KO3_Kilometer");
            write("[5] ... KO3_Land");
            write("[6] ... KO3_Marke");
            write("[7] ... KO3_Mp_Code");
            write("[8] ... KO3_Radumfang");
            write("[9] ... KO3_Reserve1");
            write("[10] ... KO3_Reserve2");
            write("[11] ... KO3_SWA_AnzFeh");
            write("[12] ... KO3_Schluessel");
            write("[13] ... KO3_Sprache");
            write("[14] ... KO3_Sta_Standz");
            write("[15] ... KO3_Standzeit");
            write("[16] ... KO3_Verbau_ADR");
            write("[17] ... KO3_Verbau_Air");
            write("[18] ... KO3_Verbau_BN");
            write("[19] ... KO3_Verbau_Br");
            write("[20] ... KO3_Verbau_DP");
            write("[21] ... KO3_Verbau_Get");
            write("[22] ... KO3_Verbau_Kl");
            write("[23] ... KO3_Verbau_LH");
            write("[24] ... KO3_Verbau_LWS");
            write("[25] ... KO3_Verbau_Mot");
            write("[26] ... KO3_Verbau_Niveau");
            write("[27] ... KO3_Verbau_Syn");
        }
        break;
        case FRM_HANDLE_LW_1:
        {
            write("[0] ... LW1_CRC");
            write("[1] ... LW1_Gesch_Sign");
            write("[2] ... LW1_ID");
            write("[3] ... LW1_Initquelle");
            write("[4] ... LW1_Kodier");
            write("[5] ... LW1_LRW");
            write("[6] ... LW1_LRW_Sign");
            write("[7] ... LW1_Lenk_Gesch");
            write("[8] ... LW1_Sta_KL30");
            write("[9] ... LW1_Status");
            write("[10] ... LW1_Zaehler");
        }
        break;
        case FRM_HANDLE_Lenkhilfe_3:
        {
            write("[0] ... LH3_BLW");
            write("[1] ... LH3_BLWSign");
            write("[2] ... LH3_BLWValid");
            write("[3] ... LH3_BS_Spiegel");
            write("[4] ... LH3_Checksumme");
            write("[5] ... LH3_LM");
            write("[6] ... LH3_LMSign");
            write("[7] ... LH3_LMValid");
            write("[8] ... LH3_Lenkungstyp");
            write("[9] ... LH3_Sta_DSR");
            write("[10] ... LH3_Zaehler");
        }
        break;
        case FRM_HANDLE_NMH_Gateway:
        {
            write("[0] ... NMH_GW_Abschaltstufe_aktiv");
            write("[1] ... NMH_GW_CAN_Diag_deaktiv");
            write("[2] ... NMH_GW_Car_WakeUp");
            write("[3] ... NMH_GW_Eindraht_Fehler");
            write("[4] ... NMH_GW_Fkt_WakeUp");
            write("[5] ... NMH_GW_KompSchutz");
            write("[6] ... NMH_GW_Mute_Mode");
            write("[7] ... NMH_GW_NL_0");
            write("[8] ... NMH_GW_NL_1");
            write("[9] ... NMH_GW_NL_2");
            write("[10] ... NMH_GW_NL_3");
            write("[11] ... NMH_GW_NL_4");
            write("[12] ... NMH_GW_NL_5");
            write("[13] ... NMH_GW_NL_6");
            write("[14] ... NMH_GW_NL_7");
            write("[15] ... NMH_GW_NL_aktiv_4");
            write("[16] ... NMH_GW_NL_aktiv_5");
            write("[17] ... NMH_GW_NL_aktiv_6");
            write("[18] ... NMH_GW_NL_aktiv_7");
            write("[19] ... NMH_GW_NL_aktiv_8");
            write("[20] ... NMH_GW_NM_aktiv_Diagnose");
            write("[21] ... NMH_GW_NM_aktiv_Klemme_15");
            write("[22] ... NMH_GW_NM_aktiv_Start");
            write("[23] ... NMH_GW_Normal_Mode_1");
            write("[24] ... NMH_GW_Normal_Mode_2");
            write("[25] ... NMH_GW_Per_WakeUp");
            write("[26] ... NMH_GW_Start_1");
            write("[27] ... NMH_GW_Start_2");
            write("[28] ... NMH_GW_TimeOut_Fehler");
            write("[29] ... NMH_GW_Transport_Mode");
        }
        break;
        case FRM_HANDLE_Niveau_1:
        {
            write("[0] ... Absenkung_Fahrzeug");
            write("[1] ... Anhebung_Fahrzeug");
            write("[2] ... Aufpruefbit_Warnlampe_Niveau");
            write("[3] ... Beladungszustand");
            write("[4] ... ESP_Beeinflussung");
            write("[5] ... FSPE_Niveau1");
            write("[6] ... Fehlerlampe_Niveau");
            write("[7] ... Kompressor_laeuft");
            write("[8] ... Kompressorlauf_in_Kuerze");
            write("[9] ... NI1_Checksum");
            write("[10] ... NI1_Fahrzeugart");
            write("[11] ... NI1_MSG_Eingriff");
            write("[12] ... NI1_Zaehler");
            write("[13] ... Niveaustati");
            write("[14] ... Parkniveau");
            write("[15] ... SIB_Niveau");
            write("[16] ... Stromaufnahme");
            write("[17] ... Systemstatus");
            write("[18] ... Taster_Niveau");
            write("[19] ... Textbits_Niveau");
            write("[20] ... Tiefniveaulampe");
            write("[21] ... Verstellung_HL");
            write("[22] ... Verstellung_HR");
            write("[23] ... Verstellung_VL");
            write("[24] ... Verstellung_VR");
            write("[25] ... Verstellung_aktiv");
            write("[26] ... Verstellung_in_Kuerze");
            write("[27] ... Warnlampe");
            write("[28] ... Zwischenniveau");
        }
        break;
        case FRM_HANDLE_OBD_Tankgeber_01:
        {
            write("[0] ... OBD_TG_F_Status_1");
            write("[1] ... OBD_TG_F_Status_2");
            write("[2] ... OBD_TG_F_Status_3");
            write("[3] ... OBD_TG_F_Status_4");
            write("[4] ... OBD_TG_Sens_Rohwert_1");
            write("[5] ... OBD_TG_Sens_Rohwert_2");
            write("[6] ... OBD_TG_Sens_Rohwert_3");
            write("[7] ... OBD_TG_Sens_Rohwert_4");
        }
        break;
        case FRM_HANDLE_Parkhilfe_01:
        {
            write("[0] ... PH_Abschaltursache");
            write("[1] ... PH_Anf_Audioabsenkung");
            write("[2] ... PH_Aufbauten_erk");
            write("[3] ... PH_BerErk_hinten");
            write("[4] ... PH_BerErk_vorn");
            write("[5] ... PH_Display_Kundenwunsch");
            write("[6] ... PH_Frequenz_hinten");
            write("[7] ... PH_Frequenz_vorn");
            write("[8] ... PH_KD_Fehler");
            write("[9] ... PH_Lautstaerke_hinten");
            write("[10] ... PH_Lautstaerke_vorn");
            write("[11] ... PH_Opt_Anz_H_Hindernis");
            write("[12] ... PH_Opt_Anz_V_Hindernis");
            write("[13] ... PH_Opt_Anzeige_H_ein");
            write("[14] ... PH_Opt_Anzeige_V_ein");
            write("[15] ... PH_StartStopp_Info");
            write("[16] ... PH_Systemzustand");
            write("[17] ... PH_Tongeber_H_aktiv");
            write("[18] ... PH_Tongeber_V_aktiv");
            write("[19] ... PH_Tongeber_mute");
            write("[20] ... PH_defekt");
            write("[21] ... PH_gestoert");
            write("[22] ... PH_res_00");
            write("[23] ... PH_res_01");
            write("[24] ... PH_res_02");
            write("[25] ... PH_res_03");
            write("[26] ... PH_res_04");
            write("[27] ... PH_res_05");
            write("[28] ... PH_res_06");
            write("[29] ... PH_res_07");
            write("[30] ... PH_res_08");
            write("[31] ... PH_res_09");
            write("[32] ... PH_res_10");
            write("[33] ... PH_res_11");
            write("[34] ... PH_res_12");
            write("[35] ... PH_res_24");
            write("[36] ... PH_res_25");
            write("[37] ... PH_res_26");
            write("[38] ... PH_res_27");
            write("[39] ... PH_res_28");
            write("[40] ... PH_res_29");
            write("[41] ... PH_res_30");
            write("[42] ... PH_res_31");
            write("[43] ... PH_res_48");
        }
        break;
        case FRM_HANDLE_Parkhilfe_1:
        {
            write("[0] ... APS_Frequenz_hinten");
            write("[1] ... APS_Frequenz_vorn");
            write("[2] ... APS_Lautstaerke_hinten");
            write("[3] ... APS_Lautstaerke_vorn");
            write("[4] ... Anlage_defekt");
            write("[5] ... Eis_aus");
            write("[6] ... Geschwindigkeit_aus");
            write("[7] ... KD_Fehler_Parkhilfe");
            write("[8] ... Optische_Anzeige_aktiv");
            write("[9] ... PH_StSt_Info");
            write("[10] ... Rueckwaertsgang_aktiviert");
            write("[11] ... Schlechtweg_aus");
            write("[12] ... Taster_aktiviert");
            write("[13] ... Tongeber_h_aktiv");
            write("[14] ... Tongeber_h_defekt");
            write("[15] ... Tongeber_v_aktiv");
            write("[16] ... Tongeber_v_defekt");
        }
        break;
        case FRM_HANDLE_Remotestart_FFB:
        {
            write("[0] ... RSF_Tastencode_1");
            write("[1] ... RSF_Tastencode_2");
            write("[2] ... RSF_Tastencode_Maske");
        }
        break;
        case FRM_HANDLE_Soll_Verbauliste_neu:
        {
            write("[0] ... VL1_ABS");
            write("[1] ... VL1_ADR");
            write("[2] ... VL1_ADR_getrennt");
            write("[3] ... VL1_Airbag");
            write("[4] ... VL1_Allrad");
            write("[5] ... VL1_Anhaenger");
            write("[6] ... VL1_BSG_Komf");
            write("[7] ... VL1_Clima_Komf");
            write("[8] ... VL1_DAB");
            write("[9] ... VL1_DSP");
            write("[10] ... VL1_Daempfer");
            write("[11] ... VL1_EPB");
            write("[12] ... VL1_Easy_Entry_VB");
            write("[13] ... VL1_Easy_Entry_VF");
            write("[14] ... VL1_Einparkhilfe");
            write("[15] ... VL1_GSM_Pager");
            write("[16] ... VL1_Gateway");
            write("[17] ... VL1_Getr_SG");
            write("[18] ... VL1_HCA");
            write("[19] ... VL1_Heckdeckel");
            write("[20] ... VL1_InfoElektronik");
            write("[21] ... VL1_Kombi");
            write("[22] ... VL1_Kombi_KBI");
            write("[23] ... VL1_Kompass");
            write("[24] ... VL1_LSM");
            write("[25] ... VL1_Lenkhilfe");
            write("[26] ... VL1_Lenksaeule");
            write("[27] ... VL1_MDI_I");
            write("[28] ... VL1_Memory");
            write("[29] ... VL1_Memory_BF");
            write("[30] ... VL1_MotorSlave");
            write("[31] ... VL1_Motor_SG");
            write("[32] ... VL1_Navigation");
            write("[33] ... VL1_Neigungsmodul_I");
            write("[34] ... VL1_PLA");
            write("[35] ... VL1_PTC_Heizung");
            write("[36] ... VL1_Quersperre");
            write("[37] ... VL1_RDK");
            write("[38] ... VL1_RKA_Plus");
            write("[39] ... VL1_RSE_I");
            write("[40] ... VL1_Radio");
            write("[41] ... VL1_Rearview");
            write("[42] ... VL1_SWA");
            write("[43] ... VL1_Soll_eq_Ist");
            write("[44] ... VL1_Sonderfzg_SG");
            write("[45] ... VL1_Standheiz");
            write("[46] ... VL1_TSG_BT");
            write("[47] ... VL1_TSG_FT");
            write("[48] ... VL1_TSG_HL");
            write("[49] ... VL1_TSG_HR");
            write("[50] ... VL1_TV_Tuner");
            write("[51] ... VL1_Tastenmodul");
            write("[52] ... VL1_Telefon");
            write("[53] ... VL1_Telematik");
            write("[54] ... VL1_Verdeck");
            write("[55] ... VL1_WFS_K");
            write("[56] ... VL1_WFS_KBI");
            write("[57] ... VL1_ZKE");
            write("[58] ... VL1_Zentralelektrik_II");
            write("[59] ... VL1_dyn_LWR");
            write("[60] ... VL1_res_08");
            write("[61] ... VL1_res_13");
            write("[62] ... VL1_res_31");
            write("[63] ... VL1_res_42");
        }
        break;
        case FRM_HANDLE_Systeminfo_1:
        {
            write("[0] ... SY1_Ant_HV");
            write("[1] ... SY1_Ant_NV");
            write("[2] ... SY1_CAN_Info");
            write("[3] ... SY1_CAN_extern");
            write("[4] ... SY1_Diag_Ant");
            write("[5] ... SY1_Diag_Info");
            write("[6] ... SY1_Diag_Komf");
            write("[7] ... SY1_ELV_Lock_Supply");
            write("[8] ... SY1_Fehlereintr");
            write("[9] ... SY1_Fzg_Derivat");
            write("[10] ... SY1_Fzg_Gen");
            write("[11] ... SY1_Fzg_Index");
            write("[12] ... SY1_Fzg_Klasse");
            write("[13] ... SY1_Fzg_Marke");
            write("[14] ... SY1_Komf_HV");
            write("[15] ... SY1_Komf_NV");
            write("[16] ... SY1_Lenker");
            write("[17] ... SY1_NWDF");
            write("[18] ... SY1_NWDF_gueltig");
            write("[19] ... SY1_Notbrems_Status");
            write("[20] ... SY1_QRS_Messmodus");
            write("[21] ... SY1_Relais_FAS_Zweig");
            write("[22] ... SY1_Sleep_Info");
            write("[23] ... SY1_Sleep_Komf");
            write("[24] ... SY1_Transportmode");
            write("[25] ... SY1_Tueren");
            write("[26] ... SY1_Verbauinfo");
            write("[27] ... SY1_res52");
            write("[28] ... SY1_res53");
            write("[29] ... SY1_res54");
            write("[30] ... SY1_res55");
            write("[31] ... SY1_res57");
            write("[32] ... SY1_res58");
            write("[33] ... SY1_res59");
            write("[34] ... SY1_res60");
            write("[35] ... SY1_res61");
            write("[36] ... SY1_res62");
            write("[37] ... SY1_res63");
        }
        break;
        case FRM_HANDLE_TOG:
        {
            write("[0] ... TOG_Fuellstand_1");
            write("[1] ... TOG_Fuellstand_2");
            write("[2] ... TOG_Fuellstand_3");
            write("[3] ... TOG_Fuellstand_4");
            write("[4] ... TOG_OelmaxUeber");
            write("[5] ... TOG_Oelmax_hoch");
            write("[6] ... TOG_Oeltempzeit");
            write("[7] ... TOG_OelwarnUeber");
            write("[8] ... TOG_Oelwarn_hoch");
            write("[9] ... TOG_Reserve1");
            write("[10] ... TOG_Sensorfehler");
            write("[11] ... TOG_Zaehler");
        }
        break;
        case FRM_HANDLE_ZAS_1:
        {
            write("[0] ... CHK_ZAS");
            write("[1] ... ZA1_Klemme_15");
            write("[2] ... ZA1_Klemme_50");
            write("[3] ... ZA1_Klemme_P");
            write("[4] ... ZA1_Klemme_SV");
            write("[5] ... ZA1_Klemme_X");
            write("[6] ... ZA1_Reserve1");
            write("[7] ... ZA1_S_Kontakt");
            write("[8] ... ZA1_res07");
            write("[9] ... Zaehler_ZAS");
        }
        break;

    }
}

/*@@caplFunc:HelpSignal():*/
HelpSignal ()
{
    //REPLACE_HELP_SIGNAL
}
/*@@end*/

/*@@caplFunc:GetFrameName(int):*/
GetFrameName (int FrmIdx)
{
    switch (FrmIdx)
    {
        case FRM_HANDLE_ACC_1:
            strncpy(CaplCtrl_FrameName, "ACC_1", 6);
            break;
        case FRM_HANDLE_ACC_System:
            strncpy(CaplCtrl_FrameName, "ACC_System", 11);
            break;
        case FRM_HANDLE_Airbag_1:
            strncpy(CaplCtrl_FrameName, "Airbag_1", 9);
            break;
        case FRM_HANDLE_Allrad_1:
            strncpy(CaplCtrl_FrameName, "Allrad_1", 9);
            break;
        case FRM_HANDLE_BEM_1:
            strncpy(CaplCtrl_FrameName, "BEM_1", 6);
            break;
        case FRM_HANDLE_BSG_Last:
            strncpy(CaplCtrl_FrameName, "BSG_Last", 9);
            break;
        case FRM_HANDLE_Batman_1:
            strncpy(CaplCtrl_FrameName, "Batman_1", 9);
            break;
        case FRM_HANDLE_Booster_1:
            strncpy(CaplCtrl_FrameName, "Booster_1", 10);
            break;
        case FRM_HANDLE_Bremse_1:
            strncpy(CaplCtrl_FrameName, "Bremse_1", 9);
            break;
        case FRM_HANDLE_Bremse_10:
            strncpy(CaplCtrl_FrameName, "Bremse_10", 10);
            break;
        case FRM_HANDLE_Bremse_11:
            strncpy(CaplCtrl_FrameName, "Bremse_11", 10);
            break;
        case FRM_HANDLE_Bremse_2:
            strncpy(CaplCtrl_FrameName, "Bremse_2", 9);
            break;
        case FRM_HANDLE_Bremse_3:
            strncpy(CaplCtrl_FrameName, "Bremse_3", 9);
            break;
        case FRM_HANDLE_Bremse_4:
            strncpy(CaplCtrl_FrameName, "Bremse_4", 9);
            break;
        case FRM_HANDLE_Bremse_5:
            strncpy(CaplCtrl_FrameName, "Bremse_5", 9);
            break;
        case FRM_HANDLE_Bremse_8:
            strncpy(CaplCtrl_FrameName, "Bremse_8", 9);
            break;
        case FRM_HANDLE_Clima_1:
            strncpy(CaplCtrl_FrameName, "Clima_1", 8);
            break;
        case FRM_HANDLE_Diagnose_1:
            strncpy(CaplCtrl_FrameName, "Diagnose_1", 11);
            break;
        case FRM_HANDLE_EPB_1:
            strncpy(CaplCtrl_FrameName, "EPB_1", 6);
            break;
        case FRM_HANDLE_EPB_2:
            strncpy(CaplCtrl_FrameName, "EPB_2", 6);
            break;
        case FRM_HANDLE_GME:
            strncpy(CaplCtrl_FrameName, "GME", 4);
            break;
        case FRM_HANDLE_GRA_Neu:
            strncpy(CaplCtrl_FrameName, "GRA_Neu", 8);
            break;
        case FRM_HANDLE_Gate_Komf_1:
            strncpy(CaplCtrl_FrameName, "Gate_Komf_1", 12);
            break;
        case FRM_HANDLE_Gate_Komf_2:
            strncpy(CaplCtrl_FrameName, "Gate_Komf_2", 12);
            break;
        case FRM_HANDLE_Gate_Komf_3:
            strncpy(CaplCtrl_FrameName, "Gate_Komf_3", 12);
            break;
        case FRM_HANDLE_Getriebe_1:
            strncpy(CaplCtrl_FrameName, "Getriebe_1", 11);
            break;
        case FRM_HANDLE_Getriebe_2:
            strncpy(CaplCtrl_FrameName, "Getriebe_2", 11);
            break;
        case FRM_HANDLE_Getriebe_3_Momente:
            strncpy(CaplCtrl_FrameName, "Getriebe_3_Momente", 19);
            break;
        case FRM_HANDLE_Getriebe_6:
            strncpy(CaplCtrl_FrameName, "Getriebe_6", 11);
            break;
        case FRM_HANDLE_Getriebe_Hybrid_1:
            strncpy(CaplCtrl_FrameName, "Getriebe_Hybrid_1", 18);
            break;
        case FRM_HANDLE_Klima_5:
            strncpy(CaplCtrl_FrameName, "Klima_5", 8);
            break;
        case FRM_HANDLE_Kombi_1:
            strncpy(CaplCtrl_FrameName, "Kombi_1", 8);
            break;
        case FRM_HANDLE_Kombi_2:
            strncpy(CaplCtrl_FrameName, "Kombi_2", 8);
            break;
        case FRM_HANDLE_Kombi_3:
            strncpy(CaplCtrl_FrameName, "Kombi_3", 8);
            break;
        case FRM_HANDLE_LW_1:
            strncpy(CaplCtrl_FrameName, "LW_1", 5);
            break;
        case FRM_HANDLE_Lenkhilfe_3:
            strncpy(CaplCtrl_FrameName, "Lenkhilfe_3", 12);
            break;
        case FRM_HANDLE_NMH_Gateway:
            strncpy(CaplCtrl_FrameName, "NMH_Gateway", 12);
            break;
        case FRM_HANDLE_Niveau_1:
            strncpy(CaplCtrl_FrameName, "Niveau_1", 9);
            break;
        case FRM_HANDLE_OBD_Tankgeber_01:
            strncpy(CaplCtrl_FrameName, "OBD_Tankgeber_01", 17);
            break;
        case FRM_HANDLE_Parkhilfe_01:
            strncpy(CaplCtrl_FrameName, "Parkhilfe_01", 13);
            break;
        case FRM_HANDLE_Parkhilfe_1:
            strncpy(CaplCtrl_FrameName, "Parkhilfe_1", 12);
            break;
        case FRM_HANDLE_Remotestart_FFB:
            strncpy(CaplCtrl_FrameName, "Remotestart_FFB", 16);
            break;
        case FRM_HANDLE_Soll_Verbauliste_neu:
            strncpy(CaplCtrl_FrameName, "Soll_Verbauliste_neu", 21);
            break;
        case FRM_HANDLE_Systeminfo_1:
            strncpy(CaplCtrl_FrameName, "Systeminfo_1", 13);
            break;
        case FRM_HANDLE_TOG:
            strncpy(CaplCtrl_FrameName, "TOG", 4);
            break;
        case FRM_HANDLE_ZAS_1:
            strncpy(CaplCtrl_FrameName, "ZAS_1", 6);
            break;
    }
}
/*@@end*/

/*@@caplFunc:GetSignalName(int,int):*/
GetSignalName (int FrmIdx, int SigIdx)
{
    switch (FrmIdx)
    {
        case FRM_HANDLE_ACC_1:
        {
            switch (SigIdx)
            {
                case 0:
                    strncpy(CaplCtrl_SignalName, "AWV1_Freigabe", 14);
                    break;
                case 1:
                    strncpy(CaplCtrl_SignalName, "AWV1_Parameter_HBA", 19);
                    break;
                case 2:
                    strncpy(CaplCtrl_SignalName, "AWV1_Parameter_Nachtreten_HBA", 30);
                    break;
                case 3:
                    strncpy(CaplCtrl_SignalName, "AWV1_Prefill", 13);
                    break;
                case 4:
                    strncpy(CaplCtrl_SignalName, "AWV2_Freigabe", 14);
                    break;
                case 5:
                    strncpy(CaplCtrl_SignalName, "AWV2_Priowarnung_LDW", 21);
                    break;
                case 6:
                    strncpy(CaplCtrl_SignalName, "AWV2_Ruckprofil", 16);
                    break;
                case 7:
                    strncpy(CaplCtrl_SignalName, "Anhalten", 9);
                    break;
                case 8:
                    strncpy(CaplCtrl_SignalName, "BZ_ACC1", 8);
                    break;
                case 9:
                    strncpy(CaplCtrl_SignalName, "CHK_ACC1", 9);
                    break;
                case 10:
                    strncpy(CaplCtrl_SignalName, "Dynamik_Bremsdruck", 19);
                    break;
                case 11:
                    strncpy(CaplCtrl_SignalName, "ESP_Beeinflussung_ACC", 22);
                    break;
                case 12:
                    strncpy(CaplCtrl_SignalName, "FSPE_ACC", 9);
                    break;
                case 13:
                    strncpy(CaplCtrl_SignalName, "Freigabe_Momenten_Anf", 22);
                    break;
                case 14:
                    strncpy(CaplCtrl_SignalName, "Freigabe_Verzoeg_Anf", 21);
                    break;
                case 15:
                    strncpy(CaplCtrl_SignalName, "Momenten_Anf_ACC", 17);
                    break;
                case 16:
                    strncpy(CaplCtrl_SignalName, "Sender_Info", 12);
                    break;
                case 17:
                    strncpy(CaplCtrl_SignalName, "Sollbeschl_Getr", 16);
                    break;
                case 18:
                    strncpy(CaplCtrl_SignalName, "Status_ACC", 11);
                    break;
                case 19:
                    strncpy(CaplCtrl_SignalName, "Verhinderung_SA", 16);
                    break;
                case 20:
                    strncpy(CaplCtrl_SignalName, "Verzoeg_Anf_ACC", 16);
                    break;
                case 21:
                    strncpy(CaplCtrl_SignalName, "Vorbefuellung_Bremsanlage", 26);
                    break;
            }
        }
        break;
        case FRM_HANDLE_ACC_System:
        {
            switch (SigIdx)
            {
                case 0:
                    strncpy(CaplCtrl_SignalName, "ACS_ADR_Schub", 14);
                    break;
                case 1:
                    strncpy(CaplCtrl_SignalName, "ACS_Anhaltewunsch", 18);
                    break;
                case 2:
                    strncpy(CaplCtrl_SignalName, "ACS_Checksum", 13);
                    break;
                case 3:
                    strncpy(CaplCtrl_SignalName, "ACS_Fehler", 11);
                    break;
                case 4:
                    strncpy(CaplCtrl_SignalName, "ACS_FreigSollB", 15);
                    break;
                case 5:
                    strncpy(CaplCtrl_SignalName, "ACS_MomEingriff", 16);
                    break;
                case 6:
                    strncpy(CaplCtrl_SignalName, "ACS_Schubabsch", 15);
                    break;
                case 7:
                    strncpy(CaplCtrl_SignalName, "ACS_Sollbeschl", 15);
                    break;
                case 8:
                    strncpy(CaplCtrl_SignalName, "ACS_StSt_Info", 14);
                    break;
                case 9:
                    strncpy(CaplCtrl_SignalName, "ACS_Sta_ADR", 12);
                    break;
                case 10:
                    strncpy(CaplCtrl_SignalName, "ACS_Typ_ACC", 12);
                    break;
                case 11:
                    strncpy(CaplCtrl_SignalName, "ACS_Zaehler", 12);
                    break;
                case 12:
                    strncpy(CaplCtrl_SignalName, "ACS_max_AendGrad", 17);
                    break;
                case 13:
                    strncpy(CaplCtrl_SignalName, "ACS_res_21", 11);
                    break;
                case 14:
                    strncpy(CaplCtrl_SignalName, "ACS_res_35", 11);
                    break;
                case 15:
                    strncpy(CaplCtrl_SignalName, "ACS_res_36", 11);
                    break;
                case 16:
                    strncpy(CaplCtrl_SignalName, "ACS_res_37", 11);
                    break;
                case 17:
                    strncpy(CaplCtrl_SignalName, "ACS_res_56", 11);
                    break;
                case 18:
                    strncpy(CaplCtrl_SignalName, "ACS_res_57", 11);
                    break;
                case 19:
                    strncpy(CaplCtrl_SignalName, "ACS_res_58", 11);
                    break;
                case 20:
                    strncpy(CaplCtrl_SignalName, "ACS_res_59", 11);
                    break;
                case 21:
                    strncpy(CaplCtrl_SignalName, "ACS_res_60", 11);
                    break;
                case 22:
                    strncpy(CaplCtrl_SignalName, "ACS_res_61", 11);
                    break;
                case 23:
                    strncpy(CaplCtrl_SignalName, "ACS_res_62", 11);
                    break;
                case 24:
                    strncpy(CaplCtrl_SignalName, "ACS_res_63", 11);
                    break;
                case 25:
                    strncpy(CaplCtrl_SignalName, "ACS_zul_Regelabw", 17);
                    break;
            }
        }
        break;
        case FRM_HANDLE_Airbag_1:
        {
            switch (SigIdx)
            {
                case 0:
                    strncpy(CaplCtrl_SignalName, "AB1_BF_Warnung", 15);
                    break;
                case 1:
                    strncpy(CaplCtrl_SignalName, "AB1_Beifahrer", 14);
                    break;
                case 2:
                    strncpy(CaplCtrl_SignalName, "AB1_Bf_Seite", 13);
                    break;
                case 3:
                    strncpy(CaplCtrl_SignalName, "AB1_Checksumme", 15);
                    break;
                case 4:
                    strncpy(CaplCtrl_SignalName, "AB1_Diagnose", 13);
                    break;
                case 5:
                    strncpy(CaplCtrl_SignalName, "AB1_Fa_Seite", 13);
                    break;
                case 6:
                    strncpy(CaplCtrl_SignalName, "AB1_Fehlereintr", 16);
                    break;
                case 7:
                    strncpy(CaplCtrl_SignalName, "AB1_Front", 10);
                    break;
                case 8:
                    strncpy(CaplCtrl_SignalName, "AB1_Gurt_Bf", 12);
                    break;
                case 9:
                    strncpy(CaplCtrl_SignalName, "AB1_Gurt_Fa", 12);
                    break;
                case 10:
                    strncpy(CaplCtrl_SignalName, "AB1_Heck", 9);
                    break;
                case 11:
                    strncpy(CaplCtrl_SignalName, "AB1_Intens", 11);
                    break;
                case 12:
                    strncpy(CaplCtrl_SignalName, "AB1_Lampe", 10);
                    break;
                case 13:
                    strncpy(CaplCtrl_SignalName, "AB1_Rollover", 13);
                    break;
                case 14:
                    strncpy(CaplCtrl_SignalName, "AB1_Status", 11);
                    break;
                case 15:
                    strncpy(CaplCtrl_SignalName, "AB1_Stellglied", 15);
                    break;
                case 16:
                    strncpy(CaplCtrl_SignalName, "AB1_System", 11);
                    break;
                case 17:
                    strncpy(CaplCtrl_SignalName, "AB1_Zaehler", 12);
                    break;
            }
        }
        break;
        case FRM_HANDLE_Allrad_1:
        {
            switch (SigIdx)
            {
                case 0:
                    strncpy(CaplCtrl_SignalName, "AL1_AnfVerteiler", 17);
                    break;
                case 1:
                    strncpy(CaplCtrl_SignalName, "AL1_Anz_blinken", 16);
                    break;
                case 2:
                    strncpy(CaplCtrl_SignalName, "AL1_Begrenzungsmo", 18);
                    break;
                case 3:
                    strncpy(CaplCtrl_SignalName, "AL1_Diff_Gong", 14);
                    break;
                case 4:
                    strncpy(CaplCtrl_SignalName, "AL1_Diff_Lampe", 15);
                    break;
                case 5:
                    strncpy(CaplCtrl_SignalName, "AL1_Diff_Verbau", 16);
                    break;
                case 6:
                    strncpy(CaplCtrl_SignalName, "AL1_Einheit", 12);
                    break;
                case 7:
                    strncpy(CaplCtrl_SignalName, "AL1_FaWu_HA", 12);
                    break;
                case 8:
                    strncpy(CaplCtrl_SignalName, "AL1_FaWu_Laengs", 16);
                    break;
                case 9:
                    strncpy(CaplCtrl_SignalName, "AL1_FaWu_VA", 12);
                    break;
                case 10:
                    strncpy(CaplCtrl_SignalName, "AL1_Fehler", 11);
                    break;
                case 11:
                    strncpy(CaplCtrl_SignalName, "AL1_Fehlereintr", 16);
                    break;
                case 12:
                    strncpy(CaplCtrl_SignalName, "AL1_Ist_Nm", 11);
                    break;
                case 13:
                    strncpy(CaplCtrl_SignalName, "AL1_Ist_Proz", 13);
                    break;
                case 14:
                    strncpy(CaplCtrl_SignalName, "AL1_KupSteifig_F", 17);
                    break;
                case 15:
                    strncpy(CaplCtrl_SignalName, "AL1_Kup_offen", 14);
                    break;
                case 16:
                    strncpy(CaplCtrl_SignalName, "AL1_Limit_maxkmh", 17);
                    break;
                case 17:
                    strncpy(CaplCtrl_SignalName, "AL1_Limiter", 12);
                    break;
                case 18:
                    strncpy(CaplCtrl_SignalName, "AL1_Notlauf", 12);
                    break;
                case 19:
                    strncpy(CaplCtrl_SignalName, "AL1_Quersp_Sta", 15);
                    break;
                case 20:
                    strncpy(CaplCtrl_SignalName, "AL1_Reserve2", 13);
                    break;
                case 21:
                    strncpy(CaplCtrl_SignalName, "AL1_Schalten", 13);
                    break;
                case 22:
                    strncpy(CaplCtrl_SignalName, "AL1_Sta_Kup", 12);
                    break;
                case 23:
                    strncpy(CaplCtrl_SignalName, "AL1_Sta_Laengssp", 17);
                    break;
                case 24:
                    strncpy(CaplCtrl_SignalName, "AL1_Sta_PNG", 12);
                    break;
                case 25:
                    strncpy(CaplCtrl_SignalName, "AL1_Sta_Quersp", 15);
                    break;
                case 26:
                    strncpy(CaplCtrl_SignalName, "AL1_Sta_VA", 11);
                    break;
                case 27:
                    strncpy(CaplCtrl_SignalName, "AL1_Stellung_Getr", 18);
                    break;
                case 28:
                    strncpy(CaplCtrl_SignalName, "AL1_Uebertemp", 14);
                    break;
                case 29:
                    strncpy(CaplCtrl_SignalName, "AL1_Vorwarnung", 15);
                    break;
                case 30:
                    strncpy(CaplCtrl_SignalName, "AL1_Warnlampe", 14);
                    break;
                case 31:
                    strncpy(CaplCtrl_SignalName, "AL1_Zaehler", 12);
                    break;
            }
        }
        break;
        case FRM_HANDLE_BEM_1:
        {
            switch (SigIdx)
            {
                case 0:
                    strncpy(CaplCtrl_SignalName, "Abschalt_Heizsysteme", 21);
                    break;
                case 1:
                    strncpy(CaplCtrl_SignalName, "Abschaltstufen", 15);
                    break;
                case 2:
                    strncpy(CaplCtrl_SignalName, "Anforderung_HSH", 16);
                    break;
                case 3:
                    strncpy(CaplCtrl_SignalName, "Anforderung_Kluefter_", 22);
                    break;
                case 4:
                    strncpy(CaplCtrl_SignalName, "BEM_Batteriespannung", 21);
                    break;
                case 5:
                    strncpy(CaplCtrl_SignalName, "BEM_StSt_Info", 14);
                    break;
                case 6:
                    strncpy(CaplCtrl_SignalName, "BZ_BEM1", 8);
                    break;
                case 7:
                    strncpy(CaplCtrl_SignalName, "CHK_BEM1", 9);
                    break;
                case 8:
                    strncpy(CaplCtrl_SignalName, "Einschaltung_PTC_Hzg", 21);
                    break;
                case 9:
                    strncpy(CaplCtrl_SignalName, "Generator_Lastmoment", 21);
                    break;
                case 10:
                    strncpy(CaplCtrl_SignalName, "Generator_Leistungsaufnahme", 28);
                    break;
                case 11:
                    strncpy(CaplCtrl_SignalName, "HL_Systeme_Status", 18);
                    break;
                case 12:
                    strncpy(CaplCtrl_SignalName, "HL_Systemregelung_Status", 25);
                    break;
                case 13:
                    strncpy(CaplCtrl_SignalName, "Lastabwurf_Rueckmeldung", 24);
                    break;
                case 14:
                    strncpy(CaplCtrl_SignalName, "Leerlaufdrehzahl_Erhoehung", 27);
                    break;
                case 15:
                    strncpy(CaplCtrl_SignalName, "Load_Response_Generator", 24);
                    break;
                case 16:
                    strncpy(CaplCtrl_SignalName, "Red_Innenraumgeblaese", 22);
                    break;
                case 17:
                    strncpy(CaplCtrl_SignalName, "Ruecknahme_HSH", 15);
                    break;
            }
        }
        break;
        case FRM_HANDLE_BSG_Last:
        {
            switch (SigIdx)
            {
                case 0:
                    strncpy(CaplCtrl_SignalName, "BSL_Ab_Batterie", 16);
                    break;
                case 1:
                    strncpy(CaplCtrl_SignalName, "BSL_Aussensp", 13);
                    break;
                case 2:
                    strncpy(CaplCtrl_SignalName, "BSL_BSG_2_alt", 14);
                    break;
                case 3:
                    strncpy(CaplCtrl_SignalName, "BSL_BSG_3_alt", 14);
                    break;
                case 4:
                    strncpy(CaplCtrl_SignalName, "BSL_Clima", 10);
                    break;
                case 5:
                    strncpy(CaplCtrl_SignalName, "BSL_DFM", 8);
                    break;
                case 6:
                    strncpy(CaplCtrl_SignalName, "BSL_Fehlereintr", 16);
                    break;
                case 7:
                    strncpy(CaplCtrl_SignalName, "BSL_Frontsch", 13);
                    break;
                case 8:
                    strncpy(CaplCtrl_SignalName, "BSL_Hecksch", 12);
                    break;
                case 9:
                    strncpy(CaplCtrl_SignalName, "BSL_Kl_15_Motor", 16);
                    break;
                case 10:
                    strncpy(CaplCtrl_SignalName, "BSL_Kl_L", 9);
                    break;
                case 11:
                    strncpy(CaplCtrl_SignalName, "BSL_Kuehlerlueft", 17);
                    break;
                case 12:
                    strncpy(CaplCtrl_SignalName, "BSL_LL_Anheb", 13);
                    break;
                case 13:
                    strncpy(CaplCtrl_SignalName, "BSL_LL_Anheb2", 14);
                    break;
                case 14:
                    strncpy(CaplCtrl_SignalName, "BSL_Lenkradheiz", 16);
                    break;
                case 15:
                    strncpy(CaplCtrl_SignalName, "BSL_Motor_Haube", 16);
                    break;
                case 16:
                    strncpy(CaplCtrl_SignalName, "BSL_Parklicht", 14);
                    break;
                case 17:
                    strncpy(CaplCtrl_SignalName, "BSL_Sitzbelueft", 16);
                    break;
                case 18:
                    strncpy(CaplCtrl_SignalName, "BSL_Sitzheiz", 13);
                    break;
                case 19:
                    strncpy(CaplCtrl_SignalName, "BSL_Sta_LWR", 12);
                    break;
                case 20:
                    strncpy(CaplCtrl_SignalName, "BSL_Sta_StBat", 14);
                    break;
                case 21:
                    strncpy(CaplCtrl_SignalName, "BSL_Sta_UBat", 13);
                    break;
                case 22:
                    strncpy(CaplCtrl_SignalName, "BSL_Starterlaubnis", 19);
                    break;
                case 23:
                    strncpy(CaplCtrl_SignalName, "BSL_UBat", 9);
                    break;
                case 24:
                    strncpy(CaplCtrl_SignalName, "BSL_Wake_Up_ACAN", 17);
                    break;
                case 25:
                    strncpy(CaplCtrl_SignalName, "BSL_Wasserheiz", 15);
                    break;
                case 26:
                    strncpy(CaplCtrl_SignalName, "BSL_Weckursache_ACAN", 21);
                    break;
                case 27:
                    strncpy(CaplCtrl_SignalName, "BSL_ZAS_Kl_15", 14);
                    break;
                case 28:
                    strncpy(CaplCtrl_SignalName, "BSL_ZAS_Kl_50", 14);
                    break;
                case 29:
                    strncpy(CaplCtrl_SignalName, "BSL_ZAS_Kl_S", 13);
                    break;
                case 30:
                    strncpy(CaplCtrl_SignalName, "BSL_ZAS_Kl_X", 13);
                    break;
            }
        }
        break;
        case FRM_HANDLE_Batman_1:
        {
            switch (SigIdx)
            {
                case 0:
                    strncpy(CaplCtrl_SignalName, "BEM_EM_LIN_ungueltig", 21);
                    break;
                case 1:
                    strncpy(CaplCtrl_SignalName, "BEM_P_Generator", 16);
                    break;
                case 2:
                    strncpy(CaplCtrl_SignalName, "BM1_BEM_Reku_Aktiv", 19);
                    break;
                case 3:
                    strncpy(CaplCtrl_SignalName, "BM1_DFM", 8);
                    break;
                case 4:
                    strncpy(CaplCtrl_SignalName, "BM1_Fehlereintr", 16);
                    break;
                case 5:
                    strncpy(CaplCtrl_SignalName, "BM1_Mess_Leitung", 17);
                    break;
                case 6:
                    strncpy(CaplCtrl_SignalName, "BM1_Relais", 11);
                    break;
                case 7:
                    strncpy(CaplCtrl_SignalName, "BM1_Sta_Leitung", 16);
                    break;
                case 8:
                    strncpy(CaplCtrl_SignalName, "BM1_Sta_Relais", 15);
                    break;
                case 9:
                    strncpy(CaplCtrl_SignalName, "BM1_Sta_StBat", 14);
                    break;
                case 10:
                    strncpy(CaplCtrl_SignalName, "BM1_Startmodus", 15);
                    break;
            }
        }
        break;
        case FRM_HANDLE_Booster_1:
        {
            switch (SigIdx)
            {
                case 0:
                    strncpy(CaplCtrl_SignalName, "BO1_AWV2_Bremsruck", 19);
                    break;
                case 1:
                    strncpy(CaplCtrl_SignalName, "BO1_AWV2_Fehler", 16);
                    break;
                case 2:
                    strncpy(CaplCtrl_SignalName, "BO1_Anf_EPB_Span", 17);
                    break;
                case 3:
                    strncpy(CaplCtrl_SignalName, "BO1_Anf_EPB_aus", 16);
                    break;
                case 4:
                    strncpy(CaplCtrl_SignalName, "BO1_Anf_EPB_ein", 16);
                    break;
                case 5:
                    strncpy(CaplCtrl_SignalName, "BO1_Checksumme", 15);
                    break;
                case 6:
                    strncpy(CaplCtrl_SignalName, "BO1_Fa_bremst", 14);
                    break;
                case 7:
                    strncpy(CaplCtrl_SignalName, "BO1_Freigabe_EPB", 17);
                    break;
                case 8:
                    strncpy(CaplCtrl_SignalName, "BO1_KD_Fehler", 14);
                    break;
                case 9:
                    strncpy(CaplCtrl_SignalName, "BO1_Laengsbeschl", 17);
                    break;
                case 10:
                    strncpy(CaplCtrl_SignalName, "BO1_StaBrSyst", 14);
                    break;
                case 11:
                    strncpy(CaplCtrl_SignalName, "BO1_Sta_ACC_Anf", 16);
                    break;
                case 12:
                    strncpy(CaplCtrl_SignalName, "BO1_Sta_ADR_BR", 15);
                    break;
                case 13:
                    strncpy(CaplCtrl_SignalName, "BO1_Sta_BLS", 12);
                    break;
                case 14:
                    strncpy(CaplCtrl_SignalName, "BO1_Sta_Br_Druck", 17);
                    break;
                case 15:
                    strncpy(CaplCtrl_SignalName, "BO1_Sta_VerzReg", 16);
                    break;
                case 16:
                    strncpy(CaplCtrl_SignalName, "BO1_Verz_EPB_akt", 17);
                    break;
                case 17:
                    strncpy(CaplCtrl_SignalName, "BO1_Zaehler", 12);
                    break;
                case 18:
                    strncpy(CaplCtrl_SignalName, "BO1_aktBrSyst", 14);
                    break;
                case 19:
                    strncpy(CaplCtrl_SignalName, "BO1_res_14", 11);
                    break;
                case 20:
                    strncpy(CaplCtrl_SignalName, "BO1_res_16", 11);
                    break;
                case 21:
                    strncpy(CaplCtrl_SignalName, "BO1_res_17", 11);
                    break;
                case 22:
                    strncpy(CaplCtrl_SignalName, "BO1_res_22", 11);
                    break;
                case 23:
                    strncpy(CaplCtrl_SignalName, "BO1_res_25", 11);
                    break;
                case 24:
                    strncpy(CaplCtrl_SignalName, "BO1_res_27", 11);
                    break;
                case 25:
                    strncpy(CaplCtrl_SignalName, "BO1_res_28", 11);
                    break;
                case 26:
                    strncpy(CaplCtrl_SignalName, "BO1_res_29", 11);
                    break;
                case 27:
                    strncpy(CaplCtrl_SignalName, "BO1_res_30", 11);
                    break;
                case 28:
                    strncpy(CaplCtrl_SignalName, "BO1_res_31", 11);
                    break;
                case 29:
                    strncpy(CaplCtrl_SignalName, "BO1_res_32", 11);
                    break;
                case 30:
                    strncpy(CaplCtrl_SignalName, "BO1_res_41", 11);
                    break;
                case 31:
                    strncpy(CaplCtrl_SignalName, "BO1_res_42", 11);
                    break;
                case 32:
                    strncpy(CaplCtrl_SignalName, "BO1_res_43", 11);
                    break;
                case 33:
                    strncpy(CaplCtrl_SignalName, "BO1_res_44", 11);
                    break;
                case 34:
                    strncpy(CaplCtrl_SignalName, "BO1_res_59", 11);
                    break;
                case 35:
                    strncpy(CaplCtrl_SignalName, "BO1_res_62", 11);
                    break;
                case 36:
                    strncpy(CaplCtrl_SignalName, "BO1_res_63", 11);
                    break;
            }
        }
        break;
        case FRM_HANDLE_Bremse_1:
        {
            switch (SigIdx)
            {
                case 0:
                    strncpy(CaplCtrl_SignalName, "BR1_ABS_Brems", 14);
                    break;
                case 1:
                    strncpy(CaplCtrl_SignalName, "BR1_ASRMo_fa", 13);
                    break;
                case 2:
                    strncpy(CaplCtrl_SignalName, "BR1_ASRMo_sl", 13);
                    break;
                case 3:
                    strncpy(CaplCtrl_SignalName, "BR1_ASR_Anf", 12);
                    break;
                case 4:
                    strncpy(CaplCtrl_SignalName, "BR1_ASR_ESP", 12);
                    break;
                case 5:
                    strncpy(CaplCtrl_SignalName, "BR1_ASR_Eingr", 14);
                    break;
                case 6:
                    strncpy(CaplCtrl_SignalName, "BR1_BKV_aktiv", 14);
                    break;
                case 7:
                    strncpy(CaplCtrl_SignalName, "BR1_Diagnose", 13);
                    break;
                case 8:
                    strncpy(CaplCtrl_SignalName, "BR1_EBV_Eingr", 14);
                    break;
                case 9:
                    strncpy(CaplCtrl_SignalName, "BR1_EDS_Eingr", 14);
                    break;
                case 10:
                    strncpy(CaplCtrl_SignalName, "BR1_ESPASR_passiv", 18);
                    break;
                case 11:
                    strncpy(CaplCtrl_SignalName, "BR1_ESP_Eingr", 14);
                    break;
                case 12:
                    strncpy(CaplCtrl_SignalName, "BR1_Ersatz_Kmh", 15);
                    break;
                case 13:
                    strncpy(CaplCtrl_SignalName, "BR1_Lampe_ABS", 14);
                    break;
                case 14:
                    strncpy(CaplCtrl_SignalName, "BR1_Lampe_ASR", 14);
                    break;
                case 15:
                    strncpy(CaplCtrl_SignalName, "BR1_Lampe_BK", 13);
                    break;
                case 16:
                    strncpy(CaplCtrl_SignalName, "BR1_Lichtschalt", 16);
                    break;
                case 17:
                    strncpy(CaplCtrl_SignalName, "BR1_MAD", 8);
                    break;
                case 18:
                    strncpy(CaplCtrl_SignalName, "BR1_MSR_Anf", 12);
                    break;
                case 19:
                    strncpy(CaplCtrl_SignalName, "BR1_MSR_Mo", 11);
                    break;
                case 20:
                    strncpy(CaplCtrl_SignalName, "BR1_MSR_Mo_inv", 15);
                    break;
                case 21:
                    strncpy(CaplCtrl_SignalName, "BR1_Rad_kmh", 12);
                    break;
                case 22:
                    strncpy(CaplCtrl_SignalName, "BR1_StaDruckschw", 17);
                    break;
                case 23:
                    strncpy(CaplCtrl_SignalName, "BR1_Sta_ESP", 12);
                    break;
                case 24:
                    strncpy(CaplCtrl_SignalName, "BR1_Sta_MAD", 12);
                    break;
                case 25:
                    strncpy(CaplCtrl_SignalName, "BR1_Zaehler", 12);
                    break;
            }
        }
        break;
        case FRM_HANDLE_Bremse_10:
        {
            switch (SigIdx)
            {
                case 0:
                    strncpy(CaplCtrl_SignalName, "B10_Checksumme", 15);
                    break;
                case 1:
                    strncpy(CaplCtrl_SignalName, "B10_Fahrtr_HL", 14);
                    break;
                case 2:
                    strncpy(CaplCtrl_SignalName, "B10_Fahrtr_HR", 14);
                    break;
                case 3:
                    strncpy(CaplCtrl_SignalName, "B10_Fahrtr_VL", 14);
                    break;
                case 4:
                    strncpy(CaplCtrl_SignalName, "B10_Fahrtr_VR", 14);
                    break;
                case 5:
                    strncpy(CaplCtrl_SignalName, "B10_QB_Fahrtr_HL", 17);
                    break;
                case 6:
                    strncpy(CaplCtrl_SignalName, "B10_QB_Fahrtr_HR", 17);
                    break;
                case 7:
                    strncpy(CaplCtrl_SignalName, "B10_QB_Fahrtr_VL", 17);
                    break;
                case 8:
                    strncpy(CaplCtrl_SignalName, "B10_QB_Fahrtr_VR", 17);
                    break;
                case 9:
                    strncpy(CaplCtrl_SignalName, "B10_QB_Wegimp_HL", 17);
                    break;
                case 10:
                    strncpy(CaplCtrl_SignalName, "B10_QB_Wegimp_HR", 17);
                    break;
                case 11:
                    strncpy(CaplCtrl_SignalName, "B10_QB_Wegimp_VL", 17);
                    break;
                case 12:
                    strncpy(CaplCtrl_SignalName, "B10_QB_Wegimp_VR", 17);
                    break;
                case 13:
                    strncpy(CaplCtrl_SignalName, "B10_Wegimp_HL", 14);
                    break;
                case 14:
                    strncpy(CaplCtrl_SignalName, "B10_Wegimp_HR", 14);
                    break;
                case 15:
                    strncpy(CaplCtrl_SignalName, "B10_Wegimp_VL", 14);
                    break;
                case 16:
                    strncpy(CaplCtrl_SignalName, "B10_Wegimp_VR", 14);
                    break;
                case 17:
                    strncpy(CaplCtrl_SignalName, "B10_Zaehler", 12);
                    break;
            }
        }
        break;
        case FRM_HANDLE_Bremse_11:
        {
            switch (SigIdx)
            {
                case 0:
                    strncpy(CaplCtrl_SignalName, "B11_Br_StSt_Info", 17);
                    break;
                case 1:
                    strncpy(CaplCtrl_SignalName, "B11_EPB_Steller_akt", 20);
                    break;
                case 2:
                    strncpy(CaplCtrl_SignalName, "B11_EPB_Steller_gue", 20);
                    break;
                case 3:
                    strncpy(CaplCtrl_SignalName, "B11_HydHalten", 14);
                    break;
                case 4:
                    strncpy(CaplCtrl_SignalName, "B11_OBD_Nib_HL", 15);
                    break;
                case 5:
                    strncpy(CaplCtrl_SignalName, "B11_OBD_Nib_HR", 15);
                    break;
                case 6:
                    strncpy(CaplCtrl_SignalName, "B11_OBD_Nib_VL", 15);
                    break;
                case 7:
                    strncpy(CaplCtrl_SignalName, "B11_OBD_Nib_VR", 15);
                    break;
                case 8:
                    strncpy(CaplCtrl_SignalName, "BR11_Checksumme", 16);
                    break;
                case 9:
                    strncpy(CaplCtrl_SignalName, "BR11_Zaehler", 13);
                    break;
            }
        }
        break;
        case FRM_HANDLE_Bremse_2:
        {
            switch (SigIdx)
            {
                case 0:
                    strncpy(CaplCtrl_SignalName, "BR2_Aku_Warn", 13);
                    break;
                case 1:
                    strncpy(CaplCtrl_SignalName, "BR2_Blinkmode", 14);
                    break;
                case 2:
                    strncpy(CaplCtrl_SignalName, "BR2_Fehlereintr", 16);
                    break;
                case 3:
                    strncpy(CaplCtrl_SignalName, "BR2_HDC_aktiv", 14);
                    break;
                case 4:
                    strncpy(CaplCtrl_SignalName, "BR2_Impulszahl", 15);
                    break;
                case 5:
                    strncpy(CaplCtrl_SignalName, "BR2_LampeHDC", 13);
                    break;
                case 6:
                    strncpy(CaplCtrl_SignalName, "BR2_Lampe_ABS", 14);
                    break;
                case 7:
                    strncpy(CaplCtrl_SignalName, "BR2_Lampe_ASR", 14);
                    break;
                case 8:
                    strncpy(CaplCtrl_SignalName, "BR2_Lampe_BK", 13);
                    break;
                case 9:
                    strncpy(CaplCtrl_SignalName, "BR2_Lampe_RKA", 14);
                    break;
                case 10:
                    strncpy(CaplCtrl_SignalName, "BR2_QB_Querbeschl", 18);
                    break;
                case 11:
                    strncpy(CaplCtrl_SignalName, "BR2_Querb_Zahn", 15);
                    break;
                case 12:
                    strncpy(CaplCtrl_SignalName, "BR2_Querbeschl", 15);
                    break;
                case 13:
                    strncpy(CaplCtrl_SignalName, "BR2_SleepInd", 13);
                    break;
                case 14:
                    strncpy(CaplCtrl_SignalName, "BR2_Sta_Imp", 12);
                    break;
                case 15:
                    strncpy(CaplCtrl_SignalName, "BR2_Sta_Quer", 13);
                    break;
                case 16:
                    strncpy(CaplCtrl_SignalName, "BR2_Text", 9);
                    break;
                case 17:
                    strncpy(CaplCtrl_SignalName, "BR2_Ueberl_Imp", 15);
                    break;
                case 18:
                    strncpy(CaplCtrl_SignalName, "BR2_Wegimpulse", 15);
                    break;
                case 19:
                    strncpy(CaplCtrl_SignalName, "BR2_Zaehler", 12);
                    break;
                case 20:
                    strncpy(CaplCtrl_SignalName, "BR2_Zahnzahl", 13);
                    break;
                case 21:
                    strncpy(CaplCtrl_SignalName, "BR2_mi_Radgeschw", 17);
                    break;
            }
        }
        break;
        case FRM_HANDLE_Bremse_3:
        {
            switch (SigIdx)
            {
                case 0:
                    strncpy(CaplCtrl_SignalName, "BR3_Fahrtr_HL", 14);
                    break;
                case 1:
                    strncpy(CaplCtrl_SignalName, "BR3_Fahrtr_HR", 14);
                    break;
                case 2:
                    strncpy(CaplCtrl_SignalName, "BR3_Fahrtr_VL", 14);
                    break;
                case 3:
                    strncpy(CaplCtrl_SignalName, "BR3_Fahrtr_VR", 14);
                    break;
                case 4:
                    strncpy(CaplCtrl_SignalName, "BR3_Rad_kmh_HL", 15);
                    break;
                case 5:
                    strncpy(CaplCtrl_SignalName, "BR3_Rad_kmh_HR", 15);
                    break;
                case 6:
                    strncpy(CaplCtrl_SignalName, "BR3_Rad_kmh_VL", 15);
                    break;
                case 7:
                    strncpy(CaplCtrl_SignalName, "BR3_Rad_kmh_VR", 15);
                    break;
            }
        }
        break;
        case FRM_HANDLE_Bremse_4:
        {
            switch (SigIdx)
            {
                case 0:
                    strncpy(CaplCtrl_SignalName, "BR4_Abschaltung_HL", 19);
                    break;
                case 1:
                    strncpy(CaplCtrl_SignalName, "BR4_Abschaltung_HR", 19);
                    break;
                case 2:
                    strncpy(CaplCtrl_SignalName, "BR4_Abschaltung_VL", 19);
                    break;
                case 3:
                    strncpy(CaplCtrl_SignalName, "BR4_Abschaltung_VR", 19);
                    break;
                case 4:
                    strncpy(CaplCtrl_SignalName, "BR4_Checksum", 13);
                    break;
                case 5:
                    strncpy(CaplCtrl_SignalName, "BR4_Einheit", 12);
                    break;
                case 6:
                    strncpy(CaplCtrl_SignalName, "BR4_Lampe_RKA", 14);
                    break;
                case 7:
                    strncpy(CaplCtrl_SignalName, "BR4_Reserve2", 13);
                    break;
                case 8:
                    strncpy(CaplCtrl_SignalName, "BR4_Schwelle", 13);
                    break;
                case 9:
                    strncpy(CaplCtrl_SignalName, "BR4_Status_ESP", 15);
                    break;
                case 10:
                    strncpy(CaplCtrl_SignalName, "BR4_Summer_RKA", 15);
                    break;
                case 11:
                    strncpy(CaplCtrl_SignalName, "BR4_Unterdruck", 15);
                    break;
                case 12:
                    strncpy(CaplCtrl_SignalName, "BR4_Vorgabe_Hi", 15);
                    break;
                case 13:
                    strncpy(CaplCtrl_SignalName, "BR4_Vorgabe_Max", 16);
                    break;
                case 14:
                    strncpy(CaplCtrl_SignalName, "BR4_Vorgabe_Mi", 15);
                    break;
                case 15:
                    strncpy(CaplCtrl_SignalName, "BR4_Vorgabe_Mi_", 16);
                    break;
                case 16:
                    strncpy(CaplCtrl_SignalName, "BR4_Vorgabe_Min", 16);
                    break;
                case 17:
                    strncpy(CaplCtrl_SignalName, "BR4_Zaehler", 12);
                    break;
                case 18:
                    strncpy(CaplCtrl_SignalName, "BR4_res_42", 11);
                    break;
                case 19:
                    strncpy(CaplCtrl_SignalName, "BR4_res_48", 11);
                    break;
            }
        }
        break;
        case FRM_HANDLE_Bremse_5:
        {
            switch (SigIdx)
            {
                case 0:
                    strncpy(CaplCtrl_SignalName, "Anfahrhilfe_aktiv", 18);
                    break;
                case 1:
                    strncpy(CaplCtrl_SignalName, "BR5_AWV2_Bremsruck", 19);
                    break;
                case 2:
                    strncpy(CaplCtrl_SignalName, "BR5_AWV2_Fehler", 16);
                    break;
                case 3:
                    strncpy(CaplCtrl_SignalName, "BR5_AnhStabAktiv", 17);
                    break;
                case 4:
                    strncpy(CaplCtrl_SignalName, "BR5_Anhi_Sta", 13);
                    break;
                case 5:
                    strncpy(CaplCtrl_SignalName, "BR5_Anhi_akt", 13);
                    break;
                case 6:
                    strncpy(CaplCtrl_SignalName, "BR5_Bremsdruck", 15);
                    break;
                case 7:
                    strncpy(CaplCtrl_SignalName, "BR5_Checksumme", 15);
                    break;
                case 8:
                    strncpy(CaplCtrl_SignalName, "BR5_Druckgueltig", 17);
                    break;
                case 9:
                    strncpy(CaplCtrl_SignalName, "BR5_ECD_Lampe", 14);
                    break;
                case 10:
                    strncpy(CaplCtrl_SignalName, "BR5_ECD_Rueckfall", 18);
                    break;
                case 11:
                    strncpy(CaplCtrl_SignalName, "BR5_Giergeschw", 15);
                    break;
                case 12:
                    strncpy(CaplCtrl_SignalName, "BR5_Notbremsung", 16);
                    break;
                case 13:
                    strncpy(CaplCtrl_SignalName, "BR5_Sign_Druck", 15);
                    break;
                case 14:
                    strncpy(CaplCtrl_SignalName, "BR5_Sta_Druck", 14);
                    break;
                case 15:
                    strncpy(CaplCtrl_SignalName, "BR5_Sta_Gierrate", 17);
                    break;
                case 16:
                    strncpy(CaplCtrl_SignalName, "BR5_Stillstand", 15);
                    break;
                case 17:
                    strncpy(CaplCtrl_SignalName, "BR5_Temperatur", 15);
                    break;
                case 18:
                    strncpy(CaplCtrl_SignalName, "BR5_TolAbgl_VR", 15);
                    break;
                case 19:
                    strncpy(CaplCtrl_SignalName, "BR5_Vorzeichen", 15);
                    break;
                case 20:
                    strncpy(CaplCtrl_SignalName, "BR5_Zaehler", 12);
                    break;
                case 21:
                    strncpy(CaplCtrl_SignalName, "BR5_v_Ueberw", 13);
                    break;
                case 22:
                    strncpy(CaplCtrl_SignalName, "FStatus_Anfahrhilfe", 20);
                    break;
            }
        }
        break;
        case FRM_HANDLE_Bremse_8:
        {
            switch (SigIdx)
            {
                case 0:
                    strncpy(CaplCtrl_SignalName, "BR8_AWV1_BasPar", 16);
                    break;
                case 1:
                    strncpy(CaplCtrl_SignalName, "BR8_Check_EPB", 14);
                    break;
                case 2:
                    strncpy(CaplCtrl_SignalName, "BR8_Checksumme", 15);
                    break;
                case 3:
                    strncpy(CaplCtrl_SignalName, "BR8_Fa_bremst", 14);
                    break;
                case 4:
                    strncpy(CaplCtrl_SignalName, "BR8_Istbeschl", 14);
                    break;
                case 5:
                    strncpy(CaplCtrl_SignalName, "BR8_Laengsbeschl", 17);
                    break;
                case 6:
                    strncpy(CaplCtrl_SignalName, "BR8_QB_LBeschl", 15);
                    break;
                case 7:
                    strncpy(CaplCtrl_SignalName, "BR8_Quattro", 12);
                    break;
                case 8:
                    strncpy(CaplCtrl_SignalName, "BR8_StaBrSyst", 14);
                    break;
                case 9:
                    strncpy(CaplCtrl_SignalName, "BR8_Sta_ACC_Anf", 16);
                    break;
                case 10:
                    strncpy(CaplCtrl_SignalName, "BR8_Sta_ADR_BR", 15);
                    break;
                case 11:
                    strncpy(CaplCtrl_SignalName, "BR8_Sta_BLS", 12);
                    break;
                case 12:
                    strncpy(CaplCtrl_SignalName, "BR8_Sta_Br_Druck", 17);
                    break;
                case 13:
                    strncpy(CaplCtrl_SignalName, "BR8_Sta_Br_temp", 16);
                    break;
                case 14:
                    strncpy(CaplCtrl_SignalName, "BR8_Sta_HW_BLS", 15);
                    break;
                case 15:
                    strncpy(CaplCtrl_SignalName, "BR8_Sta_VerzReg", 16);
                    break;
                case 16:
                    strncpy(CaplCtrl_SignalName, "BR8_TolAbgl_HL", 15);
                    break;
                case 17:
                    strncpy(CaplCtrl_SignalName, "BR8_TolAbgl_HR", 15);
                    break;
                case 18:
                    strncpy(CaplCtrl_SignalName, "BR8_Verz_EPB", 13);
                    break;
                case 19:
                    strncpy(CaplCtrl_SignalName, "BR8_Verz_EPB_akt", 17);
                    break;
                case 20:
                    strncpy(CaplCtrl_SignalName, "BR8_Zaehler", 12);
                    break;
                case 21:
                    strncpy(CaplCtrl_SignalName, "BR8_aktBrSyst", 14);
                    break;
            }
        }
        break;
        case FRM_HANDLE_Clima_1:
        {
            switch (SigIdx)
            {
                case 0:
                    strncpy(CaplCtrl_SignalName, "CL1_AC_Schalter", 16);
                    break;
                case 1:
                    strncpy(CaplCtrl_SignalName, "CL1_Aussentemp", 15);
                    break;
                case 2:
                    strncpy(CaplCtrl_SignalName, "CL1_Druck", 10);
                    break;
                case 3:
                    strncpy(CaplCtrl_SignalName, "CL1_Einheit_Temp", 17);
                    break;
                case 4:
                    strncpy(CaplCtrl_SignalName, "CL1_Fa_Zuheiz", 14);
                    break;
                case 5:
                    strncpy(CaplCtrl_SignalName, "CL1_Fehlereintr", 16);
                    break;
                case 6:
                    strncpy(CaplCtrl_SignalName, "CL1_Frontsch", 13);
                    break;
                case 7:
                    strncpy(CaplCtrl_SignalName, "CL1_Gebl_last", 14);
                    break;
                case 8:
                    strncpy(CaplCtrl_SignalName, "CL1_Hecksch", 12);
                    break;
                case 9:
                    strncpy(CaplCtrl_SignalName, "CL1_Heizleist", 14);
                    break;
                case 10:
                    strncpy(CaplCtrl_SignalName, "CL1_HzgWischer", 15);
                    break;
                case 11:
                    strncpy(CaplCtrl_SignalName, "CL1_Kompr_Last", 15);
                    break;
                case 12:
                    strncpy(CaplCtrl_SignalName, "CL1_Kompressor", 15);
                    break;
                case 13:
                    strncpy(CaplCtrl_SignalName, "CL1_LL_Dz", 10);
                    break;
                case 14:
                    strncpy(CaplCtrl_SignalName, "CL1_Luefter", 12);
                    break;
                case 15:
                    strncpy(CaplCtrl_SignalName, "CL1_Restwaerme", 15);
                    break;
                case 16:
                    strncpy(CaplCtrl_SignalName, "CL1_Sta_Druck", 14);
                    break;
                case 17:
                    strncpy(CaplCtrl_SignalName, "CL1_Sta_Moment", 15);
                    break;
                case 18:
                    strncpy(CaplCtrl_SignalName, "CL1_Temp_Stoss", 15);
                    break;
                case 19:
                    strncpy(CaplCtrl_SignalName, "KL_4_Zonen", 11);
                    break;
                case 20:
                    strncpy(CaplCtrl_SignalName, "KL_Thermomanagement", 20);
                    break;
                case 21:
                    strncpy(CaplCtrl_SignalName, "SH_MVW", 7);
                    break;
                case 22:
                    strncpy(CaplCtrl_SignalName, "SH_aktiv_Flag", 14);
                    break;
            }
        }
        break;
        case FRM_HANDLE_Diagnose_1:
        {
            switch (SigIdx)
            {
                case 0:
                    strncpy(CaplCtrl_SignalName, "DI1_Jahr", 9);
                    break;
                case 1:
                    strncpy(CaplCtrl_SignalName, "DI1_KM_Stand_alt", 17);
                    break;
                case 2:
                    strncpy(CaplCtrl_SignalName, "DI1_Minute", 11);
                    break;
                case 3:
                    strncpy(CaplCtrl_SignalName, "DI1_Monat", 10);
                    break;
                case 4:
                    strncpy(CaplCtrl_SignalName, "DI1_Reserve1", 13);
                    break;
                case 5:
                    strncpy(CaplCtrl_SignalName, "DI1_Sekunde", 12);
                    break;
                case 6:
                    strncpy(CaplCtrl_SignalName, "DI1_Stunde", 11);
                    break;
                case 7:
                    strncpy(CaplCtrl_SignalName, "DI1_Tag", 8);
                    break;
                case 8:
                    strncpy(CaplCtrl_SignalName, "DI1_VerlernZaehl", 17);
                    break;
                case 9:
                    strncpy(CaplCtrl_SignalName, "DI1_Zeit_alt", 13);
                    break;
                case 10:
                    strncpy(CaplCtrl_SignalName, "DI1_km_Stand", 13);
                    break;
            }
        }
        break;
        case FRM_HANDLE_EPB_1:
        {
            switch (SigIdx)
            {
                case 0:
                    strncpy(CaplCtrl_SignalName, "EP1_AnfShLock", 14);
                    break;
                case 1:
                    strncpy(CaplCtrl_SignalName, "EP1_Auto_Schl_Oe", 17);
                    break;
                case 2:
                    strncpy(CaplCtrl_SignalName, "EP1_Bremslicht", 15);
                    break;
                case 3:
                    strncpy(CaplCtrl_SignalName, "EP1_Checksum", 13);
                    break;
                case 4:
                    strncpy(CaplCtrl_SignalName, "EP1_Fehler_BKL", 15);
                    break;
                case 5:
                    strncpy(CaplCtrl_SignalName, "EP1_Fehler_Sta", 15);
                    break;
                case 6:
                    strncpy(CaplCtrl_SignalName, "EP1_Fehler_gelb", 16);
                    break;
                case 7:
                    strncpy(CaplCtrl_SignalName, "EP1_Fehlereintr", 16);
                    break;
                case 8:
                    strncpy(CaplCtrl_SignalName, "EP1_Fkt_Lampe", 14);
                    break;
                case 9:
                    strncpy(CaplCtrl_SignalName, "EP1_Freigabe_Ver", 17);
                    break;
                case 10:
                    strncpy(CaplCtrl_SignalName, "EP1_HydrHalten", 15);
                    break;
                case 11:
                    strncpy(CaplCtrl_SignalName, "EP1_KuppModBer", 15);
                    break;
                case 12:
                    strncpy(CaplCtrl_SignalName, "EP1_Lampe_AutoP", 16);
                    break;
                case 13:
                    strncpy(CaplCtrl_SignalName, "EP1_Neig_winkel", 16);
                    break;
                case 14:
                    strncpy(CaplCtrl_SignalName, "EP1_QualNeigWi", 15);
                    break;
                case 15:
                    strncpy(CaplCtrl_SignalName, "EP1_Schalterinfo", 17);
                    break;
                case 16:
                    strncpy(CaplCtrl_SignalName, "EP1_SleepInd", 13);
                    break;
                case 17:
                    strncpy(CaplCtrl_SignalName, "EP1_Spannkraft", 15);
                    break;
                case 18:
                    strncpy(CaplCtrl_SignalName, "EP1_Sta_EPB", 12);
                    break;
                case 19:
                    strncpy(CaplCtrl_SignalName, "EP1_Sta_NWS", 12);
                    break;
                case 20:
                    strncpy(CaplCtrl_SignalName, "EP1_Sta_Schalter", 17);
                    break;
                case 21:
                    strncpy(CaplCtrl_SignalName, "EP1_Status_Kl_15", 17);
                    break;
                case 22:
                    strncpy(CaplCtrl_SignalName, "EP1_Verschleiss", 16);
                    break;
                case 23:
                    strncpy(CaplCtrl_SignalName, "EP1_Verzoegerung", 17);
                    break;
                case 24:
                    strncpy(CaplCtrl_SignalName, "EP1_Warnton", 12);
                    break;
                case 25:
                    strncpy(CaplCtrl_SignalName, "EP1_Warnton1", 13);
                    break;
                case 26:
                    strncpy(CaplCtrl_SignalName, "EP1_Warnton2", 13);
                    break;
                case 27:
                    strncpy(CaplCtrl_SignalName, "EP1_Zaehler", 12);
                    break;
                case 28:
                    strncpy(CaplCtrl_SignalName, "EP1__Text", 10);
                    break;
            }
        }
        break;
        case FRM_HANDLE_EPB_2:
        {
            switch (SigIdx)
            {
                case 0:
                    strncpy(CaplCtrl_SignalName, "BZ_EPB2", 8);
                    break;
                case 1:
                    strncpy(CaplCtrl_SignalName, "CHK_EPB2", 9);
                    break;
                case 2:
                    strncpy(CaplCtrl_SignalName, "EPB_Pedalweg_Kuppl", 19);
                    break;
            }
        }
        break;
        case FRM_HANDLE_GME:
        {
            switch (SigIdx)
            {
                case 0:
                    strncpy(CaplCtrl_SignalName, "BZ_GME", 7);
                    break;
                case 1:
                    strncpy(CaplCtrl_SignalName, "CHK_GME", 8);
                    break;
                case 2:
                    strncpy(CaplCtrl_SignalName, "CVT_Anf_EPB", 12);
                    break;
                case 3:
                    strncpy(CaplCtrl_SignalName, "CVT_Anf_EPB_gueltig", 20);
                    break;
                case 4:
                    strncpy(CaplCtrl_SignalName, "Dynamischer_Eingriff", 21);
                    break;
                case 5:
                    strncpy(CaplCtrl_SignalName, "GME_QB_UeFkt", 13);
                    break;
                case 6:
                    strncpy(CaplCtrl_SignalName, "GME_Schaltung", 14);
                    break;
                case 7:
                    strncpy(CaplCtrl_SignalName, "GME_UeFkt", 10);
                    break;
                case 8:
                    strncpy(CaplCtrl_SignalName, "GME_Verlustmom", 15);
                    break;
                case 9:
                    strncpy(CaplCtrl_SignalName, "Kuehlkreislaufventil_GME", 25);
                    break;
                case 10:
                    strncpy(CaplCtrl_SignalName, "Langfristiger_Eingriff", 23);
                    break;
                case 11:
                    strncpy(CaplCtrl_SignalName, "Status_Dyn_Eingriff", 20);
                    break;
                case 12:
                    strncpy(CaplCtrl_SignalName, "Status_Langfr_Eingriff", 23);
                    break;
            }
        }
        break;
        case FRM_HANDLE_GRA_Neu:
        {
            switch (SigIdx)
            {
                case 0:
                    strncpy(CaplCtrl_SignalName, "GRA_Abbrechen", 14);
                    break;
                case 1:
                    strncpy(CaplCtrl_SignalName, "GRA_Checksum", 13);
                    break;
                case 2:
                    strncpy(CaplCtrl_SignalName, "GRA_Down_kurz", 14);
                    break;
                case 3:
                    strncpy(CaplCtrl_SignalName, "GRA_Down_lang", 14);
                    break;
                case 4:
                    strncpy(CaplCtrl_SignalName, "GRA_Fehler_Bed", 15);
                    break;
                case 5:
                    strncpy(CaplCtrl_SignalName, "GRA_Fehler_Tip", 15);
                    break;
                case 6:
                    strncpy(CaplCtrl_SignalName, "GRA_Hauptschalt", 16);
                    break;
                case 7:
                    strncpy(CaplCtrl_SignalName, "GRA_Kodierinfo", 15);
                    break;
                case 8:
                    strncpy(CaplCtrl_SignalName, "GRA_Neu_Setzen", 15);
                    break;
                case 9:
                    strncpy(CaplCtrl_SignalName, "GRA_Neu_Zaehler", 16);
                    break;
                case 10:
                    strncpy(CaplCtrl_SignalName, "GRA_Recall", 11);
                    break;
                case 11:
                    strncpy(CaplCtrl_SignalName, "GRA_Sender", 11);
                    break;
                case 12:
                    strncpy(CaplCtrl_SignalName, "GRA_Sportschalter", 18);
                    break;
                case 13:
                    strncpy(CaplCtrl_SignalName, "GRA_Sta_Limiter", 16);
                    break;
                case 14:
                    strncpy(CaplCtrl_SignalName, "GRA_Tip_Down", 13);
                    break;
                case 15:
                    strncpy(CaplCtrl_SignalName, "GRA_Tip_Up", 11);
                    break;
                case 16:
                    strncpy(CaplCtrl_SignalName, "GRA_Typ_Hauptschalt", 20);
                    break;
                case 17:
                    strncpy(CaplCtrl_SignalName, "GRA_Up_kurz", 12);
                    break;
                case 18:
                    strncpy(CaplCtrl_SignalName, "GRA_Up_lang", 12);
                    break;
                case 19:
                    strncpy(CaplCtrl_SignalName, "GRA_Zeitluecke", 15);
                    break;
            }
        }
        break;
        case FRM_HANDLE_Gate_Komf_1:
        {
            switch (SigIdx)
            {
                case 0:
                    strncpy(CaplCtrl_SignalName, "BCM_Offroad_Taster", 19);
                    break;
                case 1:
                    strncpy(CaplCtrl_SignalName, "BCM_Remotestart_Betrieb", 24);
                    break;
                case 2:
                    strncpy(CaplCtrl_SignalName, "BSK_BT_geoeffnet", 17);
                    break;
                case 3:
                    strncpy(CaplCtrl_SignalName, "BSK_HD_Hauptraste", 18);
                    break;
                case 4:
                    strncpy(CaplCtrl_SignalName, "BSK_HL_geoeffnet", 17);
                    break;
                case 5:
                    strncpy(CaplCtrl_SignalName, "BSK_HR_geoeffnet", 17);
                    break;
                case 6:
                    strncpy(CaplCtrl_SignalName, "BSK_Tankklappe", 15);
                    break;
                case 7:
                    strncpy(CaplCtrl_SignalName, "EV1_Anf_Klemme_50", 18);
                    break;
                case 8:
                    strncpy(CaplCtrl_SignalName, "GK1_Abbl_VL_def", 16);
                    break;
                case 9:
                    strncpy(CaplCtrl_SignalName, "GK1_Abbl_VR_def", 16);
                    break;
                case 10:
                    strncpy(CaplCtrl_SignalName, "GK1_Abblendlicht", 17);
                    break;
                case 11:
                    strncpy(CaplCtrl_SignalName, "GK1_AnhKonLamp", 15);
                    break;
                case 12:
                    strncpy(CaplCtrl_SignalName, "GK1_Anh_abgesteckt", 19);
                    break;
                case 13:
                    strncpy(CaplCtrl_SignalName, "GK1_Anhaenger", 14);
                    break;
                case 14:
                    strncpy(CaplCtrl_SignalName, "GK1_BLS_AAG", 12);
                    break;
                case 15:
                    strncpy(CaplCtrl_SignalName, "GK1_BLS_ILM", 12);
                    break;
                case 16:
                    strncpy(CaplCtrl_SignalName, "GK1_Blink_Autob", 16);
                    break;
                case 17:
                    strncpy(CaplCtrl_SignalName, "GK1_Blinker_li", 15);
                    break;
                case 18:
                    strncpy(CaplCtrl_SignalName, "GK1_Blinker_re", 15);
                    break;
                case 19:
                    strncpy(CaplCtrl_SignalName, "GK1_BrLi_Anhaen", 16);
                    break;
                case 20:
                    strncpy(CaplCtrl_SignalName, "GK1_BrLi_links", 15);
                    break;
                case 21:
                    strncpy(CaplCtrl_SignalName, "GK1_BrLi_mitte", 15);
                    break;
                case 22:
                    strncpy(CaplCtrl_SignalName, "GK1_BrLi_rechts", 16);
                    break;
                case 23:
                    strncpy(CaplCtrl_SignalName, "GK1_Bremslicht", 15);
                    break;
                case 24:
                    strncpy(CaplCtrl_SignalName, "GK1_CharismaModus", 18);
                    break;
                case 25:
                    strncpy(CaplCtrl_SignalName, "GK1_Count_Anhaen", 17);
                    break;
                case 26:
                    strncpy(CaplCtrl_SignalName, "GK1_Count_Li_Hi", 16);
                    break;
                case 27:
                    strncpy(CaplCtrl_SignalName, "GK1_EDC_AAG", 12);
                    break;
                case 28:
                    strncpy(CaplCtrl_SignalName, "GK1_EDC_ILM", 12);
                    break;
                case 29:
                    strncpy(CaplCtrl_SignalName, "GK1_ELV_verrieg", 16);
                    break;
                case 30:
                    strncpy(CaplCtrl_SignalName, "GK1_Fa_Tuerkont", 16);
                    break;
                case 31:
                    strncpy(CaplCtrl_SignalName, "GK1_Fernlicht", 14);
                    break;
                case 32:
                    strncpy(CaplCtrl_SignalName, "GK1_KW_Warm", 12);
                    break;
                case 33:
                    strncpy(CaplCtrl_SignalName, "GK1_Nebel_ein", 14);
                    break;
                case 34:
                    strncpy(CaplCtrl_SignalName, "GK1_ParkFrontWi", 16);
                    break;
                case 35:
                    strncpy(CaplCtrl_SignalName, "GK1_Reserve3", 13);
                    break;
                case 36:
                    strncpy(CaplCtrl_SignalName, "GK1_Rueckfahr", 14);
                    break;
                case 37:
                    strncpy(CaplCtrl_SignalName, "GK1_RueckfahrSch", 17);
                    break;
                case 38:
                    strncpy(CaplCtrl_SignalName, "GK1_SH_Verbau", 14);
                    break;
                case 39:
                    strncpy(CaplCtrl_SignalName, "GK1_SH_Zusatzfkt", 17);
                    break;
                case 40:
                    strncpy(CaplCtrl_SignalName, "GK1_SH_laeuft", 14);
                    break;
                case 41:
                    strncpy(CaplCtrl_SignalName, "GK1_SamFktNr", 13);
                    break;
                case 42:
                    strncpy(CaplCtrl_SignalName, "GK1_SleepAckn", 14);
                    break;
                case 43:
                    strncpy(CaplCtrl_SignalName, "GK1_Sta_Anhaen", 15);
                    break;
                case 44:
                    strncpy(CaplCtrl_SignalName, "GK1_Sta_ILM_F_1", 16);
                    break;
                case 45:
                    strncpy(CaplCtrl_SignalName, "GK1_Sta_Kessy_2", 16);
                    break;
                case 46:
                    strncpy(CaplCtrl_SignalName, "GK1_Sta_LSM", 12);
                    break;
                case 47:
                    strncpy(CaplCtrl_SignalName, "GK1_Sta_Li_vorn", 16);
                    break;
                case 48:
                    strncpy(CaplCtrl_SignalName, "GK1_Sta_Licht1", 15);
                    break;
                case 49:
                    strncpy(CaplCtrl_SignalName, "GK1_Sta_Licht2", 15);
                    break;
            }

            switch (SigIdx)
            {
                case 50:
                    strncpy(CaplCtrl_SignalName, "GK1_Sta_Licht3", 15);
                    break;
                case 51:
                    strncpy(CaplCtrl_SignalName, "GK1_Sta_RDK_Warn", 17);
                    break;
                case 52:
                    strncpy(CaplCtrl_SignalName, "GK1_Sta_Stdhzg", 15);
                    break;
                case 53:
                    strncpy(CaplCtrl_SignalName, "GK1_Sta_Tuerkont", 17);
                    break;
                case 54:
                    strncpy(CaplCtrl_SignalName, "GK1_Warnblk_Status", 19);
                    break;
                case 55:
                    strncpy(CaplCtrl_SignalName, "GK1_Wischer_vorn", 17);
                    break;
                case 56:
                    strncpy(CaplCtrl_SignalName, "GK1_def_P_verr", 15);
                    break;
                case 57:
                    strncpy(CaplCtrl_SignalName, "GK1_res_06", 11);
                    break;
                case 58:
                    strncpy(CaplCtrl_SignalName, "GK1_res_62", 11);
                    break;
                case 59:
                    strncpy(CaplCtrl_SignalName, "KL_EKP_Anst", 12);
                    break;
                case 60:
                    strncpy(CaplCtrl_SignalName, "KY2_StSt_Info", 14);
                    break;
                case 61:
                    strncpy(CaplCtrl_SignalName, "Klima_5_D3_alt", 15);
                    break;
                case 62:
                    strncpy(CaplCtrl_SignalName, "Motorhaubenkontakt_ein", 23);
                    break;
                case 63:
                    strncpy(CaplCtrl_SignalName, "SH1_ein_Wasserpumpe", 20);
                    break;
                case 64:
                    strncpy(CaplCtrl_SignalName, "mKessy2_alt", 12);
                    break;
            }
        }
        break;
        case FRM_HANDLE_Gate_Komf_2:
        {
            switch (SigIdx)
            {
                case 0:
                    strncpy(CaplCtrl_SignalName, "BEM_Segel_Info", 15);
                    break;
                case 1:
                    strncpy(CaplCtrl_SignalName, "GK2_BEM_DFM", 12);
                    break;
                case 2:
                    strncpy(CaplCtrl_SignalName, "GK2_BEM_P_Generator", 20);
                    break;
                case 3:
                    strncpy(CaplCtrl_SignalName, "GK2_BEM_StSt_Info", 18);
                    break;
                case 4:
                    strncpy(CaplCtrl_SignalName, "GK2_BSG_StSt_Info", 18);
                    break;
                case 5:
                    strncpy(CaplCtrl_SignalName, "GK2_Blk_L_Kontrolle", 20);
                    break;
                case 6:
                    strncpy(CaplCtrl_SignalName, "GK2_Blk_R_Kontrolle", 20);
                    break;
                case 7:
                    strncpy(CaplCtrl_SignalName, "GK2_EM_LIN_ungueltig", 21);
                    break;
                case 8:
                    strncpy(CaplCtrl_SignalName, "GK2_Feh_VLR", 12);
                    break;
                case 9:
                    strncpy(CaplCtrl_SignalName, "GK2_Hardtop", 12);
                    break;
                case 10:
                    strncpy(CaplCtrl_SignalName, "GK2_Helligkeit", 15);
                    break;
                case 11:
                    strncpy(CaplCtrl_SignalName, "GK2_Kessy_StSt_Info", 20);
                    break;
                case 12:
                    strncpy(CaplCtrl_SignalName, "GK2_Kl_StSt_Info", 17);
                    break;
                case 13:
                    strncpy(CaplCtrl_SignalName, "GK2_LS_KomFehler", 17);
                    break;
                case 14:
                    strncpy(CaplCtrl_SignalName, "GK2_LS_def", 11);
                    break;
                case 15:
                    strncpy(CaplCtrl_SignalName, "GK2_Profil", 11);
                    break;
                case 16:
                    strncpy(CaplCtrl_SignalName, "GK2_Schluessel", 15);
                    break;
                case 17:
                    strncpy(CaplCtrl_SignalName, "GK2_Sta_BSG4", 13);
                    break;
                case 18:
                    strncpy(CaplCtrl_SignalName, "GK2_Sta_Clima2", 15);
                    break;
                case 19:
                    strncpy(CaplCtrl_SignalName, "GK2_Sta_Kessy_4", 16);
                    break;
                case 20:
                    strncpy(CaplCtrl_SignalName, "GK2_Sta_LSM", 12);
                    break;
                case 21:
                    strncpy(CaplCtrl_SignalName, "GK2_Sta_Licht1", 15);
                    break;
                case 22:
                    strncpy(CaplCtrl_SignalName, "GK2_Sta_Lichtsensor", 20);
                    break;
                case 23:
                    strncpy(CaplCtrl_SignalName, "GK2_Sta_Profil", 15);
                    break;
                case 24:
                    strncpy(CaplCtrl_SignalName, "GK2_Sta_Schluessel", 19);
                    break;
                case 25:
                    strncpy(CaplCtrl_SignalName, "GK2_Sta_VSG", 12);
                    break;
                case 26:
                    strncpy(CaplCtrl_SignalName, "GK2_VDKD_auf", 13);
                    break;
                case 27:
                    strncpy(CaplCtrl_SignalName, "GK2_VD_entriegelt", 18);
                    break;
                case 28:
                    strncpy(CaplCtrl_SignalName, "GK2_VD_offen_ver", 17);
                    break;
                case 29:
                    strncpy(CaplCtrl_SignalName, "GK2_VD_zu_ver", 14);
                    break;
                case 30:
                    strncpy(CaplCtrl_SignalName, "GK2_Verdeck_Anf", 16);
                    break;
                case 31:
                    strncpy(CaplCtrl_SignalName, "GK2_res_09", 11);
                    break;
                case 32:
                    strncpy(CaplCtrl_SignalName, "GK2_res_13", 11);
                    break;
                case 33:
                    strncpy(CaplCtrl_SignalName, "GK2_res_29", 11);
                    break;
                case 34:
                    strncpy(CaplCtrl_SignalName, "GK2_res_30", 11);
                    break;
            }
        }
        break;
        case FRM_HANDLE_Gate_Komf_3:
        {
            switch (SigIdx)
            {
                case 0:
                    strncpy(CaplCtrl_SignalName, "BCM_Tankwunsch", 15);
                    break;
                case 1:
                    strncpy(CaplCtrl_SignalName, "BK1_Anlern_Info", 16);
                    break;
                case 2:
                    strncpy(CaplCtrl_SignalName, "BK1_IDGeber_1_Status", 21);
                    break;
                case 3:
                    strncpy(CaplCtrl_SignalName, "BK1_IDGeber_2_Status", 21);
                    break;
                case 4:
                    strncpy(CaplCtrl_SignalName, "BK1_IDGeber_3_Status", 21);
                    break;
                case 5:
                    strncpy(CaplCtrl_SignalName, "BK1_IDGeber_4_Status", 21);
                    break;
                case 6:
                    strncpy(CaplCtrl_SignalName, "CL3_SH_Wasserpumpe", 19);
                    break;
                case 7:
                    strncpy(CaplCtrl_SignalName, "GK2_Sta_Kessy_4", 16);
                    break;
                case 8:
                    strncpy(CaplCtrl_SignalName, "GK3_Sta_BCM_KY1", 16);
                    break;
                case 9:
                    strncpy(CaplCtrl_SignalName, "GK3_Sta_BSG4", 13);
                    break;
                case 10:
                    strncpy(CaplCtrl_SignalName, "GK3_Sta_Clima_3", 16);
                    break;
                case 11:
                    strncpy(CaplCtrl_SignalName, "GK3_Sta_res_03", 15);
                    break;
                case 12:
                    strncpy(CaplCtrl_SignalName, "GK3_Sta_res_04", 15);
                    break;
                case 13:
                    strncpy(CaplCtrl_SignalName, "GK3_Sta_res_05", 15);
                    break;
                case 14:
                    strncpy(CaplCtrl_SignalName, "GK3_Sta_res_06", 15);
                    break;
                case 15:
                    strncpy(CaplCtrl_SignalName, "GK3_Sta_res_07", 15);
                    break;
                case 16:
                    strncpy(CaplCtrl_SignalName, "KY4_Gong_600", 13);
                    break;
                case 17:
                    strncpy(CaplCtrl_SignalName, "KY4_Meldungen", 14);
                    break;
                case 18:
                    strncpy(CaplCtrl_SignalName, "KY4_Passiv_Autolock_Menue", 26);
                    break;
                case 19:
                    strncpy(CaplCtrl_SignalName, "KY4_Passiv_Autolock_akt", 24);
                    break;
            }
        }
        break;
        case FRM_HANDLE_Getriebe_1:
        {
            switch (SigIdx)
            {
                case 0:
                    strncpy(CaplCtrl_SignalName, "GE1_Code_MSG", 13);
                    break;
                case 1:
                    strncpy(CaplCtrl_SignalName, "GE1_EGS_Anf", 12);
                    break;
                case 2:
                    strncpy(CaplCtrl_SignalName, "GE1_Fahrwistd", 14);
                    break;
                case 3:
                    strncpy(CaplCtrl_SignalName, "GE1_Fehlereintr", 16);
                    break;
                case 4:
                    strncpy(CaplCtrl_SignalName, "GE1_Infobit", 12);
                    break;
                case 5:
                    strncpy(CaplCtrl_SignalName, "GE1_Klimakompr", 15);
                    break;
                case 6:
                    strncpy(CaplCtrl_SignalName, "GE1_Kuehlung", 13);
                    break;
                case 7:
                    strncpy(CaplCtrl_SignalName, "GE1_LaunchControl", 18);
                    break;
                case 8:
                    strncpy(CaplCtrl_SignalName, "GE1_Mrad_Mkurb", 15);
                    break;
                case 9:
                    strncpy(CaplCtrl_SignalName, "GE1_Notlauf", 12);
                    break;
                case 10:
                    strncpy(CaplCtrl_SignalName, "GE1_Schaltung", 14);
                    break;
                case 11:
                    strncpy(CaplCtrl_SignalName, "GE1_SleepInd", 13);
                    break;
                case 12:
                    strncpy(CaplCtrl_SignalName, "GE1_Soll_Mo", 12);
                    break;
                case 13:
                    strncpy(CaplCtrl_SignalName, "GE1_Sta_OBD", 12);
                    break;
                case 14:
                    strncpy(CaplCtrl_SignalName, "GE1_Sta_Schutz", 15);
                    break;
                case 15:
                    strncpy(CaplCtrl_SignalName, "GE1_Start_Stopp_Info", 21);
                    break;
                case 16:
                    strncpy(CaplCtrl_SignalName, "GE1_Startverbot", 16);
                    break;
                case 17:
                    strncpy(CaplCtrl_SignalName, "GE1_WK", 7);
                    break;
                case 18:
                    strncpy(CaplCtrl_SignalName, "GE1_WaVerl_Mo", 14);
                    break;
                case 19:
                    strncpy(CaplCtrl_SignalName, "GE1_Wahl_Pos", 13);
                    break;
                case 20:
                    strncpy(CaplCtrl_SignalName, "GE1_Zaehler", 12);
                    break;
                case 21:
                    strncpy(CaplCtrl_SignalName, "GE1_Zielgang", 13);
                    break;
                case 22:
                    strncpy(CaplCtrl_SignalName, "GE1_v_Umkehr", 13);
                    break;
            }
        }
        break;
        case FRM_HANDLE_Getriebe_2:
        {
            switch (SigIdx)
            {
                case 0:
                    strncpy(CaplCtrl_SignalName, "GE2_4Gang", 10);
                    break;
                case 1:
                    strncpy(CaplCtrl_SignalName, "GE2_5Gang", 10);
                    break;
                case 2:
                    strncpy(CaplCtrl_SignalName, "GE2_ASG", 8);
                    break;
                case 3:
                    strncpy(CaplCtrl_SignalName, "GE2_DZM_Daempf", 15);
                    break;
                case 4:
                    strncpy(CaplCtrl_SignalName, "GE2_Gong", 9);
                    break;
                case 5:
                    strncpy(CaplCtrl_SignalName, "GE2_Grad_begr", 14);
                    break;
                case 6:
                    strncpy(CaplCtrl_SignalName, "GE2_LFR_Adap", 13);
                    break;
                case 7:
                    strncpy(CaplCtrl_SignalName, "GE2_LL_Solldz", 14);
                    break;
                case 8:
                    strncpy(CaplCtrl_SignalName, "GE2_MSB_Sync", 13);
                    break;
                case 9:
                    strncpy(CaplCtrl_SignalName, "GE2_PRND", 9);
                    break;
                case 10:
                    strncpy(CaplCtrl_SignalName, "GE2_PRNDS", 10);
                    break;
                case 11:
                    strncpy(CaplCtrl_SignalName, "GE2_Segeln_aktiv", 17);
                    break;
                case 12:
                    strncpy(CaplCtrl_SignalName, "GE2_Selespeed", 14);
                    break;
                case 13:
                    strncpy(CaplCtrl_SignalName, "GE2_Senderkennung", 18);
                    break;
                case 14:
                    strncpy(CaplCtrl_SignalName, "GE2_Shift_Lock", 15);
                    break;
                case 15:
                    strncpy(CaplCtrl_SignalName, "GE2_SlipStDZEingr", 18);
                    break;
                case 16:
                    strncpy(CaplCtrl_SignalName, "GE2_Sta_SAS", 12);
                    break;
                case 17:
                    strncpy(CaplCtrl_SignalName, "GE2_Sta_ZwGas", 14);
                    break;
                case 18:
                    strncpy(CaplCtrl_SignalName, "GE2_Sync_Dz", 12);
                    break;
                case 19:
                    strncpy(CaplCtrl_SignalName, "GE2_Sync_Zeit", 14);
                    break;
                case 20:
                    strncpy(CaplCtrl_SignalName, "GE2_Tip4Gang", 13);
                    break;
                case 21:
                    strncpy(CaplCtrl_SignalName, "GE2_Tip5Gang", 13);
                    break;
                case 22:
                    strncpy(CaplCtrl_SignalName, "GE2_Tip6Gang", 13);
                    break;
                case 23:
                    strncpy(CaplCtrl_SignalName, "GE2_Tip7Gang", 13);
                    break;
                case 24:
                    strncpy(CaplCtrl_SignalName, "GE2_Variante", 13);
                    break;
                case 25:
                    strncpy(CaplCtrl_SignalName, "GE2_WBA_Blinken", 16);
                    break;
                case 26:
                    strncpy(CaplCtrl_SignalName, "GE2_Zaehler", 12);
                    break;
                case 27:
                    strncpy(CaplCtrl_SignalName, "GE2_akt_Gang", 13);
                    break;
                case 28:
                    strncpy(CaplCtrl_SignalName, "GE2_invMSB_Sync", 16);
                    break;
                case 29:
                    strncpy(CaplCtrl_SignalName, "GE2_invSync_Dz", 15);
                    break;
            }
        }
        break;
        case FRM_HANDLE_Getriebe_3_Momente:
        {
            switch (SigIdx)
            {
                case 0:
                    strncpy(CaplCtrl_SignalName, "GM3_Checksum", 13);
                    break;
                case 1:
                    strncpy(CaplCtrl_SignalName, "GM3_LangEingr", 14);
                    break;
                case 2:
                    strncpy(CaplCtrl_SignalName, "GM3_MoSoMom", 12);
                    break;
                case 3:
                    strncpy(CaplCtrl_SignalName, "GM3_MomEingr", 13);
                    break;
                case 4:
                    strncpy(CaplCtrl_SignalName, "GM3_MomID", 10);
                    break;
                case 5:
                    strncpy(CaplCtrl_SignalName, "GM3_Moment", 11);
                    break;
                case 6:
                    strncpy(CaplCtrl_SignalName, "GM3_QB_LangEingr", 17);
                    break;
                case 7:
                    strncpy(CaplCtrl_SignalName, "GM3_StaSoMom", 13);
                    break;
                case 8:
                    strncpy(CaplCtrl_SignalName, "GM3_Zaehler", 12);
                    break;
                case 9:
                    strncpy(CaplCtrl_SignalName, "GM3_Zeit", 9);
                    break;
                case 10:
                    strncpy(CaplCtrl_SignalName, "GM3_res_13", 11);
                    break;
                case 11:
                    strncpy(CaplCtrl_SignalName, "GM3_res_14", 11);
                    break;
                case 12:
                    strncpy(CaplCtrl_SignalName, "GM3_res_15", 11);
                    break;
                case 13:
                    strncpy(CaplCtrl_SignalName, "GM3_res_61", 11);
                    break;
                case 14:
                    strncpy(CaplCtrl_SignalName, "GM3_res_62", 11);
                    break;
                case 15:
                    strncpy(CaplCtrl_SignalName, "GM3_res_63", 11);
                    break;
            }
        }
        break;
        case FRM_HANDLE_Getriebe_6:
        {
            switch (SigIdx)
            {
                case 0:
                    strncpy(CaplCtrl_SignalName, "GE6_Checksum", 13);
                    break;
                case 1:
                    strncpy(CaplCtrl_SignalName, "GE6_Gangwechsel", 16);
                    break;
                case 2:
                    strncpy(CaplCtrl_SignalName, "GE6_OelTemp", 12);
                    break;
                case 3:
                    strncpy(CaplCtrl_SignalName, "GE6_QB_OelTemp", 15);
                    break;
                case 4:
                    strncpy(CaplCtrl_SignalName, "GE6_QmaxBeschl", 15);
                    break;
                case 5:
                    strncpy(CaplCtrl_SignalName, "GE6_Sta_Shift_Spontan", 22);
                    break;
                case 6:
                    strncpy(CaplCtrl_SignalName, "GE6_TurbDZ", 11);
                    break;
                case 7:
                    strncpy(CaplCtrl_SignalName, "GE6_Verlustmom", 15);
                    break;
                case 8:
                    strncpy(CaplCtrl_SignalName, "GE6_Zaehler", 12);
                    break;
                case 9:
                    strncpy(CaplCtrl_SignalName, "GE6_Zielgang_err", 17);
                    break;
                case 10:
                    strncpy(CaplCtrl_SignalName, "GE6_maxBeschl", 14);
                    break;
                case 11:
                    strncpy(CaplCtrl_SignalName, "GE_Heizwunsch", 14);
                    break;
                case 12:
                    strncpy(CaplCtrl_SignalName, "GE_StSt_Info", 13);
                    break;
            }
        }
        break;
        case FRM_HANDLE_Getriebe_Hybrid_1:
        {
            switch (SigIdx)
            {
                case 0:
                    strncpy(CaplCtrl_SignalName, "GH1_AnzeigeDZ", 14);
                    break;
                case 1:
                    strncpy(CaplCtrl_SignalName, "GH1_FehlerstatusGSG", 20);
                    break;
                case 2:
                    strncpy(CaplCtrl_SignalName, "GH1_Filt_MomAufbau", 19);
                    break;
                case 3:
                    strncpy(CaplCtrl_SignalName, "GH1_Freig_LL_Reg", 17);
                    break;
                case 4:
                    strncpy(CaplCtrl_SignalName, "GH1_FreigabeK0", 15);
                    break;
                case 5:
                    strncpy(CaplCtrl_SignalName, "GH1_FreigabeSSK0", 17);
                    break;
                case 6:
                    strncpy(CaplCtrl_SignalName, "GH1_FreigabeVMStop", 19);
                    break;
                case 7:
                    strncpy(CaplCtrl_SignalName, "GH1_MomEingriff_EM", 19);
                    break;
                case 8:
                    strncpy(CaplCtrl_SignalName, "GH1_Sportfaktor", 16);
                    break;
                case 9:
                    strncpy(CaplCtrl_SignalName, "GH1_VKMstartanforderung", 24);
                    break;
                case 10:
                    strncpy(CaplCtrl_SignalName, "GH1_VKMstartkontrolle", 22);
                    break;
                case 11:
                    strncpy(CaplCtrl_SignalName, "GH1_VM_akt_halten", 18);
                    break;
                case 12:
                    strncpy(CaplCtrl_SignalName, "GH1_VZMomEingriff", 18);
                    break;
                case 13:
                    strncpy(CaplCtrl_SignalName, "GH1_Wiederstart", 16);
                    break;
                case 14:
                    strncpy(CaplCtrl_SignalName, "GH1_Zaehler", 12);
                    break;
                case 15:
                    strncpy(CaplCtrl_SignalName, "GH1_nK0", 8);
                    break;
            }
        }
        break;
        case FRM_HANDLE_Klima_5:
        {
            switch (SigIdx)
            {
                case 0:
                    strncpy(CaplCtrl_SignalName, "HYB_Anf_E_Mode", 15);
                    break;
                case 1:
                    strncpy(CaplCtrl_SignalName, "KL_Magnetventil", 16);
                    break;
                case 2:
                    strncpy(CaplCtrl_SignalName, "KL_Schalter_StartStopp", 23);
                    break;
                case 3:
                    strncpy(CaplCtrl_SignalName, "KL_Thermomanagement", 20);
                    break;
                case 4:
                    strncpy(CaplCtrl_SignalName, "Klima_StSt_Info", 16);
                    break;
                case 5:
                    strncpy(CaplCtrl_SignalName, "SH_Betriebsdauer", 17);
                    break;
                case 6:
                    strncpy(CaplCtrl_SignalName, "SH_Monat", 9);
                    break;
                case 7:
                    strncpy(CaplCtrl_SignalName, "SH_Offset_Jahr", 15);
                    break;
                case 8:
                    strncpy(CaplCtrl_SignalName, "SH_Tag", 7);
                    break;
                case 9:
                    strncpy(CaplCtrl_SignalName, "SH_Timer_aktiv", 15);
                    break;
                case 10:
                    strncpy(CaplCtrl_SignalName, "SH_Timerstatus", 15);
                    break;
                case 11:
                    strncpy(CaplCtrl_SignalName, "SH_WP_Fehler", 13);
                    break;
                case 12:
                    strncpy(CaplCtrl_SignalName, "SH_Wochentag", 13);
                    break;
                case 13:
                    strncpy(CaplCtrl_SignalName, "SH_h_Einschaltzeit", 19);
                    break;
                case 14:
                    strncpy(CaplCtrl_SignalName, "SH_min_Einschaltzeit", 21);
                    break;
                case 15:
                    strncpy(CaplCtrl_SignalName, "STH_Betriebsart", 16);
                    break;
            }
        }
        break;
        case FRM_HANDLE_Kombi_1:
        {
            switch (SigIdx)
            {
                case 0:
                    strncpy(CaplCtrl_SignalName, "KO1_ABS_Lampe", 14);
                    break;
                case 1:
                    strncpy(CaplCtrl_SignalName, "KO1_ACC_AnzFhl", 15);
                    break;
                case 2:
                    strncpy(CaplCtrl_SignalName, "KO1_ACC_Inkons", 15);
                    break;
                case 3:
                    strncpy(CaplCtrl_SignalName, "KO1_ASRESP_Lampe", 17);
                    break;
                case 4:
                    strncpy(CaplCtrl_SignalName, "KO1_Airbag_Lampe", 17);
                    break;
                case 5:
                    strncpy(CaplCtrl_SignalName, "KO1_Brems_Lampe", 16);
                    break;
                case 6:
                    strncpy(CaplCtrl_SignalName, "KO1_Bremsinfo", 14);
                    break;
                case 7:
                    strncpy(CaplCtrl_SignalName, "KO1_Handbremse", 15);
                    break;
                case 8:
                    strncpy(CaplCtrl_SignalName, "KO1_Kuehlmittel", 16);
                    break;
                case 9:
                    strncpy(CaplCtrl_SignalName, "KO1_LDW_AnzFeh", 15);
                    break;
                case 10:
                    strncpy(CaplCtrl_SignalName, "KO1_La_Ladekon", 15);
                    break;
                case 11:
                    strncpy(CaplCtrl_SignalName, "KO1_Lenkh_Lampe", 16);
                    break;
                case 12:
                    strncpy(CaplCtrl_SignalName, "KO1_OBD_Tank", 13);
                    break;
                case 13:
                    strncpy(CaplCtrl_SignalName, "KO1_Oeldruck", 13);
                    break;
                case 14:
                    strncpy(CaplCtrl_SignalName, "KO1_Quelle_kmh", 15);
                    break;
                case 15:
                    strncpy(CaplCtrl_SignalName, "KO1_SILA_gueltig", 17);
                    break;
                case 16:
                    strncpy(CaplCtrl_SignalName, "KO1_SleepInd", 13);
                    break;
                case 17:
                    strncpy(CaplCtrl_SignalName, "KO1_Sta_Oeldr", 14);
                    break;
                case 18:
                    strncpy(CaplCtrl_SignalName, "KO1_Sta_Tank", 13);
                    break;
                case 19:
                    strncpy(CaplCtrl_SignalName, "KO1_Stellglieder", 17);
                    break;
                case 20:
                    strncpy(CaplCtrl_SignalName, "KO1_Tankinhalt", 15);
                    break;
                case 21:
                    strncpy(CaplCtrl_SignalName, "KO1_Tankstop", 13);
                    break;
                case 22:
                    strncpy(CaplCtrl_SignalName, "KO1_Vorgluehen", 15);
                    break;
                case 23:
                    strncpy(CaplCtrl_SignalName, "KO1_Wakeup_Komfort", 19);
                    break;
                case 24:
                    strncpy(CaplCtrl_SignalName, "KO1_Warn_Tank", 14);
                    break;
                case 25:
                    strncpy(CaplCtrl_SignalName, "KO1_Zaehler", 12);
                    break;
                case 26:
                    strncpy(CaplCtrl_SignalName, "KO1_Zeitluecke", 15);
                    break;
                case 27:
                    strncpy(CaplCtrl_SignalName, "KO1_angez_kmh", 14);
                    break;
                case 28:
                    strncpy(CaplCtrl_SignalName, "KO1_kmh", 8);
                    break;
                case 29:
                    strncpy(CaplCtrl_SignalName, "KO1_kmh_mph", 12);
                    break;
            }
        }
        break;
        case FRM_HANDLE_Kombi_2:
        {
            switch (SigIdx)
            {
                case 0:
                    strncpy(CaplCtrl_SignalName, "KO2_Aussen_T", 13);
                    break;
                case 1:
                    strncpy(CaplCtrl_SignalName, "KO2_Bel_Displ", 14);
                    break;
                case 2:
                    strncpy(CaplCtrl_SignalName, "KO2_Bel_Schalt", 15);
                    break;
                case 3:
                    strncpy(CaplCtrl_SignalName, "KO2_Fehlereintr", 16);
                    break;
                case 4:
                    strncpy(CaplCtrl_SignalName, "KO2_GRA_High", 13);
                    break;
                case 5:
                    strncpy(CaplCtrl_SignalName, "KO2_MFA_v_Einheit", 18);
                    break;
                case 6:
                    strncpy(CaplCtrl_SignalName, "KO2_OBD_Nib_Temp", 17);
                    break;
                case 7:
                    strncpy(CaplCtrl_SignalName, "KO2_OelTemp", 12);
                    break;
                case 8:
                    strncpy(CaplCtrl_SignalName, "KO2_Oelwarn", 12);
                    break;
                case 9:
                    strncpy(CaplCtrl_SignalName, "KO2_PLA_Displaystatus", 22);
                    break;
                case 10:
                    strncpy(CaplCtrl_SignalName, "KO2_Reserve4", 13);
                    break;
                case 11:
                    strncpy(CaplCtrl_SignalName, "KO2_Reserve5", 13);
                    break;
                case 12:
                    strncpy(CaplCtrl_SignalName, "KO2_Sta_Auss_T", 15);
                    break;
                case 13:
                    strncpy(CaplCtrl_SignalName, "KO2_Sta_Displ", 14);
                    break;
                case 14:
                    strncpy(CaplCtrl_SignalName, "KO2_Sta_Oel_T", 14);
                    break;
                case 15:
                    strncpy(CaplCtrl_SignalName, "KO2_Sta_Schalt", 15);
                    break;
                case 16:
                    strncpy(CaplCtrl_SignalName, "KO2_Temp_Einheit", 17);
                    break;
                case 17:
                    strncpy(CaplCtrl_SignalName, "KO2_Verb_TOG", 13);
                    break;
                case 18:
                    strncpy(CaplCtrl_SignalName, "KO2_Wischwasser", 16);
                    break;
                case 19:
                    strncpy(CaplCtrl_SignalName, "KO2_gef_Auss_T", 15);
                    break;
                case 20:
                    strncpy(CaplCtrl_SignalName, "MFA_Strecke_Einheit", 20);
                    break;
            }
        }
        break;
        case FRM_HANDLE_Kombi_3:
        {
            switch (SigIdx)
            {
                case 0:
                    strncpy(CaplCtrl_SignalName, "KBI_Oelwechsel_durchgefuehrt", 29);
                    break;
                case 1:
                    strncpy(CaplCtrl_SignalName, "KO3_Baureihe", 13);
                    break;
                case 2:
                    strncpy(CaplCtrl_SignalName, "KO3_Derivat", 12);
                    break;
                case 3:
                    strncpy(CaplCtrl_SignalName, "KO3_Generation", 15);
                    break;
                case 4:
                    strncpy(CaplCtrl_SignalName, "KO3_Kilometer", 14);
                    break;
                case 5:
                    strncpy(CaplCtrl_SignalName, "KO3_Land", 9);
                    break;
                case 6:
                    strncpy(CaplCtrl_SignalName, "KO3_Marke", 10);
                    break;
                case 7:
                    strncpy(CaplCtrl_SignalName, "KO3_Mp_Code", 12);
                    break;
                case 8:
                    strncpy(CaplCtrl_SignalName, "KO3_Radumfang", 14);
                    break;
                case 9:
                    strncpy(CaplCtrl_SignalName, "KO3_Reserve1", 13);
                    break;
                case 10:
                    strncpy(CaplCtrl_SignalName, "KO3_Reserve2", 13);
                    break;
                case 11:
                    strncpy(CaplCtrl_SignalName, "KO3_SWA_AnzFeh", 15);
                    break;
                case 12:
                    strncpy(CaplCtrl_SignalName, "KO3_Schluessel", 15);
                    break;
                case 13:
                    strncpy(CaplCtrl_SignalName, "KO3_Sprache", 12);
                    break;
                case 14:
                    strncpy(CaplCtrl_SignalName, "KO3_Sta_Standz", 15);
                    break;
                case 15:
                    strncpy(CaplCtrl_SignalName, "KO3_Standzeit", 14);
                    break;
                case 16:
                    strncpy(CaplCtrl_SignalName, "KO3_Verbau_ADR", 15);
                    break;
                case 17:
                    strncpy(CaplCtrl_SignalName, "KO3_Verbau_Air", 15);
                    break;
                case 18:
                    strncpy(CaplCtrl_SignalName, "KO3_Verbau_BN", 14);
                    break;
                case 19:
                    strncpy(CaplCtrl_SignalName, "KO3_Verbau_Br", 14);
                    break;
                case 20:
                    strncpy(CaplCtrl_SignalName, "KO3_Verbau_DP", 14);
                    break;
                case 21:
                    strncpy(CaplCtrl_SignalName, "KO3_Verbau_Get", 15);
                    break;
                case 22:
                    strncpy(CaplCtrl_SignalName, "KO3_Verbau_Kl", 14);
                    break;
                case 23:
                    strncpy(CaplCtrl_SignalName, "KO3_Verbau_LH", 14);
                    break;
                case 24:
                    strncpy(CaplCtrl_SignalName, "KO3_Verbau_LWS", 15);
                    break;
                case 25:
                    strncpy(CaplCtrl_SignalName, "KO3_Verbau_Mot", 15);
                    break;
                case 26:
                    strncpy(CaplCtrl_SignalName, "KO3_Verbau_Niveau", 18);
                    break;
                case 27:
                    strncpy(CaplCtrl_SignalName, "KO3_Verbau_Syn", 15);
                    break;
            }
        }
        break;
        case FRM_HANDLE_LW_1:
        {
            switch (SigIdx)
            {
                case 0:
                    strncpy(CaplCtrl_SignalName, "LW1_CRC", 8);
                    break;
                case 1:
                    strncpy(CaplCtrl_SignalName, "LW1_Gesch_Sign", 15);
                    break;
                case 2:
                    strncpy(CaplCtrl_SignalName, "LW1_ID", 7);
                    break;
                case 3:
                    strncpy(CaplCtrl_SignalName, "LW1_Initquelle", 15);
                    break;
                case 4:
                    strncpy(CaplCtrl_SignalName, "LW1_Kodier", 11);
                    break;
                case 5:
                    strncpy(CaplCtrl_SignalName, "LW1_LRW", 8);
                    break;
                case 6:
                    strncpy(CaplCtrl_SignalName, "LW1_LRW_Sign", 13);
                    break;
                case 7:
                    strncpy(CaplCtrl_SignalName, "LW1_Lenk_Gesch", 15);
                    break;
                case 8:
                    strncpy(CaplCtrl_SignalName, "LW1_Sta_KL30", 13);
                    break;
                case 9:
                    strncpy(CaplCtrl_SignalName, "LW1_Status", 11);
                    break;
                case 10:
                    strncpy(CaplCtrl_SignalName, "LW1_Zaehler", 12);
                    break;
            }
        }
        break;
        case FRM_HANDLE_Lenkhilfe_3:
        {
            switch (SigIdx)
            {
                case 0:
                    strncpy(CaplCtrl_SignalName, "LH3_BLW", 8);
                    break;
                case 1:
                    strncpy(CaplCtrl_SignalName, "LH3_BLWSign", 12);
                    break;
                case 2:
                    strncpy(CaplCtrl_SignalName, "LH3_BLWValid", 13);
                    break;
                case 3:
                    strncpy(CaplCtrl_SignalName, "LH3_BS_Spiegel", 15);
                    break;
                case 4:
                    strncpy(CaplCtrl_SignalName, "LH3_Checksumme", 15);
                    break;
                case 5:
                    strncpy(CaplCtrl_SignalName, "LH3_LM", 7);
                    break;
                case 6:
                    strncpy(CaplCtrl_SignalName, "LH3_LMSign", 11);
                    break;
                case 7:
                    strncpy(CaplCtrl_SignalName, "LH3_LMValid", 12);
                    break;
                case 8:
                    strncpy(CaplCtrl_SignalName, "LH3_Lenkungstyp", 16);
                    break;
                case 9:
                    strncpy(CaplCtrl_SignalName, "LH3_Sta_DSR", 12);
                    break;
                case 10:
                    strncpy(CaplCtrl_SignalName, "LH3_Zaehler", 12);
                    break;
            }
        }
        break;
        case FRM_HANDLE_NMH_Gateway:
        {
            switch (SigIdx)
            {
                case 0:
                    strncpy(CaplCtrl_SignalName, "NMH_GW_Abschaltstufe_aktiv", 27);
                    break;
                case 1:
                    strncpy(CaplCtrl_SignalName, "NMH_GW_CAN_Diag_deaktiv", 24);
                    break;
                case 2:
                    strncpy(CaplCtrl_SignalName, "NMH_GW_Car_WakeUp", 18);
                    break;
                case 3:
                    strncpy(CaplCtrl_SignalName, "NMH_GW_Eindraht_Fehler", 23);
                    break;
                case 4:
                    strncpy(CaplCtrl_SignalName, "NMH_GW_Fkt_WakeUp", 18);
                    break;
                case 5:
                    strncpy(CaplCtrl_SignalName, "NMH_GW_KompSchutz", 18);
                    break;
                case 6:
                    strncpy(CaplCtrl_SignalName, "NMH_GW_Mute_Mode", 17);
                    break;
                case 7:
                    strncpy(CaplCtrl_SignalName, "NMH_GW_NL_0", 12);
                    break;
                case 8:
                    strncpy(CaplCtrl_SignalName, "NMH_GW_NL_1", 12);
                    break;
                case 9:
                    strncpy(CaplCtrl_SignalName, "NMH_GW_NL_2", 12);
                    break;
                case 10:
                    strncpy(CaplCtrl_SignalName, "NMH_GW_NL_3", 12);
                    break;
                case 11:
                    strncpy(CaplCtrl_SignalName, "NMH_GW_NL_4", 12);
                    break;
                case 12:
                    strncpy(CaplCtrl_SignalName, "NMH_GW_NL_5", 12);
                    break;
                case 13:
                    strncpy(CaplCtrl_SignalName, "NMH_GW_NL_6", 12);
                    break;
                case 14:
                    strncpy(CaplCtrl_SignalName, "NMH_GW_NL_7", 12);
                    break;
                case 15:
                    strncpy(CaplCtrl_SignalName, "NMH_GW_NL_aktiv_4", 18);
                    break;
                case 16:
                    strncpy(CaplCtrl_SignalName, "NMH_GW_NL_aktiv_5", 18);
                    break;
                case 17:
                    strncpy(CaplCtrl_SignalName, "NMH_GW_NL_aktiv_6", 18);
                    break;
                case 18:
                    strncpy(CaplCtrl_SignalName, "NMH_GW_NL_aktiv_7", 18);
                    break;
                case 19:
                    strncpy(CaplCtrl_SignalName, "NMH_GW_NL_aktiv_8", 18);
                    break;
                case 20:
                    strncpy(CaplCtrl_SignalName, "NMH_GW_NM_aktiv_Diagnose", 25);
                    break;
                case 21:
                    strncpy(CaplCtrl_SignalName, "NMH_GW_NM_aktiv_Klemme_15", 26);
                    break;
                case 22:
                    strncpy(CaplCtrl_SignalName, "NMH_GW_NM_aktiv_Start", 22);
                    break;
                case 23:
                    strncpy(CaplCtrl_SignalName, "NMH_GW_Normal_Mode_1", 21);
                    break;
                case 24:
                    strncpy(CaplCtrl_SignalName, "NMH_GW_Normal_Mode_2", 21);
                    break;
                case 25:
                    strncpy(CaplCtrl_SignalName, "NMH_GW_Per_WakeUp", 18);
                    break;
                case 26:
                    strncpy(CaplCtrl_SignalName, "NMH_GW_Start_1", 15);
                    break;
                case 27:
                    strncpy(CaplCtrl_SignalName, "NMH_GW_Start_2", 15);
                    break;
                case 28:
                    strncpy(CaplCtrl_SignalName, "NMH_GW_TimeOut_Fehler", 22);
                    break;
                case 29:
                    strncpy(CaplCtrl_SignalName, "NMH_GW_Transport_Mode", 22);
                    break;
            }
        }
        break;
        case FRM_HANDLE_Niveau_1:
        {
            switch (SigIdx)
            {
                case 0:
                    strncpy(CaplCtrl_SignalName, "Absenkung_Fahrzeug", 19);
                    break;
                case 1:
                    strncpy(CaplCtrl_SignalName, "Anhebung_Fahrzeug", 18);
                    break;
                case 2:
                    strncpy(CaplCtrl_SignalName, "Aufpruefbit_Warnlampe_Niveau", 29);
                    break;
                case 3:
                    strncpy(CaplCtrl_SignalName, "Beladungszustand", 17);
                    break;
                case 4:
                    strncpy(CaplCtrl_SignalName, "ESP_Beeinflussung", 18);
                    break;
                case 5:
                    strncpy(CaplCtrl_SignalName, "FSPE_Niveau1", 13);
                    break;
                case 6:
                    strncpy(CaplCtrl_SignalName, "Fehlerlampe_Niveau", 19);
                    break;
                case 7:
                    strncpy(CaplCtrl_SignalName, "Kompressor_laeuft", 18);
                    break;
                case 8:
                    strncpy(CaplCtrl_SignalName, "Kompressorlauf_in_Kuerze", 25);
                    break;
                case 9:
                    strncpy(CaplCtrl_SignalName, "NI1_Checksum", 13);
                    break;
                case 10:
                    strncpy(CaplCtrl_SignalName, "NI1_Fahrzeugart", 16);
                    break;
                case 11:
                    strncpy(CaplCtrl_SignalName, "NI1_MSG_Eingriff", 17);
                    break;
                case 12:
                    strncpy(CaplCtrl_SignalName, "NI1_Zaehler", 12);
                    break;
                case 13:
                    strncpy(CaplCtrl_SignalName, "Niveaustati", 12);
                    break;
                case 14:
                    strncpy(CaplCtrl_SignalName, "Parkniveau", 11);
                    break;
                case 15:
                    strncpy(CaplCtrl_SignalName, "SIB_Niveau", 11);
                    break;
                case 16:
                    strncpy(CaplCtrl_SignalName, "Stromaufnahme", 14);
                    break;
                case 17:
                    strncpy(CaplCtrl_SignalName, "Systemstatus", 13);
                    break;
                case 18:
                    strncpy(CaplCtrl_SignalName, "Taster_Niveau", 14);
                    break;
                case 19:
                    strncpy(CaplCtrl_SignalName, "Textbits_Niveau", 16);
                    break;
                case 20:
                    strncpy(CaplCtrl_SignalName, "Tiefniveaulampe", 16);
                    break;
                case 21:
                    strncpy(CaplCtrl_SignalName, "Verstellung_HL", 15);
                    break;
                case 22:
                    strncpy(CaplCtrl_SignalName, "Verstellung_HR", 15);
                    break;
                case 23:
                    strncpy(CaplCtrl_SignalName, "Verstellung_VL", 15);
                    break;
                case 24:
                    strncpy(CaplCtrl_SignalName, "Verstellung_VR", 15);
                    break;
                case 25:
                    strncpy(CaplCtrl_SignalName, "Verstellung_aktiv", 18);
                    break;
                case 26:
                    strncpy(CaplCtrl_SignalName, "Verstellung_in_Kuerze", 22);
                    break;
                case 27:
                    strncpy(CaplCtrl_SignalName, "Warnlampe", 10);
                    break;
                case 28:
                    strncpy(CaplCtrl_SignalName, "Zwischenniveau", 15);
                    break;
            }
        }
        break;
        case FRM_HANDLE_OBD_Tankgeber_01:
        {
            switch (SigIdx)
            {
                case 0:
                    strncpy(CaplCtrl_SignalName, "OBD_TG_F_Status_1", 18);
                    break;
                case 1:
                    strncpy(CaplCtrl_SignalName, "OBD_TG_F_Status_2", 18);
                    break;
                case 2:
                    strncpy(CaplCtrl_SignalName, "OBD_TG_F_Status_3", 18);
                    break;
                case 3:
                    strncpy(CaplCtrl_SignalName, "OBD_TG_F_Status_4", 18);
                    break;
                case 4:
                    strncpy(CaplCtrl_SignalName, "OBD_TG_Sens_Rohwert_1", 22);
                    break;
                case 5:
                    strncpy(CaplCtrl_SignalName, "OBD_TG_Sens_Rohwert_2", 22);
                    break;
                case 6:
                    strncpy(CaplCtrl_SignalName, "OBD_TG_Sens_Rohwert_3", 22);
                    break;
                case 7:
                    strncpy(CaplCtrl_SignalName, "OBD_TG_Sens_Rohwert_4", 22);
                    break;
            }
        }
        break;
        case FRM_HANDLE_Parkhilfe_01:
        {
            switch (SigIdx)
            {
                case 0:
                    strncpy(CaplCtrl_SignalName, "PH_Abschaltursache", 19);
                    break;
                case 1:
                    strncpy(CaplCtrl_SignalName, "PH_Anf_Audioabsenkung", 22);
                    break;
                case 2:
                    strncpy(CaplCtrl_SignalName, "PH_Aufbauten_erk", 17);
                    break;
                case 3:
                    strncpy(CaplCtrl_SignalName, "PH_BerErk_hinten", 17);
                    break;
                case 4:
                    strncpy(CaplCtrl_SignalName, "PH_BerErk_vorn", 15);
                    break;
                case 5:
                    strncpy(CaplCtrl_SignalName, "PH_Display_Kundenwunsch", 24);
                    break;
                case 6:
                    strncpy(CaplCtrl_SignalName, "PH_Frequenz_hinten", 19);
                    break;
                case 7:
                    strncpy(CaplCtrl_SignalName, "PH_Frequenz_vorn", 17);
                    break;
                case 8:
                    strncpy(CaplCtrl_SignalName, "PH_KD_Fehler", 13);
                    break;
                case 9:
                    strncpy(CaplCtrl_SignalName, "PH_Lautstaerke_hinten", 22);
                    break;
                case 10:
                    strncpy(CaplCtrl_SignalName, "PH_Lautstaerke_vorn", 20);
                    break;
                case 11:
                    strncpy(CaplCtrl_SignalName, "PH_Opt_Anz_H_Hindernis", 23);
                    break;
                case 12:
                    strncpy(CaplCtrl_SignalName, "PH_Opt_Anz_V_Hindernis", 23);
                    break;
                case 13:
                    strncpy(CaplCtrl_SignalName, "PH_Opt_Anzeige_H_ein", 21);
                    break;
                case 14:
                    strncpy(CaplCtrl_SignalName, "PH_Opt_Anzeige_V_ein", 21);
                    break;
                case 15:
                    strncpy(CaplCtrl_SignalName, "PH_StartStopp_Info", 19);
                    break;
                case 16:
                    strncpy(CaplCtrl_SignalName, "PH_Systemzustand", 17);
                    break;
                case 17:
                    strncpy(CaplCtrl_SignalName, "PH_Tongeber_H_aktiv", 20);
                    break;
                case 18:
                    strncpy(CaplCtrl_SignalName, "PH_Tongeber_V_aktiv", 20);
                    break;
                case 19:
                    strncpy(CaplCtrl_SignalName, "PH_Tongeber_mute", 17);
                    break;
                case 20:
                    strncpy(CaplCtrl_SignalName, "PH_defekt", 10);
                    break;
                case 21:
                    strncpy(CaplCtrl_SignalName, "PH_gestoert", 12);
                    break;
                case 22:
                    strncpy(CaplCtrl_SignalName, "PH_res_00", 10);
                    break;
                case 23:
                    strncpy(CaplCtrl_SignalName, "PH_res_01", 10);
                    break;
                case 24:
                    strncpy(CaplCtrl_SignalName, "PH_res_02", 10);
                    break;
                case 25:
                    strncpy(CaplCtrl_SignalName, "PH_res_03", 10);
                    break;
                case 26:
                    strncpy(CaplCtrl_SignalName, "PH_res_04", 10);
                    break;
                case 27:
                    strncpy(CaplCtrl_SignalName, "PH_res_05", 10);
                    break;
                case 28:
                    strncpy(CaplCtrl_SignalName, "PH_res_06", 10);
                    break;
                case 29:
                    strncpy(CaplCtrl_SignalName, "PH_res_07", 10);
                    break;
                case 30:
                    strncpy(CaplCtrl_SignalName, "PH_res_08", 10);
                    break;
                case 31:
                    strncpy(CaplCtrl_SignalName, "PH_res_09", 10);
                    break;
                case 32:
                    strncpy(CaplCtrl_SignalName, "PH_res_10", 10);
                    break;
                case 33:
                    strncpy(CaplCtrl_SignalName, "PH_res_11", 10);
                    break;
                case 34:
                    strncpy(CaplCtrl_SignalName, "PH_res_12", 10);
                    break;
                case 35:
                    strncpy(CaplCtrl_SignalName, "PH_res_24", 10);
                    break;
                case 36:
                    strncpy(CaplCtrl_SignalName, "PH_res_25", 10);
                    break;
                case 37:
                    strncpy(CaplCtrl_SignalName, "PH_res_26", 10);
                    break;
                case 38:
                    strncpy(CaplCtrl_SignalName, "PH_res_27", 10);
                    break;
                case 39:
                    strncpy(CaplCtrl_SignalName, "PH_res_28", 10);
                    break;
                case 40:
                    strncpy(CaplCtrl_SignalName, "PH_res_29", 10);
                    break;
                case 41:
                    strncpy(CaplCtrl_SignalName, "PH_res_30", 10);
                    break;
                case 42:
                    strncpy(CaplCtrl_SignalName, "PH_res_31", 10);
                    break;
                case 43:
                    strncpy(CaplCtrl_SignalName, "PH_res_48", 10);
                    break;
            }
        }
        break;
        case FRM_HANDLE_Parkhilfe_1:
        {
            switch (SigIdx)
            {
                case 0:
                    strncpy(CaplCtrl_SignalName, "APS_Frequenz_hinten", 20);
                    break;
                case 1:
                    strncpy(CaplCtrl_SignalName, "APS_Frequenz_vorn", 18);
                    break;
                case 2:
                    strncpy(CaplCtrl_SignalName, "APS_Lautstaerke_hinten", 23);
                    break;
                case 3:
                    strncpy(CaplCtrl_SignalName, "APS_Lautstaerke_vorn", 21);
                    break;
                case 4:
                    strncpy(CaplCtrl_SignalName, "Anlage_defekt", 14);
                    break;
                case 5:
                    strncpy(CaplCtrl_SignalName, "Eis_aus", 8);
                    break;
                case 6:
                    strncpy(CaplCtrl_SignalName, "Geschwindigkeit_aus", 20);
                    break;
                case 7:
                    strncpy(CaplCtrl_SignalName, "KD_Fehler_Parkhilfe", 20);
                    break;
                case 8:
                    strncpy(CaplCtrl_SignalName, "Optische_Anzeige_aktiv", 23);
                    break;
                case 9:
                    strncpy(CaplCtrl_SignalName, "PH_StSt_Info", 13);
                    break;
                case 10:
                    strncpy(CaplCtrl_SignalName, "Rueckwaertsgang_aktiviert", 26);
                    break;
                case 11:
                    strncpy(CaplCtrl_SignalName, "Schlechtweg_aus", 16);
                    break;
                case 12:
                    strncpy(CaplCtrl_SignalName, "Taster_aktiviert", 17);
                    break;
                case 13:
                    strncpy(CaplCtrl_SignalName, "Tongeber_h_aktiv", 17);
                    break;
                case 14:
                    strncpy(CaplCtrl_SignalName, "Tongeber_h_defekt", 18);
                    break;
                case 15:
                    strncpy(CaplCtrl_SignalName, "Tongeber_v_aktiv", 17);
                    break;
                case 16:
                    strncpy(CaplCtrl_SignalName, "Tongeber_v_defekt", 18);
                    break;
            }
        }
        break;
        case FRM_HANDLE_Remotestart_FFB:
        {
            switch (SigIdx)
            {
                case 0:
                    strncpy(CaplCtrl_SignalName, "RSF_Tastencode_1", 17);
                    break;
                case 1:
                    strncpy(CaplCtrl_SignalName, "RSF_Tastencode_2", 17);
                    break;
                case 2:
                    strncpy(CaplCtrl_SignalName, "RSF_Tastencode_Maske", 21);
                    break;
            }
        }
        break;
        case FRM_HANDLE_Soll_Verbauliste_neu:
        {
            switch (SigIdx)
            {
                case 0:
                    strncpy(CaplCtrl_SignalName, "VL1_ABS", 8);
                    break;
                case 1:
                    strncpy(CaplCtrl_SignalName, "VL1_ADR", 8);
                    break;
                case 2:
                    strncpy(CaplCtrl_SignalName, "VL1_ADR_getrennt", 17);
                    break;
                case 3:
                    strncpy(CaplCtrl_SignalName, "VL1_Airbag", 11);
                    break;
                case 4:
                    strncpy(CaplCtrl_SignalName, "VL1_Allrad", 11);
                    break;
                case 5:
                    strncpy(CaplCtrl_SignalName, "VL1_Anhaenger", 14);
                    break;
                case 6:
                    strncpy(CaplCtrl_SignalName, "VL1_BSG_Komf", 13);
                    break;
                case 7:
                    strncpy(CaplCtrl_SignalName, "VL1_Clima_Komf", 15);
                    break;
                case 8:
                    strncpy(CaplCtrl_SignalName, "VL1_DAB", 8);
                    break;
                case 9:
                    strncpy(CaplCtrl_SignalName, "VL1_DSP", 8);
                    break;
                case 10:
                    strncpy(CaplCtrl_SignalName, "VL1_Daempfer", 13);
                    break;
                case 11:
                    strncpy(CaplCtrl_SignalName, "VL1_EPB", 8);
                    break;
                case 12:
                    strncpy(CaplCtrl_SignalName, "VL1_Easy_Entry_VB", 18);
                    break;
                case 13:
                    strncpy(CaplCtrl_SignalName, "VL1_Easy_Entry_VF", 18);
                    break;
                case 14:
                    strncpy(CaplCtrl_SignalName, "VL1_Einparkhilfe", 17);
                    break;
                case 15:
                    strncpy(CaplCtrl_SignalName, "VL1_GSM_Pager", 14);
                    break;
                case 16:
                    strncpy(CaplCtrl_SignalName, "VL1_Gateway", 12);
                    break;
                case 17:
                    strncpy(CaplCtrl_SignalName, "VL1_Getr_SG", 12);
                    break;
                case 18:
                    strncpy(CaplCtrl_SignalName, "VL1_HCA", 8);
                    break;
                case 19:
                    strncpy(CaplCtrl_SignalName, "VL1_Heckdeckel", 15);
                    break;
                case 20:
                    strncpy(CaplCtrl_SignalName, "VL1_InfoElektronik", 19);
                    break;
                case 21:
                    strncpy(CaplCtrl_SignalName, "VL1_Kombi", 10);
                    break;
                case 22:
                    strncpy(CaplCtrl_SignalName, "VL1_Kombi_KBI", 14);
                    break;
                case 23:
                    strncpy(CaplCtrl_SignalName, "VL1_Kompass", 12);
                    break;
                case 24:
                    strncpy(CaplCtrl_SignalName, "VL1_LSM", 8);
                    break;
                case 25:
                    strncpy(CaplCtrl_SignalName, "VL1_Lenkhilfe", 14);
                    break;
                case 26:
                    strncpy(CaplCtrl_SignalName, "VL1_Lenksaeule", 15);
                    break;
                case 27:
                    strncpy(CaplCtrl_SignalName, "VL1_MDI_I", 10);
                    break;
                case 28:
                    strncpy(CaplCtrl_SignalName, "VL1_Memory", 11);
                    break;
                case 29:
                    strncpy(CaplCtrl_SignalName, "VL1_Memory_BF", 14);
                    break;
                case 30:
                    strncpy(CaplCtrl_SignalName, "VL1_MotorSlave", 15);
                    break;
                case 31:
                    strncpy(CaplCtrl_SignalName, "VL1_Motor_SG", 13);
                    break;
                case 32:
                    strncpy(CaplCtrl_SignalName, "VL1_Navigation", 15);
                    break;
                case 33:
                    strncpy(CaplCtrl_SignalName, "VL1_Neigungsmodul_I", 20);
                    break;
                case 34:
                    strncpy(CaplCtrl_SignalName, "VL1_PLA", 8);
                    break;
                case 35:
                    strncpy(CaplCtrl_SignalName, "VL1_PTC_Heizung", 16);
                    break;
                case 36:
                    strncpy(CaplCtrl_SignalName, "VL1_Quersperre", 15);
                    break;
                case 37:
                    strncpy(CaplCtrl_SignalName, "VL1_RDK", 8);
                    break;
                case 38:
                    strncpy(CaplCtrl_SignalName, "VL1_RKA_Plus", 13);
                    break;
                case 39:
                    strncpy(CaplCtrl_SignalName, "VL1_RSE_I", 10);
                    break;
                case 40:
                    strncpy(CaplCtrl_SignalName, "VL1_Radio", 10);
                    break;
                case 41:
                    strncpy(CaplCtrl_SignalName, "VL1_Rearview", 13);
                    break;
                case 42:
                    strncpy(CaplCtrl_SignalName, "VL1_SWA", 8);
                    break;
                case 43:
                    strncpy(CaplCtrl_SignalName, "VL1_Soll_eq_Ist", 16);
                    break;
                case 44:
                    strncpy(CaplCtrl_SignalName, "VL1_Sonderfzg_SG", 17);
                    break;
                case 45:
                    strncpy(CaplCtrl_SignalName, "VL1_Standheiz", 14);
                    break;
                case 46:
                    strncpy(CaplCtrl_SignalName, "VL1_TSG_BT", 11);
                    break;
                case 47:
                    strncpy(CaplCtrl_SignalName, "VL1_TSG_FT", 11);
                    break;
                case 48:
                    strncpy(CaplCtrl_SignalName, "VL1_TSG_HL", 11);
                    break;
                case 49:
                    strncpy(CaplCtrl_SignalName, "VL1_TSG_HR", 11);
                    break;
            }

            switch (SigIdx)
            {
                case 50:
                    strncpy(CaplCtrl_SignalName, "VL1_TV_Tuner", 13);
                    break;
                case 51:
                    strncpy(CaplCtrl_SignalName, "VL1_Tastenmodul", 16);
                    break;
                case 52:
                    strncpy(CaplCtrl_SignalName, "VL1_Telefon", 12);
                    break;
                case 53:
                    strncpy(CaplCtrl_SignalName, "VL1_Telematik", 14);
                    break;
                case 54:
                    strncpy(CaplCtrl_SignalName, "VL1_Verdeck", 12);
                    break;
                case 55:
                    strncpy(CaplCtrl_SignalName, "VL1_WFS_K", 10);
                    break;
                case 56:
                    strncpy(CaplCtrl_SignalName, "VL1_WFS_KBI", 12);
                    break;
                case 57:
                    strncpy(CaplCtrl_SignalName, "VL1_ZKE", 8);
                    break;
                case 58:
                    strncpy(CaplCtrl_SignalName, "VL1_Zentralelektrik_II", 23);
                    break;
                case 59:
                    strncpy(CaplCtrl_SignalName, "VL1_dyn_LWR", 12);
                    break;
                case 60:
                    strncpy(CaplCtrl_SignalName, "VL1_res_08", 11);
                    break;
                case 61:
                    strncpy(CaplCtrl_SignalName, "VL1_res_13", 11);
                    break;
                case 62:
                    strncpy(CaplCtrl_SignalName, "VL1_res_31", 11);
                    break;
                case 63:
                    strncpy(CaplCtrl_SignalName, "VL1_res_42", 11);
                    break;
            }
        }
        break;
        case FRM_HANDLE_Systeminfo_1:
        {
            switch (SigIdx)
            {
                case 0:
                    strncpy(CaplCtrl_SignalName, "SY1_Ant_HV", 11);
                    break;
                case 1:
                    strncpy(CaplCtrl_SignalName, "SY1_Ant_NV", 11);
                    break;
                case 2:
                    strncpy(CaplCtrl_SignalName, "SY1_CAN_Info", 13);
                    break;
                case 3:
                    strncpy(CaplCtrl_SignalName, "SY1_CAN_extern", 15);
                    break;
                case 4:
                    strncpy(CaplCtrl_SignalName, "SY1_Diag_Ant", 13);
                    break;
                case 5:
                    strncpy(CaplCtrl_SignalName, "SY1_Diag_Info", 14);
                    break;
                case 6:
                    strncpy(CaplCtrl_SignalName, "SY1_Diag_Komf", 14);
                    break;
                case 7:
                    strncpy(CaplCtrl_SignalName, "SY1_ELV_Lock_Supply", 20);
                    break;
                case 8:
                    strncpy(CaplCtrl_SignalName, "SY1_Fehlereintr", 16);
                    break;
                case 9:
                    strncpy(CaplCtrl_SignalName, "SY1_Fzg_Derivat", 16);
                    break;
                case 10:
                    strncpy(CaplCtrl_SignalName, "SY1_Fzg_Gen", 12);
                    break;
                case 11:
                    strncpy(CaplCtrl_SignalName, "SY1_Fzg_Index", 14);
                    break;
                case 12:
                    strncpy(CaplCtrl_SignalName, "SY1_Fzg_Klasse", 15);
                    break;
                case 13:
                    strncpy(CaplCtrl_SignalName, "SY1_Fzg_Marke", 14);
                    break;
                case 14:
                    strncpy(CaplCtrl_SignalName, "SY1_Komf_HV", 12);
                    break;
                case 15:
                    strncpy(CaplCtrl_SignalName, "SY1_Komf_NV", 12);
                    break;
                case 16:
                    strncpy(CaplCtrl_SignalName, "SY1_Lenker", 11);
                    break;
                case 17:
                    strncpy(CaplCtrl_SignalName, "SY1_NWDF", 9);
                    break;
                case 18:
                    strncpy(CaplCtrl_SignalName, "SY1_NWDF_gueltig", 17);
                    break;
                case 19:
                    strncpy(CaplCtrl_SignalName, "SY1_Notbrems_Status", 20);
                    break;
                case 20:
                    strncpy(CaplCtrl_SignalName, "SY1_QRS_Messmodus", 18);
                    break;
                case 21:
                    strncpy(CaplCtrl_SignalName, "SY1_Relais_FAS_Zweig", 21);
                    break;
                case 22:
                    strncpy(CaplCtrl_SignalName, "SY1_Sleep_Info", 15);
                    break;
                case 23:
                    strncpy(CaplCtrl_SignalName, "SY1_Sleep_Komf", 15);
                    break;
                case 24:
                    strncpy(CaplCtrl_SignalName, "SY1_Transportmode", 18);
                    break;
                case 25:
                    strncpy(CaplCtrl_SignalName, "SY1_Tueren", 11);
                    break;
                case 26:
                    strncpy(CaplCtrl_SignalName, "SY1_Verbauinfo", 15);
                    break;
                case 27:
                    strncpy(CaplCtrl_SignalName, "SY1_res52", 10);
                    break;
                case 28:
                    strncpy(CaplCtrl_SignalName, "SY1_res53", 10);
                    break;
                case 29:
                    strncpy(CaplCtrl_SignalName, "SY1_res54", 10);
                    break;
                case 30:
                    strncpy(CaplCtrl_SignalName, "SY1_res55", 10);
                    break;
                case 31:
                    strncpy(CaplCtrl_SignalName, "SY1_res57", 10);
                    break;
                case 32:
                    strncpy(CaplCtrl_SignalName, "SY1_res58", 10);
                    break;
                case 33:
                    strncpy(CaplCtrl_SignalName, "SY1_res59", 10);
                    break;
                case 34:
                    strncpy(CaplCtrl_SignalName, "SY1_res60", 10);
                    break;
                case 35:
                    strncpy(CaplCtrl_SignalName, "SY1_res61", 10);
                    break;
                case 36:
                    strncpy(CaplCtrl_SignalName, "SY1_res62", 10);
                    break;
                case 37:
                    strncpy(CaplCtrl_SignalName, "SY1_res63", 10);
                    break;
            }
        }
        break;
        case FRM_HANDLE_TOG:
        {
            switch (SigIdx)
            {
                case 0:
                    strncpy(CaplCtrl_SignalName, "TOG_Fuellstand_1", 17);
                    break;
                case 1:
                    strncpy(CaplCtrl_SignalName, "TOG_Fuellstand_2", 17);
                    break;
                case 2:
                    strncpy(CaplCtrl_SignalName, "TOG_Fuellstand_3", 17);
                    break;
                case 3:
                    strncpy(CaplCtrl_SignalName, "TOG_Fuellstand_4", 17);
                    break;
                case 4:
                    strncpy(CaplCtrl_SignalName, "TOG_OelmaxUeber", 16);
                    break;
                case 5:
                    strncpy(CaplCtrl_SignalName, "TOG_Oelmax_hoch", 16);
                    break;
                case 6:
                    strncpy(CaplCtrl_SignalName, "TOG_Oeltempzeit", 16);
                    break;
                case 7:
                    strncpy(CaplCtrl_SignalName, "TOG_OelwarnUeber", 17);
                    break;
                case 8:
                    strncpy(CaplCtrl_SignalName, "TOG_Oelwarn_hoch", 17);
                    break;
                case 9:
                    strncpy(CaplCtrl_SignalName, "TOG_Reserve1", 13);
                    break;
                case 10:
                    strncpy(CaplCtrl_SignalName, "TOG_Sensorfehler", 17);
                    break;
                case 11:
                    strncpy(CaplCtrl_SignalName, "TOG_Zaehler", 12);
                    break;
            }
        }
        break;
        case FRM_HANDLE_ZAS_1:
        {
            switch (SigIdx)
            {
                case 0:
                    strncpy(CaplCtrl_SignalName, "CHK_ZAS", 8);
                    break;
                case 1:
                    strncpy(CaplCtrl_SignalName, "ZA1_Klemme_15", 14);
                    break;
                case 2:
                    strncpy(CaplCtrl_SignalName, "ZA1_Klemme_50", 14);
                    break;
                case 3:
                    strncpy(CaplCtrl_SignalName, "ZA1_Klemme_P", 13);
                    break;
                case 4:
                    strncpy(CaplCtrl_SignalName, "ZA1_Klemme_SV", 14);
                    break;
                case 5:
                    strncpy(CaplCtrl_SignalName, "ZA1_Klemme_X", 13);
                    break;
                case 6:
                    strncpy(CaplCtrl_SignalName, "ZA1_Reserve1", 13);
                    break;
                case 7:
                    strncpy(CaplCtrl_SignalName, "ZA1_S_Kontakt", 14);
                    break;
                case 8:
                    strncpy(CaplCtrl_SignalName, "ZA1_res07", 10);
                    break;
                case 9:
                    strncpy(CaplCtrl_SignalName, "Zaehler_ZAS", 12);
                    break;
            }
        }
        break;
    }
}
/*@@end*/

/*@@caplFunc:Frm_SetSignal(long,long,long):*/
Frm_SetSignal (long FrmIdx, long SigIdx, long SigVal)
{
    switch (FrmIdx)
    {
        case FRM_HANDLE_ACC_1:
        {
            switch (SigIdx)
            {
                case 0:
                    MsgObj_ACC_1.AWV1_Freigabe = SigVal;
                    break;
                case 1:
                    MsgObj_ACC_1.AWV1_Parameter_HBA = SigVal;
                    break;
                case 2:
                    MsgObj_ACC_1.AWV1_Parameter_Nachtreten_HBA = SigVal;
                    break;
                case 3:
                    MsgObj_ACC_1.AWV1_Prefill = SigVal;
                    break;
                case 4:
                    MsgObj_ACC_1.AWV2_Freigabe = SigVal;
                    break;
                case 5:
                    MsgObj_ACC_1.AWV2_Priowarnung_LDW = SigVal;
                    break;
                case 6:
                    MsgObj_ACC_1.AWV2_Ruckprofil = SigVal;
                    break;
                case 7:
                    MsgObj_ACC_1.Anhalten = SigVal;
                    break;
                case 8:
                    MsgObj_ACC_1.BZ_ACC1 = SigVal;
                    break;
                case 9:
                    MsgObj_ACC_1.CHK_ACC1 = SigVal;
                    break;
                case 10:
                    MsgObj_ACC_1.Dynamik_Bremsdruck = SigVal;
                    break;
                case 11:
                    MsgObj_ACC_1.ESP_Beeinflussung_ACC = SigVal;
                    break;
                case 12:
                    MsgObj_ACC_1.FSPE_ACC = SigVal;
                    break;
                case 13:
                    MsgObj_ACC_1.Freigabe_Momenten_Anf = SigVal;
                    break;
                case 14:
                    MsgObj_ACC_1.Freigabe_Verzoeg_Anf = SigVal;
                    break;
                case 15:
                    MsgObj_ACC_1.Momenten_Anf_ACC = SigVal;
                    break;
                case 16:
                    MsgObj_ACC_1.Sender_Info = SigVal;
                    break;
                case 17:
                    MsgObj_ACC_1.Sollbeschl_Getr = SigVal;
                    break;
                case 18:
                    MsgObj_ACC_1.Status_ACC = SigVal;
                    break;
                case 19:
                    MsgObj_ACC_1.Verhinderung_SA = SigVal;
                    break;
                case 20:
                    MsgObj_ACC_1.Verzoeg_Anf_ACC = SigVal;
                    break;
                case 21:
                    MsgObj_ACC_1.Vorbefuellung_Bremsanlage = SigVal;
                    break;
            }
        }
        break;
        case FRM_HANDLE_ACC_System:
        {
            switch (SigIdx)
            {
                case 0:
                    MsgObj_ACC_System.ACS_ADR_Schub = SigVal;
                    break;
                case 1:
                    MsgObj_ACC_System.ACS_Anhaltewunsch = SigVal;
                    break;
                case 2:
                    MsgObj_ACC_System.ACS_Checksum = SigVal;
                    break;
                case 3:
                    MsgObj_ACC_System.ACS_Fehler = SigVal;
                    break;
                case 4:
                    MsgObj_ACC_System.ACS_FreigSollB = SigVal;
                    break;
                case 5:
                    MsgObj_ACC_System.ACS_MomEingriff = SigVal;
                    break;
                case 6:
                    MsgObj_ACC_System.ACS_Schubabsch = SigVal;
                    break;
                case 7:
                    MsgObj_ACC_System.ACS_Sollbeschl = SigVal;
                    break;
                case 8:
                    MsgObj_ACC_System.ACS_StSt_Info = SigVal;
                    break;
                case 9:
                    MsgObj_ACC_System.ACS_Sta_ADR = SigVal;
                    break;
                case 10:
                    MsgObj_ACC_System.ACS_Typ_ACC = SigVal;
                    break;
                case 11:
                    MsgObj_ACC_System.ACS_Zaehler = SigVal;
                    break;
                case 12:
                    MsgObj_ACC_System.ACS_max_AendGrad = SigVal;
                    break;
                case 13:
                    MsgObj_ACC_System.ACS_res_21 = SigVal;
                    break;
                case 14:
                    MsgObj_ACC_System.ACS_res_35 = SigVal;
                    break;
                case 15:
                    MsgObj_ACC_System.ACS_res_36 = SigVal;
                    break;
                case 16:
                    MsgObj_ACC_System.ACS_res_37 = SigVal;
                    break;
                case 17:
                    MsgObj_ACC_System.ACS_res_56 = SigVal;
                    break;
                case 18:
                    MsgObj_ACC_System.ACS_res_57 = SigVal;
                    break;
                case 19:
                    MsgObj_ACC_System.ACS_res_58 = SigVal;
                    break;
                case 20:
                    MsgObj_ACC_System.ACS_res_59 = SigVal;
                    break;
                case 21:
                    MsgObj_ACC_System.ACS_res_60 = SigVal;
                    break;
                case 22:
                    MsgObj_ACC_System.ACS_res_61 = SigVal;
                    break;
                case 23:
                    MsgObj_ACC_System.ACS_res_62 = SigVal;
                    break;
                case 24:
                    MsgObj_ACC_System.ACS_res_63 = SigVal;
                    break;
                case 25:
                    MsgObj_ACC_System.ACS_zul_Regelabw = SigVal;
                    break;
            }
        }
        break;
        case FRM_HANDLE_Airbag_1:
        {
            switch (SigIdx)
            {
                case 0:
                    MsgObj_Airbag_1.AB1_BF_Warnung = SigVal;
                    break;
                case 1:
                    MsgObj_Airbag_1.AB1_Beifahrer = SigVal;
                    break;
                case 2:
                    MsgObj_Airbag_1.AB1_Bf_Seite = SigVal;
                    break;
                case 3:
                    MsgObj_Airbag_1.AB1_Checksumme = SigVal;
                    break;
                case 4:
                    MsgObj_Airbag_1.AB1_Diagnose = SigVal;
                    break;
                case 5:
                    MsgObj_Airbag_1.AB1_Fa_Seite = SigVal;
                    break;
                case 6:
                    MsgObj_Airbag_1.AB1_Fehlereintr = SigVal;
                    break;
                case 7:
                    MsgObj_Airbag_1.AB1_Front = SigVal;
                    break;
                case 8:
                    MsgObj_Airbag_1.AB1_Gurt_Bf = SigVal;
                    break;
                case 9:
                    MsgObj_Airbag_1.AB1_Gurt_Fa = SigVal;
                    break;
                case 10:
                    MsgObj_Airbag_1.AB1_Heck = SigVal;
                    break;
                case 11:
                    MsgObj_Airbag_1.AB1_Intens = SigVal;
                    break;
                case 12:
                    MsgObj_Airbag_1.AB1_Lampe = SigVal;
                    break;
                case 13:
                    MsgObj_Airbag_1.AB1_Rollover = SigVal;
                    break;
                case 14:
                    MsgObj_Airbag_1.AB1_Status = SigVal;
                    break;
                case 15:
                    MsgObj_Airbag_1.AB1_Stellglied = SigVal;
                    break;
                case 16:
                    MsgObj_Airbag_1.AB1_System = SigVal;
                    break;
                case 17:
                    MsgObj_Airbag_1.AB1_Zaehler = SigVal;
                    break;
            }
        }
        break;
        case FRM_HANDLE_Allrad_1:
        {
            switch (SigIdx)
            {
                case 0:
                    MsgObj_Allrad_1.AL1_AnfVerteiler = SigVal;
                    break;
                case 1:
                    MsgObj_Allrad_1.AL1_Anz_blinken = SigVal;
                    break;
                case 2:
                    MsgObj_Allrad_1.AL1_Begrenzungsmo = SigVal;
                    break;
                case 3:
                    MsgObj_Allrad_1.AL1_Diff_Gong = SigVal;
                    break;
                case 4:
                    MsgObj_Allrad_1.AL1_Diff_Lampe = SigVal;
                    break;
                case 5:
                    MsgObj_Allrad_1.AL1_Diff_Verbau = SigVal;
                    break;
                case 6:
                    MsgObj_Allrad_1.AL1_Einheit = SigVal;
                    break;
                case 7:
                    MsgObj_Allrad_1.AL1_FaWu_HA = SigVal;
                    break;
                case 8:
                    MsgObj_Allrad_1.AL1_FaWu_Laengs = SigVal;
                    break;
                case 9:
                    MsgObj_Allrad_1.AL1_FaWu_VA = SigVal;
                    break;
                case 10:
                    MsgObj_Allrad_1.AL1_Fehler = SigVal;
                    break;
                case 11:
                    MsgObj_Allrad_1.AL1_Fehlereintr = SigVal;
                    break;
                case 12:
                    MsgObj_Allrad_1.AL1_Einheit = 0;
                    MsgObj_Allrad_1.AL1_Ist_Nm = SigVal;
                    break;
                case 13:
                    MsgObj_Allrad_1.AL1_Einheit = 1;
                    MsgObj_Allrad_1.AL1_Ist_Proz = SigVal;
                    break;
                case 14:
                    MsgObj_Allrad_1.AL1_KupSteifig_F = SigVal;
                    break;
                case 15:
                    MsgObj_Allrad_1.AL1_Kup_offen = SigVal;
                    break;
                case 16:
                    MsgObj_Allrad_1.AL1_Limit_maxkmh = SigVal;
                    break;
                case 17:
                    MsgObj_Allrad_1.AL1_Limiter = SigVal;
                    break;
                case 18:
                    MsgObj_Allrad_1.AL1_Notlauf = SigVal;
                    break;
                case 19:
                    MsgObj_Allrad_1.AL1_Quersp_Sta = SigVal;
                    break;
                case 20:
                    MsgObj_Allrad_1.AL1_Reserve2 = SigVal;
                    break;
                case 21:
                    MsgObj_Allrad_1.AL1_Schalten = SigVal;
                    break;
                case 22:
                    MsgObj_Allrad_1.AL1_Sta_Kup = SigVal;
                    break;
                case 23:
                    MsgObj_Allrad_1.AL1_Sta_Laengssp = SigVal;
                    break;
                case 24:
                    MsgObj_Allrad_1.AL1_Sta_PNG = SigVal;
                    break;
                case 25:
                    MsgObj_Allrad_1.AL1_Sta_Quersp = SigVal;
                    break;
                case 26:
                    MsgObj_Allrad_1.AL1_Sta_VA = SigVal;
                    break;
                case 27:
                    MsgObj_Allrad_1.AL1_Stellung_Getr = SigVal;
                    break;
                case 28:
                    MsgObj_Allrad_1.AL1_Uebertemp = SigVal;
                    break;
                case 29:
                    MsgObj_Allrad_1.AL1_Vorwarnung = SigVal;
                    break;
                case 30:
                    MsgObj_Allrad_1.AL1_Warnlampe = SigVal;
                    break;
                case 31:
                    MsgObj_Allrad_1.AL1_Zaehler = SigVal;
                    break;
            }
        }
        break;
        case FRM_HANDLE_BEM_1:
        {
            switch (SigIdx)
            {
                case 0:
                    MsgObj_BEM_1.Abschalt_Heizsysteme = SigVal;
                    break;
                case 1:
                    MsgObj_BEM_1.Abschaltstufen = SigVal;
                    break;
                case 2:
                    MsgObj_BEM_1.Anforderung_HSH = SigVal;
                    break;
                case 3:
                    MsgObj_BEM_1.Anforderung_Kluefter_ = SigVal;
                    break;
                case 4:
                    MsgObj_BEM_1.BEM_Batteriespannung = SigVal;
                    break;
                case 5:
                    MsgObj_BEM_1.BEM_StSt_Info = SigVal;
                    break;
                case 6:
                    MsgObj_BEM_1.BZ_BEM1 = SigVal;
                    break;
                case 7:
                    MsgObj_BEM_1.CHK_BEM1 = SigVal;
                    break;
                case 8:
                    MsgObj_BEM_1.Einschaltung_PTC_Hzg = SigVal;
                    break;
                case 9:
                    MsgObj_BEM_1.Generator_Lastmoment = SigVal;
                    break;
                case 10:
                    MsgObj_BEM_1.Generator_Leistungsaufnahme = SigVal;
                    break;
                case 11:
                    MsgObj_BEM_1.HL_Systeme_Status = SigVal;
                    break;
                case 12:
                    MsgObj_BEM_1.HL_Systemregelung_Status = SigVal;
                    break;
                case 13:
                    MsgObj_BEM_1.Lastabwurf_Rueckmeldung = SigVal;
                    break;
                case 14:
                    MsgObj_BEM_1.Leerlaufdrehzahl_Erhoehung = SigVal;
                    break;
                case 15:
                    MsgObj_BEM_1.Load_Response_Generator = SigVal;
                    break;
                case 16:
                    MsgObj_BEM_1.Red_Innenraumgeblaese = SigVal;
                    break;
                case 17:
                    MsgObj_BEM_1.Ruecknahme_HSH = SigVal;
                    break;
            }
        }
        break;
        case FRM_HANDLE_BSG_Last:
        {
            switch (SigIdx)
            {
                case 0:
                    MsgObj_BSG_Last.BSL_Ab_Batterie = SigVal;
                    break;
                case 1:
                    MsgObj_BSG_Last.BSL_Aussensp = SigVal;
                    break;
                case 2:
                    MsgObj_BSG_Last.BSL_BSG_2_alt = SigVal;
                    break;
                case 3:
                    MsgObj_BSG_Last.BSL_BSG_3_alt = SigVal;
                    break;
                case 4:
                    MsgObj_BSG_Last.BSL_Clima = SigVal;
                    break;
                case 5:
                    MsgObj_BSG_Last.BSL_DFM = SigVal;
                    break;
                case 6:
                    MsgObj_BSG_Last.BSL_Fehlereintr = SigVal;
                    break;
                case 7:
                    MsgObj_BSG_Last.BSL_Frontsch = SigVal;
                    break;
                case 8:
                    MsgObj_BSG_Last.BSL_Hecksch = SigVal;
                    break;
                case 9:
                    MsgObj_BSG_Last.BSL_Kl_15_Motor = SigVal;
                    break;
                case 10:
                    MsgObj_BSG_Last.BSL_Kl_L = SigVal;
                    break;
                case 11:
                    MsgObj_BSG_Last.BSL_Kuehlerlueft = SigVal;
                    break;
                case 12:
                    MsgObj_BSG_Last.BSL_LL_Anheb = SigVal;
                    break;
                case 13:
                    MsgObj_BSG_Last.BSL_LL_Anheb2 = SigVal;
                    break;
                case 14:
                    MsgObj_BSG_Last.BSL_Lenkradheiz = SigVal;
                    break;
                case 15:
                    MsgObj_BSG_Last.BSL_Motor_Haube = SigVal;
                    break;
                case 16:
                    MsgObj_BSG_Last.BSL_Parklicht = SigVal;
                    break;
                case 17:
                    MsgObj_BSG_Last.BSL_Sitzbelueft = SigVal;
                    break;
                case 18:
                    MsgObj_BSG_Last.BSL_Sitzheiz = SigVal;
                    break;
                case 19:
                    MsgObj_BSG_Last.BSL_Sta_LWR = SigVal;
                    break;
                case 20:
                    MsgObj_BSG_Last.BSL_Sta_StBat = SigVal;
                    break;
                case 21:
                    MsgObj_BSG_Last.BSL_Sta_UBat = SigVal;
                    break;
                case 22:
                    MsgObj_BSG_Last.BSL_Starterlaubnis = SigVal;
                    break;
                case 23:
                    MsgObj_BSG_Last.BSL_UBat = SigVal;
                    break;
                case 24:
                    MsgObj_BSG_Last.BSL_Wake_Up_ACAN = SigVal;
                    break;
                case 25:
                    MsgObj_BSG_Last.BSL_Wasserheiz = SigVal;
                    break;
                case 26:
                    MsgObj_BSG_Last.BSL_Weckursache_ACAN = SigVal;
                    break;
                case 27:
                    MsgObj_BSG_Last.BSL_ZAS_Kl_15 = SigVal;
                    break;
                case 28:
                    MsgObj_BSG_Last.BSL_ZAS_Kl_50 = SigVal;
                    break;
                case 29:
                    MsgObj_BSG_Last.BSL_ZAS_Kl_S = SigVal;
                    break;
                case 30:
                    MsgObj_BSG_Last.BSL_ZAS_Kl_X = SigVal;
                    break;
            }
        }
        break;
        case FRM_HANDLE_Batman_1:
        {
            switch (SigIdx)
            {
                case 0:
                    MsgObj_Batman_1.BEM_EM_LIN_ungueltig = SigVal;
                    break;
                case 1:
                    MsgObj_Batman_1.BEM_P_Generator = SigVal;
                    break;
                case 2:
                    MsgObj_Batman_1.BM1_BEM_Reku_Aktiv = SigVal;
                    break;
                case 3:
                    MsgObj_Batman_1.BM1_DFM = SigVal;
                    break;
                case 4:
                    MsgObj_Batman_1.BM1_Fehlereintr = SigVal;
                    break;
                case 5:
                    MsgObj_Batman_1.BM1_Mess_Leitung = SigVal;
                    break;
                case 6:
                    MsgObj_Batman_1.BM1_Relais = SigVal;
                    break;
                case 7:
                    MsgObj_Batman_1.BM1_Sta_Leitung = SigVal;
                    break;
                case 8:
                    MsgObj_Batman_1.BM1_Sta_Relais = SigVal;
                    break;
                case 9:
                    MsgObj_Batman_1.BM1_Sta_StBat = SigVal;
                    break;
                case 10:
                    MsgObj_Batman_1.BM1_Startmodus = SigVal;
                    break;
            }
        }
        break;
        case FRM_HANDLE_Booster_1:
        {
            switch (SigIdx)
            {
                case 0:
                    MsgObj_Booster_1.BO1_AWV2_Bremsruck = SigVal;
                    break;
                case 1:
                    MsgObj_Booster_1.BO1_AWV2_Fehler = SigVal;
                    break;
                case 2:
                    MsgObj_Booster_1.BO1_Anf_EPB_Span = SigVal;
                    break;
                case 3:
                    MsgObj_Booster_1.BO1_Anf_EPB_aus = SigVal;
                    break;
                case 4:
                    MsgObj_Booster_1.BO1_Anf_EPB_ein = SigVal;
                    break;
                case 5:
                    MsgObj_Booster_1.BO1_Checksumme = SigVal;
                    break;
                case 6:
                    MsgObj_Booster_1.BO1_Fa_bremst = SigVal;
                    break;
                case 7:
                    MsgObj_Booster_1.BO1_Freigabe_EPB = SigVal;
                    break;
                case 8:
                    MsgObj_Booster_1.BO1_KD_Fehler = SigVal;
                    break;
                case 9:
                    MsgObj_Booster_1.BO1_Laengsbeschl = SigVal;
                    break;
                case 10:
                    MsgObj_Booster_1.BO1_StaBrSyst = SigVal;
                    break;
                case 11:
                    MsgObj_Booster_1.BO1_Sta_ACC_Anf = SigVal;
                    break;
                case 12:
                    MsgObj_Booster_1.BO1_Sta_ADR_BR = SigVal;
                    break;
                case 13:
                    MsgObj_Booster_1.BO1_Sta_BLS = SigVal;
                    break;
                case 14:
                    MsgObj_Booster_1.BO1_Sta_Br_Druck = SigVal;
                    break;
                case 15:
                    MsgObj_Booster_1.BO1_Sta_VerzReg = SigVal;
                    break;
                case 16:
                    MsgObj_Booster_1.BO1_Verz_EPB_akt = SigVal;
                    break;
                case 17:
                    MsgObj_Booster_1.BO1_Zaehler = SigVal;
                    break;
                case 18:
                    MsgObj_Booster_1.BO1_aktBrSyst = SigVal;
                    break;
                case 19:
                    MsgObj_Booster_1.BO1_res_14 = SigVal;
                    break;
                case 20:
                    MsgObj_Booster_1.BO1_res_16 = SigVal;
                    break;
                case 21:
                    MsgObj_Booster_1.BO1_res_17 = SigVal;
                    break;
                case 22:
                    MsgObj_Booster_1.BO1_res_22 = SigVal;
                    break;
                case 23:
                    MsgObj_Booster_1.BO1_res_25 = SigVal;
                    break;
                case 24:
                    MsgObj_Booster_1.BO1_res_27 = SigVal;
                    break;
                case 25:
                    MsgObj_Booster_1.BO1_res_28 = SigVal;
                    break;
                case 26:
                    MsgObj_Booster_1.BO1_res_29 = SigVal;
                    break;
                case 27:
                    MsgObj_Booster_1.BO1_res_30 = SigVal;
                    break;
                case 28:
                    MsgObj_Booster_1.BO1_res_31 = SigVal;
                    break;
                case 29:
                    MsgObj_Booster_1.BO1_res_32 = SigVal;
                    break;
                case 30:
                    MsgObj_Booster_1.BO1_res_41 = SigVal;
                    break;
                case 31:
                    MsgObj_Booster_1.BO1_res_42 = SigVal;
                    break;
                case 32:
                    MsgObj_Booster_1.BO1_res_43 = SigVal;
                    break;
                case 33:
                    MsgObj_Booster_1.BO1_res_44 = SigVal;
                    break;
                case 34:
                    MsgObj_Booster_1.BO1_res_59 = SigVal;
                    break;
                case 35:
                    MsgObj_Booster_1.BO1_res_62 = SigVal;
                    break;
                case 36:
                    MsgObj_Booster_1.BO1_res_63 = SigVal;
                    break;
            }
        }
        break;
        case FRM_HANDLE_Bremse_1:
        {
            switch (SigIdx)
            {
                case 0:
                    MsgObj_Bremse_1.BR1_ABS_Brems = SigVal;
                    break;
                case 1:
                    MsgObj_Bremse_1.BR1_MSR_Anf = 0;
                    MsgObj_Bremse_1.BR1_ASRMo_fa = SigVal;
                    break;
                case 2:
                    MsgObj_Bremse_1.BR1_ASRMo_sl = SigVal;
                    break;
                case 3:
                    MsgObj_Bremse_1.BR1_ASR_Anf = SigVal;
                    break;
                case 4:
                    MsgObj_Bremse_1.BR1_ASR_ESP = SigVal;
                    break;
                case 5:
                    MsgObj_Bremse_1.BR1_ASR_Eingr = SigVal;
                    break;
                case 6:
                    MsgObj_Bremse_1.BR1_BKV_aktiv = SigVal;
                    break;
                case 7:
                    MsgObj_Bremse_1.BR1_Diagnose = SigVal;
                    break;
                case 8:
                    MsgObj_Bremse_1.BR1_EBV_Eingr = SigVal;
                    break;
                case 9:
                    MsgObj_Bremse_1.BR1_EDS_Eingr = SigVal;
                    break;
                case 10:
                    MsgObj_Bremse_1.BR1_ESPASR_passiv = SigVal;
                    break;
                case 11:
                    MsgObj_Bremse_1.BR1_ESP_Eingr = SigVal;
                    break;
                case 12:
                    MsgObj_Bremse_1.BR1_Ersatz_Kmh = SigVal;
                    break;
                case 13:
                    MsgObj_Bremse_1.BR1_Lampe_ABS = SigVal;
                    break;
                case 14:
                    MsgObj_Bremse_1.BR1_Lampe_ASR = SigVal;
                    break;
                case 15:
                    MsgObj_Bremse_1.BR1_Lampe_BK = SigVal;
                    break;
                case 16:
                    MsgObj_Bremse_1.BR1_Lichtschalt = SigVal;
                    break;
                case 17:
                    MsgObj_Bremse_1.BR1_MAD = SigVal;
                    break;
                case 18:
                    MsgObj_Bremse_1.BR1_MSR_Anf = SigVal;
                    break;
                case 19:
                    MsgObj_Bremse_1.BR1_MSR_Mo = SigVal;
                    break;
                case 20:
                    MsgObj_Bremse_1.BR1_MSR_Anf = 1;
                    MsgObj_Bremse_1.BR1_MSR_Mo_inv = SigVal;
                    break;
                case 21:
                    MsgObj_Bremse_1.BR1_Rad_kmh = SigVal;
                    break;
                case 22:
                    MsgObj_Bremse_1.BR1_StaDruckschw = SigVal;
                    break;
                case 23:
                    MsgObj_Bremse_1.BR1_Sta_ESP = SigVal;
                    break;
                case 24:
                    MsgObj_Bremse_1.BR1_Sta_MAD = SigVal;
                    break;
                case 25:
                    MsgObj_Bremse_1.BR1_Zaehler = SigVal;
                    break;
            }
        }
        break;
        case FRM_HANDLE_Bremse_10:
        {
            switch (SigIdx)
            {
                case 0:
                    MsgObj_Bremse_10.B10_Checksumme = SigVal;
                    break;
                case 1:
                    MsgObj_Bremse_10.B10_Fahrtr_HL = SigVal;
                    break;
                case 2:
                    MsgObj_Bremse_10.B10_Fahrtr_HR = SigVal;
                    break;
                case 3:
                    MsgObj_Bremse_10.B10_Fahrtr_VL = SigVal;
                    break;
                case 4:
                    MsgObj_Bremse_10.B10_Fahrtr_VR = SigVal;
                    break;
                case 5:
                    MsgObj_Bremse_10.B10_QB_Fahrtr_HL = SigVal;
                    break;
                case 6:
                    MsgObj_Bremse_10.B10_QB_Fahrtr_HR = SigVal;
                    break;
                case 7:
                    MsgObj_Bremse_10.B10_QB_Fahrtr_VL = SigVal;
                    break;
                case 8:
                    MsgObj_Bremse_10.B10_QB_Fahrtr_VR = SigVal;
                    break;
                case 9:
                    MsgObj_Bremse_10.B10_QB_Wegimp_HL = SigVal;
                    break;
                case 10:
                    MsgObj_Bremse_10.B10_QB_Wegimp_HR = SigVal;
                    break;
                case 11:
                    MsgObj_Bremse_10.B10_QB_Wegimp_VL = SigVal;
                    break;
                case 12:
                    MsgObj_Bremse_10.B10_QB_Wegimp_VR = SigVal;
                    break;
                case 13:
                    MsgObj_Bremse_10.B10_Wegimp_HL = SigVal;
                    break;
                case 14:
                    MsgObj_Bremse_10.B10_Wegimp_HR = SigVal;
                    break;
                case 15:
                    MsgObj_Bremse_10.B10_Wegimp_VL = SigVal;
                    break;
                case 16:
                    MsgObj_Bremse_10.B10_Wegimp_VR = SigVal;
                    break;
                case 17:
                    MsgObj_Bremse_10.B10_Zaehler = SigVal;
                    break;
            }
        }
        break;
        case FRM_HANDLE_Bremse_11:
        {
            switch (SigIdx)
            {
                case 0:
                    MsgObj_Bremse_11.B11_Br_StSt_Info = SigVal;
                    break;
                case 1:
                    MsgObj_Bremse_11.B11_EPB_Steller_akt = SigVal;
                    break;
                case 2:
                    MsgObj_Bremse_11.B11_EPB_Steller_gue = SigVal;
                    break;
                case 3:
                    MsgObj_Bremse_11.B11_HydHalten = SigVal;
                    break;
                case 4:
                    MsgObj_Bremse_11.B11_OBD_Nib_HL = SigVal;
                    break;
                case 5:
                    MsgObj_Bremse_11.B11_OBD_Nib_HR = SigVal;
                    break;
                case 6:
                    MsgObj_Bremse_11.B11_OBD_Nib_VL = SigVal;
                    break;
                case 7:
                    MsgObj_Bremse_11.B11_OBD_Nib_VR = SigVal;
                    break;
                case 8:
                    MsgObj_Bremse_11.BR11_Checksumme = SigVal;
                    break;
                case 9:
                    MsgObj_Bremse_11.BR11_Zaehler = SigVal;
                    break;
            }
        }
        break;
        case FRM_HANDLE_Bremse_2:
        {
            switch (SigIdx)
            {
                case 0:
                    MsgObj_Bremse_2.BR2_Aku_Warn = SigVal;
                    break;
                case 1:
                    MsgObj_Bremse_2.BR2_Blinkmode = SigVal;
                    break;
                case 2:
                    MsgObj_Bremse_2.BR2_Fehlereintr = SigVal;
                    break;
                case 3:
                    MsgObj_Bremse_2.BR2_HDC_aktiv = SigVal;
                    break;
                case 4:
                    MsgObj_Bremse_2.BR2_Impulszahl = SigVal;
                    break;
                case 5:
                    MsgObj_Bremse_2.BR2_LampeHDC = SigVal;
                    break;
                case 6:
                    MsgObj_Bremse_2.BR2_Lampe_ABS = SigVal;
                    break;
                case 7:
                    MsgObj_Bremse_2.BR2_Lampe_ASR = SigVal;
                    break;
                case 8:
                    MsgObj_Bremse_2.BR2_Lampe_BK = SigVal;
                    break;
                case 9:
                    MsgObj_Bremse_2.BR2_Lampe_RKA = SigVal;
                    break;
                case 10:
                    MsgObj_Bremse_2.BR2_Querb_Zahn = 0;
                    MsgObj_Bremse_2.BR2_QB_Querbeschl = SigVal;
                    break;
                case 11:
                    MsgObj_Bremse_2.BR2_Querb_Zahn = SigVal;
                    break;
                case 12:
                    MsgObj_Bremse_2.BR2_Querb_Zahn = 0;
                    MsgObj_Bremse_2.BR2_Querbeschl = SigVal;
                    break;
                case 13:
                    MsgObj_Bremse_2.BR2_SleepInd = SigVal;
                    break;
                case 14:
                    MsgObj_Bremse_2.BR2_Sta_Imp = SigVal;
                    break;
                case 15:
                    MsgObj_Bremse_2.BR2_Sta_Quer = SigVal;
                    break;
                case 16:
                    MsgObj_Bremse_2.BR2_Text = SigVal;
                    break;
                case 17:
                    MsgObj_Bremse_2.BR2_Ueberl_Imp = SigVal;
                    break;
                case 18:
                    MsgObj_Bremse_2.BR2_Wegimpulse = SigVal;
                    break;
                case 19:
                    MsgObj_Bremse_2.BR2_Zaehler = SigVal;
                    break;
                case 20:
                    MsgObj_Bremse_2.BR2_Querb_Zahn = 1;
                    MsgObj_Bremse_2.BR2_Zahnzahl = SigVal;
                    break;
                case 21:
                    MsgObj_Bremse_2.BR2_mi_Radgeschw = SigVal;
                    break;
            }
        }
        break;
        case FRM_HANDLE_Bremse_3:
        {
            switch (SigIdx)
            {
                case 0:
                    MsgObj_Bremse_3.BR3_Fahrtr_HL = SigVal;
                    break;
                case 1:
                    MsgObj_Bremse_3.BR3_Fahrtr_HR = SigVal;
                    break;
                case 2:
                    MsgObj_Bremse_3.BR3_Fahrtr_VL = SigVal;
                    break;
                case 3:
                    MsgObj_Bremse_3.BR3_Fahrtr_VR = SigVal;
                    break;
                case 4:
                    MsgObj_Bremse_3.BR3_Rad_kmh_HL = SigVal;
                    break;
                case 5:
                    MsgObj_Bremse_3.BR3_Rad_kmh_HR = SigVal;
                    break;
                case 6:
                    MsgObj_Bremse_3.BR3_Rad_kmh_VL = SigVal;
                    break;
                case 7:
                    MsgObj_Bremse_3.BR3_Rad_kmh_VR = SigVal;
                    break;
            }
        }
        break;
        case FRM_HANDLE_Bremse_4:
        {
            switch (SigIdx)
            {
                case 0:
                    MsgObj_Bremse_4.BR4_Abschaltung_HL = SigVal;
                    break;
                case 1:
                    MsgObj_Bremse_4.BR4_Abschaltung_HR = SigVal;
                    break;
                case 2:
                    MsgObj_Bremse_4.BR4_Abschaltung_VL = SigVal;
                    break;
                case 3:
                    MsgObj_Bremse_4.BR4_Abschaltung_VR = SigVal;
                    break;
                case 4:
                    MsgObj_Bremse_4.BR4_Checksum = SigVal;
                    break;
                case 5:
                    MsgObj_Bremse_4.BR4_Einheit = SigVal;
                    break;
                case 6:
                    MsgObj_Bremse_4.BR4_Lampe_RKA = SigVal;
                    break;
                case 7:
                    MsgObj_Bremse_4.BR4_Reserve2 = SigVal;
                    break;
                case 8:
                    MsgObj_Bremse_4.BR4_Schwelle = SigVal;
                    break;
                case 9:
                    MsgObj_Bremse_4.BR4_Status_ESP = SigVal;
                    break;
                case 10:
                    MsgObj_Bremse_4.BR4_Summer_RKA = SigVal;
                    break;
                case 11:
                    MsgObj_Bremse_4.BR4_Unterdruck = SigVal;
                    break;
                case 12:
                    MsgObj_Bremse_4.BR4_Einheit = 1;
                    MsgObj_Bremse_4.BR4_Vorgabe_Hi = SigVal;
                    break;
                case 13:
                    MsgObj_Bremse_4.BR4_Einheit = 2;
                    MsgObj_Bremse_4.BR4_Vorgabe_Max = SigVal;
                    break;
                case 14:
                    MsgObj_Bremse_4.BR4_Einheit = 1;
                    MsgObj_Bremse_4.BR4_Vorgabe_Mi = SigVal;
                    break;
                case 15:
                    MsgObj_Bremse_4.BR4_Einheit = 0;
                    MsgObj_Bremse_4.BR4_Vorgabe_Mi_ = SigVal;
                    break;
                case 16:
                    MsgObj_Bremse_4.BR4_Einheit = 2;
                    MsgObj_Bremse_4.BR4_Vorgabe_Min = SigVal;
                    break;
                case 17:
                    MsgObj_Bremse_4.BR4_Zaehler = SigVal;
                    break;
                case 18:
                    MsgObj_Bremse_4.BR4_res_42 = SigVal;
                    break;
                case 19:
                    MsgObj_Bremse_4.BR4_res_48 = SigVal;
                    break;
            }
        }
        break;
        case FRM_HANDLE_Bremse_5:
        {
            switch (SigIdx)
            {
                case 0:
                    MsgObj_Bremse_5.Anfahrhilfe_aktiv = SigVal;
                    break;
                case 1:
                    MsgObj_Bremse_5.BR5_AWV2_Bremsruck = SigVal;
                    break;
                case 2:
                    MsgObj_Bremse_5.BR5_AWV2_Fehler = SigVal;
                    break;
                case 3:
                    MsgObj_Bremse_5.BR5_AnhStabAktiv = SigVal;
                    break;
                case 4:
                    MsgObj_Bremse_5.BR5_Anhi_Sta = SigVal;
                    break;
                case 5:
                    MsgObj_Bremse_5.BR5_Anhi_akt = SigVal;
                    break;
                case 6:
                    MsgObj_Bremse_5.BR5_Bremsdruck = SigVal;
                    break;
                case 7:
                    MsgObj_Bremse_5.BR5_Checksumme = SigVal;
                    break;
                case 8:
                    MsgObj_Bremse_5.BR5_Druckgueltig = SigVal;
                    break;
                case 9:
                    MsgObj_Bremse_5.BR5_ECD_Lampe = SigVal;
                    break;
                case 10:
                    MsgObj_Bremse_5.BR5_ECD_Rueckfall = SigVal;
                    break;
                case 11:
                    MsgObj_Bremse_5.BR5_Giergeschw = SigVal;
                    break;
                case 12:
                    MsgObj_Bremse_5.BR5_Notbremsung = SigVal;
                    break;
                case 13:
                    MsgObj_Bremse_5.BR5_Sign_Druck = SigVal;
                    break;
                case 14:
                    MsgObj_Bremse_5.BR5_Sta_Druck = SigVal;
                    break;
                case 15:
                    MsgObj_Bremse_5.BR5_Sta_Gierrate = SigVal;
                    break;
                case 16:
                    MsgObj_Bremse_5.BR5_Stillstand = SigVal;
                    break;
                case 17:
                    MsgObj_Bremse_5.BR5_Temperatur = SigVal;
                    break;
                case 18:
                    MsgObj_Bremse_5.BR5_TolAbgl_VR = SigVal;
                    break;
                case 19:
                    MsgObj_Bremse_5.BR5_Vorzeichen = SigVal;
                    break;
                case 20:
                    MsgObj_Bremse_5.BR5_Zaehler = SigVal;
                    break;
                case 21:
                    MsgObj_Bremse_5.BR5_v_Ueberw = SigVal;
                    break;
                case 22:
                    MsgObj_Bremse_5.FStatus_Anfahrhilfe = SigVal;
                    break;
            }
        }
        break;
        case FRM_HANDLE_Bremse_8:
        {
            switch (SigIdx)
            {
                case 0:
                    MsgObj_Bremse_8.BR8_AWV1_BasPar = SigVal;
                    break;
                case 1:
                    MsgObj_Bremse_8.BR8_Check_EPB = SigVal;
                    break;
                case 2:
                    MsgObj_Bremse_8.BR8_Checksumme = SigVal;
                    break;
                case 3:
                    MsgObj_Bremse_8.BR8_Fa_bremst = SigVal;
                    break;
                case 4:
                    MsgObj_Bremse_8.BR8_Istbeschl = SigVal;
                    break;
                case 5:
                    MsgObj_Bremse_8.BR8_Laengsbeschl = SigVal;
                    break;
                case 6:
                    MsgObj_Bremse_8.BR8_QB_LBeschl = SigVal;
                    break;
                case 7:
                    MsgObj_Bremse_8.BR8_Quattro = SigVal;
                    break;
                case 8:
                    MsgObj_Bremse_8.BR8_StaBrSyst = SigVal;
                    break;
                case 9:
                    MsgObj_Bremse_8.BR8_Sta_ACC_Anf = SigVal;
                    break;
                case 10:
                    MsgObj_Bremse_8.BR8_Sta_ADR_BR = SigVal;
                    break;
                case 11:
                    MsgObj_Bremse_8.BR8_Sta_BLS = SigVal;
                    break;
                case 12:
                    MsgObj_Bremse_8.BR8_Sta_Br_Druck = SigVal;
                    break;
                case 13:
                    MsgObj_Bremse_8.BR8_Sta_Br_temp = SigVal;
                    break;
                case 14:
                    MsgObj_Bremse_8.BR8_Sta_HW_BLS = SigVal;
                    break;
                case 15:
                    MsgObj_Bremse_8.BR8_Sta_VerzReg = SigVal;
                    break;
                case 16:
                    MsgObj_Bremse_8.BR8_TolAbgl_HL = SigVal;
                    break;
                case 17:
                    MsgObj_Bremse_8.BR8_TolAbgl_HR = SigVal;
                    break;
                case 18:
                    MsgObj_Bremse_8.BR8_Verz_EPB = SigVal;
                    break;
                case 19:
                    MsgObj_Bremse_8.BR8_Verz_EPB_akt = SigVal;
                    break;
                case 20:
                    MsgObj_Bremse_8.BR8_Zaehler = SigVal;
                    break;
                case 21:
                    MsgObj_Bremse_8.BR8_aktBrSyst = SigVal;
                    break;
            }
        }
        break;
        case FRM_HANDLE_Clima_1:
        {
            switch (SigIdx)
            {
                case 0:
                    MsgObj_Clima_1.CL1_AC_Schalter = SigVal;
                    break;
                case 1:
                    MsgObj_Clima_1.CL1_Aussentemp = SigVal;
                    break;
                case 2:
                    MsgObj_Clima_1.CL1_Druck = SigVal;
                    break;
                case 3:
                    MsgObj_Clima_1.CL1_Einheit_Temp = SigVal;
                    break;
                case 4:
                    MsgObj_Clima_1.CL1_Fa_Zuheiz = SigVal;
                    break;
                case 5:
                    MsgObj_Clima_1.CL1_Fehlereintr = SigVal;
                    break;
                case 6:
                    MsgObj_Clima_1.CL1_Frontsch = SigVal;
                    break;
                case 7:
                    MsgObj_Clima_1.CL1_Gebl_last = SigVal;
                    break;
                case 8:
                    MsgObj_Clima_1.CL1_Hecksch = SigVal;
                    break;
                case 9:
                    MsgObj_Clima_1.CL1_Heizleist = SigVal;
                    break;
                case 10:
                    MsgObj_Clima_1.CL1_HzgWischer = SigVal;
                    break;
                case 11:
                    MsgObj_Clima_1.CL1_Kompr_Last = SigVal;
                    break;
                case 12:
                    MsgObj_Clima_1.CL1_Kompressor = SigVal;
                    break;
                case 13:
                    MsgObj_Clima_1.CL1_LL_Dz = SigVal;
                    break;
                case 14:
                    MsgObj_Clima_1.CL1_Luefter = SigVal;
                    break;
                case 15:
                    MsgObj_Clima_1.CL1_Restwaerme = SigVal;
                    break;
                case 16:
                    MsgObj_Clima_1.CL1_Sta_Druck = SigVal;
                    break;
                case 17:
                    MsgObj_Clima_1.CL1_Sta_Moment = SigVal;
                    break;
                case 18:
                    MsgObj_Clima_1.CL1_Temp_Stoss = SigVal;
                    break;
                case 19:
                    MsgObj_Clima_1.KL_4_Zonen = SigVal;
                    break;
                case 20:
                    MsgObj_Clima_1.KL_Thermomanagement = SigVal;
                    break;
                case 21:
                    MsgObj_Clima_1.SH_MVW = SigVal;
                    break;
                case 22:
                    MsgObj_Clima_1.SH_aktiv_Flag = SigVal;
                    break;
            }
        }
        break;
        case FRM_HANDLE_Diagnose_1:
        {
            switch (SigIdx)
            {
                case 0:
                    MsgObj_Diagnose_1.DI1_Jahr = SigVal;
                    break;
                case 1:
                    MsgObj_Diagnose_1.DI1_KM_Stand_alt = SigVal;
                    break;
                case 2:
                    MsgObj_Diagnose_1.DI1_Minute = SigVal;
                    break;
                case 3:
                    MsgObj_Diagnose_1.DI1_Monat = SigVal;
                    break;
                case 4:
                    MsgObj_Diagnose_1.DI1_Reserve1 = SigVal;
                    break;
                case 5:
                    MsgObj_Diagnose_1.DI1_Sekunde = SigVal;
                    break;
                case 6:
                    MsgObj_Diagnose_1.DI1_Stunde = SigVal;
                    break;
                case 7:
                    MsgObj_Diagnose_1.DI1_Tag = SigVal;
                    break;
                case 8:
                    MsgObj_Diagnose_1.DI1_VerlernZaehl = SigVal;
                    break;
                case 9:
                    MsgObj_Diagnose_1.DI1_Zeit_alt = SigVal;
                    break;
                case 10:
                    MsgObj_Diagnose_1.DI1_km_Stand = SigVal;
                    break;
            }
        }
        break;
        case FRM_HANDLE_EPB_1:
        {
            switch (SigIdx)
            {
                case 0:
                    MsgObj_EPB_1.EP1_AnfShLock = SigVal;
                    break;
                case 1:
                    MsgObj_EPB_1.EP1_Auto_Schl_Oe = SigVal;
                    break;
                case 2:
                    MsgObj_EPB_1.EP1_Bremslicht = SigVal;
                    break;
                case 3:
                    MsgObj_EPB_1.EP1_Checksum = SigVal;
                    break;
                case 4:
                    MsgObj_EPB_1.EP1_Fehler_BKL = SigVal;
                    break;
                case 5:
                    MsgObj_EPB_1.EP1_Fehler_Sta = SigVal;
                    break;
                case 6:
                    MsgObj_EPB_1.EP1_Fehler_gelb = SigVal;
                    break;
                case 7:
                    MsgObj_EPB_1.EP1_Fehlereintr = SigVal;
                    break;
                case 8:
                    MsgObj_EPB_1.EP1_Fkt_Lampe = SigVal;
                    break;
                case 9:
                    MsgObj_EPB_1.EP1_Freigabe_Ver = SigVal;
                    break;
                case 10:
                    MsgObj_EPB_1.EP1_HydrHalten = SigVal;
                    break;
                case 11:
                    MsgObj_EPB_1.EP1_KuppModBer = SigVal;
                    break;
                case 12:
                    MsgObj_EPB_1.EP1_Lampe_AutoP = SigVal;
                    break;
                case 13:
                    MsgObj_EPB_1.EP1_Neig_winkel = SigVal;
                    break;
                case 14:
                    MsgObj_EPB_1.EP1_QualNeigWi = SigVal;
                    break;
                case 15:
                    MsgObj_EPB_1.EP1_Schalterinfo = SigVal;
                    break;
                case 16:
                    MsgObj_EPB_1.EP1_SleepInd = SigVal;
                    break;
                case 17:
                    MsgObj_EPB_1.EP1_Spannkraft = SigVal;
                    break;
                case 18:
                    MsgObj_EPB_1.EP1_Sta_EPB = SigVal;
                    break;
                case 19:
                    MsgObj_EPB_1.EP1_Sta_NWS = SigVal;
                    break;
                case 20:
                    MsgObj_EPB_1.EP1_Sta_Schalter = SigVal;
                    break;
                case 21:
                    MsgObj_EPB_1.EP1_Status_Kl_15 = SigVal;
                    break;
                case 22:
                    MsgObj_EPB_1.EP1_Verschleiss = SigVal;
                    break;
                case 23:
                    MsgObj_EPB_1.EP1_Verzoegerung = SigVal;
                    break;
                case 24:
                    MsgObj_EPB_1.EP1_Warnton = SigVal;
                    break;
                case 25:
                    MsgObj_EPB_1.EP1_Warnton1 = SigVal;
                    break;
                case 26:
                    MsgObj_EPB_1.EP1_Warnton2 = SigVal;
                    break;
                case 27:
                    MsgObj_EPB_1.EP1_Zaehler = SigVal;
                    break;
                case 28:
                    MsgObj_EPB_1.EP1__Text = SigVal;
                    break;
            }
        }
        break;
        case FRM_HANDLE_EPB_2:
        {
            switch (SigIdx)
            {
                case 0:
                    MsgObj_EPB_2.BZ_EPB2 = SigVal;
                    break;
                case 1:
                    MsgObj_EPB_2.CHK_EPB2 = SigVal;
                    break;
                case 2:
                    MsgObj_EPB_2.EPB_Pedalweg_Kuppl = SigVal;
                    break;
            }
        }
        break;
        case FRM_HANDLE_GME:
        {
            switch (SigIdx)
            {
                case 0:
                    MsgObj_GME.BZ_GME = SigVal;
                    break;
                case 1:
                    MsgObj_GME.CHK_GME = SigVal;
                    break;
                case 2:
                    MsgObj_GME.CVT_Anf_EPB = SigVal;
                    break;
                case 3:
                    MsgObj_GME.CVT_Anf_EPB_gueltig = SigVal;
                    break;
                case 4:
                    MsgObj_GME.Dynamischer_Eingriff = SigVal;
                    break;
                case 5:
                    MsgObj_GME.GME_QB_UeFkt = SigVal;
                    break;
                case 6:
                    MsgObj_GME.GME_Schaltung = SigVal;
                    break;
                case 7:
                    MsgObj_GME.GME_UeFkt = SigVal;
                    break;
                case 8:
                    MsgObj_GME.GME_Verlustmom = SigVal;
                    break;
                case 9:
                    MsgObj_GME.Kuehlkreislaufventil_GME = SigVal;
                    break;
                case 10:
                    MsgObj_GME.Langfristiger_Eingriff = SigVal;
                    break;
                case 11:
                    MsgObj_GME.Status_Dyn_Eingriff = SigVal;
                    break;
                case 12:
                    MsgObj_GME.Status_Langfr_Eingriff = SigVal;
                    break;
            }
        }
        break;
        case FRM_HANDLE_GRA_Neu:
        {
            switch (SigIdx)
            {
                case 0:
                    MsgObj_GRA_Neu.GRA_Abbrechen = SigVal;
                    break;
                case 1:
                    MsgObj_GRA_Neu.GRA_Checksum = SigVal;
                    break;
                case 2:
                    MsgObj_GRA_Neu.GRA_Down_kurz = SigVal;
                    break;
                case 3:
                    MsgObj_GRA_Neu.GRA_Down_lang = SigVal;
                    break;
                case 4:
                    MsgObj_GRA_Neu.GRA_Fehler_Bed = SigVal;
                    break;
                case 5:
                    MsgObj_GRA_Neu.GRA_Fehler_Tip = SigVal;
                    break;
                case 6:
                    MsgObj_GRA_Neu.GRA_Hauptschalt = SigVal;
                    break;
                case 7:
                    MsgObj_GRA_Neu.GRA_Kodierinfo = SigVal;
                    break;
                case 8:
                    MsgObj_GRA_Neu.GRA_Neu_Setzen = SigVal;
                    break;
                case 9:
                    MsgObj_GRA_Neu.GRA_Neu_Zaehler = SigVal;
                    break;
                case 10:
                    MsgObj_GRA_Neu.GRA_Recall = SigVal;
                    break;
                case 11:
                    MsgObj_GRA_Neu.GRA_Sender = SigVal;
                    break;
                case 12:
                    MsgObj_GRA_Neu.GRA_Sportschalter = SigVal;
                    break;
                case 13:
                    MsgObj_GRA_Neu.GRA_Sta_Limiter = SigVal;
                    break;
                case 14:
                    MsgObj_GRA_Neu.GRA_Tip_Down = SigVal;
                    break;
                case 15:
                    MsgObj_GRA_Neu.GRA_Tip_Up = SigVal;
                    break;
                case 16:
                    MsgObj_GRA_Neu.GRA_Typ_Hauptschalt = SigVal;
                    break;
                case 17:
                    MsgObj_GRA_Neu.GRA_Up_kurz = SigVal;
                    break;
                case 18:
                    MsgObj_GRA_Neu.GRA_Up_lang = SigVal;
                    break;
                case 19:
                    MsgObj_GRA_Neu.GRA_Zeitluecke = SigVal;
                    break;
            }
        }
        break;
        case FRM_HANDLE_Gate_Komf_1:
        {
            switch (SigIdx)
            {
                case 0:
                    MsgObj_Gate_Komf_1.BCM_Offroad_Taster = SigVal;
                    break;
                case 1:
                    MsgObj_Gate_Komf_1.BCM_Remotestart_Betrieb = SigVal;
                    break;
                case 2:
                    MsgObj_Gate_Komf_1.BSK_BT_geoeffnet = SigVal;
                    break;
                case 3:
                    MsgObj_Gate_Komf_1.BSK_HD_Hauptraste = SigVal;
                    break;
                case 4:
                    MsgObj_Gate_Komf_1.BSK_HL_geoeffnet = SigVal;
                    break;
                case 5:
                    MsgObj_Gate_Komf_1.BSK_HR_geoeffnet = SigVal;
                    break;
                case 6:
                    MsgObj_Gate_Komf_1.BSK_Tankklappe = SigVal;
                    break;
                case 7:
                    MsgObj_Gate_Komf_1.EV1_Anf_Klemme_50 = SigVal;
                    break;
                case 8:
                    MsgObj_Gate_Komf_1.GK1_Abbl_VL_def = SigVal;
                    break;
                case 9:
                    MsgObj_Gate_Komf_1.GK1_Abbl_VR_def = SigVal;
                    break;
                case 10:
                    MsgObj_Gate_Komf_1.GK1_Abblendlicht = SigVal;
                    break;
                case 11:
                    MsgObj_Gate_Komf_1.GK1_AnhKonLamp = SigVal;
                    break;
                case 12:
                    MsgObj_Gate_Komf_1.GK1_Anh_abgesteckt = SigVal;
                    break;
                case 13:
                    MsgObj_Gate_Komf_1.GK1_Anhaenger = SigVal;
                    break;
                case 14:
                    MsgObj_Gate_Komf_1.GK1_BLS_AAG = SigVal;
                    break;
                case 15:
                    MsgObj_Gate_Komf_1.GK1_BLS_ILM = SigVal;
                    break;
                case 16:
                    MsgObj_Gate_Komf_1.GK1_Blink_Autob = SigVal;
                    break;
                case 17:
                    MsgObj_Gate_Komf_1.GK1_Blinker_li = SigVal;
                    break;
                case 18:
                    MsgObj_Gate_Komf_1.GK1_Blinker_re = SigVal;
                    break;
                case 19:
                    MsgObj_Gate_Komf_1.GK1_BrLi_Anhaen = SigVal;
                    break;
                case 20:
                    MsgObj_Gate_Komf_1.GK1_BrLi_links = SigVal;
                    break;
                case 21:
                    MsgObj_Gate_Komf_1.GK1_BrLi_mitte = SigVal;
                    break;
                case 22:
                    MsgObj_Gate_Komf_1.GK1_BrLi_rechts = SigVal;
                    break;
                case 23:
                    MsgObj_Gate_Komf_1.GK1_Bremslicht = SigVal;
                    break;
                case 24:
                    MsgObj_Gate_Komf_1.GK1_SamFktNr = 1;
                    MsgObj_Gate_Komf_1.GK1_CharismaModus = SigVal;
                    break;
                case 25:
                    MsgObj_Gate_Komf_1.GK1_Count_Anhaen = SigVal;
                    break;
                case 26:
                    MsgObj_Gate_Komf_1.GK1_Count_Li_Hi = SigVal;
                    break;
                case 27:
                    MsgObj_Gate_Komf_1.GK1_EDC_AAG = SigVal;
                    break;
                case 28:
                    MsgObj_Gate_Komf_1.GK1_EDC_ILM = SigVal;
                    break;
                case 29:
                    MsgObj_Gate_Komf_1.GK1_ELV_verrieg = SigVal;
                    break;
                case 30:
                    MsgObj_Gate_Komf_1.GK1_Fa_Tuerkont = SigVal;
                    break;
                case 31:
                    MsgObj_Gate_Komf_1.GK1_Fernlicht = SigVal;
                    break;
                case 32:
                    MsgObj_Gate_Komf_1.GK1_KW_Warm = SigVal;
                    break;
                case 33:
                    MsgObj_Gate_Komf_1.GK1_Nebel_ein = SigVal;
                    break;
                case 34:
                    MsgObj_Gate_Komf_1.GK1_ParkFrontWi = SigVal;
                    break;
                case 35:
                    MsgObj_Gate_Komf_1.GK1_Reserve3 = SigVal;
                    break;
                case 36:
                    MsgObj_Gate_Komf_1.GK1_Rueckfahr = SigVal;
                    break;
                case 37:
                    MsgObj_Gate_Komf_1.GK1_RueckfahrSch = SigVal;
                    break;
                case 38:
                    MsgObj_Gate_Komf_1.GK1_SH_Verbau = SigVal;
                    break;
                case 39:
                    MsgObj_Gate_Komf_1.GK1_SH_Zusatzfkt = SigVal;
                    break;
                case 40:
                    MsgObj_Gate_Komf_1.GK1_SH_laeuft = SigVal;
                    break;
                case 41:
                    MsgObj_Gate_Komf_1.GK1_SamFktNr = SigVal;
                    break;
                case 42:
                    MsgObj_Gate_Komf_1.GK1_SleepAckn = SigVal;
                    break;
                case 43:
                    MsgObj_Gate_Komf_1.GK1_Sta_Anhaen = SigVal;
                    break;
                case 44:
                    MsgObj_Gate_Komf_1.GK1_Sta_ILM_F_1 = SigVal;
                    break;
                case 45:
                    MsgObj_Gate_Komf_1.GK1_Sta_Kessy_2 = SigVal;
                    break;
                case 46:
                    MsgObj_Gate_Komf_1.GK1_Sta_LSM = SigVal;
                    break;
                case 47:
                    MsgObj_Gate_Komf_1.GK1_Sta_Li_vorn = SigVal;
                    break;
                case 48:
                    MsgObj_Gate_Komf_1.GK1_Sta_Licht1 = SigVal;
                    break;
                case 49:
                    MsgObj_Gate_Komf_1.GK1_Sta_Licht2 = SigVal;
                    break;
            }

            switch (SigIdx)
            {
                case 50:
                    MsgObj_Gate_Komf_1.GK1_Sta_Licht3 = SigVal;
                    break;
                case 51:
                    MsgObj_Gate_Komf_1.GK1_Sta_RDK_Warn = SigVal;
                    break;
                case 52:
                    MsgObj_Gate_Komf_1.GK1_Sta_Stdhzg = SigVal;
                    break;
                case 53:
                    MsgObj_Gate_Komf_1.GK1_Sta_Tuerkont = SigVal;
                    break;
                case 54:
                    MsgObj_Gate_Komf_1.GK1_Warnblk_Status = SigVal;
                    break;
                case 55:
                    MsgObj_Gate_Komf_1.GK1_Wischer_vorn = SigVal;
                    break;
                case 56:
                    MsgObj_Gate_Komf_1.GK1_def_P_verr = SigVal;
                    break;
                case 57:
                    MsgObj_Gate_Komf_1.GK1_res_06 = SigVal;
                    break;
                case 58:
                    MsgObj_Gate_Komf_1.GK1_res_62 = SigVal;
                    break;
                case 59:
                    MsgObj_Gate_Komf_1.KL_EKP_Anst = SigVal;
                    break;
                case 60:
                    MsgObj_Gate_Komf_1.KY2_StSt_Info = SigVal;
                    break;
                case 61:
                    MsgObj_Gate_Komf_1.Klima_5_D3_alt = SigVal;
                    break;
                case 62:
                    MsgObj_Gate_Komf_1.Motorhaubenkontakt_ein = SigVal;
                    break;
                case 63:
                    MsgObj_Gate_Komf_1.SH1_ein_Wasserpumpe = SigVal;
                    break;
                case 64:
                    MsgObj_Gate_Komf_1.mKessy2_alt = SigVal;
                    break;
            }
        }
        break;
        case FRM_HANDLE_Gate_Komf_2:
        {
            switch (SigIdx)
            {
                case 0:
                    MsgObj_Gate_Komf_2.BEM_Segel_Info = SigVal;
                    break;
                case 1:
                    MsgObj_Gate_Komf_2.GK2_BEM_DFM = SigVal;
                    break;
                case 2:
                    MsgObj_Gate_Komf_2.GK2_BEM_P_Generator = SigVal;
                    break;
                case 3:
                    MsgObj_Gate_Komf_2.GK2_BEM_StSt_Info = SigVal;
                    break;
                case 4:
                    MsgObj_Gate_Komf_2.GK2_BSG_StSt_Info = SigVal;
                    break;
                case 5:
                    MsgObj_Gate_Komf_2.GK2_Blk_L_Kontrolle = SigVal;
                    break;
                case 6:
                    MsgObj_Gate_Komf_2.GK2_Blk_R_Kontrolle = SigVal;
                    break;
                case 7:
                    MsgObj_Gate_Komf_2.GK2_EM_LIN_ungueltig = SigVal;
                    break;
                case 8:
                    MsgObj_Gate_Komf_2.GK2_Feh_VLR = SigVal;
                    break;
                case 9:
                    MsgObj_Gate_Komf_2.GK2_Hardtop = SigVal;
                    break;
                case 10:
                    MsgObj_Gate_Komf_2.GK2_Helligkeit = SigVal;
                    break;
                case 11:
                    MsgObj_Gate_Komf_2.GK2_Kessy_StSt_Info = SigVal;
                    break;
                case 12:
                    MsgObj_Gate_Komf_2.GK2_Kl_StSt_Info = SigVal;
                    break;
                case 13:
                    MsgObj_Gate_Komf_2.GK2_LS_KomFehler = SigVal;
                    break;
                case 14:
                    MsgObj_Gate_Komf_2.GK2_LS_def = SigVal;
                    break;
                case 15:
                    MsgObj_Gate_Komf_2.GK2_Profil = SigVal;
                    break;
                case 16:
                    MsgObj_Gate_Komf_2.GK2_Schluessel = SigVal;
                    break;
                case 17:
                    MsgObj_Gate_Komf_2.GK2_Sta_BSG4 = SigVal;
                    break;
                case 18:
                    MsgObj_Gate_Komf_2.GK2_Sta_Clima2 = SigVal;
                    break;
                case 19:
                    MsgObj_Gate_Komf_2.GK2_Sta_Kessy_4 = SigVal;
                    break;
                case 20:
                    MsgObj_Gate_Komf_2.GK2_Sta_LSM = SigVal;
                    break;
                case 21:
                    MsgObj_Gate_Komf_2.GK2_Sta_Licht1 = SigVal;
                    break;
                case 22:
                    MsgObj_Gate_Komf_2.GK2_Sta_Lichtsensor = SigVal;
                    break;
                case 23:
                    MsgObj_Gate_Komf_2.GK2_Sta_Profil = SigVal;
                    break;
                case 24:
                    MsgObj_Gate_Komf_2.GK2_Sta_Schluessel = SigVal;
                    break;
                case 25:
                    MsgObj_Gate_Komf_2.GK2_Sta_VSG = SigVal;
                    break;
                case 26:
                    MsgObj_Gate_Komf_2.GK2_VDKD_auf = SigVal;
                    break;
                case 27:
                    MsgObj_Gate_Komf_2.GK2_VD_entriegelt = SigVal;
                    break;
                case 28:
                    MsgObj_Gate_Komf_2.GK2_VD_offen_ver = SigVal;
                    break;
                case 29:
                    MsgObj_Gate_Komf_2.GK2_VD_zu_ver = SigVal;
                    break;
                case 30:
                    MsgObj_Gate_Komf_2.GK2_Verdeck_Anf = SigVal;
                    break;
                case 31:
                    MsgObj_Gate_Komf_2.GK2_res_09 = SigVal;
                    break;
                case 32:
                    MsgObj_Gate_Komf_2.GK2_res_13 = SigVal;
                    break;
                case 33:
                    MsgObj_Gate_Komf_2.GK2_res_29 = SigVal;
                    break;
                case 34:
                    MsgObj_Gate_Komf_2.GK2_res_30 = SigVal;
                    break;
            }
        }
        break;
        case FRM_HANDLE_Gate_Komf_3:
        {
            switch (SigIdx)
            {
                case 0:
                    MsgObj_Gate_Komf_3.BCM_Tankwunsch = SigVal;
                    break;
                case 1:
                    MsgObj_Gate_Komf_3.BK1_Anlern_Info = SigVal;
                    break;
                case 2:
                    MsgObj_Gate_Komf_3.BK1_IDGeber_1_Status = SigVal;
                    break;
                case 3:
                    MsgObj_Gate_Komf_3.BK1_IDGeber_2_Status = SigVal;
                    break;
                case 4:
                    MsgObj_Gate_Komf_3.BK1_IDGeber_3_Status = SigVal;
                    break;
                case 5:
                    MsgObj_Gate_Komf_3.BK1_IDGeber_4_Status = SigVal;
                    break;
                case 6:
                    MsgObj_Gate_Komf_3.CL3_SH_Wasserpumpe = SigVal;
                    break;
                case 7:
                    MsgObj_Gate_Komf_3.GK2_Sta_Kessy_4 = SigVal;
                    break;
                case 8:
                    MsgObj_Gate_Komf_3.GK3_Sta_BCM_KY1 = SigVal;
                    break;
                case 9:
                    MsgObj_Gate_Komf_3.GK3_Sta_BSG4 = SigVal;
                    break;
                case 10:
                    MsgObj_Gate_Komf_3.GK3_Sta_Clima_3 = SigVal;
                    break;
                case 11:
                    MsgObj_Gate_Komf_3.GK3_Sta_res_03 = SigVal;
                    break;
                case 12:
                    MsgObj_Gate_Komf_3.GK3_Sta_res_04 = SigVal;
                    break;
                case 13:
                    MsgObj_Gate_Komf_3.GK3_Sta_res_05 = SigVal;
                    break;
                case 14:
                    MsgObj_Gate_Komf_3.GK3_Sta_res_06 = SigVal;
                    break;
                case 15:
                    MsgObj_Gate_Komf_3.GK3_Sta_res_07 = SigVal;
                    break;
                case 16:
                    MsgObj_Gate_Komf_3.KY4_Gong_600 = SigVal;
                    break;
                case 17:
                    MsgObj_Gate_Komf_3.KY4_Meldungen = SigVal;
                    break;
                case 18:
                    MsgObj_Gate_Komf_3.KY4_Passiv_Autolock_Menue = SigVal;
                    break;
                case 19:
                    MsgObj_Gate_Komf_3.KY4_Passiv_Autolock_akt = SigVal;
                    break;
            }
        }
        break;
        case FRM_HANDLE_Getriebe_1:
        {
            switch (SigIdx)
            {
                case 0:
                    MsgObj_Getriebe_1.GE1_Code_MSG = SigVal;
                    break;
                case 1:
                    MsgObj_Getriebe_1.GE1_EGS_Anf = SigVal;
                    break;
                case 2:
                    MsgObj_Getriebe_1.GE1_Fahrwistd = SigVal;
                    break;
                case 3:
                    MsgObj_Getriebe_1.GE1_Fehlereintr = SigVal;
                    break;
                case 4:
                    MsgObj_Getriebe_1.GE1_Infobit = SigVal;
                    break;
                case 5:
                    MsgObj_Getriebe_1.GE1_Klimakompr = SigVal;
                    break;
                case 6:
                    MsgObj_Getriebe_1.GE1_Kuehlung = SigVal;
                    break;
                case 7:
                    MsgObj_Getriebe_1.GE1_LaunchControl = SigVal;
                    break;
                case 8:
                    MsgObj_Getriebe_1.GE1_Mrad_Mkurb = SigVal;
                    break;
                case 9:
                    MsgObj_Getriebe_1.GE1_Notlauf = SigVal;
                    break;
                case 10:
                    MsgObj_Getriebe_1.GE1_Schaltung = SigVal;
                    break;
                case 11:
                    MsgObj_Getriebe_1.GE1_SleepInd = SigVal;
                    break;
                case 12:
                    MsgObj_Getriebe_1.GE1_Soll_Mo = SigVal;
                    break;
                case 13:
                    MsgObj_Getriebe_1.GE1_Sta_OBD = SigVal;
                    break;
                case 14:
                    MsgObj_Getriebe_1.GE1_Sta_Schutz = SigVal;
                    break;
                case 15:
                    MsgObj_Getriebe_1.GE1_Start_Stopp_Info = SigVal;
                    break;
                case 16:
                    MsgObj_Getriebe_1.GE1_Startverbot = SigVal;
                    break;
                case 17:
                    MsgObj_Getriebe_1.GE1_WK = SigVal;
                    break;
                case 18:
                    MsgObj_Getriebe_1.GE1_WaVerl_Mo = SigVal;
                    break;
                case 19:
                    MsgObj_Getriebe_1.GE1_Wahl_Pos = SigVal;
                    break;
                case 20:
                    MsgObj_Getriebe_1.GE1_Zaehler = SigVal;
                    break;
                case 21:
                    MsgObj_Getriebe_1.GE1_Zielgang = SigVal;
                    break;
                case 22:
                    MsgObj_Getriebe_1.GE1_v_Umkehr = SigVal;
                    break;
            }
        }
        break;
        case FRM_HANDLE_Getriebe_2:
        {
            switch (SigIdx)
            {
                case 0:
                    MsgObj_Getriebe_2.GE2_Variante = 2;
                    MsgObj_Getriebe_2.GE2_4Gang = SigVal;
                    break;
                case 1:
                    MsgObj_Getriebe_2.GE2_Variante = 0;
                    MsgObj_Getriebe_2.GE2_5Gang = SigVal;
                    break;
                case 2:
                    MsgObj_Getriebe_2.GE2_Variante = 3;
                    MsgObj_Getriebe_2.GE2_ASG = SigVal;
                    break;
                case 3:
                    MsgObj_Getriebe_2.GE2_DZM_Daempf = SigVal;
                    break;
                case 4:
                    MsgObj_Getriebe_2.GE2_Gong = SigVal;
                    break;
                case 5:
                    MsgObj_Getriebe_2.GE2_Grad_begr = SigVal;
                    break;
                case 6:
                    MsgObj_Getriebe_2.GE2_LFR_Adap = SigVal;
                    break;
                case 7:
                    MsgObj_Getriebe_2.GE2_LL_Solldz = SigVal;
                    break;
                case 8:
                    MsgObj_Getriebe_2.GE2_MSB_Sync = SigVal;
                    break;
                case 9:
                    MsgObj_Getriebe_2.GE2_Variante = 1;
                    MsgObj_Getriebe_2.GE2_PRND = SigVal;
                    break;
                case 10:
                    MsgObj_Getriebe_2.GE2_Variante = 6;
                    MsgObj_Getriebe_2.GE2_PRNDS = SigVal;
                    break;
                case 11:
                    MsgObj_Getriebe_2.GE2_Segeln_aktiv = SigVal;
                    break;
                case 12:
                    MsgObj_Getriebe_2.GE2_Variante = 4;
                    MsgObj_Getriebe_2.GE2_Selespeed = SigVal;
                    break;
                case 13:
                    MsgObj_Getriebe_2.GE2_Senderkennung = SigVal;
                    break;
                case 14:
                    MsgObj_Getriebe_2.GE2_Shift_Lock = SigVal;
                    break;
                case 15:
                    MsgObj_Getriebe_2.GE2_SlipStDZEingr = SigVal;
                    break;
                case 16:
                    MsgObj_Getriebe_2.GE2_Sta_SAS = SigVal;
                    break;
                case 17:
                    MsgObj_Getriebe_2.GE2_Sta_ZwGas = SigVal;
                    break;
                case 18:
                    MsgObj_Getriebe_2.GE2_Sync_Dz = SigVal;
                    break;
                case 19:
                    MsgObj_Getriebe_2.GE2_Sync_Zeit = SigVal;
                    break;
                case 20:
                    MsgObj_Getriebe_2.GE2_Variante = 8;
                    MsgObj_Getriebe_2.GE2_Tip4Gang = SigVal;
                    break;
                case 21:
                    MsgObj_Getriebe_2.GE2_Variante = 9;
                    MsgObj_Getriebe_2.GE2_Tip5Gang = SigVal;
                    break;
                case 22:
                    MsgObj_Getriebe_2.GE2_Variante = 12;
                    MsgObj_Getriebe_2.GE2_Tip6Gang = SigVal;
                    break;
                case 23:
                    MsgObj_Getriebe_2.GE2_Variante = 13;
                    MsgObj_Getriebe_2.GE2_Tip7Gang = SigVal;
                    break;
                case 24:
                    MsgObj_Getriebe_2.GE2_Variante = SigVal;
                    break;
                case 25:
                    MsgObj_Getriebe_2.GE2_WBA_Blinken = SigVal;
                    break;
                case 26:
                    MsgObj_Getriebe_2.GE2_Zaehler = SigVal;
                    break;
                case 27:
                    MsgObj_Getriebe_2.GE2_Variante = 15;
                    MsgObj_Getriebe_2.GE2_akt_Gang = SigVal;
                    break;
                case 28:
                    MsgObj_Getriebe_2.GE2_invMSB_Sync = SigVal;
                    break;
                case 29:
                    MsgObj_Getriebe_2.GE2_invSync_Dz = SigVal;
                    break;
            }
        }
        break;
        case FRM_HANDLE_Getriebe_3_Momente:
        {
            switch (SigIdx)
            {
                case 0:
                    MsgObj_Getriebe_3_Momente.GM3_Checksum = SigVal;
                    break;
                case 1:
                    MsgObj_Getriebe_3_Momente.GM3_LangEingr = SigVal;
                    break;
                case 2:
                    MsgObj_Getriebe_3_Momente.GM3_MoSoMom = SigVal;
                    break;
                case 3:
                    MsgObj_Getriebe_3_Momente.GM3_MomEingr = SigVal;
                    break;
                case 4:
                    MsgObj_Getriebe_3_Momente.GM3_MomID = SigVal;
                    break;
                case 5:
                    MsgObj_Getriebe_3_Momente.GM3_Moment = SigVal;
                    break;
                case 6:
                    MsgObj_Getriebe_3_Momente.GM3_QB_LangEingr = SigVal;
                    break;
                case 7:
                    MsgObj_Getriebe_3_Momente.GM3_StaSoMom = SigVal;
                    break;
                case 8:
                    MsgObj_Getriebe_3_Momente.GM3_Zaehler = SigVal;
                    break;
                case 9:
                    MsgObj_Getriebe_3_Momente.GM3_Zeit = SigVal;
                    break;
                case 10:
                    MsgObj_Getriebe_3_Momente.GM3_res_13 = SigVal;
                    break;
                case 11:
                    MsgObj_Getriebe_3_Momente.GM3_res_14 = SigVal;
                    break;
                case 12:
                    MsgObj_Getriebe_3_Momente.GM3_res_15 = SigVal;
                    break;
                case 13:
                    MsgObj_Getriebe_3_Momente.GM3_res_61 = SigVal;
                    break;
                case 14:
                    MsgObj_Getriebe_3_Momente.GM3_res_62 = SigVal;
                    break;
                case 15:
                    MsgObj_Getriebe_3_Momente.GM3_res_63 = SigVal;
                    break;
            }
        }
        break;
        case FRM_HANDLE_Getriebe_6:
        {
            switch (SigIdx)
            {
                case 0:
                    MsgObj_Getriebe_6.GE6_Checksum = SigVal;
                    break;
                case 1:
                    MsgObj_Getriebe_6.GE6_Gangwechsel = SigVal;
                    break;
                case 2:
                    MsgObj_Getriebe_6.GE6_OelTemp = SigVal;
                    break;
                case 3:
                    MsgObj_Getriebe_6.GE6_QB_OelTemp = SigVal;
                    break;
                case 4:
                    MsgObj_Getriebe_6.GE6_QmaxBeschl = SigVal;
                    break;
                case 5:
                    MsgObj_Getriebe_6.GE6_Sta_Shift_Spontan = SigVal;
                    break;
                case 6:
                    MsgObj_Getriebe_6.GE6_TurbDZ = SigVal;
                    break;
                case 7:
                    MsgObj_Getriebe_6.GE6_Verlustmom = SigVal;
                    break;
                case 8:
                    MsgObj_Getriebe_6.GE6_Zaehler = SigVal;
                    break;
                case 9:
                    MsgObj_Getriebe_6.GE6_Zielgang_err = SigVal;
                    break;
                case 10:
                    MsgObj_Getriebe_6.GE6_maxBeschl = SigVal;
                    break;
                case 11:
                    MsgObj_Getriebe_6.GE_Heizwunsch = SigVal;
                    break;
                case 12:
                    MsgObj_Getriebe_6.GE_StSt_Info = SigVal;
                    break;
            }
        }
        break;
        case FRM_HANDLE_Getriebe_Hybrid_1:
        {
            switch (SigIdx)
            {
                case 0:
                    MsgObj_Getriebe_Hybrid_1.GH1_AnzeigeDZ = SigVal;
                    break;
                case 1:
                    MsgObj_Getriebe_Hybrid_1.GH1_FehlerstatusGSG = SigVal;
                    break;
                case 2:
                    MsgObj_Getriebe_Hybrid_1.GH1_Filt_MomAufbau = SigVal;
                    break;
                case 3:
                    MsgObj_Getriebe_Hybrid_1.GH1_Freig_LL_Reg = SigVal;
                    break;
                case 4:
                    MsgObj_Getriebe_Hybrid_1.GH1_FreigabeK0 = SigVal;
                    break;
                case 5:
                    MsgObj_Getriebe_Hybrid_1.GH1_FreigabeSSK0 = SigVal;
                    break;
                case 6:
                    MsgObj_Getriebe_Hybrid_1.GH1_FreigabeVMStop = SigVal;
                    break;
                case 7:
                    MsgObj_Getriebe_Hybrid_1.GH1_MomEingriff_EM = SigVal;
                    break;
                case 8:
                    MsgObj_Getriebe_Hybrid_1.GH1_Sportfaktor = SigVal;
                    break;
                case 9:
                    MsgObj_Getriebe_Hybrid_1.GH1_VKMstartanforderung = SigVal;
                    break;
                case 10:
                    MsgObj_Getriebe_Hybrid_1.GH1_VKMstartkontrolle = SigVal;
                    break;
                case 11:
                    MsgObj_Getriebe_Hybrid_1.GH1_VM_akt_halten = SigVal;
                    break;
                case 12:
                    MsgObj_Getriebe_Hybrid_1.GH1_VZMomEingriff = SigVal;
                    break;
                case 13:
                    MsgObj_Getriebe_Hybrid_1.GH1_Wiederstart = SigVal;
                    break;
                case 14:
                    MsgObj_Getriebe_Hybrid_1.GH1_Zaehler = SigVal;
                    break;
                case 15:
                    MsgObj_Getriebe_Hybrid_1.GH1_nK0 = SigVal;
                    break;
            }
        }
        break;
        case FRM_HANDLE_Klima_5:
        {
            switch (SigIdx)
            {
                case 0:
                    MsgObj_Klima_5.HYB_Anf_E_Mode = SigVal;
                    break;
                case 1:
                    MsgObj_Klima_5.KL_Magnetventil = SigVal;
                    break;
                case 2:
                    MsgObj_Klima_5.KL_Schalter_StartStopp = SigVal;
                    break;
                case 3:
                    MsgObj_Klima_5.KL_Thermomanagement = SigVal;
                    break;
                case 4:
                    MsgObj_Klima_5.Klima_StSt_Info = SigVal;
                    break;
                case 5:
                    MsgObj_Klima_5.SH_Betriebsdauer = SigVal;
                    break;
                case 6:
                    MsgObj_Klima_5.SH_Monat = SigVal;
                    break;
                case 7:
                    MsgObj_Klima_5.SH_Offset_Jahr = SigVal;
                    break;
                case 8:
                    MsgObj_Klima_5.SH_Tag = SigVal;
                    break;
                case 9:
                    MsgObj_Klima_5.SH_Timer_aktiv = SigVal;
                    break;
                case 10:
                    MsgObj_Klima_5.SH_Timerstatus = SigVal;
                    break;
                case 11:
                    MsgObj_Klima_5.SH_WP_Fehler = SigVal;
                    break;
                case 12:
                    MsgObj_Klima_5.SH_Wochentag = SigVal;
                    break;
                case 13:
                    MsgObj_Klima_5.SH_h_Einschaltzeit = SigVal;
                    break;
                case 14:
                    MsgObj_Klima_5.SH_min_Einschaltzeit = SigVal;
                    break;
                case 15:
                    MsgObj_Klima_5.STH_Betriebsart = SigVal;
                    break;
            }
        }
        break;
        case FRM_HANDLE_Kombi_1:
        {
            switch (SigIdx)
            {
                case 0:
                    MsgObj_Kombi_1.KO1_ABS_Lampe = SigVal;
                    break;
                case 1:
                    MsgObj_Kombi_1.KO1_ACC_AnzFhl = SigVal;
                    break;
                case 2:
                    MsgObj_Kombi_1.KO1_ACC_Inkons = SigVal;
                    break;
                case 3:
                    MsgObj_Kombi_1.KO1_ASRESP_Lampe = SigVal;
                    break;
                case 4:
                    MsgObj_Kombi_1.KO1_Airbag_Lampe = SigVal;
                    break;
                case 5:
                    MsgObj_Kombi_1.KO1_Brems_Lampe = SigVal;
                    break;
                case 6:
                    MsgObj_Kombi_1.KO1_Bremsinfo = SigVal;
                    break;
                case 7:
                    MsgObj_Kombi_1.KO1_Handbremse = SigVal;
                    break;
                case 8:
                    MsgObj_Kombi_1.KO1_Kuehlmittel = SigVal;
                    break;
                case 9:
                    MsgObj_Kombi_1.KO1_LDW_AnzFeh = SigVal;
                    break;
                case 10:
                    MsgObj_Kombi_1.KO1_La_Ladekon = SigVal;
                    break;
                case 11:
                    MsgObj_Kombi_1.KO1_Lenkh_Lampe = SigVal;
                    break;
                case 12:
                    MsgObj_Kombi_1.KO1_OBD_Tank = SigVal;
                    break;
                case 13:
                    MsgObj_Kombi_1.KO1_Oeldruck = SigVal;
                    break;
                case 14:
                    MsgObj_Kombi_1.KO1_Quelle_kmh = SigVal;
                    break;
                case 15:
                    MsgObj_Kombi_1.KO1_SILA_gueltig = SigVal;
                    break;
                case 16:
                    MsgObj_Kombi_1.KO1_SleepInd = SigVal;
                    break;
                case 17:
                    MsgObj_Kombi_1.KO1_Sta_Oeldr = SigVal;
                    break;
                case 18:
                    MsgObj_Kombi_1.KO1_Sta_Tank = SigVal;
                    break;
                case 19:
                    MsgObj_Kombi_1.KO1_Stellglieder = SigVal;
                    break;
                case 20:
                    MsgObj_Kombi_1.KO1_Tankinhalt = SigVal;
                    break;
                case 21:
                    MsgObj_Kombi_1.KO1_Tankstop = SigVal;
                    break;
                case 22:
                    MsgObj_Kombi_1.KO1_Vorgluehen = SigVal;
                    break;
                case 23:
                    MsgObj_Kombi_1.KO1_Wakeup_Komfort = SigVal;
                    break;
                case 24:
                    MsgObj_Kombi_1.KO1_Warn_Tank = SigVal;
                    break;
                case 25:
                    MsgObj_Kombi_1.KO1_Zaehler = SigVal;
                    break;
                case 26:
                    MsgObj_Kombi_1.KO1_Zeitluecke = SigVal;
                    break;
                case 27:
                    MsgObj_Kombi_1.KO1_angez_kmh = SigVal;
                    break;
                case 28:
                    MsgObj_Kombi_1.KO1_kmh = SigVal;
                    break;
                case 29:
                    MsgObj_Kombi_1.KO1_kmh_mph = SigVal;
                    break;
            }
        }
        break;
        case FRM_HANDLE_Kombi_2:
        {
            switch (SigIdx)
            {
                case 0:
                    MsgObj_Kombi_2.KO2_Aussen_T = SigVal;
                    break;
                case 1:
                    MsgObj_Kombi_2.KO2_Bel_Displ = SigVal;
                    break;
                case 2:
                    MsgObj_Kombi_2.KO2_Bel_Schalt = SigVal;
                    break;
                case 3:
                    MsgObj_Kombi_2.KO2_Fehlereintr = SigVal;
                    break;
                case 4:
                    MsgObj_Kombi_2.KO2_GRA_High = SigVal;
                    break;
                case 5:
                    MsgObj_Kombi_2.KO2_MFA_v_Einheit = SigVal;
                    break;
                case 6:
                    MsgObj_Kombi_2.KO2_OBD_Nib_Temp = SigVal;
                    break;
                case 7:
                    MsgObj_Kombi_2.KO2_OelTemp = SigVal;
                    break;
                case 8:
                    MsgObj_Kombi_2.KO2_Oelwarn = SigVal;
                    break;
                case 9:
                    MsgObj_Kombi_2.KO2_PLA_Displaystatus = SigVal;
                    break;
                case 10:
                    MsgObj_Kombi_2.KO2_Reserve4 = SigVal;
                    break;
                case 11:
                    MsgObj_Kombi_2.KO2_Reserve5 = SigVal;
                    break;
                case 12:
                    MsgObj_Kombi_2.KO2_Sta_Auss_T = SigVal;
                    break;
                case 13:
                    MsgObj_Kombi_2.KO2_Sta_Displ = SigVal;
                    break;
                case 14:
                    MsgObj_Kombi_2.KO2_Sta_Oel_T = SigVal;
                    break;
                case 15:
                    MsgObj_Kombi_2.KO2_Sta_Schalt = SigVal;
                    break;
                case 16:
                    MsgObj_Kombi_2.KO2_Temp_Einheit = SigVal;
                    break;
                case 17:
                    MsgObj_Kombi_2.KO2_Verb_TOG = SigVal;
                    break;
                case 18:
                    MsgObj_Kombi_2.KO2_Wischwasser = SigVal;
                    break;
                case 19:
                    MsgObj_Kombi_2.KO2_gef_Auss_T = SigVal;
                    break;
                case 20:
                    MsgObj_Kombi_2.MFA_Strecke_Einheit = SigVal;
                    break;
            }
        }
        break;
        case FRM_HANDLE_Kombi_3:
        {
            switch (SigIdx)
            {
                case 0:
                    MsgObj_Kombi_3.KO3_Mp_Code = 2;
                    MsgObj_Kombi_3.KBI_Oelwechsel_durchgefuehrt = SigVal;
                    break;
                case 1:
                    MsgObj_Kombi_3.KO3_Mp_Code = 1;
                    MsgObj_Kombi_3.KO3_Baureihe = SigVal;
                    break;
                case 2:
                    MsgObj_Kombi_3.KO3_Mp_Code = 1;
                    MsgObj_Kombi_3.KO3_Derivat = SigVal;
                    break;
                case 3:
                    MsgObj_Kombi_3.KO3_Mp_Code = 1;
                    MsgObj_Kombi_3.KO3_Generation = SigVal;
                    break;
                case 4:
                    MsgObj_Kombi_3.KO3_Kilometer = SigVal;
                    break;
                case 5:
                    MsgObj_Kombi_3.KO3_Mp_Code = 0;
                    MsgObj_Kombi_3.KO3_Land = SigVal;
                    break;
                case 6:
                    MsgObj_Kombi_3.KO3_Mp_Code = 1;
                    MsgObj_Kombi_3.KO3_Marke = SigVal;
                    break;
                case 7:
                    MsgObj_Kombi_3.KO3_Mp_Code = SigVal;
                    break;
                case 8:
                    MsgObj_Kombi_3.KO3_Mp_Code = 2;
                    MsgObj_Kombi_3.KO3_Radumfang = SigVal;
                    break;
                case 9:
                    MsgObj_Kombi_3.KO3_Reserve1 = SigVal;
                    break;
                case 10:
                    MsgObj_Kombi_3.KO3_Reserve2 = SigVal;
                    break;
                case 11:
                    MsgObj_Kombi_3.KO3_SWA_AnzFeh = SigVal;
                    break;
                case 12:
                    MsgObj_Kombi_3.KO3_Schluessel = SigVal;
                    break;
                case 13:
                    MsgObj_Kombi_3.KO3_Mp_Code = 0;
                    MsgObj_Kombi_3.KO3_Sprache = SigVal;
                    break;
                case 14:
                    MsgObj_Kombi_3.KO3_Sta_Standz = SigVal;
                    break;
                case 15:
                    MsgObj_Kombi_3.KO3_Standzeit = SigVal;
                    break;
                case 16:
                    MsgObj_Kombi_3.KO3_Mp_Code = 3;
                    MsgObj_Kombi_3.KO3_Verbau_ADR = SigVal;
                    break;
                case 17:
                    MsgObj_Kombi_3.KO3_Mp_Code = 3;
                    MsgObj_Kombi_3.KO3_Verbau_Air = SigVal;
                    break;
                case 18:
                    MsgObj_Kombi_3.KO3_Mp_Code = 3;
                    MsgObj_Kombi_3.KO3_Verbau_BN = SigVal;
                    break;
                case 19:
                    MsgObj_Kombi_3.KO3_Mp_Code = 3;
                    MsgObj_Kombi_3.KO3_Verbau_Br = SigVal;
                    break;
                case 20:
                    MsgObj_Kombi_3.KO3_Mp_Code = 3;
                    MsgObj_Kombi_3.KO3_Verbau_DP = SigVal;
                    break;
                case 21:
                    MsgObj_Kombi_3.KO3_Mp_Code = 3;
                    MsgObj_Kombi_3.KO3_Verbau_Get = SigVal;
                    break;
                case 22:
                    MsgObj_Kombi_3.KO3_Mp_Code = 3;
                    MsgObj_Kombi_3.KO3_Verbau_Kl = SigVal;
                    break;
                case 23:
                    MsgObj_Kombi_3.KO3_Mp_Code = 3;
                    MsgObj_Kombi_3.KO3_Verbau_LH = SigVal;
                    break;
                case 24:
                    MsgObj_Kombi_3.KO3_Mp_Code = 3;
                    MsgObj_Kombi_3.KO3_Verbau_LWS = SigVal;
                    break;
                case 25:
                    MsgObj_Kombi_3.KO3_Mp_Code = 3;
                    MsgObj_Kombi_3.KO3_Verbau_Mot = SigVal;
                    break;
                case 26:
                    MsgObj_Kombi_3.KO3_Mp_Code = 3;
                    MsgObj_Kombi_3.KO3_Verbau_Niveau = SigVal;
                    break;
                case 27:
                    MsgObj_Kombi_3.KO3_Mp_Code = 3;
                    MsgObj_Kombi_3.KO3_Verbau_Syn = SigVal;
                    break;
            }
        }
        break;
        case FRM_HANDLE_LW_1:
        {
            switch (SigIdx)
            {
                case 0:
                    MsgObj_LW_1.LW1_CRC = SigVal;
                    break;
                case 1:
                    MsgObj_LW_1.LW1_Gesch_Sign = SigVal;
                    break;
                case 2:
                    MsgObj_LW_1.LW1_ID = SigVal;
                    break;
                case 3:
                    MsgObj_LW_1.LW1_Initquelle = SigVal;
                    break;
                case 4:
                    MsgObj_LW_1.LW1_Kodier = SigVal;
                    break;
                case 5:
                    MsgObj_LW_1.LW1_LRW = SigVal;
                    break;
                case 6:
                    MsgObj_LW_1.LW1_LRW_Sign = SigVal;
                    break;
                case 7:
                    MsgObj_LW_1.LW1_Lenk_Gesch = SigVal;
                    break;
                case 8:
                    MsgObj_LW_1.LW1_Sta_KL30 = SigVal;
                    break;
                case 9:
                    MsgObj_LW_1.LW1_Status = SigVal;
                    break;
                case 10:
                    MsgObj_LW_1.LW1_Zaehler = SigVal;
                    break;
            }
        }
        break;
        case FRM_HANDLE_Lenkhilfe_3:
        {
            switch (SigIdx)
            {
                case 0:
                    MsgObj_Lenkhilfe_3.LH3_BLW = SigVal;
                    break;
                case 1:
                    MsgObj_Lenkhilfe_3.LH3_BLWSign = SigVal;
                    break;
                case 2:
                    MsgObj_Lenkhilfe_3.LH3_BLWValid = SigVal;
                    break;
                case 3:
                    MsgObj_Lenkhilfe_3.LH3_BS_Spiegel = SigVal;
                    break;
                case 4:
                    MsgObj_Lenkhilfe_3.LH3_Checksumme = SigVal;
                    break;
                case 5:
                    MsgObj_Lenkhilfe_3.LH3_LM = SigVal;
                    break;
                case 6:
                    MsgObj_Lenkhilfe_3.LH3_LMSign = SigVal;
                    break;
                case 7:
                    MsgObj_Lenkhilfe_3.LH3_LMValid = SigVal;
                    break;
                case 8:
                    MsgObj_Lenkhilfe_3.LH3_Lenkungstyp = SigVal;
                    break;
                case 9:
                    MsgObj_Lenkhilfe_3.LH3_Sta_DSR = SigVal;
                    break;
                case 10:
                    MsgObj_Lenkhilfe_3.LH3_Zaehler = SigVal;
                    break;
            }
        }
        break;
        case FRM_HANDLE_NMH_Gateway:
        {
            switch (SigIdx)
            {
                case 0:
                    MsgObj_NMH_Gateway.NMH_GW_Abschaltstufe_aktiv = SigVal;
                    break;
                case 1:
                    MsgObj_NMH_Gateway.NMH_GW_CAN_Diag_deaktiv = SigVal;
                    break;
                case 2:
                    MsgObj_NMH_Gateway.NMH_GW_Car_WakeUp = SigVal;
                    break;
                case 3:
                    MsgObj_NMH_Gateway.NMH_GW_Eindraht_Fehler = SigVal;
                    break;
                case 4:
                    MsgObj_NMH_Gateway.NMH_GW_Fkt_WakeUp = SigVal;
                    break;
                case 5:
                    MsgObj_NMH_Gateway.NMH_GW_KompSchutz = SigVal;
                    break;
                case 6:
                    MsgObj_NMH_Gateway.NMH_GW_Mute_Mode = SigVal;
                    break;
                case 7:
                    MsgObj_NMH_Gateway.NMH_GW_NL_0 = SigVal;
                    break;
                case 8:
                    MsgObj_NMH_Gateway.NMH_GW_NL_1 = SigVal;
                    break;
                case 9:
                    MsgObj_NMH_Gateway.NMH_GW_NL_2 = SigVal;
                    break;
                case 10:
                    MsgObj_NMH_Gateway.NMH_GW_NL_3 = SigVal;
                    break;
                case 11:
                    MsgObj_NMH_Gateway.NMH_GW_NL_4 = SigVal;
                    break;
                case 12:
                    MsgObj_NMH_Gateway.NMH_GW_NL_5 = SigVal;
                    break;
                case 13:
                    MsgObj_NMH_Gateway.NMH_GW_NL_6 = SigVal;
                    break;
                case 14:
                    MsgObj_NMH_Gateway.NMH_GW_NL_7 = SigVal;
                    break;
                case 15:
                    MsgObj_NMH_Gateway.NMH_GW_NL_aktiv_4 = SigVal;
                    break;
                case 16:
                    MsgObj_NMH_Gateway.NMH_GW_NL_aktiv_5 = SigVal;
                    break;
                case 17:
                    MsgObj_NMH_Gateway.NMH_GW_NL_aktiv_6 = SigVal;
                    break;
                case 18:
                    MsgObj_NMH_Gateway.NMH_GW_NL_aktiv_7 = SigVal;
                    break;
                case 19:
                    MsgObj_NMH_Gateway.NMH_GW_NL_aktiv_8 = SigVal;
                    break;
                case 20:
                    MsgObj_NMH_Gateway.NMH_GW_NM_aktiv_Diagnose = SigVal;
                    break;
                case 21:
                    MsgObj_NMH_Gateway.NMH_GW_NM_aktiv_Klemme_15 = SigVal;
                    break;
                case 22:
                    MsgObj_NMH_Gateway.NMH_GW_NM_aktiv_Start = SigVal;
                    break;
                case 23:
                    MsgObj_NMH_Gateway.NMH_GW_Normal_Mode_1 = SigVal;
                    break;
                case 24:
                    MsgObj_NMH_Gateway.NMH_GW_Normal_Mode_2 = SigVal;
                    break;
                case 25:
                    MsgObj_NMH_Gateway.NMH_GW_Per_WakeUp = SigVal;
                    break;
                case 26:
                    MsgObj_NMH_Gateway.NMH_GW_Start_1 = SigVal;
                    break;
                case 27:
                    MsgObj_NMH_Gateway.NMH_GW_Start_2 = SigVal;
                    break;
                case 28:
                    MsgObj_NMH_Gateway.NMH_GW_TimeOut_Fehler = SigVal;
                    break;
                case 29:
                    MsgObj_NMH_Gateway.NMH_GW_Transport_Mode = SigVal;
                    break;
            }
        }
        break;
        case FRM_HANDLE_Niveau_1:
        {
            switch (SigIdx)
            {
                case 0:
                    MsgObj_Niveau_1.Absenkung_Fahrzeug = SigVal;
                    break;
                case 1:
                    MsgObj_Niveau_1.Anhebung_Fahrzeug = SigVal;
                    break;
                case 2:
                    MsgObj_Niveau_1.Aufpruefbit_Warnlampe_Niveau = SigVal;
                    break;
                case 3:
                    MsgObj_Niveau_1.Beladungszustand = SigVal;
                    break;
                case 4:
                    MsgObj_Niveau_1.ESP_Beeinflussung = SigVal;
                    break;
                case 5:
                    MsgObj_Niveau_1.FSPE_Niveau1 = SigVal;
                    break;
                case 6:
                    MsgObj_Niveau_1.Fehlerlampe_Niveau = SigVal;
                    break;
                case 7:
                    MsgObj_Niveau_1.Kompressor_laeuft = SigVal;
                    break;
                case 8:
                    MsgObj_Niveau_1.Kompressorlauf_in_Kuerze = SigVal;
                    break;
                case 9:
                    MsgObj_Niveau_1.NI1_Checksum = SigVal;
                    break;
                case 10:
                    MsgObj_Niveau_1.NI1_Fahrzeugart = SigVal;
                    break;
                case 11:
                    MsgObj_Niveau_1.NI1_MSG_Eingriff = SigVal;
                    break;
                case 12:
                    MsgObj_Niveau_1.NI1_Zaehler = SigVal;
                    break;
                case 13:
                    MsgObj_Niveau_1.Niveaustati = SigVal;
                    break;
                case 14:
                    MsgObj_Niveau_1.Parkniveau = SigVal;
                    break;
                case 15:
                    MsgObj_Niveau_1.SIB_Niveau = SigVal;
                    break;
                case 16:
                    MsgObj_Niveau_1.Stromaufnahme = SigVal;
                    break;
                case 17:
                    MsgObj_Niveau_1.Systemstatus = SigVal;
                    break;
                case 18:
                    MsgObj_Niveau_1.Taster_Niveau = SigVal;
                    break;
                case 19:
                    MsgObj_Niveau_1.Textbits_Niveau = SigVal;
                    break;
                case 20:
                    MsgObj_Niveau_1.Tiefniveaulampe = SigVal;
                    break;
                case 21:
                    MsgObj_Niveau_1.Verstellung_HL = SigVal;
                    break;
                case 22:
                    MsgObj_Niveau_1.Verstellung_HR = SigVal;
                    break;
                case 23:
                    MsgObj_Niveau_1.Verstellung_VL = SigVal;
                    break;
                case 24:
                    MsgObj_Niveau_1.Verstellung_VR = SigVal;
                    break;
                case 25:
                    MsgObj_Niveau_1.Verstellung_aktiv = SigVal;
                    break;
                case 26:
                    MsgObj_Niveau_1.Verstellung_in_Kuerze = SigVal;
                    break;
                case 27:
                    MsgObj_Niveau_1.Warnlampe = SigVal;
                    break;
                case 28:
                    MsgObj_Niveau_1.Zwischenniveau = SigVal;
                    break;
            }
        }
        break;
        case FRM_HANDLE_OBD_Tankgeber_01:
        {
            switch (SigIdx)
            {
                case 0:
                    MsgObj_OBD_Tankgeber_01.OBD_TG_F_Status_1 = SigVal;
                    break;
                case 1:
                    MsgObj_OBD_Tankgeber_01.OBD_TG_F_Status_2 = SigVal;
                    break;
                case 2:
                    MsgObj_OBD_Tankgeber_01.OBD_TG_F_Status_3 = SigVal;
                    break;
                case 3:
                    MsgObj_OBD_Tankgeber_01.OBD_TG_F_Status_4 = SigVal;
                    break;
                case 4:
                    MsgObj_OBD_Tankgeber_01.OBD_TG_Sens_Rohwert_1 = SigVal;
                    break;
                case 5:
                    MsgObj_OBD_Tankgeber_01.OBD_TG_Sens_Rohwert_2 = SigVal;
                    break;
                case 6:
                    MsgObj_OBD_Tankgeber_01.OBD_TG_Sens_Rohwert_3 = SigVal;
                    break;
                case 7:
                    MsgObj_OBD_Tankgeber_01.OBD_TG_Sens_Rohwert_4 = SigVal;
                    break;
            }
        }
        break;
        case FRM_HANDLE_Parkhilfe_01:
        {
            switch (SigIdx)
            {
                case 0:
                    MsgObj_Parkhilfe_01.PH_Abschaltursache = SigVal;
                    break;
                case 1:
                    MsgObj_Parkhilfe_01.PH_Anf_Audioabsenkung = SigVal;
                    break;
                case 2:
                    MsgObj_Parkhilfe_01.PH_Aufbauten_erk = SigVal;
                    break;
                case 3:
                    MsgObj_Parkhilfe_01.PH_BerErk_hinten = SigVal;
                    break;
                case 4:
                    MsgObj_Parkhilfe_01.PH_BerErk_vorn = SigVal;
                    break;
                case 5:
                    MsgObj_Parkhilfe_01.PH_Display_Kundenwunsch = SigVal;
                    break;
                case 6:
                    MsgObj_Parkhilfe_01.PH_Frequenz_hinten = SigVal;
                    break;
                case 7:
                    MsgObj_Parkhilfe_01.PH_Frequenz_vorn = SigVal;
                    break;
                case 8:
                    MsgObj_Parkhilfe_01.PH_KD_Fehler = SigVal;
                    break;
                case 9:
                    MsgObj_Parkhilfe_01.PH_Lautstaerke_hinten = SigVal;
                    break;
                case 10:
                    MsgObj_Parkhilfe_01.PH_Lautstaerke_vorn = SigVal;
                    break;
                case 11:
                    MsgObj_Parkhilfe_01.PH_Opt_Anz_H_Hindernis = SigVal;
                    break;
                case 12:
                    MsgObj_Parkhilfe_01.PH_Opt_Anz_V_Hindernis = SigVal;
                    break;
                case 13:
                    MsgObj_Parkhilfe_01.PH_Opt_Anzeige_H_ein = SigVal;
                    break;
                case 14:
                    MsgObj_Parkhilfe_01.PH_Opt_Anzeige_V_ein = SigVal;
                    break;
                case 15:
                    MsgObj_Parkhilfe_01.PH_StartStopp_Info = SigVal;
                    break;
                case 16:
                    MsgObj_Parkhilfe_01.PH_Systemzustand = SigVal;
                    break;
                case 17:
                    MsgObj_Parkhilfe_01.PH_Tongeber_H_aktiv = SigVal;
                    break;
                case 18:
                    MsgObj_Parkhilfe_01.PH_Tongeber_V_aktiv = SigVal;
                    break;
                case 19:
                    MsgObj_Parkhilfe_01.PH_Tongeber_mute = SigVal;
                    break;
                case 20:
                    MsgObj_Parkhilfe_01.PH_defekt = SigVal;
                    break;
                case 21:
                    MsgObj_Parkhilfe_01.PH_gestoert = SigVal;
                    break;
                case 22:
                    MsgObj_Parkhilfe_01.PH_res_00 = SigVal;
                    break;
                case 23:
                    MsgObj_Parkhilfe_01.PH_res_01 = SigVal;
                    break;
                case 24:
                    MsgObj_Parkhilfe_01.PH_res_02 = SigVal;
                    break;
                case 25:
                    MsgObj_Parkhilfe_01.PH_res_03 = SigVal;
                    break;
                case 26:
                    MsgObj_Parkhilfe_01.PH_res_04 = SigVal;
                    break;
                case 27:
                    MsgObj_Parkhilfe_01.PH_res_05 = SigVal;
                    break;
                case 28:
                    MsgObj_Parkhilfe_01.PH_res_06 = SigVal;
                    break;
                case 29:
                    MsgObj_Parkhilfe_01.PH_res_07 = SigVal;
                    break;
                case 30:
                    MsgObj_Parkhilfe_01.PH_res_08 = SigVal;
                    break;
                case 31:
                    MsgObj_Parkhilfe_01.PH_res_09 = SigVal;
                    break;
                case 32:
                    MsgObj_Parkhilfe_01.PH_res_10 = SigVal;
                    break;
                case 33:
                    MsgObj_Parkhilfe_01.PH_res_11 = SigVal;
                    break;
                case 34:
                    MsgObj_Parkhilfe_01.PH_res_12 = SigVal;
                    break;
                case 35:
                    MsgObj_Parkhilfe_01.PH_res_24 = SigVal;
                    break;
                case 36:
                    MsgObj_Parkhilfe_01.PH_res_25 = SigVal;
                    break;
                case 37:
                    MsgObj_Parkhilfe_01.PH_res_26 = SigVal;
                    break;
                case 38:
                    MsgObj_Parkhilfe_01.PH_res_27 = SigVal;
                    break;
                case 39:
                    MsgObj_Parkhilfe_01.PH_res_28 = SigVal;
                    break;
                case 40:
                    MsgObj_Parkhilfe_01.PH_res_29 = SigVal;
                    break;
                case 41:
                    MsgObj_Parkhilfe_01.PH_res_30 = SigVal;
                    break;
                case 42:
                    MsgObj_Parkhilfe_01.PH_res_31 = SigVal;
                    break;
                case 43:
                    MsgObj_Parkhilfe_01.PH_res_48 = SigVal;
                    break;
            }
        }
        break;
        case FRM_HANDLE_Parkhilfe_1:
        {
            switch (SigIdx)
            {
                case 0:
                    MsgObj_Parkhilfe_1.APS_Frequenz_hinten = SigVal;
                    break;
                case 1:
                    MsgObj_Parkhilfe_1.APS_Frequenz_vorn = SigVal;
                    break;
                case 2:
                    MsgObj_Parkhilfe_1.APS_Lautstaerke_hinten = SigVal;
                    break;
                case 3:
                    MsgObj_Parkhilfe_1.APS_Lautstaerke_vorn = SigVal;
                    break;
                case 4:
                    MsgObj_Parkhilfe_1.Anlage_defekt = SigVal;
                    break;
                case 5:
                    MsgObj_Parkhilfe_1.Eis_aus = SigVal;
                    break;
                case 6:
                    MsgObj_Parkhilfe_1.Geschwindigkeit_aus = SigVal;
                    break;
                case 7:
                    MsgObj_Parkhilfe_1.KD_Fehler_Parkhilfe = SigVal;
                    break;
                case 8:
                    MsgObj_Parkhilfe_1.Optische_Anzeige_aktiv = SigVal;
                    break;
                case 9:
                    MsgObj_Parkhilfe_1.PH_StSt_Info = SigVal;
                    break;
                case 10:
                    MsgObj_Parkhilfe_1.Rueckwaertsgang_aktiviert = SigVal;
                    break;
                case 11:
                    MsgObj_Parkhilfe_1.Schlechtweg_aus = SigVal;
                    break;
                case 12:
                    MsgObj_Parkhilfe_1.Taster_aktiviert = SigVal;
                    break;
                case 13:
                    MsgObj_Parkhilfe_1.Tongeber_h_aktiv = SigVal;
                    break;
                case 14:
                    MsgObj_Parkhilfe_1.Tongeber_h_defekt = SigVal;
                    break;
                case 15:
                    MsgObj_Parkhilfe_1.Tongeber_v_aktiv = SigVal;
                    break;
                case 16:
                    MsgObj_Parkhilfe_1.Tongeber_v_defekt = SigVal;
                    break;
            }
        }
        break;
        case FRM_HANDLE_Remotestart_FFB:
        {
            switch (SigIdx)
            {
                case 0:
                    MsgObj_Remotestart_FFB.RSF_Tastencode_1 = SigVal;
                    break;
                case 1:
                    MsgObj_Remotestart_FFB.RSF_Tastencode_2 = SigVal;
                    break;
                case 2:
                    MsgObj_Remotestart_FFB.RSF_Tastencode_Maske = SigVal;
                    break;
            }
        }
        break;
        case FRM_HANDLE_Soll_Verbauliste_neu:
        {
            switch (SigIdx)
            {
                case 0:
                    MsgObj_Soll_Verbauliste_neu.VL1_ABS = SigVal;
                    break;
                case 1:
                    MsgObj_Soll_Verbauliste_neu.VL1_ADR = SigVal;
                    break;
                case 2:
                    MsgObj_Soll_Verbauliste_neu.VL1_ADR_getrennt = SigVal;
                    break;
                case 3:
                    MsgObj_Soll_Verbauliste_neu.VL1_Airbag = SigVal;
                    break;
                case 4:
                    MsgObj_Soll_Verbauliste_neu.VL1_Allrad = SigVal;
                    break;
                case 5:
                    MsgObj_Soll_Verbauliste_neu.VL1_Anhaenger = SigVal;
                    break;
                case 6:
                    MsgObj_Soll_Verbauliste_neu.VL1_BSG_Komf = SigVal;
                    break;
                case 7:
                    MsgObj_Soll_Verbauliste_neu.VL1_Clima_Komf = SigVal;
                    break;
                case 8:
                    MsgObj_Soll_Verbauliste_neu.VL1_DAB = SigVal;
                    break;
                case 9:
                    MsgObj_Soll_Verbauliste_neu.VL1_DSP = SigVal;
                    break;
                case 10:
                    MsgObj_Soll_Verbauliste_neu.VL1_Daempfer = SigVal;
                    break;
                case 11:
                    MsgObj_Soll_Verbauliste_neu.VL1_EPB = SigVal;
                    break;
                case 12:
                    MsgObj_Soll_Verbauliste_neu.VL1_Easy_Entry_VB = SigVal;
                    break;
                case 13:
                    MsgObj_Soll_Verbauliste_neu.VL1_Easy_Entry_VF = SigVal;
                    break;
                case 14:
                    MsgObj_Soll_Verbauliste_neu.VL1_Einparkhilfe = SigVal;
                    break;
                case 15:
                    MsgObj_Soll_Verbauliste_neu.VL1_GSM_Pager = SigVal;
                    break;
                case 16:
                    MsgObj_Soll_Verbauliste_neu.VL1_Gateway = SigVal;
                    break;
                case 17:
                    MsgObj_Soll_Verbauliste_neu.VL1_Getr_SG = SigVal;
                    break;
                case 18:
                    MsgObj_Soll_Verbauliste_neu.VL1_HCA = SigVal;
                    break;
                case 19:
                    MsgObj_Soll_Verbauliste_neu.VL1_Heckdeckel = SigVal;
                    break;
                case 20:
                    MsgObj_Soll_Verbauliste_neu.VL1_InfoElektronik = SigVal;
                    break;
                case 21:
                    MsgObj_Soll_Verbauliste_neu.VL1_Kombi = SigVal;
                    break;
                case 22:
                    MsgObj_Soll_Verbauliste_neu.VL1_Kombi_KBI = SigVal;
                    break;
                case 23:
                    MsgObj_Soll_Verbauliste_neu.VL1_Kompass = SigVal;
                    break;
                case 24:
                    MsgObj_Soll_Verbauliste_neu.VL1_LSM = SigVal;
                    break;
                case 25:
                    MsgObj_Soll_Verbauliste_neu.VL1_Lenkhilfe = SigVal;
                    break;
                case 26:
                    MsgObj_Soll_Verbauliste_neu.VL1_Lenksaeule = SigVal;
                    break;
                case 27:
                    MsgObj_Soll_Verbauliste_neu.VL1_MDI_I = SigVal;
                    break;
                case 28:
                    MsgObj_Soll_Verbauliste_neu.VL1_Memory = SigVal;
                    break;
                case 29:
                    MsgObj_Soll_Verbauliste_neu.VL1_Memory_BF = SigVal;
                    break;
                case 30:
                    MsgObj_Soll_Verbauliste_neu.VL1_MotorSlave = SigVal;
                    break;
                case 31:
                    MsgObj_Soll_Verbauliste_neu.VL1_Motor_SG = SigVal;
                    break;
                case 32:
                    MsgObj_Soll_Verbauliste_neu.VL1_Navigation = SigVal;
                    break;
                case 33:
                    MsgObj_Soll_Verbauliste_neu.VL1_Neigungsmodul_I = SigVal;
                    break;
                case 34:
                    MsgObj_Soll_Verbauliste_neu.VL1_PLA = SigVal;
                    break;
                case 35:
                    MsgObj_Soll_Verbauliste_neu.VL1_PTC_Heizung = SigVal;
                    break;
                case 36:
                    MsgObj_Soll_Verbauliste_neu.VL1_Quersperre = SigVal;
                    break;
                case 37:
                    MsgObj_Soll_Verbauliste_neu.VL1_RDK = SigVal;
                    break;
                case 38:
                    MsgObj_Soll_Verbauliste_neu.VL1_RKA_Plus = SigVal;
                    break;
                case 39:
                    MsgObj_Soll_Verbauliste_neu.VL1_RSE_I = SigVal;
                    break;
                case 40:
                    MsgObj_Soll_Verbauliste_neu.VL1_Radio = SigVal;
                    break;
                case 41:
                    MsgObj_Soll_Verbauliste_neu.VL1_Rearview = SigVal;
                    break;
                case 42:
                    MsgObj_Soll_Verbauliste_neu.VL1_SWA = SigVal;
                    break;
                case 43:
                    MsgObj_Soll_Verbauliste_neu.VL1_Soll_eq_Ist = SigVal;
                    break;
                case 44:
                    MsgObj_Soll_Verbauliste_neu.VL1_Sonderfzg_SG = SigVal;
                    break;
                case 45:
                    MsgObj_Soll_Verbauliste_neu.VL1_Standheiz = SigVal;
                    break;
                case 46:
                    MsgObj_Soll_Verbauliste_neu.VL1_TSG_BT = SigVal;
                    break;
                case 47:
                    MsgObj_Soll_Verbauliste_neu.VL1_TSG_FT = SigVal;
                    break;
                case 48:
                    MsgObj_Soll_Verbauliste_neu.VL1_TSG_HL = SigVal;
                    break;
                case 49:
                    MsgObj_Soll_Verbauliste_neu.VL1_TSG_HR = SigVal;
                    break;
            }

            switch (SigIdx)
            {
                case 50:
                    MsgObj_Soll_Verbauliste_neu.VL1_TV_Tuner = SigVal;
                    break;
                case 51:
                    MsgObj_Soll_Verbauliste_neu.VL1_Tastenmodul = SigVal;
                    break;
                case 52:
                    MsgObj_Soll_Verbauliste_neu.VL1_Telefon = SigVal;
                    break;
                case 53:
                    MsgObj_Soll_Verbauliste_neu.VL1_Telematik = SigVal;
                    break;
                case 54:
                    MsgObj_Soll_Verbauliste_neu.VL1_Verdeck = SigVal;
                    break;
                case 55:
                    MsgObj_Soll_Verbauliste_neu.VL1_WFS_K = SigVal;
                    break;
                case 56:
                    MsgObj_Soll_Verbauliste_neu.VL1_WFS_KBI = SigVal;
                    break;
                case 57:
                    MsgObj_Soll_Verbauliste_neu.VL1_ZKE = SigVal;
                    break;
                case 58:
                    MsgObj_Soll_Verbauliste_neu.VL1_Zentralelektrik_II = SigVal;
                    break;
                case 59:
                    MsgObj_Soll_Verbauliste_neu.VL1_dyn_LWR = SigVal;
                    break;
                case 60:
                    MsgObj_Soll_Verbauliste_neu.VL1_res_08 = SigVal;
                    break;
                case 61:
                    MsgObj_Soll_Verbauliste_neu.VL1_res_13 = SigVal;
                    break;
                case 62:
                    MsgObj_Soll_Verbauliste_neu.VL1_res_31 = SigVal;
                    break;
                case 63:
                    MsgObj_Soll_Verbauliste_neu.VL1_res_42 = SigVal;
                    break;
            }
        }
        break;
        case FRM_HANDLE_Systeminfo_1:
        {
            switch (SigIdx)
            {
                case 0:
                    MsgObj_Systeminfo_1.SY1_Ant_HV = SigVal;
                    break;
                case 1:
                    MsgObj_Systeminfo_1.SY1_Ant_NV = SigVal;
                    break;
                case 2:
                    MsgObj_Systeminfo_1.SY1_CAN_Info = SigVal;
                    break;
                case 3:
                    MsgObj_Systeminfo_1.SY1_CAN_extern = SigVal;
                    break;
                case 4:
                    MsgObj_Systeminfo_1.SY1_Diag_Ant = SigVal;
                    break;
                case 5:
                    MsgObj_Systeminfo_1.SY1_Diag_Info = SigVal;
                    break;
                case 6:
                    MsgObj_Systeminfo_1.SY1_Diag_Komf = SigVal;
                    break;
                case 7:
                    MsgObj_Systeminfo_1.SY1_ELV_Lock_Supply = SigVal;
                    break;
                case 8:
                    MsgObj_Systeminfo_1.SY1_Fehlereintr = SigVal;
                    break;
                case 9:
                    MsgObj_Systeminfo_1.SY1_Fzg_Derivat = SigVal;
                    break;
                case 10:
                    MsgObj_Systeminfo_1.SY1_Fzg_Gen = SigVal;
                    break;
                case 11:
                    MsgObj_Systeminfo_1.SY1_Fzg_Index = SigVal;
                    break;
                case 12:
                    MsgObj_Systeminfo_1.SY1_Fzg_Klasse = SigVal;
                    break;
                case 13:
                    MsgObj_Systeminfo_1.SY1_Fzg_Marke = SigVal;
                    break;
                case 14:
                    MsgObj_Systeminfo_1.SY1_Komf_HV = SigVal;
                    break;
                case 15:
                    MsgObj_Systeminfo_1.SY1_Komf_NV = SigVal;
                    break;
                case 16:
                    MsgObj_Systeminfo_1.SY1_Lenker = SigVal;
                    break;
                case 17:
                    MsgObj_Systeminfo_1.SY1_NWDF = SigVal;
                    break;
                case 18:
                    MsgObj_Systeminfo_1.SY1_NWDF_gueltig = SigVal;
                    break;
                case 19:
                    MsgObj_Systeminfo_1.SY1_Notbrems_Status = SigVal;
                    break;
                case 20:
                    MsgObj_Systeminfo_1.SY1_QRS_Messmodus = SigVal;
                    break;
                case 21:
                    MsgObj_Systeminfo_1.SY1_Relais_FAS_Zweig = SigVal;
                    break;
                case 22:
                    MsgObj_Systeminfo_1.SY1_Sleep_Info = SigVal;
                    break;
                case 23:
                    MsgObj_Systeminfo_1.SY1_Sleep_Komf = SigVal;
                    break;
                case 24:
                    MsgObj_Systeminfo_1.SY1_Transportmode = SigVal;
                    break;
                case 25:
                    MsgObj_Systeminfo_1.SY1_Tueren = SigVal;
                    break;
                case 26:
                    MsgObj_Systeminfo_1.SY1_Verbauinfo = SigVal;
                    break;
                case 27:
                    MsgObj_Systeminfo_1.SY1_res52 = SigVal;
                    break;
                case 28:
                    MsgObj_Systeminfo_1.SY1_res53 = SigVal;
                    break;
                case 29:
                    MsgObj_Systeminfo_1.SY1_res54 = SigVal;
                    break;
                case 30:
                    MsgObj_Systeminfo_1.SY1_res55 = SigVal;
                    break;
                case 31:
                    MsgObj_Systeminfo_1.SY1_res57 = SigVal;
                    break;
                case 32:
                    MsgObj_Systeminfo_1.SY1_res58 = SigVal;
                    break;
                case 33:
                    MsgObj_Systeminfo_1.SY1_res59 = SigVal;
                    break;
                case 34:
                    MsgObj_Systeminfo_1.SY1_res60 = SigVal;
                    break;
                case 35:
                    MsgObj_Systeminfo_1.SY1_res61 = SigVal;
                    break;
                case 36:
                    MsgObj_Systeminfo_1.SY1_res62 = SigVal;
                    break;
                case 37:
                    MsgObj_Systeminfo_1.SY1_res63 = SigVal;
                    break;
            }
        }
        break;
        case FRM_HANDLE_TOG:
        {
            switch (SigIdx)
            {
                case 0:
                    MsgObj_TOG.TOG_Fuellstand_1 = SigVal;
                    break;
                case 1:
                    MsgObj_TOG.TOG_Fuellstand_2 = SigVal;
                    break;
                case 2:
                    MsgObj_TOG.TOG_Fuellstand_3 = SigVal;
                    break;
                case 3:
                    MsgObj_TOG.TOG_Fuellstand_4 = SigVal;
                    break;
                case 4:
                    MsgObj_TOG.TOG_OelmaxUeber = SigVal;
                    break;
                case 5:
                    MsgObj_TOG.TOG_Oelmax_hoch = SigVal;
                    break;
                case 6:
                    MsgObj_TOG.TOG_Oeltempzeit = SigVal;
                    break;
                case 7:
                    MsgObj_TOG.TOG_OelwarnUeber = SigVal;
                    break;
                case 8:
                    MsgObj_TOG.TOG_Oelwarn_hoch = SigVal;
                    break;
                case 9:
                    MsgObj_TOG.TOG_Reserve1 = SigVal;
                    break;
                case 10:
                    MsgObj_TOG.TOG_Sensorfehler = SigVal;
                    break;
                case 11:
                    MsgObj_TOG.TOG_Zaehler = SigVal;
                    break;
            }
        }
        break;
        case FRM_HANDLE_ZAS_1:
        {
            switch (SigIdx)
            {
                case 0:
                    MsgObj_ZAS_1.CHK_ZAS = SigVal;
                    break;
                case 1:
                    MsgObj_ZAS_1.ZA1_Klemme_15 = SigVal;
                    break;
                case 2:
                    MsgObj_ZAS_1.ZA1_Klemme_50 = SigVal;
                    break;
                case 3:
                    MsgObj_ZAS_1.ZA1_Klemme_P = SigVal;
                    break;
                case 4:
                    MsgObj_ZAS_1.ZA1_Klemme_SV = SigVal;
                    break;
                case 5:
                    MsgObj_ZAS_1.ZA1_Klemme_X = SigVal;
                    break;
                case 6:
                    MsgObj_ZAS_1.ZA1_Reserve1 = SigVal;
                    break;
                case 7:
                    MsgObj_ZAS_1.ZA1_S_Kontakt = SigVal;
                    break;
                case 8:
                    MsgObj_ZAS_1.ZA1_res07 = SigVal;
                    break;
                case 9:
                    MsgObj_ZAS_1.Zaehler_ZAS = SigVal;
                    break;
            }
        }
        break;
    }
}
/*@@end*/

/*@@caplFunc:GetSignalVal(int,int):*/
int GetSignalVal (int FrmIdx, int SigIdx)
{
    int SigVal;

    switch (FrmIdx)
    {
        case FRM_HANDLE_ACC_1:
        {
            switch (SigIdx)
            {
                case 0:
                    SigVal = MsgObj_ACC_1.AWV1_Freigabe;
                    break;
                case 1:
                    SigVal = MsgObj_ACC_1.AWV1_Parameter_HBA;
                    break;
                case 2:
                    SigVal = MsgObj_ACC_1.AWV1_Parameter_Nachtreten_HBA;
                    break;
                case 3:
                    SigVal = MsgObj_ACC_1.AWV1_Prefill;
                    break;
                case 4:
                    SigVal = MsgObj_ACC_1.AWV2_Freigabe;
                    break;
                case 5:
                    SigVal = MsgObj_ACC_1.AWV2_Priowarnung_LDW;
                    break;
                case 6:
                    SigVal = MsgObj_ACC_1.AWV2_Ruckprofil;
                    break;
                case 7:
                    SigVal = MsgObj_ACC_1.Anhalten;
                    break;
                case 8:
                    SigVal = MsgObj_ACC_1.BZ_ACC1;
                    break;
                case 9:
                    SigVal = MsgObj_ACC_1.CHK_ACC1;
                    break;
                case 10:
                    SigVal = MsgObj_ACC_1.Dynamik_Bremsdruck;
                    break;
                case 11:
                    SigVal = MsgObj_ACC_1.ESP_Beeinflussung_ACC;
                    break;
                case 12:
                    SigVal = MsgObj_ACC_1.FSPE_ACC;
                    break;
                case 13:
                    SigVal = MsgObj_ACC_1.Freigabe_Momenten_Anf;
                    break;
                case 14:
                    SigVal = MsgObj_ACC_1.Freigabe_Verzoeg_Anf;
                    break;
                case 15:
                    SigVal = MsgObj_ACC_1.Momenten_Anf_ACC;
                    break;
                case 16:
                    SigVal = MsgObj_ACC_1.Sender_Info;
                    break;
                case 17:
                    SigVal = MsgObj_ACC_1.Sollbeschl_Getr;
                    break;
                case 18:
                    SigVal = MsgObj_ACC_1.Status_ACC;
                    break;
                case 19:
                    SigVal = MsgObj_ACC_1.Verhinderung_SA;
                    break;
                case 20:
                    SigVal = MsgObj_ACC_1.Verzoeg_Anf_ACC;
                    break;
                case 21:
                    SigVal = MsgObj_ACC_1.Vorbefuellung_Bremsanlage;
                    break;
            }
        }
        break;
        case FRM_HANDLE_ACC_System:
        {
            switch (SigIdx)
            {
                case 0:
                    SigVal = MsgObj_ACC_System.ACS_ADR_Schub;
                    break;
                case 1:
                    SigVal = MsgObj_ACC_System.ACS_Anhaltewunsch;
                    break;
                case 2:
                    SigVal = MsgObj_ACC_System.ACS_Checksum;
                    break;
                case 3:
                    SigVal = MsgObj_ACC_System.ACS_Fehler;
                    break;
                case 4:
                    SigVal = MsgObj_ACC_System.ACS_FreigSollB;
                    break;
                case 5:
                    SigVal = MsgObj_ACC_System.ACS_MomEingriff;
                    break;
                case 6:
                    SigVal = MsgObj_ACC_System.ACS_Schubabsch;
                    break;
                case 7:
                    SigVal = MsgObj_ACC_System.ACS_Sollbeschl;
                    break;
                case 8:
                    SigVal = MsgObj_ACC_System.ACS_StSt_Info;
                    break;
                case 9:
                    SigVal = MsgObj_ACC_System.ACS_Sta_ADR;
                    break;
                case 10:
                    SigVal = MsgObj_ACC_System.ACS_Typ_ACC;
                    break;
                case 11:
                    SigVal = MsgObj_ACC_System.ACS_Zaehler;
                    break;
                case 12:
                    SigVal = MsgObj_ACC_System.ACS_max_AendGrad;
                    break;
                case 13:
                    SigVal = MsgObj_ACC_System.ACS_res_21;
                    break;
                case 14:
                    SigVal = MsgObj_ACC_System.ACS_res_35;
                    break;
                case 15:
                    SigVal = MsgObj_ACC_System.ACS_res_36;
                    break;
                case 16:
                    SigVal = MsgObj_ACC_System.ACS_res_37;
                    break;
                case 17:
                    SigVal = MsgObj_ACC_System.ACS_res_56;
                    break;
                case 18:
                    SigVal = MsgObj_ACC_System.ACS_res_57;
                    break;
                case 19:
                    SigVal = MsgObj_ACC_System.ACS_res_58;
                    break;
                case 20:
                    SigVal = MsgObj_ACC_System.ACS_res_59;
                    break;
                case 21:
                    SigVal = MsgObj_ACC_System.ACS_res_60;
                    break;
                case 22:
                    SigVal = MsgObj_ACC_System.ACS_res_61;
                    break;
                case 23:
                    SigVal = MsgObj_ACC_System.ACS_res_62;
                    break;
                case 24:
                    SigVal = MsgObj_ACC_System.ACS_res_63;
                    break;
                case 25:
                    SigVal = MsgObj_ACC_System.ACS_zul_Regelabw;
                    break;
            }
        }
        break;
        case FRM_HANDLE_Airbag_1:
        {
            switch (SigIdx)
            {
                case 0:
                    SigVal = MsgObj_Airbag_1.AB1_BF_Warnung;
                    break;
                case 1:
                    SigVal = MsgObj_Airbag_1.AB1_Beifahrer;
                    break;
                case 2:
                    SigVal = MsgObj_Airbag_1.AB1_Bf_Seite;
                    break;
                case 3:
                    SigVal = MsgObj_Airbag_1.AB1_Checksumme;
                    break;
                case 4:
                    SigVal = MsgObj_Airbag_1.AB1_Diagnose;
                    break;
                case 5:
                    SigVal = MsgObj_Airbag_1.AB1_Fa_Seite;
                    break;
                case 6:
                    SigVal = MsgObj_Airbag_1.AB1_Fehlereintr;
                    break;
                case 7:
                    SigVal = MsgObj_Airbag_1.AB1_Front;
                    break;
                case 8:
                    SigVal = MsgObj_Airbag_1.AB1_Gurt_Bf;
                    break;
                case 9:
                    SigVal = MsgObj_Airbag_1.AB1_Gurt_Fa;
                    break;
                case 10:
                    SigVal = MsgObj_Airbag_1.AB1_Heck;
                    break;
                case 11:
                    SigVal = MsgObj_Airbag_1.AB1_Intens;
                    break;
                case 12:
                    SigVal = MsgObj_Airbag_1.AB1_Lampe;
                    break;
                case 13:
                    SigVal = MsgObj_Airbag_1.AB1_Rollover;
                    break;
                case 14:
                    SigVal = MsgObj_Airbag_1.AB1_Status;
                    break;
                case 15:
                    SigVal = MsgObj_Airbag_1.AB1_Stellglied;
                    break;
                case 16:
                    SigVal = MsgObj_Airbag_1.AB1_System;
                    break;
                case 17:
                    SigVal = MsgObj_Airbag_1.AB1_Zaehler;
                    break;
            }
        }
        break;
        case FRM_HANDLE_Allrad_1:
        {
            switch (SigIdx)
            {
                case 0:
                    SigVal = MsgObj_Allrad_1.AL1_AnfVerteiler;
                    break;
                case 1:
                    SigVal = MsgObj_Allrad_1.AL1_Anz_blinken;
                    break;
                case 2:
                    SigVal = MsgObj_Allrad_1.AL1_Begrenzungsmo;
                    break;
                case 3:
                    SigVal = MsgObj_Allrad_1.AL1_Diff_Gong;
                    break;
                case 4:
                    SigVal = MsgObj_Allrad_1.AL1_Diff_Lampe;
                    break;
                case 5:
                    SigVal = MsgObj_Allrad_1.AL1_Diff_Verbau;
                    break;
                case 6:
                    SigVal = MsgObj_Allrad_1.AL1_Einheit;
                    break;
                case 7:
                    SigVal = MsgObj_Allrad_1.AL1_FaWu_HA;
                    break;
                case 8:
                    SigVal = MsgObj_Allrad_1.AL1_FaWu_Laengs;
                    break;
                case 9:
                    SigVal = MsgObj_Allrad_1.AL1_FaWu_VA;
                    break;
                case 10:
                    SigVal = MsgObj_Allrad_1.AL1_Fehler;
                    break;
                case 11:
                    SigVal = MsgObj_Allrad_1.AL1_Fehlereintr;
                    break;
                case 12:
                    SigVal = MsgObj_Allrad_1.AL1_Ist_Nm;
                    break;
                case 13:
                    SigVal = MsgObj_Allrad_1.AL1_Ist_Proz;
                    break;
                case 14:
                    SigVal = MsgObj_Allrad_1.AL1_KupSteifig_F;
                    break;
                case 15:
                    SigVal = MsgObj_Allrad_1.AL1_Kup_offen;
                    break;
                case 16:
                    SigVal = MsgObj_Allrad_1.AL1_Limit_maxkmh;
                    break;
                case 17:
                    SigVal = MsgObj_Allrad_1.AL1_Limiter;
                    break;
                case 18:
                    SigVal = MsgObj_Allrad_1.AL1_Notlauf;
                    break;
                case 19:
                    SigVal = MsgObj_Allrad_1.AL1_Quersp_Sta;
                    break;
                case 20:
                    SigVal = MsgObj_Allrad_1.AL1_Reserve2;
                    break;
                case 21:
                    SigVal = MsgObj_Allrad_1.AL1_Schalten;
                    break;
                case 22:
                    SigVal = MsgObj_Allrad_1.AL1_Sta_Kup;
                    break;
                case 23:
                    SigVal = MsgObj_Allrad_1.AL1_Sta_Laengssp;
                    break;
                case 24:
                    SigVal = MsgObj_Allrad_1.AL1_Sta_PNG;
                    break;
                case 25:
                    SigVal = MsgObj_Allrad_1.AL1_Sta_Quersp;
                    break;
                case 26:
                    SigVal = MsgObj_Allrad_1.AL1_Sta_VA;
                    break;
                case 27:
                    SigVal = MsgObj_Allrad_1.AL1_Stellung_Getr;
                    break;
                case 28:
                    SigVal = MsgObj_Allrad_1.AL1_Uebertemp;
                    break;
                case 29:
                    SigVal = MsgObj_Allrad_1.AL1_Vorwarnung;
                    break;
                case 30:
                    SigVal = MsgObj_Allrad_1.AL1_Warnlampe;
                    break;
                case 31:
                    SigVal = MsgObj_Allrad_1.AL1_Zaehler;
                    break;
            }
        }
        break;
        case FRM_HANDLE_BEM_1:
        {
            switch (SigIdx)
            {
                case 0:
                    SigVal = MsgObj_BEM_1.Abschalt_Heizsysteme;
                    break;
                case 1:
                    SigVal = MsgObj_BEM_1.Abschaltstufen;
                    break;
                case 2:
                    SigVal = MsgObj_BEM_1.Anforderung_HSH;
                    break;
                case 3:
                    SigVal = MsgObj_BEM_1.Anforderung_Kluefter_;
                    break;
                case 4:
                    SigVal = MsgObj_BEM_1.BEM_Batteriespannung;
                    break;
                case 5:
                    SigVal = MsgObj_BEM_1.BEM_StSt_Info;
                    break;
                case 6:
                    SigVal = MsgObj_BEM_1.BZ_BEM1;
                    break;
                case 7:
                    SigVal = MsgObj_BEM_1.CHK_BEM1;
                    break;
                case 8:
                    SigVal = MsgObj_BEM_1.Einschaltung_PTC_Hzg;
                    break;
                case 9:
                    SigVal = MsgObj_BEM_1.Generator_Lastmoment;
                    break;
                case 10:
                    SigVal = MsgObj_BEM_1.Generator_Leistungsaufnahme;
                    break;
                case 11:
                    SigVal = MsgObj_BEM_1.HL_Systeme_Status;
                    break;
                case 12:
                    SigVal = MsgObj_BEM_1.HL_Systemregelung_Status;
                    break;
                case 13:
                    SigVal = MsgObj_BEM_1.Lastabwurf_Rueckmeldung;
                    break;
                case 14:
                    SigVal = MsgObj_BEM_1.Leerlaufdrehzahl_Erhoehung;
                    break;
                case 15:
                    SigVal = MsgObj_BEM_1.Load_Response_Generator;
                    break;
                case 16:
                    SigVal = MsgObj_BEM_1.Red_Innenraumgeblaese;
                    break;
                case 17:
                    SigVal = MsgObj_BEM_1.Ruecknahme_HSH;
                    break;
            }
        }
        break;
        case FRM_HANDLE_BSG_Last:
        {
            switch (SigIdx)
            {
                case 0:
                    SigVal = MsgObj_BSG_Last.BSL_Ab_Batterie;
                    break;
                case 1:
                    SigVal = MsgObj_BSG_Last.BSL_Aussensp;
                    break;
                case 2:
                    SigVal = MsgObj_BSG_Last.BSL_BSG_2_alt;
                    break;
                case 3:
                    SigVal = MsgObj_BSG_Last.BSL_BSG_3_alt;
                    break;
                case 4:
                    SigVal = MsgObj_BSG_Last.BSL_Clima;
                    break;
                case 5:
                    SigVal = MsgObj_BSG_Last.BSL_DFM;
                    break;
                case 6:
                    SigVal = MsgObj_BSG_Last.BSL_Fehlereintr;
                    break;
                case 7:
                    SigVal = MsgObj_BSG_Last.BSL_Frontsch;
                    break;
                case 8:
                    SigVal = MsgObj_BSG_Last.BSL_Hecksch;
                    break;
                case 9:
                    SigVal = MsgObj_BSG_Last.BSL_Kl_15_Motor;
                    break;
                case 10:
                    SigVal = MsgObj_BSG_Last.BSL_Kl_L;
                    break;
                case 11:
                    SigVal = MsgObj_BSG_Last.BSL_Kuehlerlueft;
                    break;
                case 12:
                    SigVal = MsgObj_BSG_Last.BSL_LL_Anheb;
                    break;
                case 13:
                    SigVal = MsgObj_BSG_Last.BSL_LL_Anheb2;
                    break;
                case 14:
                    SigVal = MsgObj_BSG_Last.BSL_Lenkradheiz;
                    break;
                case 15:
                    SigVal = MsgObj_BSG_Last.BSL_Motor_Haube;
                    break;
                case 16:
                    SigVal = MsgObj_BSG_Last.BSL_Parklicht;
                    break;
                case 17:
                    SigVal = MsgObj_BSG_Last.BSL_Sitzbelueft;
                    break;
                case 18:
                    SigVal = MsgObj_BSG_Last.BSL_Sitzheiz;
                    break;
                case 19:
                    SigVal = MsgObj_BSG_Last.BSL_Sta_LWR;
                    break;
                case 20:
                    SigVal = MsgObj_BSG_Last.BSL_Sta_StBat;
                    break;
                case 21:
                    SigVal = MsgObj_BSG_Last.BSL_Sta_UBat;
                    break;
                case 22:
                    SigVal = MsgObj_BSG_Last.BSL_Starterlaubnis;
                    break;
                case 23:
                    SigVal = MsgObj_BSG_Last.BSL_UBat;
                    break;
                case 24:
                    SigVal = MsgObj_BSG_Last.BSL_Wake_Up_ACAN;
                    break;
                case 25:
                    SigVal = MsgObj_BSG_Last.BSL_Wasserheiz;
                    break;
                case 26:
                    SigVal = MsgObj_BSG_Last.BSL_Weckursache_ACAN;
                    break;
                case 27:
                    SigVal = MsgObj_BSG_Last.BSL_ZAS_Kl_15;
                    break;
                case 28:
                    SigVal = MsgObj_BSG_Last.BSL_ZAS_Kl_50;
                    break;
                case 29:
                    SigVal = MsgObj_BSG_Last.BSL_ZAS_Kl_S;
                    break;
                case 30:
                    SigVal = MsgObj_BSG_Last.BSL_ZAS_Kl_X;
                    break;
            }
        }
        break;
        case FRM_HANDLE_Batman_1:
        {
            switch (SigIdx)
            {
                case 0:
                    SigVal = MsgObj_Batman_1.BEM_EM_LIN_ungueltig;
                    break;
                case 1:
                    SigVal = MsgObj_Batman_1.BEM_P_Generator;
                    break;
                case 2:
                    SigVal = MsgObj_Batman_1.BM1_BEM_Reku_Aktiv;
                    break;
                case 3:
                    SigVal = MsgObj_Batman_1.BM1_DFM;
                    break;
                case 4:
                    SigVal = MsgObj_Batman_1.BM1_Fehlereintr;
                    break;
                case 5:
                    SigVal = MsgObj_Batman_1.BM1_Mess_Leitung;
                    break;
                case 6:
                    SigVal = MsgObj_Batman_1.BM1_Relais;
                    break;
                case 7:
                    SigVal = MsgObj_Batman_1.BM1_Sta_Leitung;
                    break;
                case 8:
                    SigVal = MsgObj_Batman_1.BM1_Sta_Relais;
                    break;
                case 9:
                    SigVal = MsgObj_Batman_1.BM1_Sta_StBat;
                    break;
                case 10:
                    SigVal = MsgObj_Batman_1.BM1_Startmodus;
                    break;
            }
        }
        break;
        case FRM_HANDLE_Booster_1:
        {
            switch (SigIdx)
            {
                case 0:
                    SigVal = MsgObj_Booster_1.BO1_AWV2_Bremsruck;
                    break;
                case 1:
                    SigVal = MsgObj_Booster_1.BO1_AWV2_Fehler;
                    break;
                case 2:
                    SigVal = MsgObj_Booster_1.BO1_Anf_EPB_Span;
                    break;
                case 3:
                    SigVal = MsgObj_Booster_1.BO1_Anf_EPB_aus;
                    break;
                case 4:
                    SigVal = MsgObj_Booster_1.BO1_Anf_EPB_ein;
                    break;
                case 5:
                    SigVal = MsgObj_Booster_1.BO1_Checksumme;
                    break;
                case 6:
                    SigVal = MsgObj_Booster_1.BO1_Fa_bremst;
                    break;
                case 7:
                    SigVal = MsgObj_Booster_1.BO1_Freigabe_EPB;
                    break;
                case 8:
                    SigVal = MsgObj_Booster_1.BO1_KD_Fehler;
                    break;
                case 9:
                    SigVal = MsgObj_Booster_1.BO1_Laengsbeschl;
                    break;
                case 10:
                    SigVal = MsgObj_Booster_1.BO1_StaBrSyst;
                    break;
                case 11:
                    SigVal = MsgObj_Booster_1.BO1_Sta_ACC_Anf;
                    break;
                case 12:
                    SigVal = MsgObj_Booster_1.BO1_Sta_ADR_BR;
                    break;
                case 13:
                    SigVal = MsgObj_Booster_1.BO1_Sta_BLS;
                    break;
                case 14:
                    SigVal = MsgObj_Booster_1.BO1_Sta_Br_Druck;
                    break;
                case 15:
                    SigVal = MsgObj_Booster_1.BO1_Sta_VerzReg;
                    break;
                case 16:
                    SigVal = MsgObj_Booster_1.BO1_Verz_EPB_akt;
                    break;
                case 17:
                    SigVal = MsgObj_Booster_1.BO1_Zaehler;
                    break;
                case 18:
                    SigVal = MsgObj_Booster_1.BO1_aktBrSyst;
                    break;
                case 19:
                    SigVal = MsgObj_Booster_1.BO1_res_14;
                    break;
                case 20:
                    SigVal = MsgObj_Booster_1.BO1_res_16;
                    break;
                case 21:
                    SigVal = MsgObj_Booster_1.BO1_res_17;
                    break;
                case 22:
                    SigVal = MsgObj_Booster_1.BO1_res_22;
                    break;
                case 23:
                    SigVal = MsgObj_Booster_1.BO1_res_25;
                    break;
                case 24:
                    SigVal = MsgObj_Booster_1.BO1_res_27;
                    break;
                case 25:
                    SigVal = MsgObj_Booster_1.BO1_res_28;
                    break;
                case 26:
                    SigVal = MsgObj_Booster_1.BO1_res_29;
                    break;
                case 27:
                    SigVal = MsgObj_Booster_1.BO1_res_30;
                    break;
                case 28:
                    SigVal = MsgObj_Booster_1.BO1_res_31;
                    break;
                case 29:
                    SigVal = MsgObj_Booster_1.BO1_res_32;
                    break;
                case 30:
                    SigVal = MsgObj_Booster_1.BO1_res_41;
                    break;
                case 31:
                    SigVal = MsgObj_Booster_1.BO1_res_42;
                    break;
                case 32:
                    SigVal = MsgObj_Booster_1.BO1_res_43;
                    break;
                case 33:
                    SigVal = MsgObj_Booster_1.BO1_res_44;
                    break;
                case 34:
                    SigVal = MsgObj_Booster_1.BO1_res_59;
                    break;
                case 35:
                    SigVal = MsgObj_Booster_1.BO1_res_62;
                    break;
                case 36:
                    SigVal = MsgObj_Booster_1.BO1_res_63;
                    break;
            }
        }
        break;
        case FRM_HANDLE_Bremse_1:
        {
            switch (SigIdx)
            {
                case 0:
                    SigVal = MsgObj_Bremse_1.BR1_ABS_Brems;
                    break;
                case 1:
                    SigVal = MsgObj_Bremse_1.BR1_ASRMo_fa;
                    break;
                case 2:
                    SigVal = MsgObj_Bremse_1.BR1_ASRMo_sl;
                    break;
                case 3:
                    SigVal = MsgObj_Bremse_1.BR1_ASR_Anf;
                    break;
                case 4:
                    SigVal = MsgObj_Bremse_1.BR1_ASR_ESP;
                    break;
                case 5:
                    SigVal = MsgObj_Bremse_1.BR1_ASR_Eingr;
                    break;
                case 6:
                    SigVal = MsgObj_Bremse_1.BR1_BKV_aktiv;
                    break;
                case 7:
                    SigVal = MsgObj_Bremse_1.BR1_Diagnose;
                    break;
                case 8:
                    SigVal = MsgObj_Bremse_1.BR1_EBV_Eingr;
                    break;
                case 9:
                    SigVal = MsgObj_Bremse_1.BR1_EDS_Eingr;
                    break;
                case 10:
                    SigVal = MsgObj_Bremse_1.BR1_ESPASR_passiv;
                    break;
                case 11:
                    SigVal = MsgObj_Bremse_1.BR1_ESP_Eingr;
                    break;
                case 12:
                    SigVal = MsgObj_Bremse_1.BR1_Ersatz_Kmh;
                    break;
                case 13:
                    SigVal = MsgObj_Bremse_1.BR1_Lampe_ABS;
                    break;
                case 14:
                    SigVal = MsgObj_Bremse_1.BR1_Lampe_ASR;
                    break;
                case 15:
                    SigVal = MsgObj_Bremse_1.BR1_Lampe_BK;
                    break;
                case 16:
                    SigVal = MsgObj_Bremse_1.BR1_Lichtschalt;
                    break;
                case 17:
                    SigVal = MsgObj_Bremse_1.BR1_MAD;
                    break;
                case 18:
                    SigVal = MsgObj_Bremse_1.BR1_MSR_Anf;
                    break;
                case 19:
                    SigVal = MsgObj_Bremse_1.BR1_MSR_Mo;
                    break;
                case 20:
                    SigVal = MsgObj_Bremse_1.BR1_MSR_Mo_inv;
                    break;
                case 21:
                    SigVal = MsgObj_Bremse_1.BR1_Rad_kmh;
                    break;
                case 22:
                    SigVal = MsgObj_Bremse_1.BR1_StaDruckschw;
                    break;
                case 23:
                    SigVal = MsgObj_Bremse_1.BR1_Sta_ESP;
                    break;
                case 24:
                    SigVal = MsgObj_Bremse_1.BR1_Sta_MAD;
                    break;
                case 25:
                    SigVal = MsgObj_Bremse_1.BR1_Zaehler;
                    break;
            }
        }
        break;
        case FRM_HANDLE_Bremse_10:
        {
            switch (SigIdx)
            {
                case 0:
                    SigVal = MsgObj_Bremse_10.B10_Checksumme;
                    break;
                case 1:
                    SigVal = MsgObj_Bremse_10.B10_Fahrtr_HL;
                    break;
                case 2:
                    SigVal = MsgObj_Bremse_10.B10_Fahrtr_HR;
                    break;
                case 3:
                    SigVal = MsgObj_Bremse_10.B10_Fahrtr_VL;
                    break;
                case 4:
                    SigVal = MsgObj_Bremse_10.B10_Fahrtr_VR;
                    break;
                case 5:
                    SigVal = MsgObj_Bremse_10.B10_QB_Fahrtr_HL;
                    break;
                case 6:
                    SigVal = MsgObj_Bremse_10.B10_QB_Fahrtr_HR;
                    break;
                case 7:
                    SigVal = MsgObj_Bremse_10.B10_QB_Fahrtr_VL;
                    break;
                case 8:
                    SigVal = MsgObj_Bremse_10.B10_QB_Fahrtr_VR;
                    break;
                case 9:
                    SigVal = MsgObj_Bremse_10.B10_QB_Wegimp_HL;
                    break;
                case 10:
                    SigVal = MsgObj_Bremse_10.B10_QB_Wegimp_HR;
                    break;
                case 11:
                    SigVal = MsgObj_Bremse_10.B10_QB_Wegimp_VL;
                    break;
                case 12:
                    SigVal = MsgObj_Bremse_10.B10_QB_Wegimp_VR;
                    break;
                case 13:
                    SigVal = MsgObj_Bremse_10.B10_Wegimp_HL;
                    break;
                case 14:
                    SigVal = MsgObj_Bremse_10.B10_Wegimp_HR;
                    break;
                case 15:
                    SigVal = MsgObj_Bremse_10.B10_Wegimp_VL;
                    break;
                case 16:
                    SigVal = MsgObj_Bremse_10.B10_Wegimp_VR;
                    break;
                case 17:
                    SigVal = MsgObj_Bremse_10.B10_Zaehler;
                    break;
            }
        }
        break;
        case FRM_HANDLE_Bremse_11:
        {
            switch (SigIdx)
            {
                case 0:
                    SigVal = MsgObj_Bremse_11.B11_Br_StSt_Info;
                    break;
                case 1:
                    SigVal = MsgObj_Bremse_11.B11_EPB_Steller_akt;
                    break;
                case 2:
                    SigVal = MsgObj_Bremse_11.B11_EPB_Steller_gue;
                    break;
                case 3:
                    SigVal = MsgObj_Bremse_11.B11_HydHalten;
                    break;
                case 4:
                    SigVal = MsgObj_Bremse_11.B11_OBD_Nib_HL;
                    break;
                case 5:
                    SigVal = MsgObj_Bremse_11.B11_OBD_Nib_HR;
                    break;
                case 6:
                    SigVal = MsgObj_Bremse_11.B11_OBD_Nib_VL;
                    break;
                case 7:
                    SigVal = MsgObj_Bremse_11.B11_OBD_Nib_VR;
                    break;
                case 8:
                    SigVal = MsgObj_Bremse_11.BR11_Checksumme;
                    break;
                case 9:
                    SigVal = MsgObj_Bremse_11.BR11_Zaehler;
                    break;
            }
        }
        break;
        case FRM_HANDLE_Bremse_2:
        {
            switch (SigIdx)
            {
                case 0:
                    SigVal = MsgObj_Bremse_2.BR2_Aku_Warn;
                    break;
                case 1:
                    SigVal = MsgObj_Bremse_2.BR2_Blinkmode;
                    break;
                case 2:
                    SigVal = MsgObj_Bremse_2.BR2_Fehlereintr;
                    break;
                case 3:
                    SigVal = MsgObj_Bremse_2.BR2_HDC_aktiv;
                    break;
                case 4:
                    SigVal = MsgObj_Bremse_2.BR2_Impulszahl;
                    break;
                case 5:
                    SigVal = MsgObj_Bremse_2.BR2_LampeHDC;
                    break;
                case 6:
                    SigVal = MsgObj_Bremse_2.BR2_Lampe_ABS;
                    break;
                case 7:
                    SigVal = MsgObj_Bremse_2.BR2_Lampe_ASR;
                    break;
                case 8:
                    SigVal = MsgObj_Bremse_2.BR2_Lampe_BK;
                    break;
                case 9:
                    SigVal = MsgObj_Bremse_2.BR2_Lampe_RKA;
                    break;
                case 10:
                    SigVal = MsgObj_Bremse_2.BR2_QB_Querbeschl;
                    break;
                case 11:
                    SigVal = MsgObj_Bremse_2.BR2_Querb_Zahn;
                    break;
                case 12:
                    SigVal = MsgObj_Bremse_2.BR2_Querbeschl;
                    break;
                case 13:
                    SigVal = MsgObj_Bremse_2.BR2_SleepInd;
                    break;
                case 14:
                    SigVal = MsgObj_Bremse_2.BR2_Sta_Imp;
                    break;
                case 15:
                    SigVal = MsgObj_Bremse_2.BR2_Sta_Quer;
                    break;
                case 16:
                    SigVal = MsgObj_Bremse_2.BR2_Text;
                    break;
                case 17:
                    SigVal = MsgObj_Bremse_2.BR2_Ueberl_Imp;
                    break;
                case 18:
                    SigVal = MsgObj_Bremse_2.BR2_Wegimpulse;
                    break;
                case 19:
                    SigVal = MsgObj_Bremse_2.BR2_Zaehler;
                    break;
                case 20:
                    SigVal = MsgObj_Bremse_2.BR2_Zahnzahl;
                    break;
                case 21:
                    SigVal = MsgObj_Bremse_2.BR2_mi_Radgeschw;
                    break;
            }
        }
        break;
        case FRM_HANDLE_Bremse_3:
        {
            switch (SigIdx)
            {
                case 0:
                    SigVal = MsgObj_Bremse_3.BR3_Fahrtr_HL;
                    break;
                case 1:
                    SigVal = MsgObj_Bremse_3.BR3_Fahrtr_HR;
                    break;
                case 2:
                    SigVal = MsgObj_Bremse_3.BR3_Fahrtr_VL;
                    break;
                case 3:
                    SigVal = MsgObj_Bremse_3.BR3_Fahrtr_VR;
                    break;
                case 4:
                    SigVal = MsgObj_Bremse_3.BR3_Rad_kmh_HL;
                    break;
                case 5:
                    SigVal = MsgObj_Bremse_3.BR3_Rad_kmh_HR;
                    break;
                case 6:
                    SigVal = MsgObj_Bremse_3.BR3_Rad_kmh_VL;
                    break;
                case 7:
                    SigVal = MsgObj_Bremse_3.BR3_Rad_kmh_VR;
                    break;
            }
        }
        break;
        case FRM_HANDLE_Bremse_4:
        {
            switch (SigIdx)
            {
                case 0:
                    SigVal = MsgObj_Bremse_4.BR4_Abschaltung_HL;
                    break;
                case 1:
                    SigVal = MsgObj_Bremse_4.BR4_Abschaltung_HR;
                    break;
                case 2:
                    SigVal = MsgObj_Bremse_4.BR4_Abschaltung_VL;
                    break;
                case 3:
                    SigVal = MsgObj_Bremse_4.BR4_Abschaltung_VR;
                    break;
                case 4:
                    SigVal = MsgObj_Bremse_4.BR4_Checksum;
                    break;
                case 5:
                    SigVal = MsgObj_Bremse_4.BR4_Einheit;
                    break;
                case 6:
                    SigVal = MsgObj_Bremse_4.BR4_Lampe_RKA;
                    break;
                case 7:
                    SigVal = MsgObj_Bremse_4.BR4_Reserve2;
                    break;
                case 8:
                    SigVal = MsgObj_Bremse_4.BR4_Schwelle;
                    break;
                case 9:
                    SigVal = MsgObj_Bremse_4.BR4_Status_ESP;
                    break;
                case 10:
                    SigVal = MsgObj_Bremse_4.BR4_Summer_RKA;
                    break;
                case 11:
                    SigVal = MsgObj_Bremse_4.BR4_Unterdruck;
                    break;
                case 12:
                    SigVal = MsgObj_Bremse_4.BR4_Vorgabe_Hi;
                    break;
                case 13:
                    SigVal = MsgObj_Bremse_4.BR4_Vorgabe_Max;
                    break;
                case 14:
                    SigVal = MsgObj_Bremse_4.BR4_Vorgabe_Mi;
                    break;
                case 15:
                    SigVal = MsgObj_Bremse_4.BR4_Vorgabe_Mi_;
                    break;
                case 16:
                    SigVal = MsgObj_Bremse_4.BR4_Vorgabe_Min;
                    break;
                case 17:
                    SigVal = MsgObj_Bremse_4.BR4_Zaehler;
                    break;
                case 18:
                    SigVal = MsgObj_Bremse_4.BR4_res_42;
                    break;
                case 19:
                    SigVal = MsgObj_Bremse_4.BR4_res_48;
                    break;
            }
        }
        break;
        case FRM_HANDLE_Bremse_5:
        {
            switch (SigIdx)
            {
                case 0:
                    SigVal = MsgObj_Bremse_5.Anfahrhilfe_aktiv;
                    break;
                case 1:
                    SigVal = MsgObj_Bremse_5.BR5_AWV2_Bremsruck;
                    break;
                case 2:
                    SigVal = MsgObj_Bremse_5.BR5_AWV2_Fehler;
                    break;
                case 3:
                    SigVal = MsgObj_Bremse_5.BR5_AnhStabAktiv;
                    break;
                case 4:
                    SigVal = MsgObj_Bremse_5.BR5_Anhi_Sta;
                    break;
                case 5:
                    SigVal = MsgObj_Bremse_5.BR5_Anhi_akt;
                    break;
                case 6:
                    SigVal = MsgObj_Bremse_5.BR5_Bremsdruck;
                    break;
                case 7:
                    SigVal = MsgObj_Bremse_5.BR5_Checksumme;
                    break;
                case 8:
                    SigVal = MsgObj_Bremse_5.BR5_Druckgueltig;
                    break;
                case 9:
                    SigVal = MsgObj_Bremse_5.BR5_ECD_Lampe;
                    break;
                case 10:
                    SigVal = MsgObj_Bremse_5.BR5_ECD_Rueckfall;
                    break;
                case 11:
                    SigVal = MsgObj_Bremse_5.BR5_Giergeschw;
                    break;
                case 12:
                    SigVal = MsgObj_Bremse_5.BR5_Notbremsung;
                    break;
                case 13:
                    SigVal = MsgObj_Bremse_5.BR5_Sign_Druck;
                    break;
                case 14:
                    SigVal = MsgObj_Bremse_5.BR5_Sta_Druck;
                    break;
                case 15:
                    SigVal = MsgObj_Bremse_5.BR5_Sta_Gierrate;
                    break;
                case 16:
                    SigVal = MsgObj_Bremse_5.BR5_Stillstand;
                    break;
                case 17:
                    SigVal = MsgObj_Bremse_5.BR5_Temperatur;
                    break;
                case 18:
                    SigVal = MsgObj_Bremse_5.BR5_TolAbgl_VR;
                    break;
                case 19:
                    SigVal = MsgObj_Bremse_5.BR5_Vorzeichen;
                    break;
                case 20:
                    SigVal = MsgObj_Bremse_5.BR5_Zaehler;
                    break;
                case 21:
                    SigVal = MsgObj_Bremse_5.BR5_v_Ueberw;
                    break;
                case 22:
                    SigVal = MsgObj_Bremse_5.FStatus_Anfahrhilfe;
                    break;
            }
        }
        break;
        case FRM_HANDLE_Bremse_8:
        {
            switch (SigIdx)
            {
                case 0:
                    SigVal = MsgObj_Bremse_8.BR8_AWV1_BasPar;
                    break;
                case 1:
                    SigVal = MsgObj_Bremse_8.BR8_Check_EPB;
                    break;
                case 2:
                    SigVal = MsgObj_Bremse_8.BR8_Checksumme;
                    break;
                case 3:
                    SigVal = MsgObj_Bremse_8.BR8_Fa_bremst;
                    break;
                case 4:
                    SigVal = MsgObj_Bremse_8.BR8_Istbeschl;
                    break;
                case 5:
                    SigVal = MsgObj_Bremse_8.BR8_Laengsbeschl;
                    break;
                case 6:
                    SigVal = MsgObj_Bremse_8.BR8_QB_LBeschl;
                    break;
                case 7:
                    SigVal = MsgObj_Bremse_8.BR8_Quattro;
                    break;
                case 8:
                    SigVal = MsgObj_Bremse_8.BR8_StaBrSyst;
                    break;
                case 9:
                    SigVal = MsgObj_Bremse_8.BR8_Sta_ACC_Anf;
                    break;
                case 10:
                    SigVal = MsgObj_Bremse_8.BR8_Sta_ADR_BR;
                    break;
                case 11:
                    SigVal = MsgObj_Bremse_8.BR8_Sta_BLS;
                    break;
                case 12:
                    SigVal = MsgObj_Bremse_8.BR8_Sta_Br_Druck;
                    break;
                case 13:
                    SigVal = MsgObj_Bremse_8.BR8_Sta_Br_temp;
                    break;
                case 14:
                    SigVal = MsgObj_Bremse_8.BR8_Sta_HW_BLS;
                    break;
                case 15:
                    SigVal = MsgObj_Bremse_8.BR8_Sta_VerzReg;
                    break;
                case 16:
                    SigVal = MsgObj_Bremse_8.BR8_TolAbgl_HL;
                    break;
                case 17:
                    SigVal = MsgObj_Bremse_8.BR8_TolAbgl_HR;
                    break;
                case 18:
                    SigVal = MsgObj_Bremse_8.BR8_Verz_EPB;
                    break;
                case 19:
                    SigVal = MsgObj_Bremse_8.BR8_Verz_EPB_akt;
                    break;
                case 20:
                    SigVal = MsgObj_Bremse_8.BR8_Zaehler;
                    break;
                case 21:
                    SigVal = MsgObj_Bremse_8.BR8_aktBrSyst;
                    break;
            }
        }
        break;
        case FRM_HANDLE_Clima_1:
        {
            switch (SigIdx)
            {
                case 0:
                    SigVal = MsgObj_Clima_1.CL1_AC_Schalter;
                    break;
                case 1:
                    SigVal = MsgObj_Clima_1.CL1_Aussentemp;
                    break;
                case 2:
                    SigVal = MsgObj_Clima_1.CL1_Druck;
                    break;
                case 3:
                    SigVal = MsgObj_Clima_1.CL1_Einheit_Temp;
                    break;
                case 4:
                    SigVal = MsgObj_Clima_1.CL1_Fa_Zuheiz;
                    break;
                case 5:
                    SigVal = MsgObj_Clima_1.CL1_Fehlereintr;
                    break;
                case 6:
                    SigVal = MsgObj_Clima_1.CL1_Frontsch;
                    break;
                case 7:
                    SigVal = MsgObj_Clima_1.CL1_Gebl_last;
                    break;
                case 8:
                    SigVal = MsgObj_Clima_1.CL1_Hecksch;
                    break;
                case 9:
                    SigVal = MsgObj_Clima_1.CL1_Heizleist;
                    break;
                case 10:
                    SigVal = MsgObj_Clima_1.CL1_HzgWischer;
                    break;
                case 11:
                    SigVal = MsgObj_Clima_1.CL1_Kompr_Last;
                    break;
                case 12:
                    SigVal = MsgObj_Clima_1.CL1_Kompressor;
                    break;
                case 13:
                    SigVal = MsgObj_Clima_1.CL1_LL_Dz;
                    break;
                case 14:
                    SigVal = MsgObj_Clima_1.CL1_Luefter;
                    break;
                case 15:
                    SigVal = MsgObj_Clima_1.CL1_Restwaerme;
                    break;
                case 16:
                    SigVal = MsgObj_Clima_1.CL1_Sta_Druck;
                    break;
                case 17:
                    SigVal = MsgObj_Clima_1.CL1_Sta_Moment;
                    break;
                case 18:
                    SigVal = MsgObj_Clima_1.CL1_Temp_Stoss;
                    break;
                case 19:
                    SigVal = MsgObj_Clima_1.KL_4_Zonen;
                    break;
                case 20:
                    SigVal = MsgObj_Clima_1.KL_Thermomanagement;
                    break;
                case 21:
                    SigVal = MsgObj_Clima_1.SH_MVW;
                    break;
                case 22:
                    SigVal = MsgObj_Clima_1.SH_aktiv_Flag;
                    break;
            }
        }
        break;
        case FRM_HANDLE_Diagnose_1:
        {
            switch (SigIdx)
            {
                case 0:
                    SigVal = MsgObj_Diagnose_1.DI1_Jahr;
                    break;
                case 1:
                    SigVal = MsgObj_Diagnose_1.DI1_KM_Stand_alt;
                    break;
                case 2:
                    SigVal = MsgObj_Diagnose_1.DI1_Minute;
                    break;
                case 3:
                    SigVal = MsgObj_Diagnose_1.DI1_Monat;
                    break;
                case 4:
                    SigVal = MsgObj_Diagnose_1.DI1_Reserve1;
                    break;
                case 5:
                    SigVal = MsgObj_Diagnose_1.DI1_Sekunde;
                    break;
                case 6:
                    SigVal = MsgObj_Diagnose_1.DI1_Stunde;
                    break;
                case 7:
                    SigVal = MsgObj_Diagnose_1.DI1_Tag;
                    break;
                case 8:
                    SigVal = MsgObj_Diagnose_1.DI1_VerlernZaehl;
                    break;
                case 9:
                    SigVal = MsgObj_Diagnose_1.DI1_Zeit_alt;
                    break;
                case 10:
                    SigVal = MsgObj_Diagnose_1.DI1_km_Stand;
                    break;
            }
        }
        break;
        case FRM_HANDLE_EPB_1:
        {
            switch (SigIdx)
            {
                case 0:
                    SigVal = MsgObj_EPB_1.EP1_AnfShLock;
                    break;
                case 1:
                    SigVal = MsgObj_EPB_1.EP1_Auto_Schl_Oe;
                    break;
                case 2:
                    SigVal = MsgObj_EPB_1.EP1_Bremslicht;
                    break;
                case 3:
                    SigVal = MsgObj_EPB_1.EP1_Checksum;
                    break;
                case 4:
                    SigVal = MsgObj_EPB_1.EP1_Fehler_BKL;
                    break;
                case 5:
                    SigVal = MsgObj_EPB_1.EP1_Fehler_Sta;
                    break;
                case 6:
                    SigVal = MsgObj_EPB_1.EP1_Fehler_gelb;
                    break;
                case 7:
                    SigVal = MsgObj_EPB_1.EP1_Fehlereintr;
                    break;
                case 8:
                    SigVal = MsgObj_EPB_1.EP1_Fkt_Lampe;
                    break;
                case 9:
                    SigVal = MsgObj_EPB_1.EP1_Freigabe_Ver;
                    break;
                case 10:
                    SigVal = MsgObj_EPB_1.EP1_HydrHalten;
                    break;
                case 11:
                    SigVal = MsgObj_EPB_1.EP1_KuppModBer;
                    break;
                case 12:
                    SigVal = MsgObj_EPB_1.EP1_Lampe_AutoP;
                    break;
                case 13:
                    SigVal = MsgObj_EPB_1.EP1_Neig_winkel;
                    break;
                case 14:
                    SigVal = MsgObj_EPB_1.EP1_QualNeigWi;
                    break;
                case 15:
                    SigVal = MsgObj_EPB_1.EP1_Schalterinfo;
                    break;
                case 16:
                    SigVal = MsgObj_EPB_1.EP1_SleepInd;
                    break;
                case 17:
                    SigVal = MsgObj_EPB_1.EP1_Spannkraft;
                    break;
                case 18:
                    SigVal = MsgObj_EPB_1.EP1_Sta_EPB;
                    break;
                case 19:
                    SigVal = MsgObj_EPB_1.EP1_Sta_NWS;
                    break;
                case 20:
                    SigVal = MsgObj_EPB_1.EP1_Sta_Schalter;
                    break;
                case 21:
                    SigVal = MsgObj_EPB_1.EP1_Status_Kl_15;
                    break;
                case 22:
                    SigVal = MsgObj_EPB_1.EP1_Verschleiss;
                    break;
                case 23:
                    SigVal = MsgObj_EPB_1.EP1_Verzoegerung;
                    break;
                case 24:
                    SigVal = MsgObj_EPB_1.EP1_Warnton;
                    break;
                case 25:
                    SigVal = MsgObj_EPB_1.EP1_Warnton1;
                    break;
                case 26:
                    SigVal = MsgObj_EPB_1.EP1_Warnton2;
                    break;
                case 27:
                    SigVal = MsgObj_EPB_1.EP1_Zaehler;
                    break;
                case 28:
                    SigVal = MsgObj_EPB_1.EP1__Text;
                    break;
            }
        }
        break;
        case FRM_HANDLE_EPB_2:
        {
            switch (SigIdx)
            {
                case 0:
                    SigVal = MsgObj_EPB_2.BZ_EPB2;
                    break;
                case 1:
                    SigVal = MsgObj_EPB_2.CHK_EPB2;
                    break;
                case 2:
                    SigVal = MsgObj_EPB_2.EPB_Pedalweg_Kuppl;
                    break;
            }
        }
        break;
        case FRM_HANDLE_GME:
        {
            switch (SigIdx)
            {
                case 0:
                    SigVal = MsgObj_GME.BZ_GME;
                    break;
                case 1:
                    SigVal = MsgObj_GME.CHK_GME;
                    break;
                case 2:
                    SigVal = MsgObj_GME.CVT_Anf_EPB;
                    break;
                case 3:
                    SigVal = MsgObj_GME.CVT_Anf_EPB_gueltig;
                    break;
                case 4:
                    SigVal = MsgObj_GME.Dynamischer_Eingriff;
                    break;
                case 5:
                    SigVal = MsgObj_GME.GME_QB_UeFkt;
                    break;
                case 6:
                    SigVal = MsgObj_GME.GME_Schaltung;
                    break;
                case 7:
                    SigVal = MsgObj_GME.GME_UeFkt;
                    break;
                case 8:
                    SigVal = MsgObj_GME.GME_Verlustmom;
                    break;
                case 9:
                    SigVal = MsgObj_GME.Kuehlkreislaufventil_GME;
                    break;
                case 10:
                    SigVal = MsgObj_GME.Langfristiger_Eingriff;
                    break;
                case 11:
                    SigVal = MsgObj_GME.Status_Dyn_Eingriff;
                    break;
                case 12:
                    SigVal = MsgObj_GME.Status_Langfr_Eingriff;
                    break;
            }
        }
        break;
        case FRM_HANDLE_GRA_Neu:
        {
            switch (SigIdx)
            {
                case 0:
                    SigVal = MsgObj_GRA_Neu.GRA_Abbrechen;
                    break;
                case 1:
                    SigVal = MsgObj_GRA_Neu.GRA_Checksum;
                    break;
                case 2:
                    SigVal = MsgObj_GRA_Neu.GRA_Down_kurz;
                    break;
                case 3:
                    SigVal = MsgObj_GRA_Neu.GRA_Down_lang;
                    break;
                case 4:
                    SigVal = MsgObj_GRA_Neu.GRA_Fehler_Bed;
                    break;
                case 5:
                    SigVal = MsgObj_GRA_Neu.GRA_Fehler_Tip;
                    break;
                case 6:
                    SigVal = MsgObj_GRA_Neu.GRA_Hauptschalt;
                    break;
                case 7:
                    SigVal = MsgObj_GRA_Neu.GRA_Kodierinfo;
                    break;
                case 8:
                    SigVal = MsgObj_GRA_Neu.GRA_Neu_Setzen;
                    break;
                case 9:
                    SigVal = MsgObj_GRA_Neu.GRA_Neu_Zaehler;
                    break;
                case 10:
                    SigVal = MsgObj_GRA_Neu.GRA_Recall;
                    break;
                case 11:
                    SigVal = MsgObj_GRA_Neu.GRA_Sender;
                    break;
                case 12:
                    SigVal = MsgObj_GRA_Neu.GRA_Sportschalter;
                    break;
                case 13:
                    SigVal = MsgObj_GRA_Neu.GRA_Sta_Limiter;
                    break;
                case 14:
                    SigVal = MsgObj_GRA_Neu.GRA_Tip_Down;
                    break;
                case 15:
                    SigVal = MsgObj_GRA_Neu.GRA_Tip_Up;
                    break;
                case 16:
                    SigVal = MsgObj_GRA_Neu.GRA_Typ_Hauptschalt;
                    break;
                case 17:
                    SigVal = MsgObj_GRA_Neu.GRA_Up_kurz;
                    break;
                case 18:
                    SigVal = MsgObj_GRA_Neu.GRA_Up_lang;
                    break;
                case 19:
                    SigVal = MsgObj_GRA_Neu.GRA_Zeitluecke;
                    break;
            }
        }
        break;
        case FRM_HANDLE_Gate_Komf_1:
        {
            switch (SigIdx)
            {
                case 0:
                    SigVal = MsgObj_Gate_Komf_1.BCM_Offroad_Taster;
                    break;
                case 1:
                    SigVal = MsgObj_Gate_Komf_1.BCM_Remotestart_Betrieb;
                    break;
                case 2:
                    SigVal = MsgObj_Gate_Komf_1.BSK_BT_geoeffnet;
                    break;
                case 3:
                    SigVal = MsgObj_Gate_Komf_1.BSK_HD_Hauptraste;
                    break;
                case 4:
                    SigVal = MsgObj_Gate_Komf_1.BSK_HL_geoeffnet;
                    break;
                case 5:
                    SigVal = MsgObj_Gate_Komf_1.BSK_HR_geoeffnet;
                    break;
                case 6:
                    SigVal = MsgObj_Gate_Komf_1.BSK_Tankklappe;
                    break;
                case 7:
                    SigVal = MsgObj_Gate_Komf_1.EV1_Anf_Klemme_50;
                    break;
                case 8:
                    SigVal = MsgObj_Gate_Komf_1.GK1_Abbl_VL_def;
                    break;
                case 9:
                    SigVal = MsgObj_Gate_Komf_1.GK1_Abbl_VR_def;
                    break;
                case 10:
                    SigVal = MsgObj_Gate_Komf_1.GK1_Abblendlicht;
                    break;
                case 11:
                    SigVal = MsgObj_Gate_Komf_1.GK1_AnhKonLamp;
                    break;
                case 12:
                    SigVal = MsgObj_Gate_Komf_1.GK1_Anh_abgesteckt;
                    break;
                case 13:
                    SigVal = MsgObj_Gate_Komf_1.GK1_Anhaenger;
                    break;
                case 14:
                    SigVal = MsgObj_Gate_Komf_1.GK1_BLS_AAG;
                    break;
                case 15:
                    SigVal = MsgObj_Gate_Komf_1.GK1_BLS_ILM;
                    break;
                case 16:
                    SigVal = MsgObj_Gate_Komf_1.GK1_Blink_Autob;
                    break;
                case 17:
                    SigVal = MsgObj_Gate_Komf_1.GK1_Blinker_li;
                    break;
                case 18:
                    SigVal = MsgObj_Gate_Komf_1.GK1_Blinker_re;
                    break;
                case 19:
                    SigVal = MsgObj_Gate_Komf_1.GK1_BrLi_Anhaen;
                    break;
                case 20:
                    SigVal = MsgObj_Gate_Komf_1.GK1_BrLi_links;
                    break;
                case 21:
                    SigVal = MsgObj_Gate_Komf_1.GK1_BrLi_mitte;
                    break;
                case 22:
                    SigVal = MsgObj_Gate_Komf_1.GK1_BrLi_rechts;
                    break;
                case 23:
                    SigVal = MsgObj_Gate_Komf_1.GK1_Bremslicht;
                    break;
                case 24:
                    SigVal = MsgObj_Gate_Komf_1.GK1_CharismaModus;
                    break;
                case 25:
                    SigVal = MsgObj_Gate_Komf_1.GK1_Count_Anhaen;
                    break;
                case 26:
                    SigVal = MsgObj_Gate_Komf_1.GK1_Count_Li_Hi;
                    break;
                case 27:
                    SigVal = MsgObj_Gate_Komf_1.GK1_EDC_AAG;
                    break;
                case 28:
                    SigVal = MsgObj_Gate_Komf_1.GK1_EDC_ILM;
                    break;
                case 29:
                    SigVal = MsgObj_Gate_Komf_1.GK1_ELV_verrieg;
                    break;
                case 30:
                    SigVal = MsgObj_Gate_Komf_1.GK1_Fa_Tuerkont;
                    break;
                case 31:
                    SigVal = MsgObj_Gate_Komf_1.GK1_Fernlicht;
                    break;
                case 32:
                    SigVal = MsgObj_Gate_Komf_1.GK1_KW_Warm;
                    break;
                case 33:
                    SigVal = MsgObj_Gate_Komf_1.GK1_Nebel_ein;
                    break;
                case 34:
                    SigVal = MsgObj_Gate_Komf_1.GK1_ParkFrontWi;
                    break;
                case 35:
                    SigVal = MsgObj_Gate_Komf_1.GK1_Reserve3;
                    break;
                case 36:
                    SigVal = MsgObj_Gate_Komf_1.GK1_Rueckfahr;
                    break;
                case 37:
                    SigVal = MsgObj_Gate_Komf_1.GK1_RueckfahrSch;
                    break;
                case 38:
                    SigVal = MsgObj_Gate_Komf_1.GK1_SH_Verbau;
                    break;
                case 39:
                    SigVal = MsgObj_Gate_Komf_1.GK1_SH_Zusatzfkt;
                    break;
                case 40:
                    SigVal = MsgObj_Gate_Komf_1.GK1_SH_laeuft;
                    break;
                case 41:
                    SigVal = MsgObj_Gate_Komf_1.GK1_SamFktNr;
                    break;
                case 42:
                    SigVal = MsgObj_Gate_Komf_1.GK1_SleepAckn;
                    break;
                case 43:
                    SigVal = MsgObj_Gate_Komf_1.GK1_Sta_Anhaen;
                    break;
                case 44:
                    SigVal = MsgObj_Gate_Komf_1.GK1_Sta_ILM_F_1;
                    break;
                case 45:
                    SigVal = MsgObj_Gate_Komf_1.GK1_Sta_Kessy_2;
                    break;
                case 46:
                    SigVal = MsgObj_Gate_Komf_1.GK1_Sta_LSM;
                    break;
                case 47:
                    SigVal = MsgObj_Gate_Komf_1.GK1_Sta_Li_vorn;
                    break;
                case 48:
                    SigVal = MsgObj_Gate_Komf_1.GK1_Sta_Licht1;
                    break;
                case 49:
                    SigVal = MsgObj_Gate_Komf_1.GK1_Sta_Licht2;
                    break;
            }

            switch (SigIdx)
            {
                case 50:
                    SigVal = MsgObj_Gate_Komf_1.GK1_Sta_Licht3;
                    break;
                case 51:
                    SigVal = MsgObj_Gate_Komf_1.GK1_Sta_RDK_Warn;
                    break;
                case 52:
                    SigVal = MsgObj_Gate_Komf_1.GK1_Sta_Stdhzg;
                    break;
                case 53:
                    SigVal = MsgObj_Gate_Komf_1.GK1_Sta_Tuerkont;
                    break;
                case 54:
                    SigVal = MsgObj_Gate_Komf_1.GK1_Warnblk_Status;
                    break;
                case 55:
                    SigVal = MsgObj_Gate_Komf_1.GK1_Wischer_vorn;
                    break;
                case 56:
                    SigVal = MsgObj_Gate_Komf_1.GK1_def_P_verr;
                    break;
                case 57:
                    SigVal = MsgObj_Gate_Komf_1.GK1_res_06;
                    break;
                case 58:
                    SigVal = MsgObj_Gate_Komf_1.GK1_res_62;
                    break;
                case 59:
                    SigVal = MsgObj_Gate_Komf_1.KL_EKP_Anst;
                    break;
                case 60:
                    SigVal = MsgObj_Gate_Komf_1.KY2_StSt_Info;
                    break;
                case 61:
                    SigVal = MsgObj_Gate_Komf_1.Klima_5_D3_alt;
                    break;
                case 62:
                    SigVal = MsgObj_Gate_Komf_1.Motorhaubenkontakt_ein;
                    break;
                case 63:
                    SigVal = MsgObj_Gate_Komf_1.SH1_ein_Wasserpumpe;
                    break;
                case 64:
                    SigVal = MsgObj_Gate_Komf_1.mKessy2_alt;
                    break;
            }
        }
        break;
        case FRM_HANDLE_Gate_Komf_2:
        {
            switch (SigIdx)
            {
                case 0:
                    SigVal = MsgObj_Gate_Komf_2.BEM_Segel_Info;
                    break;
                case 1:
                    SigVal = MsgObj_Gate_Komf_2.GK2_BEM_DFM;
                    break;
                case 2:
                    SigVal = MsgObj_Gate_Komf_2.GK2_BEM_P_Generator;
                    break;
                case 3:
                    SigVal = MsgObj_Gate_Komf_2.GK2_BEM_StSt_Info;
                    break;
                case 4:
                    SigVal = MsgObj_Gate_Komf_2.GK2_BSG_StSt_Info;
                    break;
                case 5:
                    SigVal = MsgObj_Gate_Komf_2.GK2_Blk_L_Kontrolle;
                    break;
                case 6:
                    SigVal = MsgObj_Gate_Komf_2.GK2_Blk_R_Kontrolle;
                    break;
                case 7:
                    SigVal = MsgObj_Gate_Komf_2.GK2_EM_LIN_ungueltig;
                    break;
                case 8:
                    SigVal = MsgObj_Gate_Komf_2.GK2_Feh_VLR;
                    break;
                case 9:
                    SigVal = MsgObj_Gate_Komf_2.GK2_Hardtop;
                    break;
                case 10:
                    SigVal = MsgObj_Gate_Komf_2.GK2_Helligkeit;
                    break;
                case 11:
                    SigVal = MsgObj_Gate_Komf_2.GK2_Kessy_StSt_Info;
                    break;
                case 12:
                    SigVal = MsgObj_Gate_Komf_2.GK2_Kl_StSt_Info;
                    break;
                case 13:
                    SigVal = MsgObj_Gate_Komf_2.GK2_LS_KomFehler;
                    break;
                case 14:
                    SigVal = MsgObj_Gate_Komf_2.GK2_LS_def;
                    break;
                case 15:
                    SigVal = MsgObj_Gate_Komf_2.GK2_Profil;
                    break;
                case 16:
                    SigVal = MsgObj_Gate_Komf_2.GK2_Schluessel;
                    break;
                case 17:
                    SigVal = MsgObj_Gate_Komf_2.GK2_Sta_BSG4;
                    break;
                case 18:
                    SigVal = MsgObj_Gate_Komf_2.GK2_Sta_Clima2;
                    break;
                case 19:
                    SigVal = MsgObj_Gate_Komf_2.GK2_Sta_Kessy_4;
                    break;
                case 20:
                    SigVal = MsgObj_Gate_Komf_2.GK2_Sta_LSM;
                    break;
                case 21:
                    SigVal = MsgObj_Gate_Komf_2.GK2_Sta_Licht1;
                    break;
                case 22:
                    SigVal = MsgObj_Gate_Komf_2.GK2_Sta_Lichtsensor;
                    break;
                case 23:
                    SigVal = MsgObj_Gate_Komf_2.GK2_Sta_Profil;
                    break;
                case 24:
                    SigVal = MsgObj_Gate_Komf_2.GK2_Sta_Schluessel;
                    break;
                case 25:
                    SigVal = MsgObj_Gate_Komf_2.GK2_Sta_VSG;
                    break;
                case 26:
                    SigVal = MsgObj_Gate_Komf_2.GK2_VDKD_auf;
                    break;
                case 27:
                    SigVal = MsgObj_Gate_Komf_2.GK2_VD_entriegelt;
                    break;
                case 28:
                    SigVal = MsgObj_Gate_Komf_2.GK2_VD_offen_ver;
                    break;
                case 29:
                    SigVal = MsgObj_Gate_Komf_2.GK2_VD_zu_ver;
                    break;
                case 30:
                    SigVal = MsgObj_Gate_Komf_2.GK2_Verdeck_Anf;
                    break;
                case 31:
                    SigVal = MsgObj_Gate_Komf_2.GK2_res_09;
                    break;
                case 32:
                    SigVal = MsgObj_Gate_Komf_2.GK2_res_13;
                    break;
                case 33:
                    SigVal = MsgObj_Gate_Komf_2.GK2_res_29;
                    break;
                case 34:
                    SigVal = MsgObj_Gate_Komf_2.GK2_res_30;
                    break;
            }
        }
        break;
        case FRM_HANDLE_Gate_Komf_3:
        {
            switch (SigIdx)
            {
                case 0:
                    SigVal = MsgObj_Gate_Komf_3.BCM_Tankwunsch;
                    break;
                case 1:
                    SigVal = MsgObj_Gate_Komf_3.BK1_Anlern_Info;
                    break;
                case 2:
                    SigVal = MsgObj_Gate_Komf_3.BK1_IDGeber_1_Status;
                    break;
                case 3:
                    SigVal = MsgObj_Gate_Komf_3.BK1_IDGeber_2_Status;
                    break;
                case 4:
                    SigVal = MsgObj_Gate_Komf_3.BK1_IDGeber_3_Status;
                    break;
                case 5:
                    SigVal = MsgObj_Gate_Komf_3.BK1_IDGeber_4_Status;
                    break;
                case 6:
                    SigVal = MsgObj_Gate_Komf_3.CL3_SH_Wasserpumpe;
                    break;
                case 7:
                    SigVal = MsgObj_Gate_Komf_3.GK2_Sta_Kessy_4;
                    break;
                case 8:
                    SigVal = MsgObj_Gate_Komf_3.GK3_Sta_BCM_KY1;
                    break;
                case 9:
                    SigVal = MsgObj_Gate_Komf_3.GK3_Sta_BSG4;
                    break;
                case 10:
                    SigVal = MsgObj_Gate_Komf_3.GK3_Sta_Clima_3;
                    break;
                case 11:
                    SigVal = MsgObj_Gate_Komf_3.GK3_Sta_res_03;
                    break;
                case 12:
                    SigVal = MsgObj_Gate_Komf_3.GK3_Sta_res_04;
                    break;
                case 13:
                    SigVal = MsgObj_Gate_Komf_3.GK3_Sta_res_05;
                    break;
                case 14:
                    SigVal = MsgObj_Gate_Komf_3.GK3_Sta_res_06;
                    break;
                case 15:
                    SigVal = MsgObj_Gate_Komf_3.GK3_Sta_res_07;
                    break;
                case 16:
                    SigVal = MsgObj_Gate_Komf_3.KY4_Gong_600;
                    break;
                case 17:
                    SigVal = MsgObj_Gate_Komf_3.KY4_Meldungen;
                    break;
                case 18:
                    SigVal = MsgObj_Gate_Komf_3.KY4_Passiv_Autolock_Menue;
                    break;
                case 19:
                    SigVal = MsgObj_Gate_Komf_3.KY4_Passiv_Autolock_akt;
                    break;
            }
        }
        break;
        case FRM_HANDLE_Getriebe_1:
        {
            switch (SigIdx)
            {
                case 0:
                    SigVal = MsgObj_Getriebe_1.GE1_Code_MSG;
                    break;
                case 1:
                    SigVal = MsgObj_Getriebe_1.GE1_EGS_Anf;
                    break;
                case 2:
                    SigVal = MsgObj_Getriebe_1.GE1_Fahrwistd;
                    break;
                case 3:
                    SigVal = MsgObj_Getriebe_1.GE1_Fehlereintr;
                    break;
                case 4:
                    SigVal = MsgObj_Getriebe_1.GE1_Infobit;
                    break;
                case 5:
                    SigVal = MsgObj_Getriebe_1.GE1_Klimakompr;
                    break;
                case 6:
                    SigVal = MsgObj_Getriebe_1.GE1_Kuehlung;
                    break;
                case 7:
                    SigVal = MsgObj_Getriebe_1.GE1_LaunchControl;
                    break;
                case 8:
                    SigVal = MsgObj_Getriebe_1.GE1_Mrad_Mkurb;
                    break;
                case 9:
                    SigVal = MsgObj_Getriebe_1.GE1_Notlauf;
                    break;
                case 10:
                    SigVal = MsgObj_Getriebe_1.GE1_Schaltung;
                    break;
                case 11:
                    SigVal = MsgObj_Getriebe_1.GE1_SleepInd;
                    break;
                case 12:
                    SigVal = MsgObj_Getriebe_1.GE1_Soll_Mo;
                    break;
                case 13:
                    SigVal = MsgObj_Getriebe_1.GE1_Sta_OBD;
                    break;
                case 14:
                    SigVal = MsgObj_Getriebe_1.GE1_Sta_Schutz;
                    break;
                case 15:
                    SigVal = MsgObj_Getriebe_1.GE1_Start_Stopp_Info;
                    break;
                case 16:
                    SigVal = MsgObj_Getriebe_1.GE1_Startverbot;
                    break;
                case 17:
                    SigVal = MsgObj_Getriebe_1.GE1_WK;
                    break;
                case 18:
                    SigVal = MsgObj_Getriebe_1.GE1_WaVerl_Mo;
                    break;
                case 19:
                    SigVal = MsgObj_Getriebe_1.GE1_Wahl_Pos;
                    break;
                case 20:
                    SigVal = MsgObj_Getriebe_1.GE1_Zaehler;
                    break;
                case 21:
                    SigVal = MsgObj_Getriebe_1.GE1_Zielgang;
                    break;
                case 22:
                    SigVal = MsgObj_Getriebe_1.GE1_v_Umkehr;
                    break;
            }
        }
        break;
        case FRM_HANDLE_Getriebe_2:
        {
            switch (SigIdx)
            {
                case 0:
                    SigVal = MsgObj_Getriebe_2.GE2_4Gang;
                    break;
                case 1:
                    SigVal = MsgObj_Getriebe_2.GE2_5Gang;
                    break;
                case 2:
                    SigVal = MsgObj_Getriebe_2.GE2_ASG;
                    break;
                case 3:
                    SigVal = MsgObj_Getriebe_2.GE2_DZM_Daempf;
                    break;
                case 4:
                    SigVal = MsgObj_Getriebe_2.GE2_Gong;
                    break;
                case 5:
                    SigVal = MsgObj_Getriebe_2.GE2_Grad_begr;
                    break;
                case 6:
                    SigVal = MsgObj_Getriebe_2.GE2_LFR_Adap;
                    break;
                case 7:
                    SigVal = MsgObj_Getriebe_2.GE2_LL_Solldz;
                    break;
                case 8:
                    SigVal = MsgObj_Getriebe_2.GE2_MSB_Sync;
                    break;
                case 9:
                    SigVal = MsgObj_Getriebe_2.GE2_PRND;
                    break;
                case 10:
                    SigVal = MsgObj_Getriebe_2.GE2_PRNDS;
                    break;
                case 11:
                    SigVal = MsgObj_Getriebe_2.GE2_Segeln_aktiv;
                    break;
                case 12:
                    SigVal = MsgObj_Getriebe_2.GE2_Selespeed;
                    break;
                case 13:
                    SigVal = MsgObj_Getriebe_2.GE2_Senderkennung;
                    break;
                case 14:
                    SigVal = MsgObj_Getriebe_2.GE2_Shift_Lock;
                    break;
                case 15:
                    SigVal = MsgObj_Getriebe_2.GE2_SlipStDZEingr;
                    break;
                case 16:
                    SigVal = MsgObj_Getriebe_2.GE2_Sta_SAS;
                    break;
                case 17:
                    SigVal = MsgObj_Getriebe_2.GE2_Sta_ZwGas;
                    break;
                case 18:
                    SigVal = MsgObj_Getriebe_2.GE2_Sync_Dz;
                    break;
                case 19:
                    SigVal = MsgObj_Getriebe_2.GE2_Sync_Zeit;
                    break;
                case 20:
                    SigVal = MsgObj_Getriebe_2.GE2_Tip4Gang;
                    break;
                case 21:
                    SigVal = MsgObj_Getriebe_2.GE2_Tip5Gang;
                    break;
                case 22:
                    SigVal = MsgObj_Getriebe_2.GE2_Tip6Gang;
                    break;
                case 23:
                    SigVal = MsgObj_Getriebe_2.GE2_Tip7Gang;
                    break;
                case 24:
                    SigVal = MsgObj_Getriebe_2.GE2_Variante;
                    break;
                case 25:
                    SigVal = MsgObj_Getriebe_2.GE2_WBA_Blinken;
                    break;
                case 26:
                    SigVal = MsgObj_Getriebe_2.GE2_Zaehler;
                    break;
                case 27:
                    SigVal = MsgObj_Getriebe_2.GE2_akt_Gang;
                    break;
                case 28:
                    SigVal = MsgObj_Getriebe_2.GE2_invMSB_Sync;
                    break;
                case 29:
                    SigVal = MsgObj_Getriebe_2.GE2_invSync_Dz;
                    break;
            }
        }
        break;
        case FRM_HANDLE_Getriebe_3_Momente:
        {
            switch (SigIdx)
            {
                case 0:
                    SigVal = MsgObj_Getriebe_3_Momente.GM3_Checksum;
                    break;
                case 1:
                    SigVal = MsgObj_Getriebe_3_Momente.GM3_LangEingr;
                    break;
                case 2:
                    SigVal = MsgObj_Getriebe_3_Momente.GM3_MoSoMom;
                    break;
                case 3:
                    SigVal = MsgObj_Getriebe_3_Momente.GM3_MomEingr;
                    break;
                case 4:
                    SigVal = MsgObj_Getriebe_3_Momente.GM3_MomID;
                    break;
                case 5:
                    SigVal = MsgObj_Getriebe_3_Momente.GM3_Moment;
                    break;
                case 6:
                    SigVal = MsgObj_Getriebe_3_Momente.GM3_QB_LangEingr;
                    break;
                case 7:
                    SigVal = MsgObj_Getriebe_3_Momente.GM3_StaSoMom;
                    break;
                case 8:
                    SigVal = MsgObj_Getriebe_3_Momente.GM3_Zaehler;
                    break;
                case 9:
                    SigVal = MsgObj_Getriebe_3_Momente.GM3_Zeit;
                    break;
                case 10:
                    SigVal = MsgObj_Getriebe_3_Momente.GM3_res_13;
                    break;
                case 11:
                    SigVal = MsgObj_Getriebe_3_Momente.GM3_res_14;
                    break;
                case 12:
                    SigVal = MsgObj_Getriebe_3_Momente.GM3_res_15;
                    break;
                case 13:
                    SigVal = MsgObj_Getriebe_3_Momente.GM3_res_61;
                    break;
                case 14:
                    SigVal = MsgObj_Getriebe_3_Momente.GM3_res_62;
                    break;
                case 15:
                    SigVal = MsgObj_Getriebe_3_Momente.GM3_res_63;
                    break;
            }
        }
        break;
        case FRM_HANDLE_Getriebe_6:
        {
            switch (SigIdx)
            {
                case 0:
                    SigVal = MsgObj_Getriebe_6.GE6_Checksum;
                    break;
                case 1:
                    SigVal = MsgObj_Getriebe_6.GE6_Gangwechsel;
                    break;
                case 2:
                    SigVal = MsgObj_Getriebe_6.GE6_OelTemp;
                    break;
                case 3:
                    SigVal = MsgObj_Getriebe_6.GE6_QB_OelTemp;
                    break;
                case 4:
                    SigVal = MsgObj_Getriebe_6.GE6_QmaxBeschl;
                    break;
                case 5:
                    SigVal = MsgObj_Getriebe_6.GE6_Sta_Shift_Spontan;
                    break;
                case 6:
                    SigVal = MsgObj_Getriebe_6.GE6_TurbDZ;
                    break;
                case 7:
                    SigVal = MsgObj_Getriebe_6.GE6_Verlustmom;
                    break;
                case 8:
                    SigVal = MsgObj_Getriebe_6.GE6_Zaehler;
                    break;
                case 9:
                    SigVal = MsgObj_Getriebe_6.GE6_Zielgang_err;
                    break;
                case 10:
                    SigVal = MsgObj_Getriebe_6.GE6_maxBeschl;
                    break;
                case 11:
                    SigVal = MsgObj_Getriebe_6.GE_Heizwunsch;
                    break;
                case 12:
                    SigVal = MsgObj_Getriebe_6.GE_StSt_Info;
                    break;
            }
        }
        break;
        case FRM_HANDLE_Getriebe_Hybrid_1:
        {
            switch (SigIdx)
            {
                case 0:
                    SigVal = MsgObj_Getriebe_Hybrid_1.GH1_AnzeigeDZ;
                    break;
                case 1:
                    SigVal = MsgObj_Getriebe_Hybrid_1.GH1_FehlerstatusGSG;
                    break;
                case 2:
                    SigVal = MsgObj_Getriebe_Hybrid_1.GH1_Filt_MomAufbau;
                    break;
                case 3:
                    SigVal = MsgObj_Getriebe_Hybrid_1.GH1_Freig_LL_Reg;
                    break;
                case 4:
                    SigVal = MsgObj_Getriebe_Hybrid_1.GH1_FreigabeK0;
                    break;
                case 5:
                    SigVal = MsgObj_Getriebe_Hybrid_1.GH1_FreigabeSSK0;
                    break;
                case 6:
                    SigVal = MsgObj_Getriebe_Hybrid_1.GH1_FreigabeVMStop;
                    break;
                case 7:
                    SigVal = MsgObj_Getriebe_Hybrid_1.GH1_MomEingriff_EM;
                    break;
                case 8:
                    SigVal = MsgObj_Getriebe_Hybrid_1.GH1_Sportfaktor;
                    break;
                case 9:
                    SigVal = MsgObj_Getriebe_Hybrid_1.GH1_VKMstartanforderung;
                    break;
                case 10:
                    SigVal = MsgObj_Getriebe_Hybrid_1.GH1_VKMstartkontrolle;
                    break;
                case 11:
                    SigVal = MsgObj_Getriebe_Hybrid_1.GH1_VM_akt_halten;
                    break;
                case 12:
                    SigVal = MsgObj_Getriebe_Hybrid_1.GH1_VZMomEingriff;
                    break;
                case 13:
                    SigVal = MsgObj_Getriebe_Hybrid_1.GH1_Wiederstart;
                    break;
                case 14:
                    SigVal = MsgObj_Getriebe_Hybrid_1.GH1_Zaehler;
                    break;
                case 15:
                    SigVal = MsgObj_Getriebe_Hybrid_1.GH1_nK0;
                    break;
            }
        }
        break;
        case FRM_HANDLE_Klima_5:
        {
            switch (SigIdx)
            {
                case 0:
                    SigVal = MsgObj_Klima_5.HYB_Anf_E_Mode;
                    break;
                case 1:
                    SigVal = MsgObj_Klima_5.KL_Magnetventil;
                    break;
                case 2:
                    SigVal = MsgObj_Klima_5.KL_Schalter_StartStopp;
                    break;
                case 3:
                    SigVal = MsgObj_Klima_5.KL_Thermomanagement;
                    break;
                case 4:
                    SigVal = MsgObj_Klima_5.Klima_StSt_Info;
                    break;
                case 5:
                    SigVal = MsgObj_Klima_5.SH_Betriebsdauer;
                    break;
                case 6:
                    SigVal = MsgObj_Klima_5.SH_Monat;
                    break;
                case 7:
                    SigVal = MsgObj_Klima_5.SH_Offset_Jahr;
                    break;
                case 8:
                    SigVal = MsgObj_Klima_5.SH_Tag;
                    break;
                case 9:
                    SigVal = MsgObj_Klima_5.SH_Timer_aktiv;
                    break;
                case 10:
                    SigVal = MsgObj_Klima_5.SH_Timerstatus;
                    break;
                case 11:
                    SigVal = MsgObj_Klima_5.SH_WP_Fehler;
                    break;
                case 12:
                    SigVal = MsgObj_Klima_5.SH_Wochentag;
                    break;
                case 13:
                    SigVal = MsgObj_Klima_5.SH_h_Einschaltzeit;
                    break;
                case 14:
                    SigVal = MsgObj_Klima_5.SH_min_Einschaltzeit;
                    break;
                case 15:
                    SigVal = MsgObj_Klima_5.STH_Betriebsart;
                    break;
            }
        }
        break;
        case FRM_HANDLE_Kombi_1:
        {
            switch (SigIdx)
            {
                case 0:
                    SigVal = MsgObj_Kombi_1.KO1_ABS_Lampe;
                    break;
                case 1:
                    SigVal = MsgObj_Kombi_1.KO1_ACC_AnzFhl;
                    break;
                case 2:
                    SigVal = MsgObj_Kombi_1.KO1_ACC_Inkons;
                    break;
                case 3:
                    SigVal = MsgObj_Kombi_1.KO1_ASRESP_Lampe;
                    break;
                case 4:
                    SigVal = MsgObj_Kombi_1.KO1_Airbag_Lampe;
                    break;
                case 5:
                    SigVal = MsgObj_Kombi_1.KO1_Brems_Lampe;
                    break;
                case 6:
                    SigVal = MsgObj_Kombi_1.KO1_Bremsinfo;
                    break;
                case 7:
                    SigVal = MsgObj_Kombi_1.KO1_Handbremse;
                    break;
                case 8:
                    SigVal = MsgObj_Kombi_1.KO1_Kuehlmittel;
                    break;
                case 9:
                    SigVal = MsgObj_Kombi_1.KO1_LDW_AnzFeh;
                    break;
                case 10:
                    SigVal = MsgObj_Kombi_1.KO1_La_Ladekon;
                    break;
                case 11:
                    SigVal = MsgObj_Kombi_1.KO1_Lenkh_Lampe;
                    break;
                case 12:
                    SigVal = MsgObj_Kombi_1.KO1_OBD_Tank;
                    break;
                case 13:
                    SigVal = MsgObj_Kombi_1.KO1_Oeldruck;
                    break;
                case 14:
                    SigVal = MsgObj_Kombi_1.KO1_Quelle_kmh;
                    break;
                case 15:
                    SigVal = MsgObj_Kombi_1.KO1_SILA_gueltig;
                    break;
                case 16:
                    SigVal = MsgObj_Kombi_1.KO1_SleepInd;
                    break;
                case 17:
                    SigVal = MsgObj_Kombi_1.KO1_Sta_Oeldr;
                    break;
                case 18:
                    SigVal = MsgObj_Kombi_1.KO1_Sta_Tank;
                    break;
                case 19:
                    SigVal = MsgObj_Kombi_1.KO1_Stellglieder;
                    break;
                case 20:
                    SigVal = MsgObj_Kombi_1.KO1_Tankinhalt;
                    break;
                case 21:
                    SigVal = MsgObj_Kombi_1.KO1_Tankstop;
                    break;
                case 22:
                    SigVal = MsgObj_Kombi_1.KO1_Vorgluehen;
                    break;
                case 23:
                    SigVal = MsgObj_Kombi_1.KO1_Wakeup_Komfort;
                    break;
                case 24:
                    SigVal = MsgObj_Kombi_1.KO1_Warn_Tank;
                    break;
                case 25:
                    SigVal = MsgObj_Kombi_1.KO1_Zaehler;
                    break;
                case 26:
                    SigVal = MsgObj_Kombi_1.KO1_Zeitluecke;
                    break;
                case 27:
                    SigVal = MsgObj_Kombi_1.KO1_angez_kmh;
                    break;
                case 28:
                    SigVal = MsgObj_Kombi_1.KO1_kmh;
                    break;
                case 29:
                    SigVal = MsgObj_Kombi_1.KO1_kmh_mph;
                    break;
            }
        }
        break;
        case FRM_HANDLE_Kombi_2:
        {
            switch (SigIdx)
            {
                case 0:
                    SigVal = MsgObj_Kombi_2.KO2_Aussen_T;
                    break;
                case 1:
                    SigVal = MsgObj_Kombi_2.KO2_Bel_Displ;
                    break;
                case 2:
                    SigVal = MsgObj_Kombi_2.KO2_Bel_Schalt;
                    break;
                case 3:
                    SigVal = MsgObj_Kombi_2.KO2_Fehlereintr;
                    break;
                case 4:
                    SigVal = MsgObj_Kombi_2.KO2_GRA_High;
                    break;
                case 5:
                    SigVal = MsgObj_Kombi_2.KO2_MFA_v_Einheit;
                    break;
                case 6:
                    SigVal = MsgObj_Kombi_2.KO2_OBD_Nib_Temp;
                    break;
                case 7:
                    SigVal = MsgObj_Kombi_2.KO2_OelTemp;
                    break;
                case 8:
                    SigVal = MsgObj_Kombi_2.KO2_Oelwarn;
                    break;
                case 9:
                    SigVal = MsgObj_Kombi_2.KO2_PLA_Displaystatus;
                    break;
                case 10:
                    SigVal = MsgObj_Kombi_2.KO2_Reserve4;
                    break;
                case 11:
                    SigVal = MsgObj_Kombi_2.KO2_Reserve5;
                    break;
                case 12:
                    SigVal = MsgObj_Kombi_2.KO2_Sta_Auss_T;
                    break;
                case 13:
                    SigVal = MsgObj_Kombi_2.KO2_Sta_Displ;
                    break;
                case 14:
                    SigVal = MsgObj_Kombi_2.KO2_Sta_Oel_T;
                    break;
                case 15:
                    SigVal = MsgObj_Kombi_2.KO2_Sta_Schalt;
                    break;
                case 16:
                    SigVal = MsgObj_Kombi_2.KO2_Temp_Einheit;
                    break;
                case 17:
                    SigVal = MsgObj_Kombi_2.KO2_Verb_TOG;
                    break;
                case 18:
                    SigVal = MsgObj_Kombi_2.KO2_Wischwasser;
                    break;
                case 19:
                    SigVal = MsgObj_Kombi_2.KO2_gef_Auss_T;
                    break;
                case 20:
                    SigVal = MsgObj_Kombi_2.MFA_Strecke_Einheit;
                    break;
            }
        }
        break;
        case FRM_HANDLE_Kombi_3:
        {
            switch (SigIdx)
            {
                case 0:
                    SigVal = MsgObj_Kombi_3.KBI_Oelwechsel_durchgefuehrt;
                    break;
                case 1:
                    SigVal = MsgObj_Kombi_3.KO3_Baureihe;
                    break;
                case 2:
                    SigVal = MsgObj_Kombi_3.KO3_Derivat;
                    break;
                case 3:
                    SigVal = MsgObj_Kombi_3.KO3_Generation;
                    break;
                case 4:
                    SigVal = MsgObj_Kombi_3.KO3_Kilometer;
                    break;
                case 5:
                    SigVal = MsgObj_Kombi_3.KO3_Land;
                    break;
                case 6:
                    SigVal = MsgObj_Kombi_3.KO3_Marke;
                    break;
                case 7:
                    SigVal = MsgObj_Kombi_3.KO3_Mp_Code;
                    break;
                case 8:
                    SigVal = MsgObj_Kombi_3.KO3_Radumfang;
                    break;
                case 9:
                    SigVal = MsgObj_Kombi_3.KO3_Reserve1;
                    break;
                case 10:
                    SigVal = MsgObj_Kombi_3.KO3_Reserve2;
                    break;
                case 11:
                    SigVal = MsgObj_Kombi_3.KO3_SWA_AnzFeh;
                    break;
                case 12:
                    SigVal = MsgObj_Kombi_3.KO3_Schluessel;
                    break;
                case 13:
                    SigVal = MsgObj_Kombi_3.KO3_Sprache;
                    break;
                case 14:
                    SigVal = MsgObj_Kombi_3.KO3_Sta_Standz;
                    break;
                case 15:
                    SigVal = MsgObj_Kombi_3.KO3_Standzeit;
                    break;
                case 16:
                    SigVal = MsgObj_Kombi_3.KO3_Verbau_ADR;
                    break;
                case 17:
                    SigVal = MsgObj_Kombi_3.KO3_Verbau_Air;
                    break;
                case 18:
                    SigVal = MsgObj_Kombi_3.KO3_Verbau_BN;
                    break;
                case 19:
                    SigVal = MsgObj_Kombi_3.KO3_Verbau_Br;
                    break;
                case 20:
                    SigVal = MsgObj_Kombi_3.KO3_Verbau_DP;
                    break;
                case 21:
                    SigVal = MsgObj_Kombi_3.KO3_Verbau_Get;
                    break;
                case 22:
                    SigVal = MsgObj_Kombi_3.KO3_Verbau_Kl;
                    break;
                case 23:
                    SigVal = MsgObj_Kombi_3.KO3_Verbau_LH;
                    break;
                case 24:
                    SigVal = MsgObj_Kombi_3.KO3_Verbau_LWS;
                    break;
                case 25:
                    SigVal = MsgObj_Kombi_3.KO3_Verbau_Mot;
                    break;
                case 26:
                    SigVal = MsgObj_Kombi_3.KO3_Verbau_Niveau;
                    break;
                case 27:
                    SigVal = MsgObj_Kombi_3.KO3_Verbau_Syn;
                    break;
            }
        }
        break;
        case FRM_HANDLE_LW_1:
        {
            switch (SigIdx)
            {
                case 0:
                    SigVal = MsgObj_LW_1.LW1_CRC;
                    break;
                case 1:
                    SigVal = MsgObj_LW_1.LW1_Gesch_Sign;
                    break;
                case 2:
                    SigVal = MsgObj_LW_1.LW1_ID;
                    break;
                case 3:
                    SigVal = MsgObj_LW_1.LW1_Initquelle;
                    break;
                case 4:
                    SigVal = MsgObj_LW_1.LW1_Kodier;
                    break;
                case 5:
                    SigVal = MsgObj_LW_1.LW1_LRW;
                    break;
                case 6:
                    SigVal = MsgObj_LW_1.LW1_LRW_Sign;
                    break;
                case 7:
                    SigVal = MsgObj_LW_1.LW1_Lenk_Gesch;
                    break;
                case 8:
                    SigVal = MsgObj_LW_1.LW1_Sta_KL30;
                    break;
                case 9:
                    SigVal = MsgObj_LW_1.LW1_Status;
                    break;
                case 10:
                    SigVal = MsgObj_LW_1.LW1_Zaehler;
                    break;
            }
        }
        break;
        case FRM_HANDLE_Lenkhilfe_3:
        {
            switch (SigIdx)
            {
                case 0:
                    SigVal = MsgObj_Lenkhilfe_3.LH3_BLW;
                    break;
                case 1:
                    SigVal = MsgObj_Lenkhilfe_3.LH3_BLWSign;
                    break;
                case 2:
                    SigVal = MsgObj_Lenkhilfe_3.LH3_BLWValid;
                    break;
                case 3:
                    SigVal = MsgObj_Lenkhilfe_3.LH3_BS_Spiegel;
                    break;
                case 4:
                    SigVal = MsgObj_Lenkhilfe_3.LH3_Checksumme;
                    break;
                case 5:
                    SigVal = MsgObj_Lenkhilfe_3.LH3_LM;
                    break;
                case 6:
                    SigVal = MsgObj_Lenkhilfe_3.LH3_LMSign;
                    break;
                case 7:
                    SigVal = MsgObj_Lenkhilfe_3.LH3_LMValid;
                    break;
                case 8:
                    SigVal = MsgObj_Lenkhilfe_3.LH3_Lenkungstyp;
                    break;
                case 9:
                    SigVal = MsgObj_Lenkhilfe_3.LH3_Sta_DSR;
                    break;
                case 10:
                    SigVal = MsgObj_Lenkhilfe_3.LH3_Zaehler;
                    break;
            }
        }
        break;
        case FRM_HANDLE_NMH_Gateway:
        {
            switch (SigIdx)
            {
                case 0:
                    SigVal = MsgObj_NMH_Gateway.NMH_GW_Abschaltstufe_aktiv;
                    break;
                case 1:
                    SigVal = MsgObj_NMH_Gateway.NMH_GW_CAN_Diag_deaktiv;
                    break;
                case 2:
                    SigVal = MsgObj_NMH_Gateway.NMH_GW_Car_WakeUp;
                    break;
                case 3:
                    SigVal = MsgObj_NMH_Gateway.NMH_GW_Eindraht_Fehler;
                    break;
                case 4:
                    SigVal = MsgObj_NMH_Gateway.NMH_GW_Fkt_WakeUp;
                    break;
                case 5:
                    SigVal = MsgObj_NMH_Gateway.NMH_GW_KompSchutz;
                    break;
                case 6:
                    SigVal = MsgObj_NMH_Gateway.NMH_GW_Mute_Mode;
                    break;
                case 7:
                    SigVal = MsgObj_NMH_Gateway.NMH_GW_NL_0;
                    break;
                case 8:
                    SigVal = MsgObj_NMH_Gateway.NMH_GW_NL_1;
                    break;
                case 9:
                    SigVal = MsgObj_NMH_Gateway.NMH_GW_NL_2;
                    break;
                case 10:
                    SigVal = MsgObj_NMH_Gateway.NMH_GW_NL_3;
                    break;
                case 11:
                    SigVal = MsgObj_NMH_Gateway.NMH_GW_NL_4;
                    break;
                case 12:
                    SigVal = MsgObj_NMH_Gateway.NMH_GW_NL_5;
                    break;
                case 13:
                    SigVal = MsgObj_NMH_Gateway.NMH_GW_NL_6;
                    break;
                case 14:
                    SigVal = MsgObj_NMH_Gateway.NMH_GW_NL_7;
                    break;
                case 15:
                    SigVal = MsgObj_NMH_Gateway.NMH_GW_NL_aktiv_4;
                    break;
                case 16:
                    SigVal = MsgObj_NMH_Gateway.NMH_GW_NL_aktiv_5;
                    break;
                case 17:
                    SigVal = MsgObj_NMH_Gateway.NMH_GW_NL_aktiv_6;
                    break;
                case 18:
                    SigVal = MsgObj_NMH_Gateway.NMH_GW_NL_aktiv_7;
                    break;
                case 19:
                    SigVal = MsgObj_NMH_Gateway.NMH_GW_NL_aktiv_8;
                    break;
                case 20:
                    SigVal = MsgObj_NMH_Gateway.NMH_GW_NM_aktiv_Diagnose;
                    break;
                case 21:
                    SigVal = MsgObj_NMH_Gateway.NMH_GW_NM_aktiv_Klemme_15;
                    break;
                case 22:
                    SigVal = MsgObj_NMH_Gateway.NMH_GW_NM_aktiv_Start;
                    break;
                case 23:
                    SigVal = MsgObj_NMH_Gateway.NMH_GW_Normal_Mode_1;
                    break;
                case 24:
                    SigVal = MsgObj_NMH_Gateway.NMH_GW_Normal_Mode_2;
                    break;
                case 25:
                    SigVal = MsgObj_NMH_Gateway.NMH_GW_Per_WakeUp;
                    break;
                case 26:
                    SigVal = MsgObj_NMH_Gateway.NMH_GW_Start_1;
                    break;
                case 27:
                    SigVal = MsgObj_NMH_Gateway.NMH_GW_Start_2;
                    break;
                case 28:
                    SigVal = MsgObj_NMH_Gateway.NMH_GW_TimeOut_Fehler;
                    break;
                case 29:
                    SigVal = MsgObj_NMH_Gateway.NMH_GW_Transport_Mode;
                    break;
            }
        }
        break;
        case FRM_HANDLE_Niveau_1:
        {
            switch (SigIdx)
            {
                case 0:
                    SigVal = MsgObj_Niveau_1.Absenkung_Fahrzeug;
                    break;
                case 1:
                    SigVal = MsgObj_Niveau_1.Anhebung_Fahrzeug;
                    break;
                case 2:
                    SigVal = MsgObj_Niveau_1.Aufpruefbit_Warnlampe_Niveau;
                    break;
                case 3:
                    SigVal = MsgObj_Niveau_1.Beladungszustand;
                    break;
                case 4:
                    SigVal = MsgObj_Niveau_1.ESP_Beeinflussung;
                    break;
                case 5:
                    SigVal = MsgObj_Niveau_1.FSPE_Niveau1;
                    break;
                case 6:
                    SigVal = MsgObj_Niveau_1.Fehlerlampe_Niveau;
                    break;
                case 7:
                    SigVal = MsgObj_Niveau_1.Kompressor_laeuft;
                    break;
                case 8:
                    SigVal = MsgObj_Niveau_1.Kompressorlauf_in_Kuerze;
                    break;
                case 9:
                    SigVal = MsgObj_Niveau_1.NI1_Checksum;
                    break;
                case 10:
                    SigVal = MsgObj_Niveau_1.NI1_Fahrzeugart;
                    break;
                case 11:
                    SigVal = MsgObj_Niveau_1.NI1_MSG_Eingriff;
                    break;
                case 12:
                    SigVal = MsgObj_Niveau_1.NI1_Zaehler;
                    break;
                case 13:
                    SigVal = MsgObj_Niveau_1.Niveaustati;
                    break;
                case 14:
                    SigVal = MsgObj_Niveau_1.Parkniveau;
                    break;
                case 15:
                    SigVal = MsgObj_Niveau_1.SIB_Niveau;
                    break;
                case 16:
                    SigVal = MsgObj_Niveau_1.Stromaufnahme;
                    break;
                case 17:
                    SigVal = MsgObj_Niveau_1.Systemstatus;
                    break;
                case 18:
                    SigVal = MsgObj_Niveau_1.Taster_Niveau;
                    break;
                case 19:
                    SigVal = MsgObj_Niveau_1.Textbits_Niveau;
                    break;
                case 20:
                    SigVal = MsgObj_Niveau_1.Tiefniveaulampe;
                    break;
                case 21:
                    SigVal = MsgObj_Niveau_1.Verstellung_HL;
                    break;
                case 22:
                    SigVal = MsgObj_Niveau_1.Verstellung_HR;
                    break;
                case 23:
                    SigVal = MsgObj_Niveau_1.Verstellung_VL;
                    break;
                case 24:
                    SigVal = MsgObj_Niveau_1.Verstellung_VR;
                    break;
                case 25:
                    SigVal = MsgObj_Niveau_1.Verstellung_aktiv;
                    break;
                case 26:
                    SigVal = MsgObj_Niveau_1.Verstellung_in_Kuerze;
                    break;
                case 27:
                    SigVal = MsgObj_Niveau_1.Warnlampe;
                    break;
                case 28:
                    SigVal = MsgObj_Niveau_1.Zwischenniveau;
                    break;
            }
        }
        break;
        case FRM_HANDLE_OBD_Tankgeber_01:
        {
            switch (SigIdx)
            {
                case 0:
                    SigVal = MsgObj_OBD_Tankgeber_01.OBD_TG_F_Status_1;
                    break;
                case 1:
                    SigVal = MsgObj_OBD_Tankgeber_01.OBD_TG_F_Status_2;
                    break;
                case 2:
                    SigVal = MsgObj_OBD_Tankgeber_01.OBD_TG_F_Status_3;
                    break;
                case 3:
                    SigVal = MsgObj_OBD_Tankgeber_01.OBD_TG_F_Status_4;
                    break;
                case 4:
                    SigVal = MsgObj_OBD_Tankgeber_01.OBD_TG_Sens_Rohwert_1;
                    break;
                case 5:
                    SigVal = MsgObj_OBD_Tankgeber_01.OBD_TG_Sens_Rohwert_2;
                    break;
                case 6:
                    SigVal = MsgObj_OBD_Tankgeber_01.OBD_TG_Sens_Rohwert_3;
                    break;
                case 7:
                    SigVal = MsgObj_OBD_Tankgeber_01.OBD_TG_Sens_Rohwert_4;
                    break;
            }
        }
        break;
        case FRM_HANDLE_Parkhilfe_01:
        {
            switch (SigIdx)
            {
                case 0:
                    SigVal = MsgObj_Parkhilfe_01.PH_Abschaltursache;
                    break;
                case 1:
                    SigVal = MsgObj_Parkhilfe_01.PH_Anf_Audioabsenkung;
                    break;
                case 2:
                    SigVal = MsgObj_Parkhilfe_01.PH_Aufbauten_erk;
                    break;
                case 3:
                    SigVal = MsgObj_Parkhilfe_01.PH_BerErk_hinten;
                    break;
                case 4:
                    SigVal = MsgObj_Parkhilfe_01.PH_BerErk_vorn;
                    break;
                case 5:
                    SigVal = MsgObj_Parkhilfe_01.PH_Display_Kundenwunsch;
                    break;
                case 6:
                    SigVal = MsgObj_Parkhilfe_01.PH_Frequenz_hinten;
                    break;
                case 7:
                    SigVal = MsgObj_Parkhilfe_01.PH_Frequenz_vorn;
                    break;
                case 8:
                    SigVal = MsgObj_Parkhilfe_01.PH_KD_Fehler;
                    break;
                case 9:
                    SigVal = MsgObj_Parkhilfe_01.PH_Lautstaerke_hinten;
                    break;
                case 10:
                    SigVal = MsgObj_Parkhilfe_01.PH_Lautstaerke_vorn;
                    break;
                case 11:
                    SigVal = MsgObj_Parkhilfe_01.PH_Opt_Anz_H_Hindernis;
                    break;
                case 12:
                    SigVal = MsgObj_Parkhilfe_01.PH_Opt_Anz_V_Hindernis;
                    break;
                case 13:
                    SigVal = MsgObj_Parkhilfe_01.PH_Opt_Anzeige_H_ein;
                    break;
                case 14:
                    SigVal = MsgObj_Parkhilfe_01.PH_Opt_Anzeige_V_ein;
                    break;
                case 15:
                    SigVal = MsgObj_Parkhilfe_01.PH_StartStopp_Info;
                    break;
                case 16:
                    SigVal = MsgObj_Parkhilfe_01.PH_Systemzustand;
                    break;
                case 17:
                    SigVal = MsgObj_Parkhilfe_01.PH_Tongeber_H_aktiv;
                    break;
                case 18:
                    SigVal = MsgObj_Parkhilfe_01.PH_Tongeber_V_aktiv;
                    break;
                case 19:
                    SigVal = MsgObj_Parkhilfe_01.PH_Tongeber_mute;
                    break;
                case 20:
                    SigVal = MsgObj_Parkhilfe_01.PH_defekt;
                    break;
                case 21:
                    SigVal = MsgObj_Parkhilfe_01.PH_gestoert;
                    break;
                case 22:
                    SigVal = MsgObj_Parkhilfe_01.PH_res_00;
                    break;
                case 23:
                    SigVal = MsgObj_Parkhilfe_01.PH_res_01;
                    break;
                case 24:
                    SigVal = MsgObj_Parkhilfe_01.PH_res_02;
                    break;
                case 25:
                    SigVal = MsgObj_Parkhilfe_01.PH_res_03;
                    break;
                case 26:
                    SigVal = MsgObj_Parkhilfe_01.PH_res_04;
                    break;
                case 27:
                    SigVal = MsgObj_Parkhilfe_01.PH_res_05;
                    break;
                case 28:
                    SigVal = MsgObj_Parkhilfe_01.PH_res_06;
                    break;
                case 29:
                    SigVal = MsgObj_Parkhilfe_01.PH_res_07;
                    break;
                case 30:
                    SigVal = MsgObj_Parkhilfe_01.PH_res_08;
                    break;
                case 31:
                    SigVal = MsgObj_Parkhilfe_01.PH_res_09;
                    break;
                case 32:
                    SigVal = MsgObj_Parkhilfe_01.PH_res_10;
                    break;
                case 33:
                    SigVal = MsgObj_Parkhilfe_01.PH_res_11;
                    break;
                case 34:
                    SigVal = MsgObj_Parkhilfe_01.PH_res_12;
                    break;
                case 35:
                    SigVal = MsgObj_Parkhilfe_01.PH_res_24;
                    break;
                case 36:
                    SigVal = MsgObj_Parkhilfe_01.PH_res_25;
                    break;
                case 37:
                    SigVal = MsgObj_Parkhilfe_01.PH_res_26;
                    break;
                case 38:
                    SigVal = MsgObj_Parkhilfe_01.PH_res_27;
                    break;
                case 39:
                    SigVal = MsgObj_Parkhilfe_01.PH_res_28;
                    break;
                case 40:
                    SigVal = MsgObj_Parkhilfe_01.PH_res_29;
                    break;
                case 41:
                    SigVal = MsgObj_Parkhilfe_01.PH_res_30;
                    break;
                case 42:
                    SigVal = MsgObj_Parkhilfe_01.PH_res_31;
                    break;
                case 43:
                    SigVal = MsgObj_Parkhilfe_01.PH_res_48;
                    break;
            }
        }
        break;
        case FRM_HANDLE_Parkhilfe_1:
        {
            switch (SigIdx)
            {
                case 0:
                    SigVal = MsgObj_Parkhilfe_1.APS_Frequenz_hinten;
                    break;
                case 1:
                    SigVal = MsgObj_Parkhilfe_1.APS_Frequenz_vorn;
                    break;
                case 2:
                    SigVal = MsgObj_Parkhilfe_1.APS_Lautstaerke_hinten;
                    break;
                case 3:
                    SigVal = MsgObj_Parkhilfe_1.APS_Lautstaerke_vorn;
                    break;
                case 4:
                    SigVal = MsgObj_Parkhilfe_1.Anlage_defekt;
                    break;
                case 5:
                    SigVal = MsgObj_Parkhilfe_1.Eis_aus;
                    break;
                case 6:
                    SigVal = MsgObj_Parkhilfe_1.Geschwindigkeit_aus;
                    break;
                case 7:
                    SigVal = MsgObj_Parkhilfe_1.KD_Fehler_Parkhilfe;
                    break;
                case 8:
                    SigVal = MsgObj_Parkhilfe_1.Optische_Anzeige_aktiv;
                    break;
                case 9:
                    SigVal = MsgObj_Parkhilfe_1.PH_StSt_Info;
                    break;
                case 10:
                    SigVal = MsgObj_Parkhilfe_1.Rueckwaertsgang_aktiviert;
                    break;
                case 11:
                    SigVal = MsgObj_Parkhilfe_1.Schlechtweg_aus;
                    break;
                case 12:
                    SigVal = MsgObj_Parkhilfe_1.Taster_aktiviert;
                    break;
                case 13:
                    SigVal = MsgObj_Parkhilfe_1.Tongeber_h_aktiv;
                    break;
                case 14:
                    SigVal = MsgObj_Parkhilfe_1.Tongeber_h_defekt;
                    break;
                case 15:
                    SigVal = MsgObj_Parkhilfe_1.Tongeber_v_aktiv;
                    break;
                case 16:
                    SigVal = MsgObj_Parkhilfe_1.Tongeber_v_defekt;
                    break;
            }
        }
        break;
        case FRM_HANDLE_Remotestart_FFB:
        {
            switch (SigIdx)
            {
                case 0:
                    SigVal = MsgObj_Remotestart_FFB.RSF_Tastencode_1;
                    break;
                case 1:
                    SigVal = MsgObj_Remotestart_FFB.RSF_Tastencode_2;
                    break;
                case 2:
                    SigVal = MsgObj_Remotestart_FFB.RSF_Tastencode_Maske;
                    break;
            }
        }
        break;
        case FRM_HANDLE_Soll_Verbauliste_neu:
        {
            switch (SigIdx)
            {
                case 0:
                    SigVal = MsgObj_Soll_Verbauliste_neu.VL1_ABS;
                    break;
                case 1:
                    SigVal = MsgObj_Soll_Verbauliste_neu.VL1_ADR;
                    break;
                case 2:
                    SigVal = MsgObj_Soll_Verbauliste_neu.VL1_ADR_getrennt;
                    break;
                case 3:
                    SigVal = MsgObj_Soll_Verbauliste_neu.VL1_Airbag;
                    break;
                case 4:
                    SigVal = MsgObj_Soll_Verbauliste_neu.VL1_Allrad;
                    break;
                case 5:
                    SigVal = MsgObj_Soll_Verbauliste_neu.VL1_Anhaenger;
                    break;
                case 6:
                    SigVal = MsgObj_Soll_Verbauliste_neu.VL1_BSG_Komf;
                    break;
                case 7:
                    SigVal = MsgObj_Soll_Verbauliste_neu.VL1_Clima_Komf;
                    break;
                case 8:
                    SigVal = MsgObj_Soll_Verbauliste_neu.VL1_DAB;
                    break;
                case 9:
                    SigVal = MsgObj_Soll_Verbauliste_neu.VL1_DSP;
                    break;
                case 10:
                    SigVal = MsgObj_Soll_Verbauliste_neu.VL1_Daempfer;
                    break;
                case 11:
                    SigVal = MsgObj_Soll_Verbauliste_neu.VL1_EPB;
                    break;
                case 12:
                    SigVal = MsgObj_Soll_Verbauliste_neu.VL1_Easy_Entry_VB;
                    break;
                case 13:
                    SigVal = MsgObj_Soll_Verbauliste_neu.VL1_Easy_Entry_VF;
                    break;
                case 14:
                    SigVal = MsgObj_Soll_Verbauliste_neu.VL1_Einparkhilfe;
                    break;
                case 15:
                    SigVal = MsgObj_Soll_Verbauliste_neu.VL1_GSM_Pager;
                    break;
                case 16:
                    SigVal = MsgObj_Soll_Verbauliste_neu.VL1_Gateway;
                    break;
                case 17:
                    SigVal = MsgObj_Soll_Verbauliste_neu.VL1_Getr_SG;
                    break;
                case 18:
                    SigVal = MsgObj_Soll_Verbauliste_neu.VL1_HCA;
                    break;
                case 19:
                    SigVal = MsgObj_Soll_Verbauliste_neu.VL1_Heckdeckel;
                    break;
                case 20:
                    SigVal = MsgObj_Soll_Verbauliste_neu.VL1_InfoElektronik;
                    break;
                case 21:
                    SigVal = MsgObj_Soll_Verbauliste_neu.VL1_Kombi;
                    break;
                case 22:
                    SigVal = MsgObj_Soll_Verbauliste_neu.VL1_Kombi_KBI;
                    break;
                case 23:
                    SigVal = MsgObj_Soll_Verbauliste_neu.VL1_Kompass;
                    break;
                case 24:
                    SigVal = MsgObj_Soll_Verbauliste_neu.VL1_LSM;
                    break;
                case 25:
                    SigVal = MsgObj_Soll_Verbauliste_neu.VL1_Lenkhilfe;
                    break;
                case 26:
                    SigVal = MsgObj_Soll_Verbauliste_neu.VL1_Lenksaeule;
                    break;
                case 27:
                    SigVal = MsgObj_Soll_Verbauliste_neu.VL1_MDI_I;
                    break;
                case 28:
                    SigVal = MsgObj_Soll_Verbauliste_neu.VL1_Memory;
                    break;
                case 29:
                    SigVal = MsgObj_Soll_Verbauliste_neu.VL1_Memory_BF;
                    break;
                case 30:
                    SigVal = MsgObj_Soll_Verbauliste_neu.VL1_MotorSlave;
                    break;
                case 31:
                    SigVal = MsgObj_Soll_Verbauliste_neu.VL1_Motor_SG;
                    break;
                case 32:
                    SigVal = MsgObj_Soll_Verbauliste_neu.VL1_Navigation;
                    break;
                case 33:
                    SigVal = MsgObj_Soll_Verbauliste_neu.VL1_Neigungsmodul_I;
                    break;
                case 34:
                    SigVal = MsgObj_Soll_Verbauliste_neu.VL1_PLA;
                    break;
                case 35:
                    SigVal = MsgObj_Soll_Verbauliste_neu.VL1_PTC_Heizung;
                    break;
                case 36:
                    SigVal = MsgObj_Soll_Verbauliste_neu.VL1_Quersperre;
                    break;
                case 37:
                    SigVal = MsgObj_Soll_Verbauliste_neu.VL1_RDK;
                    break;
                case 38:
                    SigVal = MsgObj_Soll_Verbauliste_neu.VL1_RKA_Plus;
                    break;
                case 39:
                    SigVal = MsgObj_Soll_Verbauliste_neu.VL1_RSE_I;
                    break;
                case 40:
                    SigVal = MsgObj_Soll_Verbauliste_neu.VL1_Radio;
                    break;
                case 41:
                    SigVal = MsgObj_Soll_Verbauliste_neu.VL1_Rearview;
                    break;
                case 42:
                    SigVal = MsgObj_Soll_Verbauliste_neu.VL1_SWA;
                    break;
                case 43:
                    SigVal = MsgObj_Soll_Verbauliste_neu.VL1_Soll_eq_Ist;
                    break;
                case 44:
                    SigVal = MsgObj_Soll_Verbauliste_neu.VL1_Sonderfzg_SG;
                    break;
                case 45:
                    SigVal = MsgObj_Soll_Verbauliste_neu.VL1_Standheiz;
                    break;
                case 46:
                    SigVal = MsgObj_Soll_Verbauliste_neu.VL1_TSG_BT;
                    break;
                case 47:
                    SigVal = MsgObj_Soll_Verbauliste_neu.VL1_TSG_FT;
                    break;
                case 48:
                    SigVal = MsgObj_Soll_Verbauliste_neu.VL1_TSG_HL;
                    break;
                case 49:
                    SigVal = MsgObj_Soll_Verbauliste_neu.VL1_TSG_HR;
                    break;
            }

            switch (SigIdx)
            {
                case 50:
                    SigVal = MsgObj_Soll_Verbauliste_neu.VL1_TV_Tuner;
                    break;
                case 51:
                    SigVal = MsgObj_Soll_Verbauliste_neu.VL1_Tastenmodul;
                    break;
                case 52:
                    SigVal = MsgObj_Soll_Verbauliste_neu.VL1_Telefon;
                    break;
                case 53:
                    SigVal = MsgObj_Soll_Verbauliste_neu.VL1_Telematik;
                    break;
                case 54:
                    SigVal = MsgObj_Soll_Verbauliste_neu.VL1_Verdeck;
                    break;
                case 55:
                    SigVal = MsgObj_Soll_Verbauliste_neu.VL1_WFS_K;
                    break;
                case 56:
                    SigVal = MsgObj_Soll_Verbauliste_neu.VL1_WFS_KBI;
                    break;
                case 57:
                    SigVal = MsgObj_Soll_Verbauliste_neu.VL1_ZKE;
                    break;
                case 58:
                    SigVal = MsgObj_Soll_Verbauliste_neu.VL1_Zentralelektrik_II;
                    break;
                case 59:
                    SigVal = MsgObj_Soll_Verbauliste_neu.VL1_dyn_LWR;
                    break;
                case 60:
                    SigVal = MsgObj_Soll_Verbauliste_neu.VL1_res_08;
                    break;
                case 61:
                    SigVal = MsgObj_Soll_Verbauliste_neu.VL1_res_13;
                    break;
                case 62:
                    SigVal = MsgObj_Soll_Verbauliste_neu.VL1_res_31;
                    break;
                case 63:
                    SigVal = MsgObj_Soll_Verbauliste_neu.VL1_res_42;
                    break;
            }
        }
        break;
        case FRM_HANDLE_Systeminfo_1:
        {
            switch (SigIdx)
            {
                case 0:
                    SigVal = MsgObj_Systeminfo_1.SY1_Ant_HV;
                    break;
                case 1:
                    SigVal = MsgObj_Systeminfo_1.SY1_Ant_NV;
                    break;
                case 2:
                    SigVal = MsgObj_Systeminfo_1.SY1_CAN_Info;
                    break;
                case 3:
                    SigVal = MsgObj_Systeminfo_1.SY1_CAN_extern;
                    break;
                case 4:
                    SigVal = MsgObj_Systeminfo_1.SY1_Diag_Ant;
                    break;
                case 5:
                    SigVal = MsgObj_Systeminfo_1.SY1_Diag_Info;
                    break;
                case 6:
                    SigVal = MsgObj_Systeminfo_1.SY1_Diag_Komf;
                    break;
                case 7:
                    SigVal = MsgObj_Systeminfo_1.SY1_ELV_Lock_Supply;
                    break;
                case 8:
                    SigVal = MsgObj_Systeminfo_1.SY1_Fehlereintr;
                    break;
                case 9:
                    SigVal = MsgObj_Systeminfo_1.SY1_Fzg_Derivat;
                    break;
                case 10:
                    SigVal = MsgObj_Systeminfo_1.SY1_Fzg_Gen;
                    break;
                case 11:
                    SigVal = MsgObj_Systeminfo_1.SY1_Fzg_Index;
                    break;
                case 12:
                    SigVal = MsgObj_Systeminfo_1.SY1_Fzg_Klasse;
                    break;
                case 13:
                    SigVal = MsgObj_Systeminfo_1.SY1_Fzg_Marke;
                    break;
                case 14:
                    SigVal = MsgObj_Systeminfo_1.SY1_Komf_HV;
                    break;
                case 15:
                    SigVal = MsgObj_Systeminfo_1.SY1_Komf_NV;
                    break;
                case 16:
                    SigVal = MsgObj_Systeminfo_1.SY1_Lenker;
                    break;
                case 17:
                    SigVal = MsgObj_Systeminfo_1.SY1_NWDF;
                    break;
                case 18:
                    SigVal = MsgObj_Systeminfo_1.SY1_NWDF_gueltig;
                    break;
                case 19:
                    SigVal = MsgObj_Systeminfo_1.SY1_Notbrems_Status;
                    break;
                case 20:
                    SigVal = MsgObj_Systeminfo_1.SY1_QRS_Messmodus;
                    break;
                case 21:
                    SigVal = MsgObj_Systeminfo_1.SY1_Relais_FAS_Zweig;
                    break;
                case 22:
                    SigVal = MsgObj_Systeminfo_1.SY1_Sleep_Info;
                    break;
                case 23:
                    SigVal = MsgObj_Systeminfo_1.SY1_Sleep_Komf;
                    break;
                case 24:
                    SigVal = MsgObj_Systeminfo_1.SY1_Transportmode;
                    break;
                case 25:
                    SigVal = MsgObj_Systeminfo_1.SY1_Tueren;
                    break;
                case 26:
                    SigVal = MsgObj_Systeminfo_1.SY1_Verbauinfo;
                    break;
                case 27:
                    SigVal = MsgObj_Systeminfo_1.SY1_res52;
                    break;
                case 28:
                    SigVal = MsgObj_Systeminfo_1.SY1_res53;
                    break;
                case 29:
                    SigVal = MsgObj_Systeminfo_1.SY1_res54;
                    break;
                case 30:
                    SigVal = MsgObj_Systeminfo_1.SY1_res55;
                    break;
                case 31:
                    SigVal = MsgObj_Systeminfo_1.SY1_res57;
                    break;
                case 32:
                    SigVal = MsgObj_Systeminfo_1.SY1_res58;
                    break;
                case 33:
                    SigVal = MsgObj_Systeminfo_1.SY1_res59;
                    break;
                case 34:
                    SigVal = MsgObj_Systeminfo_1.SY1_res60;
                    break;
                case 35:
                    SigVal = MsgObj_Systeminfo_1.SY1_res61;
                    break;
                case 36:
                    SigVal = MsgObj_Systeminfo_1.SY1_res62;
                    break;
                case 37:
                    SigVal = MsgObj_Systeminfo_1.SY1_res63;
                    break;
            }
        }
        break;
        case FRM_HANDLE_TOG:
        {
            switch (SigIdx)
            {
                case 0:
                    SigVal = MsgObj_TOG.TOG_Fuellstand_1;
                    break;
                case 1:
                    SigVal = MsgObj_TOG.TOG_Fuellstand_2;
                    break;
                case 2:
                    SigVal = MsgObj_TOG.TOG_Fuellstand_3;
                    break;
                case 3:
                    SigVal = MsgObj_TOG.TOG_Fuellstand_4;
                    break;
                case 4:
                    SigVal = MsgObj_TOG.TOG_OelmaxUeber;
                    break;
                case 5:
                    SigVal = MsgObj_TOG.TOG_Oelmax_hoch;
                    break;
                case 6:
                    SigVal = MsgObj_TOG.TOG_Oeltempzeit;
                    break;
                case 7:
                    SigVal = MsgObj_TOG.TOG_OelwarnUeber;
                    break;
                case 8:
                    SigVal = MsgObj_TOG.TOG_Oelwarn_hoch;
                    break;
                case 9:
                    SigVal = MsgObj_TOG.TOG_Reserve1;
                    break;
                case 10:
                    SigVal = MsgObj_TOG.TOG_Sensorfehler;
                    break;
                case 11:
                    SigVal = MsgObj_TOG.TOG_Zaehler;
                    break;
            }
        }
        break;
        case FRM_HANDLE_ZAS_1:
        {
            switch (SigIdx)
            {
                case 0:
                    SigVal = MsgObj_ZAS_1.CHK_ZAS;
                    break;
                case 1:
                    SigVal = MsgObj_ZAS_1.ZA1_Klemme_15;
                    break;
                case 2:
                    SigVal = MsgObj_ZAS_1.ZA1_Klemme_50;
                    break;
                case 3:
                    SigVal = MsgObj_ZAS_1.ZA1_Klemme_P;
                    break;
                case 4:
                    SigVal = MsgObj_ZAS_1.ZA1_Klemme_SV;
                    break;
                case 5:
                    SigVal = MsgObj_ZAS_1.ZA1_Klemme_X;
                    break;
                case 6:
                    SigVal = MsgObj_ZAS_1.ZA1_Reserve1;
                    break;
                case 7:
                    SigVal = MsgObj_ZAS_1.ZA1_S_Kontakt;
                    break;
                case 8:
                    SigVal = MsgObj_ZAS_1.ZA1_res07;
                    break;
                case 9:
                    SigVal = MsgObj_ZAS_1.Zaehler_ZAS;
                    break;
            }
        }
        break;
    }

    return (SigVal);
}
/*@@end*/

/*@@caplFunc:ShowPrompt():*/
ShowPrompt ()
{
    int SigVal = 0;

    switch (CaplCtrl_LevelActv)
    {
        /* currently no level selected */
        case CAPLCTRL_LEVEL_NOSEL:
        {
            if (CaplCtrl_PromptMode == CAPLCTRL_PROMPTMODE_NUM)
            {
                write("# > %s", CaplCtrl_InputBuf);
            }
            else
            {
                write("# > %s", CaplCtrl_CharBuf);
            }
        }
        break;

        case CAPLCTRL_LEVEL_FRAME:
        {
            GetFrameName(CaplCtrl_FrameActv);

            if (CaplCtrl_PromptMode == CAPLCTRL_PROMPTMODE_NUM)
            {
                write("# %s> %s", CaplCtrl_FrameName, CaplCtrl_InputBuf);
            }
            else
            {
                write("# %s> %s", CaplCtrl_FrameName, CaplCtrl_CharBuf);
            }
        }
        break;

        case CAPLCTRL_LEVEL_SIGNAL:
        {
            GetFrameName(CaplCtrl_FrameActv);
            GetSignalName(CaplCtrl_FrameActv, CaplCtrl_SignalActv);

            SigVal = GetSignalVal(CaplCtrl_FrameActv, CaplCtrl_SignalActv);

            if (CaplCtrl_PromptMode == CAPLCTRL_PROMPTMODE_NUM)
            {
                write("# %s.%s = %d> %s", CaplCtrl_FrameName, CaplCtrl_SignalName, SigVal, CaplCtrl_InputBuf);
            }
            else
            {
                write("# %s.%s = %d> %s", CaplCtrl_FrameName, CaplCtrl_SignalName, SigVal, CaplCtrl_CharBuf);
            }
        }
        break;
    }
}
/*@@end*/

/*@@caplFunc:Frm_CalcChecksumCRC8(int, message*, byte):*/
byte Frm_CalcChecksumCRC8(int FrmIdx, message *MsgObj, byte endval)
{
    int idx;
    byte crc;

    /* calculate CRC8 checksum */
    crc = 0xFF;
    /* IMPORTANT NOTE: assumes CRC8 is in byte 0 */
    for (idx = 1; idx < MsgObj.DLC; idx++)
    {
        crc = CRC8_tab_256[(MsgObj.BYTE(idx) ^ crc)];
    }
    crc = CRC8_tab_256[(endval ^ crc)];
    crc = ~crc;

    /* checksum calculation disabled, make sure checksum is wrong */
    if (Frm_MsgChksmEna[FrmIdx] == 0)
    {
        crc = ~crc;
    }

   	return (crc);
}
/*@@end*/

/*@@caplFunc:Frm_CalcChecksumCRC8Id(int, message*):*/
byte Frm_CalcChecksumCRC8Id(int FrmIdx, message *MsgObj)
{
    byte crcid;

    /* XOR high byte and low byte of CAN ID - used as checksum end value */
	crcid = MsgObj.ID;
    crcid = crcid ^ ((MsgObj.ID >> 8) & 0xFF);

    return Frm_CalcChecksumCRC8(FrmIdx, MsgObj, crcid);
}
/*@@end*/

/*@@caplFunc:Frm_CalcChecksumCRC8Dyn(int, message*, int):*/
byte Frm_CalcChecksumCRC8Dyn(int FrmIdx, message *MsgObj, int MsgCnt)
{
    byte crcid;
    byte ChksmEndVal[FRM_NUM_MAX][16] =
    {
        { 0x00,0x00,0x00,0x00,0x00,0x00,0x00,0x00,0x00,0x00,0x00,0x00,0x00,0x00,0x00,0x00 },
        { 0x00,0x00,0x00,0x00,0x00,0x00,0x00,0x00,0x00,0x00,0x00,0x00,0x00,0x00,0x00,0x00 },
        { 0x00,0x00,0x00,0x00,0x00,0x00,0x00,0x00,0x00,0x00,0x00,0x00,0x00,0x00,0x00,0x00 },
        { 0x00,0x00,0x00,0x00,0x00,0x00,0x00,0x00,0x00,0x00,0x00,0x00,0x00,0x00,0x00,0x00 },
        { 0x00,0x00,0x00,0x00,0x00,0x00,0x00,0x00,0x00,0x00,0x00,0x00,0x00,0x00,0x00,0x00 },
        { 0x00,0x00,0x00,0x00,0x00,0x00,0x00,0x00,0x00,0x00,0x00,0x00,0x00,0x00,0x00,0x00 },
        { 0x00,0x00,0x00,0x00,0x00,0x00,0x00,0x00,0x00,0x00,0x00,0x00,0x00,0x00,0x00,0x00 },
        { 0x00,0x00,0x00,0x00,0x00,0x00,0x00,0x00,0x00,0x00,0x00,0x00,0x00,0x00,0x00,0x00 },
        { 0x00,0x00,0x00,0x00,0x00,0x00,0x00,0x00,0x00,0x00,0x00,0x00,0x00,0x00,0x00,0x00 },
        { 0x00,0x00,0x00,0x00,0x00,0x00,0x00,0x00,0x00,0x00,0x00,0x00,0x00,0x00,0x00,0x00 },
        { 0x00,0x00,0x00,0x00,0x00,0x00,0x00,0x00,0x00,0x00,0x00,0x00,0x00,0x00,0x00,0x00 },
        { 0x00,0x00,0x00,0x00,0x00,0x00,0x00,0x00,0x00,0x00,0x00,0x00,0x00,0x00,0x00,0x00 },
        { 0x00,0x00,0x00,0x00,0x00,0x00,0x00,0x00,0x00,0x00,0x00,0x00,0x00,0x00,0x00,0x00 },
        { 0x00,0x00,0x00,0x00,0x00,0x00,0x00,0x00,0x00,0x00,0x00,0x00,0x00,0x00,0x00,0x00 },
        { 0x00,0x00,0x00,0x00,0x00,0x00,0x00,0x00,0x00,0x00,0x00,0x00,0x00,0x00,0x00,0x00 },
        { 0x00,0x00,0x00,0x00,0x00,0x00,0x00,0x00,0x00,0x00,0x00,0x00,0x00,0x00,0x00,0x00 },
        { 0x00,0x00,0x00,0x00,0x00,0x00,0x00,0x00,0x00,0x00,0x00,0x00,0x00,0x00,0x00,0x00 },
        { 0x00,0x00,0x00,0x00,0x00,0x00,0x00,0x00,0x00,0x00,0x00,0x00,0x00,0x00,0x00,0x00 },
        { 0x00,0x00,0x00,0x00,0x00,0x00,0x00,0x00,0x00,0x00,0x00,0x00,0x00,0x00,0x00,0x00 },
        { 0x00,0x00,0x00,0x00,0x00,0x00,0x00,0x00,0x00,0x00,0x00,0x00,0x00,0x00,0x00,0x00 },
        { 0x00,0x00,0x00,0x00,0x00,0x00,0x00,0x00,0x00,0x00,0x00,0x00,0x00,0x00,0x00,0x00 },
        { 0x00,0x00,0x00,0x00,0x00,0x00,0x00,0x00,0x00,0x00,0x00,0x00,0x00,0x00,0x00,0x00 },
        { 0x00,0x00,0x00,0x00,0x00,0x00,0x00,0x00,0x00,0x00,0x00,0x00,0x00,0x00,0x00,0x00 },
        { 0x00,0x00,0x00,0x00,0x00,0x00,0x00,0x00,0x00,0x00,0x00,0x00,0x00,0x00,0x00,0x00 },
        { 0x00,0x00,0x00,0x00,0x00,0x00,0x00,0x00,0x00,0x00,0x00,0x00,0x00,0x00,0x00,0x00 },
        { 0x00,0x00,0x00,0x00,0x00,0x00,0x00,0x00,0x00,0x00,0x00,0x00,0x00,0x00,0x00,0x00 },
        { 0x00,0x00,0x00,0x00,0x00,0x00,0x00,0x00,0x00,0x00,0x00,0x00,0x00,0x00,0x00,0x00 },
        { 0x00,0x00,0x00,0x00,0x00,0x00,0x00,0x00,0x00,0x00,0x00,0x00,0x00,0x00,0x00,0x00 },
        { 0x00,0x00,0x00,0x00,0x00,0x00,0x00,0x00,0x00,0x00,0x00,0x00,0x00,0x00,0x00,0x00 },
        { 0x00,0x00,0x00,0x00,0x00,0x00,0x00,0x00,0x00,0x00,0x00,0x00,0x00,0x00,0x00,0x00 },
        { 0x00,0x00,0x00,0x00,0x00,0x00,0x00,0x00,0x00,0x00,0x00,0x00,0x00,0x00,0x00,0x00 },
        { 0x00,0x00,0x00,0x00,0x00,0x00,0x00,0x00,0x00,0x00,0x00,0x00,0x00,0x00,0x00,0x00 },
        { 0x00,0x00,0x00,0x00,0x00,0x00,0x00,0x00,0x00,0x00,0x00,0x00,0x00,0x00,0x00,0x00 },
        { 0x00,0x00,0x00,0x00,0x00,0x00,0x00,0x00,0x00,0x00,0x00,0x00,0x00,0x00,0x00,0x00 },
        { 0x00,0x00,0x00,0x00,0x00,0x00,0x00,0x00,0x00,0x00,0x00,0x00,0x00,0x00,0x00,0x00 },
        { 0x00,0x00,0x00,0x00,0x00,0x00,0x00,0x00,0x00,0x00,0x00,0x00,0x00,0x00,0x00,0x00 },
        { 0x00,0x00,0x00,0x00,0x00,0x00,0x00,0x00,0x00,0x00,0x00,0x00,0x00,0x00,0x00,0x00 },
        { 0x00,0x00,0x00,0x00,0x00,0x00,0x00,0x00,0x00,0x00,0x00,0x00,0x00,0x00,0x00,0x00 },
        { 0x00,0x00,0x00,0x00,0x00,0x00,0x00,0x00,0x00,0x00,0x00,0x00,0x00,0x00,0x00,0x00 },
        { 0x00,0x00,0x00,0x00,0x00,0x00,0x00,0x00,0x00,0x00,0x00,0x00,0x00,0x00,0x00,0x00 },
        { 0x00,0x00,0x00,0x00,0x00,0x00,0x00,0x00,0x00,0x00,0x00,0x00,0x00,0x00,0x00,0x00 },
        { 0x00,0x00,0x00,0x00,0x00,0x00,0x00,0x00,0x00,0x00,0x00,0x00,0x00,0x00,0x00,0x00 },
        { 0x00,0x00,0x00,0x00,0x00,0x00,0x00,0x00,0x00,0x00,0x00,0x00,0x00,0x00,0x00,0x00 },
        { 0x00,0x00,0x00,0x00,0x00,0x00,0x00,0x00,0x00,0x00,0x00,0x00,0x00,0x00,0x00,0x00 },
        { 0x00,0x00,0x00,0x00,0x00,0x00,0x00,0x00,0x00,0x00,0x00,0x00,0x00,0x00,0x00,0x00 },
        { 0x00,0x00,0x00,0x00,0x00,0x00,0x00,0x00,0x00,0x00,0x00,0x00,0x00,0x00,0x00,0x00 }
    };

    /* checksum end value is based on message counter value */
    crcid = ChksmEndVal[FrmIdx][MsgCnt];

    return Frm_CalcChecksumCRC8(FrmIdx, MsgObj, crcid);
}
/*@@end*/

/*@@caplFunc:Frm_CalcChecksumXOR(int, message*, int):*/
byte Frm_CalcChecksumXOR(int FrmIdx, message *MsgObj, int dChksmIdx)
{
    int idx;
    byte chksm;

    /* reset checksum byte */
    MsgObj.BYTE(dChksmIdx) = 0;

    /* init checksum value */
    chksm = 0;

    /* calculate checksum */
    for (idx = 0; idx < MsgObj.DLC; idx++)
    {
        if (idx != dChksmIdx)
        {
            /* XOR all bytes */
            chksm = chksm ^ MsgObj.BYTE(idx);
        }
    }

    /* checksum calculation disabled, make sure checksum is wrong */
    if (Frm_MsgChksmEna[FrmIdx] == 0)
    {
        chksm = ~chksm;
    }

	return (chksm);
}
/*@@end*/

/*@@caplFunc:Frm_CalcChecksumXORID(int, message*, int):*/
byte Frm_CalcChecksumXORID(int FrmIdx, message *MsgObj, int dChksmIdx)
{
    int idx;
    byte chksm;

    /* reset checksum byte */
    MsgObj.BYTE(dChksmIdx) = 0;

    /* init checksum value */
    chksm = 0;

    /* calculate checksum */
    for (idx = 0; idx < MsgObj.DLC; idx++)
    {
        if (idx != dChksmIdx)
        {
            /* XOR all bytes */
            chksm = chksm ^ MsgObj.BYTE(idx);
        }
    }

    /* add high and low byte of CAN ID */
    chksm = chksm ^ (MsgObj.ID & 0xFF);
    chksm = chksm ^ ((MsgObj.ID >> 8) & 0xFF);

    /* checksum calculation disabled, make sure checksum is wrong */
    if (Frm_MsgChksmEna[FrmIdx] == 0)
    {
        chksm = ~chksm;
    }

	return (chksm);
}
/*@@end*/

/*@@caplFunc:Frm_CalcChecksumLW1(int, message*, int):*/
byte Frm_CalcChecksumLW1(int FrmIdx, message *MsgObj, int dChksmIdx)
{
    int idx;
    byte chksm;

    /* reset checksum byte */
    MsgObj.BYTE(dChksmIdx) = 0;

    /* init checksum value */
    chksm = 0;

    /* calculate checksum */
    chksm = ((MsgObj.BYTE(0) + MsgObj.BYTE(1) + MsgObj.BYTE(2) + MsgObj.BYTE(3) + MsgObj.BYTE(5)) & 0xFF);
    chksm = ~chksm;

    /* checksum calculation disabled, make sure checksum is wrong */
    if (Frm_MsgChksmEna[FrmIdx] == 0)
    {
        chksm = ~chksm;
    }

	return (chksm);
}
/*@@end*/

/*@@caplFunc:Frm_CalcMsgCounter(int):*/
int Frm_CalcMsgCounter(int FrmIdx)
{
    /* IMPORTANT NOTE: currently it is assumed that message counter is 4 bit long */
    if (Frm_MsgCounterEna[FrmIdx] != 0)
    {
        Frm_MsgCounter[FrmIdx] ++;
        Frm_MsgCounter[FrmIdx] &= 0x0F;
    }

    return (Frm_MsgCounter[FrmIdx]);
}
/*@@end*/

/*@@caplFunc:FrmSch_EnableFrame(long):*/
FrmSch_EnableFrame(long FrmIdx)
{
    /* enable TX of CAN frame */
    FrmSched_FrmEna[FrmIdx] = 1;
}
/*@@end*/

/*@@caplFunc:FrmSch_DisableFrame(long):*/
FrmSch_DisableFrame(long FrmIdx)
{
    /* enable TX of CAN frame */
    FrmSched_FrmEna[FrmIdx] = 0;
}
/*@@end*/

/*@@caplFunc:FrmSch_EnableAllFrames():*/
FrmSch_EnableAllFrames()
{
    int FrmIdx;

    for (FrmIdx = 0; FrmIdx < FRM_NUM_MAX; FrmIdx++)
    {
        /* enable scheduler for all frames */
        FrmSched_FrmEna[FrmIdx] = 1;
    }
}
/*@@end*/

/*@@caplFunc:FrmSch_DisableAllFrames():*/
FrmSch_DisableAllFrames()
{
    int FrmIdx;

    for (FrmIdx = 0; FrmIdx < FRM_NUM_MAX; FrmIdx++)
    {
        /* disable scheduler for all frames */
        FrmSched_FrmEna[FrmIdx] = 0;
    }
}
/*@@end*/

/*@@caplFunc:Frm_EnableMsgCounter(long):*/
Frm_EnableMsgCounter(long FrmIdx)
{
    /* enable message counter calculation */
    Frm_MsgCounterEna[FrmIdx] = 1;
}
/*@@end*/

/*@@caplFunc:Frm_DisableMsgCounter(long):*/
Frm_DisableMsgCounter(long FrmIdx)
{
    /* disable message counter calculation */
    Frm_MsgCounterEna[FrmIdx] = 0;
}
/*@@end*/

/*@@caplFunc:Frm_EnableChksm(long):*/
Frm_EnableChksm(long FrmIdx)
{
    /* enable checksum calculation */
    Frm_MsgChksmEna[FrmIdx] = 1;
}
/*@@end*/

/*@@caplFunc:Frm_DisableChksm(long):*/
Frm_DisableChksm(long FrmIdx)
{
    /* disable checksum calculation */
    Frm_MsgChksmEna[FrmIdx] = 0;
}
/*@@end*/
