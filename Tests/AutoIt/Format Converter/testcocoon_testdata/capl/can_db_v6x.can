/*@@var:*/
/* TemplateVersion: 1.0.2 */
variables 
{
    /**********************************************************************************************/
    /* BEGIN AUTO                                                                                 */
    /**********************************************************************************************/
    
    message ACC_01 MsgObj_ACC_01;
    message ACC_05 MsgObj_ACC_05;
    message Airbag_01 MsgObj_Airbag_01;
    message Airbag_02 MsgObj_Airbag_02;
    message Allrad_02 MsgObj_Allrad_02;
    message Anhaenger_01 MsgObj_Anhaenger_01;
    message BEM_01 MsgObj_BEM_01;
    message Charisma_01 MsgObj_Charisma_01;
    message Diagnose_01 MsgObj_Diagnose_01;
    message EPB_01 MsgObj_EPB_01;
    message ESP_01 MsgObj_ESP_01;
    message ESP_02 MsgObj_ESP_02;
    message ESP_03 MsgObj_ESP_03;
    message ESP_05 MsgObj_ESP_05;
    message ESP_07_FR MsgObj_ESP_07_FR;
    message ESP_16 MsgObj_ESP_16;
    message ESP_K_10 MsgObj_ESP_K_10;
    message Einheiten_01 MsgObj_Einheiten_01;
    message Fahrwerk_02 MsgObj_Fahrwerk_02;
    message GW_Fwk_01_Ant_PAG MsgObj_GW_Fwk_01_Ant_PAG;
    message Gateway_05 MsgObj_Gateway_05;
    message Gateway_11 MsgObj_Gateway_11;
    message Getriebe_01 MsgObj_Getriebe_01;
    message Getriebe_02 MsgObj_Getriebe_02;
    message Getriebe_03 MsgObj_Getriebe_03;
    message Getriebe_04 MsgObj_Getriebe_04;
    message Kessy_02 MsgObj_Kessy_02;
    message Klemmen_Status_01 MsgObj_Klemmen_Status_01;
    message Klima_01 MsgObj_Klima_01;
    message Kombi_01 MsgObj_Kombi_01;
    message Kombi_02 MsgObj_Kombi_02;
    message Kombi_03 MsgObj_Kombi_03;
    message LH_EPS_02 MsgObj_LH_EPS_02;
    message LS_01 MsgObj_LS_01;
    message LWI_01 MsgObj_LWI_01;
    message Licht_hinten_01 MsgObj_Licht_hinten_01;
    message NMH_Gateway MsgObj_NMH_Gateway;
    message OBD_Tankgeber_01 MsgObj_OBD_Tankgeber_01;
    message SCR_01 MsgObj_SCR_01;
    message SCR_02 MsgObj_SCR_02;
    message SCR_03 MsgObj_SCR_03;
    message SCR_04 MsgObj_SCR_04;
    message SCR_05 MsgObj_SCR_05;
    message SCR_CAL_ID1 MsgObj_SCR_CAL_ID1;
    message SCR_CAL_ID2 MsgObj_SCR_CAL_ID2;
    message SCU_01 MsgObj_SCU_01;
    message STH_01 MsgObj_STH_01;
    message STS_01 MsgObj_STS_01;
    message Systeminfo_01 MsgObj_Systeminfo_01;

    const FRM_HANDLE_ACC_01 = 0;
    const FRM_HANDLE_ACC_05 = 1;
    const FRM_HANDLE_Airbag_01 = 2;
    const FRM_HANDLE_Airbag_02 = 3;
    const FRM_HANDLE_Allrad_02 = 4;
    const FRM_HANDLE_Anhaenger_01 = 5;
    const FRM_HANDLE_BEM_01 = 6;
    const FRM_HANDLE_Charisma_01 = 7;
    const FRM_HANDLE_Diagnose_01 = 8;
    const FRM_HANDLE_EPB_01 = 9;
    const FRM_HANDLE_ESP_01 = 10;
    const FRM_HANDLE_ESP_02 = 11;
    const FRM_HANDLE_ESP_03 = 12;
    const FRM_HANDLE_ESP_05 = 13;
    const FRM_HANDLE_ESP_07_FR = 14;
    const FRM_HANDLE_ESP_16 = 15;
    const FRM_HANDLE_ESP_K_10 = 16;
    const FRM_HANDLE_Einheiten_01 = 17;
    const FRM_HANDLE_Fahrwerk_02 = 18;
    const FRM_HANDLE_GW_Fwk_01_Ant_PAG = 19;
    const FRM_HANDLE_Gateway_05 = 20;
    const FRM_HANDLE_Gateway_11 = 21;
    const FRM_HANDLE_Getriebe_01 = 22;
    const FRM_HANDLE_Getriebe_02 = 23;
    const FRM_HANDLE_Getriebe_03 = 24;
    const FRM_HANDLE_Getriebe_04 = 25;
    const FRM_HANDLE_Kessy_02 = 26;
    const FRM_HANDLE_Klemmen_Status_01 = 27;
    const FRM_HANDLE_Klima_01 = 28;
    const FRM_HANDLE_Kombi_01 = 29;
    const FRM_HANDLE_Kombi_02 = 30;
    const FRM_HANDLE_Kombi_03 = 31;
    const FRM_HANDLE_LH_EPS_02 = 32;
    const FRM_HANDLE_LS_01 = 33;
    const FRM_HANDLE_LWI_01 = 34;
    const FRM_HANDLE_Licht_hinten_01 = 35;
    const FRM_HANDLE_NMH_Gateway = 36;
    const FRM_HANDLE_OBD_Tankgeber_01 = 37;
    const FRM_HANDLE_SCR_01 = 38;
    const FRM_HANDLE_SCR_02 = 39;
    const FRM_HANDLE_SCR_03 = 40;
    const FRM_HANDLE_SCR_04 = 41;
    const FRM_HANDLE_SCR_05 = 42;
    const FRM_HANDLE_SCR_CAL_ID1 = 43;
    const FRM_HANDLE_SCR_CAL_ID2 = 44;
    const FRM_HANDLE_SCU_01 = 45;
    const FRM_HANDLE_STH_01 = 46;
    const FRM_HANDLE_STS_01 = 47;
    const FRM_HANDLE_Systeminfo_01 = 48;

    const FRM_NUM_MAX = 49;


    /**********************************************************************************************/
    /* END AUTO                                                                                   */
    /**********************************************************************************************/


    /* ------------------------------------------------------------------------------------------ */
    /*  timer                                                                                     */
    /* ------------------------------------------------------------------------------------------ */
    msTimer Timer_10ms;                   /* 10ms base timer */
    const TIMER_DURATION_10MS = 10;       /* timer duration for 10ms timer */
    

    /* ------------------------------------------------------------------------------------------ */
    /*  frame scheduler                                                                           */
    /* ------------------------------------------------------------------------------------------ */
    int FrmSched_SchedTmr[FRM_NUM_MAX];   /* schedule timer, incremented every 10ms, resolution [1ms] */
    int FrmSched_CycleTime[FRM_NUM_MAX];  /* cycle time of the CAN frame, resolution [1ms] */
    int FrmSched_FrmEna[FRM_NUM_MAX];     /* frame enable status */


    /* ------------------------------------------------------------------------------------------ */
    /*  frame manager                                                                             */
    /* ------------------------------------------------------------------------------------------ */
    int Frm_MsgCounter[FRM_NUM_MAX];      /* current message counter value */
    int Frm_MsgCounterEna[FRM_NUM_MAX];   /* message counter enable status */
    int Frm_MsgChksmEna[FRM_NUM_MAX];     /* checksum enable status */
    int Frm_DLC[FRM_NUM_MAX];             /* DLC */
    int Frm_DLCOk[FRM_NUM_MAX];           /* DLC status (0=DLC wrong, 1=DLC ok) */

    
    /* ------------------------------------------------------------------------------------------ */
    /*  CAPL control                                                                              */
    /* ------------------------------------------------------------------------------------------ */
    const CAPLCTRL_LEVEL_NOSEL = 0;
    const CAPLCTRL_LEVEL_FRAME = 1;
    const CAPLCTRL_LEVEL_SIGNAL = 2;

    const CAPLCTRL_NOVAL = -1;

    const CAPLCTRL_INPUTBUF_LEN = 32;
    const CAPLCTRL_CHARBUF_LEN = 64;

    const CAPLCTRL_PROMPTMODE_NUM = 0;
    const CAPLCTRL_PROMPTMODE_CHAR = 1;

    int  CaplCtrl_LevelActv = CAPLCTRL_LEVEL_NOSEL;  /* current active level */
    int  CaplCtrl_FrameActv = 0;                     /* current selected frame */
    int  CaplCtrl_SignalActv = 0;                    /* current selected signal */
    long CaplCtrl_InputValue = 0;                    /* current input value */
    char CaplCtrl_InputBuf[CAPLCTRL_INPUTBUF_LEN];   /* user input buffer */
    int  CaplCtrl_InputIdx = 0;                      /* index into input buffer */
    char CaplCtrl_FrameName[32];                     /* buffer to store frame name */
    char CaplCtrl_SignalName[64];                    /* buffer to store signal name */
    int  CaplCtrl_PromptMode;                        /* prompt mode */
    char CaplCtrl_CharBuf[CAPLCTRL_CHARBUF_LEN];     /* buffer for char output in prompt */


    /* ------------------------------------------------------------------------------------------ */
    /*  key codes                                                                                 */
    /* ------------------------------------------------------------------------------------------ */
    const KEY_ENTER = 0x0D;
    const KEY_BACKSPACE = 0x08;
    const KEY_UP = 0x4800;
    const KEY_DOWN = 0x5000;
    const KEY_TAB = 0x09;
    const KEY_LEVEL_DOWN = '.';
    const KEY_TIMEOUT = 'a';
    const KEY_MSGCNT = 'b';
    const KEY_CHKSM = 'c';
    const KEY_DLC = 'd';
    const KEY_HELP = '?';


    /* ------------------------------------------------------------------------------------------ */
    /*  checksum related variables                                                                */
    /* ------------------------------------------------------------------------------------------ */
    byte CRC8_tab_256[256] =
    {
        0x00, 0x2f, 0x5e, 0x71, 0xbc, 0x93, 0xe2, 0xcd,
        0x57, 0x78, 0x09, 0x26, 0xeb, 0xc4, 0xb5, 0x9a,
        0xae, 0x81, 0xf0, 0xdf, 0x12, 0x3d, 0x4c, 0x63,
        0xf9, 0xd6, 0xa7, 0x88, 0x45, 0x6a, 0x1b, 0x34,
        0x73, 0x5c, 0x2d, 0x02, 0xcf, 0xe0, 0x91, 0xbe,
        0x24, 0x0b, 0x7a, 0x55, 0x98, 0xb7, 0xc6, 0xe9,
        0xdd, 0xf2, 0x83, 0xac, 0x61, 0x4e, 0x3f, 0x10,
        0x8a, 0xa5, 0xd4, 0xfb, 0x36, 0x19, 0x68, 0x47,
        0xe6, 0xc9, 0xb8, 0x97, 0x5a, 0x75, 0x04, 0x2b,
        0xb1, 0x9e, 0xef, 0xc0, 0x0d, 0x22, 0x53, 0x7c,
        0x48, 0x67, 0x16, 0x39, 0xf4, 0xdb, 0xaa, 0x85,
        0x1f, 0x30, 0x41, 0x6e, 0xa3, 0x8c, 0xfd, 0xd2,
        0x95, 0xba, 0xcb, 0xe4, 0x29, 0x06, 0x77, 0x58,
        0xc2, 0xed, 0x9c, 0xb3, 0x7e, 0x51, 0x20, 0x0f,
        0x3b, 0x14, 0x65, 0x4a, 0x87, 0xa8, 0xd9, 0xf6,
        0x6c, 0x43, 0x32, 0x1d, 0xd0, 0xff, 0x8e, 0xa1,
        0xe3, 0xcc, 0xbd, 0x92, 0x5f, 0x70, 0x01, 0x2e,
        0xb4, 0x9b, 0xea, 0xc5, 0x08, 0x27, 0x56, 0x79,
        0x4d, 0x62, 0x13, 0x3c, 0xf1, 0xde, 0xaf, 0x80,
        0x1a, 0x35, 0x44, 0x6b, 0xa6, 0x89, 0xf8, 0xd7,
        0x90, 0xbf, 0xce, 0xe1, 0x2c, 0x03, 0x72, 0x5d,
        0xc7, 0xe8, 0x99, 0xb6, 0x7b, 0x54, 0x25, 0x0a,
        0x3e, 0x11, 0x60, 0x4f, 0x82, 0xad, 0xdc, 0xf3,
        0x69, 0x46, 0x37, 0x18, 0xd5, 0xfa, 0x8b, 0xa4,
        0x05, 0x2a, 0x5b, 0x74, 0xb9, 0x96, 0xe7, 0xc8,
        0x52, 0x7d, 0x0c, 0x23, 0xee, 0xc1, 0xb0, 0x9f,
        0xab, 0x84, 0xf5, 0xda, 0x17, 0x38, 0x49, 0x66,
        0xfc, 0xd3, 0xa2, 0x8d, 0x40, 0x6f, 0x1e, 0x31,
        0x76, 0x59, 0x28, 0x07, 0xca, 0xe5, 0x94, 0xbb,
        0x21, 0x0e, 0x7f, 0x50, 0x9d, 0xb2, 0xc3, 0xec,
        0xd8, 0xf7, 0x86, 0xa9, 0x64, 0x4b, 0x3a, 0x15,
        0x8f, 0xa0, 0xd1, 0xfe, 0x33, 0x1c, 0x6d, 0x42
    };
}
/*@@end*/

/*@@timer:Timer_10ms:*/
on timer Timer_10ms
{
    int FrmIdx;

    /* restart the 10ms timer */
    setTimer(Timer_10ms,TIMER_DURATION_10MS);


    /* ------------------------------------------------------------------------------------------ */
    /*  BEGIN Frame Scheduler                                                                     */
    /* ------------------------------------------------------------------------------------------ */

    for (FrmIdx = 0; FrmIdx < FRM_NUM_MAX; FrmIdx++)
    {
        /* check if frame is enabled */
        if (FrmSched_FrmEna[FrmIdx] != 0)
        {
            /* increment schedule timer */
            FrmSched_SchedTmr[FrmIdx] += 10;
        }
        else
        {
            /* frame disabled, stop schedule timer */
            FrmSched_SchedTmr[FrmIdx] = 0;
        }

        /* if schedule timer reaches cycle time, trigger transfer of CAN frame */
        if (FrmSched_SchedTmr[FrmIdx] >= FrmSched_CycleTime[FrmIdx])
        {
            /* reset schedule timer */
            FrmSched_SchedTmr[FrmIdx] = 0;

            /* trigger transmission of frame */
            FrmSched_SendFrame(FrmIdx);
        }
    }

    /* ------------------------------------------------------------------------------------------ */
    /*  END Frame Scheduler                                                                       */
    /* ------------------------------------------------------------------------------------------ */
}
/*@@end*/

/*@@preStart:PreStart:*/
on preStart
{
    dword fhdlIn;
    dword fhdlOut;
    
    /* ------------------------------------------------------------------------------------------ */
    /*  BEGIN frame and signal handle export for remote control of CAPL by Perl script            */
    /* ------------------------------------------------------------------------------------------ */

    /* check if CAPL is remote controlled by CaplCtrl Perl script */
    /* NOTE: Communication between CAPL program and Perl scritp is done via file, since with */
    /*       CANalyzer Version v4 it is not possible to use environment variables, so this is */
    /*       just a workaround. */
    fhdlIn = openFileRead ("caplctrl_req.txt", 0);
    if (fhdlIn != 0)
    {
        /* close input file */
        fileClose(fhdlIn);

        /* export frame and signal handles to file for remote control scripts */
        fhdlOut = openFileWrite ("caplctrl.txt", 0);
        if (fhdlOut != 0)
        {
            /* NOTE:   handles are 2 bytes long. */
            /* LAYOUT: frame handle: lower byte = 0xFF, upper byte = frame handle for CAPL program */
            /*         signal handle: lower byte = signal index, upper byte = frame index */
            filePutString ("ACC_01;255\n", 11, fhdlOut);
            filePutString ("ACC_01;ACC01;AliasName\n", 23, fhdlOut);    /* alias frame handle for ACC_01 */
            filePutString ("ACC_05;511\n", 11, fhdlOut);
            filePutString ("ACC_05;ACC05;AliasName\n", 23, fhdlOut);    /* alias frame handle for ACC_05 */
            filePutString ("Airbag_01;767\n", 14, fhdlOut);
            filePutString ("Airbag_01;AIRBG01;AliasName\n", 28, fhdlOut);    /* alias frame handle for Airbag_01 */
            filePutString ("Airbag_02;1023\n", 15, fhdlOut);
            filePutString ("Airbag_02;AIRBG02;AliasName\n", 28, fhdlOut);    /* alias frame handle for Airbag_02 */
            filePutString ("Allrad_02;1279\n", 15, fhdlOut);
            filePutString ("Allrad_02;AWD02;AliasName\n", 26, fhdlOut);    /* alias frame handle for Allrad_02 */
            filePutString ("Anhaenger_01;1535\n", 18, fhdlOut);
            filePutString ("Anhaenger_01;TRLR01;AliasName\n", 30, fhdlOut);    /* alias frame handle for Anhaenger_01 */
            filePutString ("BEM_01;1791\n", 12, fhdlOut);
            filePutString ("BEM_01;BEM01;AliasName\n", 23, fhdlOut);    /* alias frame handle for BEM_01 */
            filePutString ("Charisma_01;2047\n", 17, fhdlOut);
            filePutString ("Charisma_01;CHRSM01;AliasName\n", 30, fhdlOut);    /* alias frame handle for Charisma_01 */
            filePutString ("Diagnose_01;2303\n", 17, fhdlOut);
            filePutString ("Diagnose_01;DIA01;AliasName\n", 28, fhdlOut);    /* alias frame handle for Diagnose_01 */
            filePutString ("EPB_01;2559\n", 12, fhdlOut);
            filePutString ("EPB_01;EPB01;AliasName\n", 23, fhdlOut);    /* alias frame handle for EPB_01 */
            filePutString ("ESP_01;2815\n", 12, fhdlOut);
            filePutString ("ESP_01;ESP01;AliasName\n", 23, fhdlOut);    /* alias frame handle for ESP_01 */
            filePutString ("ESP_02;3071\n", 12, fhdlOut);
            filePutString ("ESP_02;ESP02;AliasName\n", 23, fhdlOut);    /* alias frame handle for ESP_02 */
            filePutString ("ESP_03;3327\n", 12, fhdlOut);
            filePutString ("ESP_03;ESP03;AliasName\n", 23, fhdlOut);    /* alias frame handle for ESP_03 */
            filePutString ("ESP_05;3583\n", 12, fhdlOut);
            filePutString ("ESP_05;ESP05;AliasName\n", 23, fhdlOut);    /* alias frame handle for ESP_05 */
            filePutString ("ESP_07_FR;3839\n", 15, fhdlOut);
            filePutString ("ESP_07_FR;ESP07FR;AliasName\n", 28, fhdlOut);    /* alias frame handle for ESP_07_FR */
            filePutString ("ESP_16;4095\n", 12, fhdlOut);
            filePutString ("ESP_16;ESP16;AliasName\n", 23, fhdlOut);    /* alias frame handle for ESP_16 */
            filePutString ("ESP_K_10;4351\n", 14, fhdlOut);
            filePutString ("ESP_K_10;ESPK10;AliasName\n", 26, fhdlOut);    /* alias frame handle for ESP_K_10 */
            filePutString ("Einheiten_01;4607\n", 18, fhdlOut);
            filePutString ("Einheiten_01;EINH01;AliasName\n", 30, fhdlOut);    /* alias frame handle for Einheiten_01 */
            filePutString ("Fahrwerk_02;4863\n", 17, fhdlOut);
            filePutString ("Fahrwerk_02;LVL02;AliasName\n", 28, fhdlOut);    /* alias frame handle for Fahrwerk_02 */
            filePutString ("GW_Fwk_01_Ant_PAG;5119\n", 23, fhdlOut);
            filePutString ("GW_Fwk_01_Ant_PAG;GWFWK01;AliasName\n", 36, fhdlOut);    /* alias frame handle for GW_Fwk_01_Ant_PAG */
            filePutString ("Gateway_05;5375\n", 16, fhdlOut);
            filePutString ("Gateway_05;GW05;AliasName\n", 26, fhdlOut);    /* alias frame handle for Gateway_05 */
            filePutString ("Gateway_11;5631\n", 16, fhdlOut);
            filePutString ("Gateway_11;GW11;AliasName\n", 26, fhdlOut);    /* alias frame handle for Gateway_11 */
            filePutString ("Getriebe_01;5887\n", 17, fhdlOut);
            filePutString ("Getriebe_01;GBX01;AliasName\n", 28, fhdlOut);    /* alias frame handle for Getriebe_01 */
            filePutString ("Getriebe_02;6143\n", 17, fhdlOut);
            filePutString ("Getriebe_02;GBX02;AliasName\n", 28, fhdlOut);    /* alias frame handle for Getriebe_02 */
            filePutString ("Getriebe_03;6399\n", 17, fhdlOut);
            filePutString ("Getriebe_03;GBX03;AliasName\n", 28, fhdlOut);    /* alias frame handle for Getriebe_03 */
            filePutString ("Getriebe_04;6655\n", 17, fhdlOut);
            filePutString ("Getriebe_04;GBX04;AliasName\n", 28, fhdlOut);    /* alias frame handle for Getriebe_04 */
            filePutString ("Kessy_02;6911\n", 14, fhdlOut);
            filePutString ("Kessy_02;KSY02;AliasName\n", 25, fhdlOut);    /* alias frame handle for Kessy_02 */
            filePutString ("Klemmen_Status_01;7167\n", 23, fhdlOut);
            filePutString ("Klemmen_Status_01;STIGN01;AliasName\n", 36, fhdlOut);    /* alias frame handle for Klemmen_Status_01 */
            filePutString ("Klima_01;7423\n", 14, fhdlOut);
            filePutString ("Klima_01;AC01;AliasName\n", 24, fhdlOut);    /* alias frame handle for Klima_01 */
            filePutString ("Kombi_01;7679\n", 14, fhdlOut);
            filePutString ("Kombi_01;DSP01;AliasName\n", 25, fhdlOut);    /* alias frame handle for Kombi_01 */
            filePutString ("Kombi_02;7935\n", 14, fhdlOut);
            filePutString ("Kombi_02;DSP02;AliasName\n", 25, fhdlOut);    /* alias frame handle for Kombi_02 */
            filePutString ("Kombi_03;8191\n", 14, fhdlOut);
            filePutString ("Kombi_03;DSP03;AliasName\n", 25, fhdlOut);    /* alias frame handle for Kombi_03 */
            filePutString ("LH_EPS_02;8447\n", 15, fhdlOut);
            filePutString ("LH_EPS_02;LHEPS02;AliasName\n", 28, fhdlOut);    /* alias frame handle for LH_EPS_02 */
            filePutString ("LS_01;8703\n", 11, fhdlOut);
            filePutString ("LS_01;LS01;AliasName\n", 21, fhdlOut);    /* alias frame handle for LS_01 */
            filePutString ("LWI_01;8959\n", 12, fhdlOut);
            filePutString ("LWI_01;LWI01;AliasName\n", 23, fhdlOut);    /* alias frame handle for LWI_01 */
            filePutString ("Licht_hinten_01;9215\n", 21, fhdlOut);
            filePutString ("Licht_hinten_01;LH01;AliasName\n", 31, fhdlOut);    /* alias frame handle for Licht_hinten_01 */
            filePutString ("NMH_Gateway;9471\n", 17, fhdlOut);
            filePutString ("NMH_Gateway;NMH_Gateway;AliasName\n", 34, fhdlOut);    /* alias frame handle for NMH_Gateway */
            filePutString ("OBD_Tankgeber_01;9727\n", 22, fhdlOut);
            filePutString ("OBD_Tankgeber_01;FLS01;AliasName\n", 33, fhdlOut);    /* alias frame handle for OBD_Tankgeber_01 */
            filePutString ("SCR_01;9983\n", 12, fhdlOut);
            filePutString ("SCR_01;SCR01;AliasName\n", 23, fhdlOut);    /* alias frame handle for SCR_01 */
            filePutString ("SCR_02;10239\n", 13, fhdlOut);
            filePutString ("SCR_02;SCR02;AliasName\n", 23, fhdlOut);    /* alias frame handle for SCR_02 */
            filePutString ("SCR_03;10495\n", 13, fhdlOut);
            filePutString ("SCR_03;SCR03;AliasName\n", 23, fhdlOut);    /* alias frame handle for SCR_03 */
            filePutString ("SCR_04;10751\n", 13, fhdlOut);
            filePutString ("SCR_04;SCR04;AliasName\n", 23, fhdlOut);    /* alias frame handle for SCR_04 */
            filePutString ("SCR_05;11007\n", 13, fhdlOut);
            filePutString ("SCR_05;SCR05;AliasName\n", 23, fhdlOut);    /* alias frame handle for SCR_05 */
            filePutString ("SCR_CAL_ID1;11263\n", 18, fhdlOut);
            filePutString ("SCR_CAL_ID1;SCRCALID1;AliasName\n", 32, fhdlOut);    /* alias frame handle for SCR_CAL_ID1 */
            filePutString ("SCR_CAL_ID2;11519\n", 18, fhdlOut);
            filePutString ("SCR_CAL_ID2;SCRCALID2;AliasName\n", 32, fhdlOut);    /* alias frame handle for SCR_CAL_ID2 */
            filePutString ("SCU_01;11775\n", 13, fhdlOut);
            filePutString ("SCU_01;SCU01;AliasName\n", 23, fhdlOut);    /* alias frame handle for SCU_01 */
            filePutString ("STH_01;12031\n", 13, fhdlOut);
            filePutString ("STH_01;STH01;AliasName\n", 23, fhdlOut);    /* alias frame handle for STH_01 */
            filePutString ("STS_01;12287\n", 13, fhdlOut);
            filePutString ("STS_01;STS01;AliasName\n", 23, fhdlOut);    /* alias frame handle for STS_01 */
            filePutString ("Systeminfo_01;12543\n", 20, fhdlOut);
            filePutString ("Systeminfo_01;SYS01;AliasName\n", 30, fhdlOut);    /* alias frame handle for Systeminfo_01 */

            filePutString ("ACC_01_BZ;0\n", 12, fhdlOut);
            filePutString ("ACC_01_BZ/ACC_01;0\n", 19, fhdlOut);
            filePutString ("ACC_01_BZ/ACC01;0\n", 18, fhdlOut);
            filePutString ("ACC_01_CHK;1\n", 13, fhdlOut);
            filePutString ("ACC_01_CHK/ACC_01;1\n", 20, fhdlOut);
            filePutString ("ACC_01_CHK/ACC01;1\n", 19, fhdlOut);
            filePutString ("ACC_Anhalten;2\n", 15, fhdlOut);
            filePutString ("ACC_Anhalten/ACC_01;2\n", 22, fhdlOut);
            filePutString ("ACC_Anhalten/ACC01;2\n", 21, fhdlOut);
            filePutString ("ACC_Dynamik;3\n", 14, fhdlOut);
            filePutString ("ACC_Dynamik/ACC_01;3\n", 21, fhdlOut);
            filePutString ("ACC_Dynamik/ACC01;3\n", 20, fhdlOut);
            filePutString ("ACC_KD_Fehler;4\n", 16, fhdlOut);
            filePutString ("ACC_KD_Fehler/ACC_01;4\n", 23, fhdlOut);
            filePutString ("ACC_KD_Fehler/ACC01;4\n", 22, fhdlOut);
            filePutString ("ACC_Minimale_Bremsung;5\n", 24, fhdlOut);
            filePutString ("ACC_Minimale_Bremsung/ACC_01;5\n", 31, fhdlOut);
            filePutString ("ACC_Minimale_Bremsung/ACC01;5\n", 30, fhdlOut);
            filePutString ("ACC_Sollbeschleunigung;6\n", 25, fhdlOut);
            filePutString ("ACC_Sollbeschleunigung/ACC_01;6\n", 32, fhdlOut);
            filePutString ("ACC_Sollbeschleunigung/ACC01;6\n", 31, fhdlOut);
            filePutString ("ACC_Status_ACC;7\n", 17, fhdlOut);
            filePutString ("ACC_Status_ACC/ACC_01;7\n", 24, fhdlOut);
            filePutString ("ACC_Status_ACC/ACC01;7\n", 23, fhdlOut);
            filePutString ("ACC_neg_Sollbeschl_Grad;8\n", 26, fhdlOut);
            filePutString ("ACC_neg_Sollbeschl_Grad/ACC_01;8\n", 33, fhdlOut);
            filePutString ("ACC_neg_Sollbeschl_Grad/ACC01;8\n", 32, fhdlOut);
            filePutString ("ACC_pos_Sollbeschl_Grad;9\n", 26, fhdlOut);
            filePutString ("ACC_pos_Sollbeschl_Grad/ACC_01;9\n", 33, fhdlOut);
            filePutString ("ACC_pos_Sollbeschl_Grad/ACC01;9\n", 32, fhdlOut);
            filePutString ("ACC_zul_Regelabw_oben;10\n", 25, fhdlOut);
            filePutString ("ACC_zul_Regelabw_oben/ACC_01;10\n", 32, fhdlOut);
            filePutString ("ACC_zul_Regelabw_oben/ACC01;10\n", 31, fhdlOut);
            filePutString ("ACC_zul_Regelabw_unten;11\n", 26, fhdlOut);
            filePutString ("ACC_zul_Regelabw_unten/ACC_01;11\n", 33, fhdlOut);
            filePutString ("ACC_zul_Regelabw_unten/ACC01;11\n", 32, fhdlOut);
            filePutString ("ACC_05_BZ;256\n", 14, fhdlOut);
            filePutString ("ACC_05_BZ/ACC_05;256\n", 21, fhdlOut);
            filePutString ("ACC_05_BZ/ACC05;256\n", 20, fhdlOut);
            filePutString ("ACC_05_CHK;257\n", 15, fhdlOut);
            filePutString ("ACC_05_CHK/ACC_05;257\n", 22, fhdlOut);
            filePutString ("ACC_05_CHK/ACC05;257\n", 21, fhdlOut);
            filePutString ("ACC_Anhalten;258\n", 17, fhdlOut);
            filePutString ("ACC_Anhalten/ACC_05;258\n", 24, fhdlOut);
            filePutString ("ACC_Anhalten/ACC05;258\n", 23, fhdlOut);
            filePutString ("ACC_Betaetigung_EPB;259\n", 24, fhdlOut);
            filePutString ("ACC_Betaetigung_EPB/ACC_05;259\n", 31, fhdlOut);
            filePutString ("ACC_Betaetigung_EPB/ACC05;259\n", 30, fhdlOut);
            filePutString ("ACC_Freigabe_Momentenanf;260\n", 29, fhdlOut);
            filePutString ("ACC_Freigabe_Momentenanf/ACC_05;260\n", 36, fhdlOut);
            filePutString ("ACC_Freigabe_Momentenanf/ACC05;260\n", 35, fhdlOut);
            filePutString ("ACC_Momentenanforderung;261\n", 28, fhdlOut);
            filePutString ("ACC_Momentenanforderung/ACC_05;261\n", 35, fhdlOut);
            filePutString ("ACC_Momentenanforderung/ACC05;261\n", 34, fhdlOut);
            filePutString ("ACC_StartStopp_Info;262\n", 24, fhdlOut);
            filePutString ("ACC_StartStopp_Info/ACC_05;262\n", 31, fhdlOut);
            filePutString ("ACC_StartStopp_Info/ACC05;262\n", 30, fhdlOut);
            filePutString ("ACC_Status_ACC;263\n", 19, fhdlOut);
            filePutString ("ACC_Status_ACC/ACC_05;263\n", 26, fhdlOut);
            filePutString ("ACC_Status_ACC/ACC05;263\n", 25, fhdlOut);
            filePutString ("ACC_limitierte_Anfahrdyn;264\n", 29, fhdlOut);
            filePutString ("ACC_limitierte_Anfahrdyn/ACC_05;264\n", 36, fhdlOut);
            filePutString ("ACC_limitierte_Anfahrdyn/ACC05;264\n", 35, fhdlOut);
            filePutString ("AB_Anzeige_Fussg;512\n", 21, fhdlOut);
            filePutString ("AB_Anzeige_Fussg/Airbag_01;512\n", 31, fhdlOut);
            filePutString ("AB_Anzeige_Fussg/AIRBG01;512\n", 29, fhdlOut);
            filePutString ("AB_Crash_Int;513\n", 17, fhdlOut);
            filePutString ("AB_Crash_Int/Airbag_01;513\n", 27, fhdlOut);
            filePutString ("AB_Crash_Int/AIRBG01;513\n", 25, fhdlOut);
            filePutString ("AB_Deaktiviert;514\n", 19, fhdlOut);
            filePutString ("AB_Deaktiviert/Airbag_01;514\n", 29, fhdlOut);
            filePutString ("AB_Deaktiviert/AIRBG01;514\n", 27, fhdlOut);
            filePutString ("AB_Deaktivierung_HV;515\n", 24, fhdlOut);
            filePutString ("AB_Deaktivierung_HV/Airbag_01;515\n", 34, fhdlOut);
            filePutString ("AB_Deaktivierung_HV/AIRBG01;515\n", 32, fhdlOut);
            filePutString ("AB_Diagnose;516\n", 16, fhdlOut);
            filePutString ("AB_Diagnose/Airbag_01;516\n", 26, fhdlOut);
            filePutString ("AB_Diagnose/AIRBG01;516\n", 24, fhdlOut);
            filePutString ("AB_Erh_Auf_VB;517\n", 18, fhdlOut);
            filePutString ("AB_Erh_Auf_VB/Airbag_01;517\n", 28, fhdlOut);
            filePutString ("AB_Erh_Auf_VB/AIRBG01;517\n", 26, fhdlOut);
            filePutString ("AB_Front_Crash;518\n", 19, fhdlOut);
            filePutString ("AB_Front_Crash/Airbag_01;518\n", 29, fhdlOut);
            filePutString ("AB_Front_Crash/AIRBG01;518\n", 27, fhdlOut);
            filePutString ("AB_Gurtwarn_VB;519\n", 19, fhdlOut);
            filePutString ("AB_Gurtwarn_VB/Airbag_01;519\n", 29, fhdlOut);
            filePutString ("AB_Gurtwarn_VB/AIRBG01;519\n", 27, fhdlOut);
            filePutString ("AB_Gurtwarn_VF;520\n", 19, fhdlOut);
            filePutString ("AB_Gurtwarn_VF/Airbag_01;520\n", 29, fhdlOut);
            filePutString ("AB_Gurtwarn_VF/AIRBG01;520\n", 27, fhdlOut);
            filePutString ("AB_Heck_Crash;521\n", 18, fhdlOut);
            filePutString ("AB_Heck_Crash/Airbag_01;521\n", 28, fhdlOut);
            filePutString ("AB_Heck_Crash/AIRBG01;521\n", 26, fhdlOut);
            filePutString ("AB_KD_Fehler;522\n", 17, fhdlOut);
            filePutString ("AB_KD_Fehler/Airbag_01;522\n", 27, fhdlOut);
            filePutString ("AB_KD_Fehler/AIRBG01;522\n", 25, fhdlOut);
            filePutString ("AB_Lampe;523\n", 13, fhdlOut);
            filePutString ("AB_Lampe/Airbag_01;523\n", 23, fhdlOut);
            filePutString ("AB_Lampe/AIRBG01;523\n", 21, fhdlOut);
            filePutString ("AB_Rollover_Crash;524\n", 22, fhdlOut);
            filePutString ("AB_Rollover_Crash/Airbag_01;524\n", 32, fhdlOut);
            filePutString ("AB_Rollover_Crash/AIRBG01;524\n", 30, fhdlOut);
            filePutString ("AB_SB_Crash;525\n", 16, fhdlOut);
            filePutString ("AB_SB_Crash/Airbag_01;525\n", 26, fhdlOut);
            filePutString ("AB_SB_Crash/AIRBG01;525\n", 24, fhdlOut);
            filePutString ("AB_SF_Crash;526\n", 16, fhdlOut);
            filePutString ("AB_SF_Crash/Airbag_01;526\n", 26, fhdlOut);
            filePutString ("AB_SF_Crash/AIRBG01;526\n", 24, fhdlOut);
            filePutString ("AB_Stellgliedtest;527\n", 22, fhdlOut);
            filePutString ("AB_Stellgliedtest/Airbag_01;527\n", 32, fhdlOut);
            filePutString ("AB_Stellgliedtest/AIRBG01;527\n", 30, fhdlOut);
            filePutString ("AB_Systemfehler;528\n", 20, fhdlOut);
            filePutString ("AB_Systemfehler/Airbag_01;528\n", 30, fhdlOut);
            filePutString ("AB_Systemfehler/AIRBG01;528\n", 28, fhdlOut);
            filePutString ("AB_VB_deaktiviert;529\n", 22, fhdlOut);
            filePutString ("AB_VB_deaktiviert/Airbag_01;529\n", 32, fhdlOut);
            filePutString ("AB_VB_deaktiviert/AIRBG01;529\n", 30, fhdlOut);
            filePutString ("Airbag_01_BZ;530\n", 17, fhdlOut);
            filePutString ("Airbag_01_BZ/Airbag_01;530\n", 27, fhdlOut);
            filePutString ("Airbag_01_BZ/AIRBG01;530\n", 25, fhdlOut);
            filePutString ("Airbag_01_CHK;531\n", 18, fhdlOut);
            filePutString ("Airbag_01_CHK/Airbag_01;531\n", 28, fhdlOut);
            filePutString ("Airbag_01_CHK/AIRBG01;531\n", 26, fhdlOut);
            filePutString ("void_Byte_02;532\n", 17, fhdlOut);
            filePutString ("void_Byte_02/Airbag_01;532\n", 27, fhdlOut);
            filePutString ("void_Byte_02/AIRBG01;532\n", 25, fhdlOut);
            filePutString ("void_Byte_03;533\n", 17, fhdlOut);
            filePutString ("void_Byte_03/Airbag_01;533\n", 27, fhdlOut);
            filePutString ("void_Byte_03/AIRBG01;533\n", 25, fhdlOut);
            filePutString ("AB_Belegung_VB;768\n", 19, fhdlOut);
            filePutString ("AB_Belegung_VB/Airbag_02;768\n", 29, fhdlOut);
            filePutString ("AB_Belegung_VB/AIRBG02;768\n", 27, fhdlOut);
            filePutString ("AB_Gurtschloss_BF;769\n", 22, fhdlOut);
            filePutString ("AB_Gurtschloss_BF/Airbag_02;769\n", 32, fhdlOut);
            filePutString ("AB_Gurtschloss_BF/AIRBG02;769\n", 30, fhdlOut);
            filePutString ("AB_Gurtschloss_FA;770\n", 22, fhdlOut);
            filePutString ("AB_Gurtschloss_FA/Airbag_02;770\n", 32, fhdlOut);
            filePutString ("AB_Gurtschloss_FA/AIRBG02;770\n", 30, fhdlOut);
            filePutString ("AB_Gurtschloss_Reihe2_BF;771\n", 29, fhdlOut);
            filePutString ("AB_Gurtschloss_Reihe2_BF/Airbag_02;771\n", 39, fhdlOut);
            filePutString ("AB_Gurtschloss_Reihe2_BF/AIRBG02;771\n", 37, fhdlOut);
            filePutString ("AB_Gurtschloss_Reihe2_FA;772\n", 29, fhdlOut);
            filePutString ("AB_Gurtschloss_Reihe2_FA/Airbag_02;772\n", 39, fhdlOut);
            filePutString ("AB_Gurtschloss_Reihe2_FA/AIRBG02;772\n", 37, fhdlOut);
            filePutString ("AB_Gurtschloss_Reihe2_MI;773\n", 29, fhdlOut);
            filePutString ("AB_Gurtschloss_Reihe2_MI/Airbag_02;773\n", 39, fhdlOut);
            filePutString ("AB_Gurtschloss_Reihe2_MI/AIRBG02;773\n", 37, fhdlOut);
            filePutString ("AB_Gurtschloss_Reihe3_BF;774\n", 29, fhdlOut);
            filePutString ("AB_Gurtschloss_Reihe3_BF/Airbag_02;774\n", 39, fhdlOut);
            filePutString ("AB_Gurtschloss_Reihe3_BF/AIRBG02;774\n", 37, fhdlOut);
            filePutString ("AB_Gurtschloss_Reihe3_FA;775\n", 29, fhdlOut);
            filePutString ("AB_Gurtschloss_Reihe3_FA/Airbag_02;775\n", 39, fhdlOut);
            filePutString ("AB_Gurtschloss_Reihe3_FA/AIRBG02;775\n", 37, fhdlOut);
            filePutString ("AB_Gurtschloss_Reihe3_MI;776\n", 29, fhdlOut);
            filePutString ("AB_Gurtschloss_Reihe3_MI/Airbag_02;776\n", 39, fhdlOut);
            filePutString ("AB_Gurtschloss_Reihe3_MI/AIRBG02;776\n", 37, fhdlOut);
            filePutString ("AB_Sitzpos_Sens_BF;777\n", 23, fhdlOut);
            filePutString ("AB_Sitzpos_Sens_BF/Airbag_02;777\n", 33, fhdlOut);
            filePutString ("AB_Sitzpos_Sens_BF/AIRBG02;777\n", 31, fhdlOut);
            filePutString ("AB_Sitzpos_Sens_FA;778\n", 23, fhdlOut);
            filePutString ("AB_Sitzpos_Sens_FA/Airbag_02;778\n", 33, fhdlOut);
            filePutString ("AB_Sitzpos_Sens_FA/AIRBG02;778\n", 31, fhdlOut);
            filePutString ("ALR_Begrenzungsmoment;1024\n", 27, fhdlOut);
            filePutString ("ALR_Begrenzungsmoment/Allrad_02;1024\n", 37, fhdlOut);
            filePutString ("ALR_Begrenzungsmoment/AWD02;1024\n", 33, fhdlOut);
            filePutString ("ALR_Charisma_FahrPr;1025\n", 25, fhdlOut);
            filePutString ("ALR_Charisma_FahrPr/Allrad_02;1025\n", 35, fhdlOut);
            filePutString ("ALR_Charisma_FahrPr/AWD02;1025\n", 31, fhdlOut);
            filePutString ("ALR_Charisma_Status;1026\n", 25, fhdlOut);
            filePutString ("ALR_Charisma_Status/Allrad_02;1026\n", 35, fhdlOut);
            filePutString ("ALR_Charisma_Status/AWD02;1026\n", 31, fhdlOut);
            filePutString ("ALR_Charisma_Umschaltung;1027\n", 30, fhdlOut);
            filePutString ("ALR_Charisma_Umschaltung/Allrad_02;1027\n", 40, fhdlOut);
            filePutString ("ALR_Charisma_Umschaltung/AWD02;1027\n", 36, fhdlOut);
            filePutString ("ALR_ESP_akt;1028\n", 17, fhdlOut);
            filePutString ("ALR_ESP_akt/Allrad_02;1028\n", 27, fhdlOut);
            filePutString ("ALR_ESP_akt/AWD02;1028\n", 23, fhdlOut);
            filePutString ("ALR_Fahrerwunsch;1029\n", 22, fhdlOut);
            filePutString ("ALR_Fahrerwunsch/Allrad_02;1029\n", 32, fhdlOut);
            filePutString ("ALR_Fahrerwunsch/AWD02;1029\n", 28, fhdlOut);
            filePutString ("ALR_KD_Fehler;1030\n", 19, fhdlOut);
            filePutString ("ALR_KD_Fehler/Allrad_02;1030\n", 29, fhdlOut);
            filePutString ("ALR_KD_Fehler/AWD02;1030\n", 25, fhdlOut);
            filePutString ("ALR_LED_Auto_Diff;1031\n", 23, fhdlOut);
            filePutString ("ALR_LED_Auto_Diff/Allrad_02;1031\n", 33, fhdlOut);
            filePutString ("ALR_LED_Auto_Diff/AWD02;1031\n", 29, fhdlOut);
            filePutString ("ALR_LED_High;1032\n", 18, fhdlOut);
            filePutString ("ALR_LED_High/Allrad_02;1032\n", 28, fhdlOut);
            filePutString ("ALR_LED_High/AWD02;1032\n", 24, fhdlOut);
            filePutString ("ALR_LED_Low;1033\n", 17, fhdlOut);
            filePutString ("ALR_LED_Low/Allrad_02;1033\n", 27, fhdlOut);
            filePutString ("ALR_LED_Low/AWD02;1033\n", 23, fhdlOut);
            filePutString ("ALR_LED_Low_Lock;1034\n", 22, fhdlOut);
            filePutString ("ALR_LED_Low_Lock/Allrad_02;1034\n", 32, fhdlOut);
            filePutString ("ALR_LED_Low_Lock/AWD02;1034\n", 28, fhdlOut);
            filePutString ("ALR_LED_Rear_Lock;1035\n", 23, fhdlOut);
            filePutString ("ALR_LED_Rear_Lock/Allrad_02;1035\n", 33, fhdlOut);
            filePutString ("ALR_LED_Rear_Lock/AWD02;1035\n", 29, fhdlOut);
            filePutString ("ALR_Limiter;1036\n", 17, fhdlOut);
            filePutString ("ALR_Limiter/Allrad_02;1036\n", 27, fhdlOut);
            filePutString ("ALR_Limiter/AWD02;1036\n", 23, fhdlOut);
            filePutString ("ALR_Offroad;1037\n", 17, fhdlOut);
            filePutString ("ALR_Offroad/Allrad_02;1037\n", 27, fhdlOut);
            filePutString ("ALR_Offroad/AWD02;1037\n", 23, fhdlOut);
            filePutString ("ALR_Schalten;1038\n", 18, fhdlOut);
            filePutString ("ALR_Schalten/Allrad_02;1038\n", 28, fhdlOut);
            filePutString ("ALR_Schalten/AWD02;1038\n", 24, fhdlOut);
            filePutString ("ALR_Sta_Begrenzungsmom;1039\n", 28, fhdlOut);
            filePutString ("ALR_Sta_Begrenzungsmom/Allrad_02;1039\n", 38, fhdlOut);
            filePutString ("ALR_Sta_Begrenzungsmom/AWD02;1039\n", 34, fhdlOut);
            filePutString ("ALR_Sta_Laengssperre;1040\n", 26, fhdlOut);
            filePutString ("ALR_Sta_Laengssperre/Allrad_02;1040\n", 36, fhdlOut);
            filePutString ("ALR_Sta_Laengssperre/AWD02;1040\n", 32, fhdlOut);
            filePutString ("ALR_Sta_PrioAnzeige;1041\n", 25, fhdlOut);
            filePutString ("ALR_Sta_PrioAnzeige/Allrad_02;1041\n", 35, fhdlOut);
            filePutString ("ALR_Sta_PrioAnzeige/AWD02;1041\n", 31, fhdlOut);
            filePutString ("ALR_Sta_Quersperre;1042\n", 24, fhdlOut);
            filePutString ("ALR_Sta_Quersperre/Allrad_02;1042\n", 34, fhdlOut);
            filePutString ("ALR_Sta_Quersperre/AWD02;1042\n", 30, fhdlOut);
            filePutString ("ALR_Sta_Untersetzung;1043\n", 26, fhdlOut);
            filePutString ("ALR_Sta_Untersetzung/Allrad_02;1043\n", 36, fhdlOut);
            filePutString ("ALR_Sta_Untersetzung/AWD02;1043\n", 32, fhdlOut);
            filePutString ("ALR_Symbol_Lock;1044\n", 21, fhdlOut);
            filePutString ("ALR_Symbol_Lock/Allrad_02;1044\n", 31, fhdlOut);
            filePutString ("ALR_Symbol_Lock/AWD02;1044\n", 27, fhdlOut);
            filePutString ("ALR_Symbol_Low;1045\n", 20, fhdlOut);
            filePutString ("ALR_Symbol_Low/Allrad_02;1045\n", 30, fhdlOut);
            filePutString ("ALR_Symbol_Low/AWD02;1045\n", 26, fhdlOut);
            filePutString ("ALR_Symbol_RearLock;1046\n", 25, fhdlOut);
            filePutString ("ALR_Symbol_RearLock/Allrad_02;1046\n", 35, fhdlOut);
            filePutString ("ALR_Symbol_RearLock/AWD02;1046\n", 31, fhdlOut);
            filePutString ("ALR_Temp_schutz;1047\n", 21, fhdlOut);
            filePutString ("ALR_Temp_schutz/Allrad_02;1047\n", 31, fhdlOut);
            filePutString ("ALR_Temp_schutz/AWD02;1047\n", 27, fhdlOut);
            filePutString ("ALR_Texte;1048\n", 15, fhdlOut);
            filePutString ("ALR_Texte/Allrad_02;1048\n", 25, fhdlOut);
            filePutString ("ALR_Texte/AWD02;1048\n", 21, fhdlOut);
            filePutString ("ALR_Vorwarnung;1049\n", 20, fhdlOut);
            filePutString ("ALR_Vorwarnung/Allrad_02;1049\n", 30, fhdlOut);
            filePutString ("ALR_Vorwarnung/AWD02;1049\n", 26, fhdlOut);
            filePutString ("AAG_AVS_Fehler;1280\n", 20, fhdlOut);
            filePutString ("AAG_AVS_Fehler/Anhaenger_01;1280\n", 33, fhdlOut);
            filePutString ("AAG_AVS_Fehler/TRLR01;1280\n", 27, fhdlOut);
            filePutString ("AAG_AVS_Stati;1281\n", 19, fhdlOut);
            filePutString ("AAG_AVS_Stati/Anhaenger_01;1281\n", 32, fhdlOut);
            filePutString ("AAG_AVS_Stati/TRLR01;1281\n", 26, fhdlOut);
            filePutString ("AAG_Anhaenger_abgesteckt;1282\n", 30, fhdlOut);
            filePutString ("AAG_Anhaenger_abgesteckt/Anhaenger_01;1282\n", 43, fhdlOut);
            filePutString ("AAG_Anhaenger_abgesteckt/TRLR01;1282\n", 37, fhdlOut);
            filePutString ("AAG_Anhaenger_erkannt;1283\n", 27, fhdlOut);
            filePutString ("AAG_Anhaenger_erkannt/Anhaenger_01;1283\n", 40, fhdlOut);
            filePutString ("AAG_Anhaenger_erkannt/TRLR01;1283\n", 34, fhdlOut);
            filePutString ("AAG_BZ;1284\n", 12, fhdlOut);
            filePutString ("AAG_BZ/Anhaenger_01;1284\n", 25, fhdlOut);
            filePutString ("AAG_BZ/TRLR01;1284\n", 19, fhdlOut);
            filePutString ("AAG_Blinker_HL_def;1285\n", 24, fhdlOut);
            filePutString ("AAG_Blinker_HL_def/Anhaenger_01;1285\n", 37, fhdlOut);
            filePutString ("AAG_Blinker_HL_def/TRLR01;1285\n", 31, fhdlOut);
            filePutString ("AAG_Blinker_HR_def;1286\n", 24, fhdlOut);
            filePutString ("AAG_Blinker_HR_def/Anhaenger_01;1286\n", 37, fhdlOut);
            filePutString ("AAG_Blinker_HR_def/TRLR01;1286\n", 31, fhdlOut);
            filePutString ("AAG_Blinker_H_aktiv;1287\n", 25, fhdlOut);
            filePutString ("AAG_Blinker_H_aktiv/Anhaenger_01;1287\n", 38, fhdlOut);
            filePutString ("AAG_Blinker_H_aktiv/TRLR01;1287\n", 32, fhdlOut);
            filePutString ("AAG_Bremsl_durch_ECD;1288\n", 26, fhdlOut);
            filePutString ("AAG_Bremsl_durch_ECD/Anhaenger_01;1288\n", 39, fhdlOut);
            filePutString ("AAG_Bremsl_durch_ECD/TRLR01;1288\n", 33, fhdlOut);
            filePutString ("AAG_Bremslicht_H_def;1289\n", 26, fhdlOut);
            filePutString ("AAG_Bremslicht_H_def/Anhaenger_01;1289\n", 39, fhdlOut);
            filePutString ("AAG_Bremslicht_H_def/TRLR01;1289\n", 33, fhdlOut);
            filePutString ("AAG_KD_Fehler;1290\n", 19, fhdlOut);
            filePutString ("AAG_KD_Fehler/Anhaenger_01;1290\n", 32, fhdlOut);
            filePutString ("AAG_KD_Fehler/TRLR01;1290\n", 26, fhdlOut);
            filePutString ("AAG_NSL_aktiv;1291\n", 19, fhdlOut);
            filePutString ("AAG_NSL_aktiv/Anhaenger_01;1291\n", 32, fhdlOut);
            filePutString ("AAG_NSL_aktiv/TRLR01;1291\n", 26, fhdlOut);
            filePutString ("AAG_Schlusslicht_HL_def;1292\n", 29, fhdlOut);
            filePutString ("AAG_Schlusslicht_HL_def/Anhaenger_01;1292\n", 42, fhdlOut);
            filePutString ("AAG_Schlusslicht_HL_def/TRLR01;1292\n", 36, fhdlOut);
            filePutString ("AAG_Schlusslicht_HR_def;1293\n", 29, fhdlOut);
            filePutString ("AAG_Schlusslicht_HR_def/Anhaenger_01;1293\n", 42, fhdlOut);
            filePutString ("AAG_Schlusslicht_HR_def/TRLR01;1293\n", 36, fhdlOut);
            filePutString ("BEM_01_Abschaltstufen;1536\n", 27, fhdlOut);
            filePutString ("BEM_01_Abschaltstufen/BEM_01;1536\n", 34, fhdlOut);
            filePutString ("BEM_01_Abschaltstufen/BEM01;1536\n", 33, fhdlOut);
            filePutString ("BEM_01_BZ;1537\n", 15, fhdlOut);
            filePutString ("BEM_01_BZ/BEM_01;1537\n", 22, fhdlOut);
            filePutString ("BEM_01_BZ/BEM01;1537\n", 21, fhdlOut);
            filePutString ("BEM_01_CHK;1538\n", 16, fhdlOut);
            filePutString ("BEM_01_CHK/BEM_01;1538\n", 23, fhdlOut);
            filePutString ("BEM_01_CHK/BEM01;1538\n", 22, fhdlOut);
            filePutString ("BEM_Anf_KL;1539\n", 16, fhdlOut);
            filePutString ("BEM_Anf_KL/BEM_01;1539\n", 23, fhdlOut);
            filePutString ("BEM_Anf_KL/BEM01;1539\n", 22, fhdlOut);
            filePutString ("BEM_P_Generator;1540\n", 21, fhdlOut);
            filePutString ("BEM_P_Generator/BEM_01;1540\n", 28, fhdlOut);
            filePutString ("BEM_P_Generator/BEM01;1540\n", 27, fhdlOut);
            filePutString ("BEM_Segel_Info;1541\n", 20, fhdlOut);
            filePutString ("BEM_Segel_Info/BEM_01;1541\n", 27, fhdlOut);
            filePutString ("BEM_Segel_Info/BEM01;1541\n", 26, fhdlOut);
            filePutString ("BEM_StartStopp_Info;1542\n", 25, fhdlOut);
            filePutString ("BEM_StartStopp_Info/BEM_01;1542\n", 32, fhdlOut);
            filePutString ("BEM_StartStopp_Info/BEM01;1542\n", 31, fhdlOut);
            filePutString ("BEM_n_LLA;1543\n", 15, fhdlOut);
            filePutString ("BEM_n_LLA/BEM_01;1543\n", 22, fhdlOut);
            filePutString ("BEM_n_LLA/BEM01;1543\n", 21, fhdlOut);
            filePutString ("CHA_01_BZ;1792\n", 15, fhdlOut);
            filePutString ("CHA_01_BZ/Charisma_01;1792\n", 27, fhdlOut);
            filePutString ("CHA_01_BZ/CHRSM01;1792\n", 23, fhdlOut);
            filePutString ("CHA_01_CHK;1793\n", 16, fhdlOut);
            filePutString ("CHA_01_CHK/Charisma_01;1793\n", 28, fhdlOut);
            filePutString ("CHA_01_CHK/CHRSM01;1793\n", 24, fhdlOut);
            filePutString ("CHA_Systemstatus;1794\n", 22, fhdlOut);
            filePutString ("CHA_Systemstatus/Charisma_01;1794\n", 34, fhdlOut);
            filePutString ("CHA_Systemstatus/CHRSM01;1794\n", 30, fhdlOut);
            filePutString ("CHA_Ziel_FahrPr_DR;1795\n", 24, fhdlOut);
            filePutString ("CHA_Ziel_FahrPr_DR/Charisma_01;1795\n", 36, fhdlOut);
            filePutString ("CHA_Ziel_FahrPr_DR/CHRSM01;1795\n", 32, fhdlOut);
            filePutString ("CHA_Ziel_FahrPr_GE;1796\n", 24, fhdlOut);
            filePutString ("CHA_Ziel_FahrPr_GE/Charisma_01;1796\n", 36, fhdlOut);
            filePutString ("CHA_Ziel_FahrPr_GE/CHRSM01;1796\n", 32, fhdlOut);
            filePutString ("CHA_Ziel_FahrPr_MO;1797\n", 24, fhdlOut);
            filePutString ("CHA_Ziel_FahrPr_MO/Charisma_01;1797\n", 36, fhdlOut);
            filePutString ("CHA_Ziel_FahrPr_MO/CHRSM01;1797\n", 32, fhdlOut);
            filePutString ("CHA_Ziel_FahrPr_QS;1798\n", 24, fhdlOut);
            filePutString ("CHA_Ziel_FahrPr_QS/Charisma_01;1798\n", 36, fhdlOut);
            filePutString ("CHA_Ziel_FahrPr_QS/CHRSM01;1798\n", 32, fhdlOut);
            filePutString ("CHA_Ziel_FahrPr_SCU;1799\n", 25, fhdlOut);
            filePutString ("CHA_Ziel_FahrPr_SCU/Charisma_01;1799\n", 37, fhdlOut);
            filePutString ("CHA_Ziel_FahrPr_SCU/CHRSM01;1799\n", 33, fhdlOut);
            filePutString ("CHA_Ziel_FahrPr_ST;1800\n", 24, fhdlOut);
            filePutString ("CHA_Ziel_FahrPr_ST/Charisma_01;1800\n", 36, fhdlOut);
            filePutString ("CHA_Ziel_FahrPr_ST/CHRSM01;1800\n", 32, fhdlOut);
            filePutString ("CHA_Ziel_FahrPr_Sys_7;1801\n", 27, fhdlOut);
            filePutString ("CHA_Ziel_FahrPr_Sys_7/Charisma_01;1801\n", 39, fhdlOut);
            filePutString ("CHA_Ziel_FahrPr_Sys_7/CHRSM01;1801\n", 35, fhdlOut);
            filePutString ("CHA_Ziel_FahrPr_Sys_8;1802\n", 27, fhdlOut);
            filePutString ("CHA_Ziel_FahrPr_Sys_8/Charisma_01;1802\n", 39, fhdlOut);
            filePutString ("CHA_Ziel_FahrPr_Sys_8/CHRSM01;1802\n", 35, fhdlOut);
            filePutString ("DGN_Verlernzaehler;2048\n", 24, fhdlOut);
            filePutString ("DGN_Verlernzaehler/Diagnose_01;2048\n", 36, fhdlOut);
            filePutString ("DGN_Verlernzaehler/DIA01;2048\n", 30, fhdlOut);
            filePutString ("KBI_Kilometerstand;2049\n", 24, fhdlOut);
            filePutString ("KBI_Kilometerstand/Diagnose_01;2049\n", 36, fhdlOut);
            filePutString ("KBI_Kilometerstand/DIA01;2049\n", 30, fhdlOut);
            filePutString ("Kombi_02_alt;2050\n", 18, fhdlOut);
            filePutString ("Kombi_02_alt/Diagnose_01;2050\n", 30, fhdlOut);
            filePutString ("Kombi_02_alt/DIA01;2050\n", 24, fhdlOut);
            filePutString ("UH_Jahr;2051\n", 13, fhdlOut);
            filePutString ("UH_Jahr/Diagnose_01;2051\n", 25, fhdlOut);
            filePutString ("UH_Jahr/DIA01;2051\n", 19, fhdlOut);
            filePutString ("UH_Minute;2052\n", 15, fhdlOut);
            filePutString ("UH_Minute/Diagnose_01;2052\n", 27, fhdlOut);
            filePutString ("UH_Minute/DIA01;2052\n", 21, fhdlOut);
            filePutString ("UH_Monat;2053\n", 14, fhdlOut);
            filePutString ("UH_Monat/Diagnose_01;2053\n", 26, fhdlOut);
            filePutString ("UH_Monat/DIA01;2053\n", 20, fhdlOut);
            filePutString ("UH_Sekunde;2054\n", 16, fhdlOut);
            filePutString ("UH_Sekunde/Diagnose_01;2054\n", 28, fhdlOut);
            filePutString ("UH_Sekunde/DIA01;2054\n", 22, fhdlOut);
            filePutString ("UH_Stunde;2055\n", 15, fhdlOut);
            filePutString ("UH_Stunde/Diagnose_01;2055\n", 27, fhdlOut);
            filePutString ("UH_Stunde/DIA01;2055\n", 21, fhdlOut);
            filePutString ("UH_Tag;2056\n", 12, fhdlOut);
            filePutString ("UH_Tag/Diagnose_01;2056\n", 24, fhdlOut);
            filePutString ("UH_Tag/DIA01;2056\n", 18, fhdlOut);
            filePutString ("Uhrzeit_01_alt;2057\n", 20, fhdlOut);
            filePutString ("Uhrzeit_01_alt/Diagnose_01;2057\n", 32, fhdlOut);
            filePutString ("Uhrzeit_01_alt/DIA01;2057\n", 26, fhdlOut);
            filePutString ("EPB_01_BZ;2304\n", 15, fhdlOut);
            filePutString ("EPB_01_BZ/EPB_01;2304\n", 22, fhdlOut);
            filePutString ("EPB_01_BZ/EPB01;2304\n", 21, fhdlOut);
            filePutString ("EPB_01_CHK;2305\n", 16, fhdlOut);
            filePutString ("EPB_01_CHK/EPB_01;2305\n", 23, fhdlOut);
            filePutString ("EPB_01_CHK/EPB01;2305\n", 22, fhdlOut);
            filePutString ("EPB_BCM2_Motor_Wakeup;2306\n", 27, fhdlOut);
            filePutString ("EPB_BCM2_Motor_Wakeup/EPB_01;2306\n", 34, fhdlOut);
            filePutString ("EPB_BCM2_Motor_Wakeup/EPB01;2306\n", 33, fhdlOut);
            filePutString ("EPB_Fehlerstatus;2307\n", 22, fhdlOut);
            filePutString ("EPB_Fehlerstatus/EPB_01;2307\n", 29, fhdlOut);
            filePutString ("EPB_Fehlerstatus/EPB01;2307\n", 28, fhdlOut);
            filePutString ("EPB_Freig_Verzoeg_Anf;2308\n", 27, fhdlOut);
            filePutString ("EPB_Freig_Verzoeg_Anf/EPB_01;2308\n", 34, fhdlOut);
            filePutString ("EPB_Freig_Verzoeg_Anf/EPB01;2308\n", 33, fhdlOut);
            filePutString ("EPB_KD_Fehler;2309\n", 19, fhdlOut);
            filePutString ("EPB_KD_Fehler/EPB_01;2309\n", 26, fhdlOut);
            filePutString ("EPB_KD_Fehler/EPB01;2309\n", 25, fhdlOut);
            filePutString ("EPB_Laengsbeschleunigung;2310\n", 30, fhdlOut);
            filePutString ("EPB_Laengsbeschleunigung/EPB_01;2310\n", 37, fhdlOut);
            filePutString ("EPB_Laengsbeschleunigung/EPB01;2310\n", 36, fhdlOut);
            filePutString ("EPB_Pedalweg_Kuppl;2311\n", 24, fhdlOut);
            filePutString ("EPB_Pedalweg_Kuppl/EPB_01;2311\n", 31, fhdlOut);
            filePutString ("EPB_Pedalweg_Kuppl/EPB01;2311\n", 30, fhdlOut);
            filePutString ("EPB_QBit_Laengsbeschleunigung;2312\n", 35, fhdlOut);
            filePutString ("EPB_QBit_Laengsbeschleunigung/EPB_01;2312\n", 42, fhdlOut);
            filePutString ("EPB_QBit_Laengsbeschleunigung/EPB01;2312\n", 41, fhdlOut);
            filePutString ("EPB_QBit_Pedalweg_Kuppl;2313\n", 29, fhdlOut);
            filePutString ("EPB_QBit_Pedalweg_Kuppl/EPB_01;2313\n", 36, fhdlOut);
            filePutString ("EPB_QBit_Pedalweg_Kuppl/EPB01;2313\n", 35, fhdlOut);
            filePutString ("EPB_QBit_Schalterpos;2314\n", 26, fhdlOut);
            filePutString ("EPB_QBit_Schalterpos/EPB_01;2314\n", 33, fhdlOut);
            filePutString ("EPB_QBit_Schalterpos/EPB01;2314\n", 32, fhdlOut);
            filePutString ("EPB_Schalterposition;2315\n", 26, fhdlOut);
            filePutString ("EPB_Schalterposition/EPB_01;2315\n", 33, fhdlOut);
            filePutString ("EPB_Schalterposition/EPB01;2315\n", 32, fhdlOut);
            filePutString ("EPB_Spannkraft;2316\n", 20, fhdlOut);
            filePutString ("EPB_Spannkraft/EPB_01;2316\n", 27, fhdlOut);
            filePutString ("EPB_Spannkraft/EPB01;2316\n", 26, fhdlOut);
            filePutString ("EPB_Status;2317\n", 16, fhdlOut);
            filePutString ("EPB_Status/EPB_01;2317\n", 23, fhdlOut);
            filePutString ("EPB_Status/EPB01;2317\n", 22, fhdlOut);
            filePutString ("EPB_Verzoeg_Anf;2318\n", 21, fhdlOut);
            filePutString ("EPB_Verzoeg_Anf/EPB_01;2318\n", 28, fhdlOut);
            filePutString ("EPB_Verzoeg_Anf/EPB01;2318\n", 27, fhdlOut);
            filePutString ("ABS_Bremsung;2560\n", 18, fhdlOut);
            filePutString ("ABS_Bremsung/ESP_01;2560\n", 25, fhdlOut);
            filePutString ("ABS_Bremsung/ESP01;2560\n", 24, fhdlOut);
            filePutString ("ASR_Anf;2561\n", 13, fhdlOut);
            filePutString ("ASR_Anf/ESP_01;2561\n", 20, fhdlOut);
            filePutString ("ASR_Anf/ESP01;2561\n", 19, fhdlOut);
            filePutString ("ASR_MSR_Moment_schnell;2562\n", 28, fhdlOut);
            filePutString ("ASR_MSR_Moment_schnell/ESP_01;2562\n", 35, fhdlOut);
            filePutString ("ASR_MSR_Moment_schnell/ESP01;2562\n", 34, fhdlOut);
            filePutString ("ASR_Moment_langsam;2563\n", 24, fhdlOut);
            filePutString ("ASR_Moment_langsam/ESP_01;2563\n", 31, fhdlOut);
            filePutString ("ASR_Moment_langsam/ESP01;2563\n", 30, fhdlOut);
            filePutString ("ASR_Schalteingriff;2564\n", 24, fhdlOut);
            filePutString ("ASR_Schalteingriff/ESP_01;2564\n", 31, fhdlOut);
            filePutString ("ASR_Schalteingriff/ESP01;2564\n", 30, fhdlOut);
            filePutString ("ASR_Tastung_passiv;2565\n", 24, fhdlOut);
            filePutString ("ASR_Tastung_passiv/ESP_01;2565\n", 31, fhdlOut);
            filePutString ("ASR_Tastung_passiv/ESP01;2565\n", 30, fhdlOut);
            filePutString ("EBV_Eingriff;2566\n", 18, fhdlOut);
            filePutString ("EBV_Eingriff/ESP_01;2566\n", 25, fhdlOut);
            filePutString ("EBV_Eingriff/ESP01;2566\n", 24, fhdlOut);
            filePutString ("EDS_Eingriff;2567\n", 18, fhdlOut);
            filePutString ("EDS_Eingriff/ESP_01;2567\n", 25, fhdlOut);
            filePutString ("EDS_Eingriff/ESP01;2567\n", 24, fhdlOut);
            filePutString ("ESP_01_BZ;2568\n", 15, fhdlOut);
            filePutString ("ESP_01_BZ/ESP_01;2568\n", 22, fhdlOut);
            filePutString ("ESP_01_BZ/ESP01;2568\n", 21, fhdlOut);
            filePutString ("ESP_01_CHK;2569\n", 16, fhdlOut);
            filePutString ("ESP_01_CHK/ESP_01;2569\n", 23, fhdlOut);
            filePutString ("ESP_01_CHK/ESP01;2569\n", 22, fhdlOut);
            filePutString ("ESP_ASP;2570\n", 13, fhdlOut);
            filePutString ("ESP_ASP/ESP_01;2570\n", 20, fhdlOut);
            filePutString ("ESP_ASP/ESP01;2570\n", 19, fhdlOut);
            filePutString ("ESP_Eingriff;2571\n", 18, fhdlOut);
            filePutString ("ESP_Eingriff/ESP_01;2571\n", 25, fhdlOut);
            filePutString ("ESP_Eingriff/ESP01;2571\n", 24, fhdlOut);
            filePutString ("ESP_KD_Fehler;2572\n", 19, fhdlOut);
            filePutString ("ESP_KD_Fehler/ESP_01;2572\n", 26, fhdlOut);
            filePutString ("ESP_KD_Fehler/ESP01;2572\n", 25, fhdlOut);
            filePutString ("ESP_QBit_v_Signal;2573\n", 23, fhdlOut);
            filePutString ("ESP_QBit_v_Signal/ESP_01;2573\n", 30, fhdlOut);
            filePutString ("ESP_QBit_v_Signal/ESP01;2573\n", 29, fhdlOut);
            filePutString ("ESP_Systemstatus;2574\n", 22, fhdlOut);
            filePutString ("ESP_Systemstatus/ESP_01;2574\n", 29, fhdlOut);
            filePutString ("ESP_Systemstatus/ESP01;2574\n", 28, fhdlOut);
            filePutString ("ESP_Tastung_passiv;2575\n", 24, fhdlOut);
            filePutString ("ESP_Tastung_passiv/ESP_01;2575\n", 31, fhdlOut);
            filePutString ("ESP_Tastung_passiv/ESP01;2575\n", 30, fhdlOut);
            filePutString ("ESP_v_Signal;2576\n", 18, fhdlOut);
            filePutString ("ESP_v_Signal/ESP_01;2576\n", 25, fhdlOut);
            filePutString ("ESP_v_Signal/ESP01;2576\n", 24, fhdlOut);
            filePutString ("MSR_Anf;2577\n", 13, fhdlOut);
            filePutString ("MSR_Anf/ESP_01;2577\n", 20, fhdlOut);
            filePutString ("MSR_Anf/ESP01;2577\n", 19, fhdlOut);
            filePutString ("OBD_QBit_Schlechtweg;2578\n", 26, fhdlOut);
            filePutString ("OBD_QBit_Schlechtweg/ESP_01;2578\n", 33, fhdlOut);
            filePutString ("OBD_QBit_Schlechtweg/ESP01;2578\n", 32, fhdlOut);
            filePutString ("OBD_Schlechtweg;2579\n", 21, fhdlOut);
            filePutString ("OBD_Schlechtweg/ESP_01;2579\n", 28, fhdlOut);
            filePutString ("OBD_Schlechtweg/ESP01;2579\n", 27, fhdlOut);
            filePutString ("ESP_02_BZ;2816\n", 15, fhdlOut);
            filePutString ("ESP_02_BZ/ESP_02;2816\n", 22, fhdlOut);
            filePutString ("ESP_02_BZ/ESP02;2816\n", 21, fhdlOut);
            filePutString ("ESP_02_CHK;2817\n", 16, fhdlOut);
            filePutString ("ESP_02_CHK/ESP_02;2817\n", 23, fhdlOut);
            filePutString ("ESP_02_CHK/ESP02;2817\n", 22, fhdlOut);
            filePutString ("ESP_Gierrate;2818\n", 18, fhdlOut);
            filePutString ("ESP_Gierrate/ESP_02;2818\n", 25, fhdlOut);
            filePutString ("ESP_Gierrate/ESP02;2818\n", 24, fhdlOut);
            filePutString ("ESP_Laengsbeschl;2819\n", 22, fhdlOut);
            filePutString ("ESP_Laengsbeschl/ESP_02;2819\n", 29, fhdlOut);
            filePutString ("ESP_Laengsbeschl/ESP02;2819\n", 28, fhdlOut);
            filePutString ("ESP_Notbremsanzeige;2820\n", 25, fhdlOut);
            filePutString ("ESP_Notbremsanzeige/ESP_02;2820\n", 32, fhdlOut);
            filePutString ("ESP_Notbremsanzeige/ESP02;2820\n", 31, fhdlOut);
            filePutString ("ESP_QBit_Anf_Vert_Wank;2821\n", 28, fhdlOut);
            filePutString ("ESP_QBit_Anf_Vert_Wank/ESP_02;2821\n", 35, fhdlOut);
            filePutString ("ESP_QBit_Anf_Vert_Wank/ESP02;2821\n", 34, fhdlOut);
            filePutString ("ESP_QBit_Gierrate;2822\n", 23, fhdlOut);
            filePutString ("ESP_QBit_Gierrate/ESP_02;2822\n", 30, fhdlOut);
            filePutString ("ESP_QBit_Gierrate/ESP02;2822\n", 29, fhdlOut);
            filePutString ("ESP_QBit_Laengsbeschl;2823\n", 27, fhdlOut);
            filePutString ("ESP_QBit_Laengsbeschl/ESP_02;2823\n", 34, fhdlOut);
            filePutString ("ESP_QBit_Laengsbeschl/ESP02;2823\n", 33, fhdlOut);
            filePutString ("ESP_QBit_Querb;2824\n", 20, fhdlOut);
            filePutString ("ESP_QBit_Querb/ESP_02;2824\n", 27, fhdlOut);
            filePutString ("ESP_QBit_Querb/ESP02;2824\n", 26, fhdlOut);
            filePutString ("ESP_Querbeschleunigung;2825\n", 28, fhdlOut);
            filePutString ("ESP_Querbeschleunigung/ESP_02;2825\n", 35, fhdlOut);
            filePutString ("ESP_Querbeschleunigung/ESP02;2825\n", 34, fhdlOut);
            filePutString ("ESP_Stillstandsflag;2826\n", 25, fhdlOut);
            filePutString ("ESP_Stillstandsflag/ESP_02;2826\n", 32, fhdlOut);
            filePutString ("ESP_Stillstandsflag/ESP02;2826\n", 31, fhdlOut);
            filePutString ("ESP_VZ_Gierrate;2827\n", 21, fhdlOut);
            filePutString ("ESP_VZ_Gierrate/ESP_02;2827\n", 28, fhdlOut);
            filePutString ("ESP_VZ_Gierrate/ESP02;2827\n", 27, fhdlOut);
            filePutString ("ESP_Verteil_Wankmom;2828\n", 25, fhdlOut);
            filePutString ("ESP_Verteil_Wankmom/ESP_02;2828\n", 32, fhdlOut);
            filePutString ("ESP_Verteil_Wankmom/ESP02;2828\n", 31, fhdlOut);
            filePutString ("void_Byte_11;2829\n", 18, fhdlOut);
            filePutString ("void_Byte_11/ESP_02;2829\n", 25, fhdlOut);
            filePutString ("void_Byte_11/ESP02;2829\n", 24, fhdlOut);
            filePutString ("ESP_03_BZ;3072\n", 15, fhdlOut);
            filePutString ("ESP_03_BZ/ESP_03;3072\n", 22, fhdlOut);
            filePutString ("ESP_03_BZ/ESP03;3072\n", 21, fhdlOut);
            filePutString ("ESP_03_CHK;3073\n", 16, fhdlOut);
            filePutString ("ESP_03_CHK/ESP_03;3073\n", 23, fhdlOut);
            filePutString ("ESP_03_CHK/ESP03;3073\n", 22, fhdlOut);
            filePutString ("ESP_HL_FR;3074\n", 15, fhdlOut);
            filePutString ("ESP_HL_FR/ESP_03;3074\n", 22, fhdlOut);
            filePutString ("ESP_HL_FR/ESP03;3074\n", 21, fhdlOut);
            filePutString ("ESP_HL_Radgeschw;3075\n", 22, fhdlOut);
            filePutString ("ESP_HL_Radgeschw/ESP_03;3075\n", 29, fhdlOut);
            filePutString ("ESP_HL_Radgeschw/ESP03;3075\n", 28, fhdlOut);
            filePutString ("ESP_HR_FR;3076\n", 15, fhdlOut);
            filePutString ("ESP_HR_FR/ESP_03;3076\n", 22, fhdlOut);
            filePutString ("ESP_HR_FR/ESP03;3076\n", 21, fhdlOut);
            filePutString ("ESP_HR_Radgeschw;3077\n", 22, fhdlOut);
            filePutString ("ESP_HR_Radgeschw/ESP_03;3077\n", 29, fhdlOut);
            filePutString ("ESP_HR_Radgeschw/ESP03;3077\n", 28, fhdlOut);
            filePutString ("ESP_VL_FR;3078\n", 15, fhdlOut);
            filePutString ("ESP_VL_FR/ESP_03;3078\n", 22, fhdlOut);
            filePutString ("ESP_VL_FR/ESP03;3078\n", 21, fhdlOut);
            filePutString ("ESP_VL_Radgeschw;3079\n", 22, fhdlOut);
            filePutString ("ESP_VL_Radgeschw/ESP_03;3079\n", 29, fhdlOut);
            filePutString ("ESP_VL_Radgeschw/ESP03;3079\n", 28, fhdlOut);
            filePutString ("ESP_VR_FR;3080\n", 15, fhdlOut);
            filePutString ("ESP_VR_FR/ESP_03;3080\n", 22, fhdlOut);
            filePutString ("ESP_VR_FR/ESP03;3080\n", 21, fhdlOut);
            filePutString ("ESP_VR_Radgeschw;3081\n", 22, fhdlOut);
            filePutString ("ESP_VR_Radgeschw/ESP_03;3081\n", 29, fhdlOut);
            filePutString ("ESP_VR_Radgeschw/ESP03;3081\n", 28, fhdlOut);
            filePutString ("ECD_Bremslicht;3328\n", 20, fhdlOut);
            filePutString ("ECD_Bremslicht/ESP_05;3328\n", 27, fhdlOut);
            filePutString ("ECD_Bremslicht/ESP05;3328\n", 26, fhdlOut);
            filePutString ("ECD_Fehler;3329\n", 16, fhdlOut);
            filePutString ("ECD_Fehler/ESP_05;3329\n", 23, fhdlOut);
            filePutString ("ECD_Fehler/ESP05;3329\n", 22, fhdlOut);
            filePutString ("ECD_nicht_verfuegbar;3330\n", 26, fhdlOut);
            filePutString ("ECD_nicht_verfuegbar/ESP_05;3330\n", 33, fhdlOut);
            filePutString ("ECD_nicht_verfuegbar/ESP05;3330\n", 32, fhdlOut);
            filePutString ("ESP_05_BZ;3331\n", 15, fhdlOut);
            filePutString ("ESP_05_BZ/ESP_05;3331\n", 22, fhdlOut);
            filePutString ("ESP_05_BZ/ESP05;3331\n", 21, fhdlOut);
            filePutString ("ESP_05_CHK;3332\n", 16, fhdlOut);
            filePutString ("ESP_05_CHK/ESP_05;3332\n", 23, fhdlOut);
            filePutString ("ESP_05_CHK/ESP05;3332\n", 22, fhdlOut);
            filePutString ("ESP_Anforderung_EPB;3333\n", 25, fhdlOut);
            filePutString ("ESP_Anforderung_EPB/ESP_05;3333\n", 32, fhdlOut);
            filePutString ("ESP_Anforderung_EPB/ESP05;3333\n", 31, fhdlOut);
            filePutString ("ESP_Autohold_Standby;3334\n", 26, fhdlOut);
            filePutString ("ESP_Autohold_Standby/ESP_05;3334\n", 33, fhdlOut);
            filePutString ("ESP_Autohold_Standby/ESP05;3334\n", 32, fhdlOut);
            filePutString ("ESP_Autohold_aktiv;3335\n", 24, fhdlOut);
            filePutString ("ESP_Autohold_aktiv/ESP_05;3335\n", 31, fhdlOut);
            filePutString ("ESP_Autohold_aktiv/ESP05;3335\n", 30, fhdlOut);
            filePutString ("ESP_BKV_Unterdruck;3336\n", 24, fhdlOut);
            filePutString ("ESP_BKV_Unterdruck/ESP_05;3336\n", 31, fhdlOut);
            filePutString ("ESP_BKV_Unterdruck/ESP05;3336\n", 30, fhdlOut);
            filePutString ("ESP_Bremsdruck;3337\n", 20, fhdlOut);
            filePutString ("ESP_Bremsdruck/ESP_05;3337\n", 27, fhdlOut);
            filePutString ("ESP_Bremsdruck/ESP05;3337\n", 26, fhdlOut);
            filePutString ("ESP_Bremsruck_AWV2;3338\n", 24, fhdlOut);
            filePutString ("ESP_Bremsruck_AWV2/ESP_05;3338\n", 31, fhdlOut);
            filePutString ("ESP_Bremsruck_AWV2/ESP05;3338\n", 30, fhdlOut);
            filePutString ("ESP_Eingr_HL;3339\n", 18, fhdlOut);
            filePutString ("ESP_Eingr_HL/ESP_05;3339\n", 25, fhdlOut);
            filePutString ("ESP_Eingr_HL/ESP05;3339\n", 24, fhdlOut);
            filePutString ("ESP_Eingr_HR;3340\n", 18, fhdlOut);
            filePutString ("ESP_Eingr_HR/ESP_05;3340\n", 25, fhdlOut);
            filePutString ("ESP_Eingr_HR/ESP05;3340\n", 24, fhdlOut);
            filePutString ("ESP_Eingr_VL;3341\n", 18, fhdlOut);
            filePutString ("ESP_Eingr_VL/ESP_05;3341\n", 25, fhdlOut);
            filePutString ("ESP_Eingr_VL/ESP05;3341\n", 24, fhdlOut);
            filePutString ("ESP_Eingr_VR;3342\n", 18, fhdlOut);
            filePutString ("ESP_Eingr_VR/ESP_05;3342\n", 25, fhdlOut);
            filePutString ("ESP_Eingr_VR/ESP05;3342\n", 24, fhdlOut);
            filePutString ("ESP_FStatus_Anfahrhilfe;3343\n", 29, fhdlOut);
            filePutString ("ESP_FStatus_Anfahrhilfe/ESP_05;3343\n", 36, fhdlOut);
            filePutString ("ESP_FStatus_Anfahrhilfe/ESP05;3343\n", 35, fhdlOut);
            filePutString ("ESP_Fahrer_bremst;3344\n", 23, fhdlOut);
            filePutString ("ESP_Fahrer_bremst/ESP_05;3344\n", 30, fhdlOut);
            filePutString ("ESP_Fahrer_bremst/ESP05;3344\n", 29, fhdlOut);
            filePutString ("ESP_HBA_aktiv;3345\n", 19, fhdlOut);
            filePutString ("ESP_HBA_aktiv/ESP_05;3345\n", 26, fhdlOut);
            filePutString ("ESP_HBA_aktiv/ESP05;3345\n", 25, fhdlOut);
            filePutString ("ESP_HDC_Standby;3346\n", 21, fhdlOut);
            filePutString ("ESP_HDC_Standby/ESP_05;3346\n", 28, fhdlOut);
            filePutString ("ESP_HDC_Standby/ESP05;3346\n", 27, fhdlOut);
            filePutString ("ESP_HDC_aktiv;3347\n", 19, fhdlOut);
            filePutString ("ESP_HDC_aktiv/ESP_05;3347\n", 26, fhdlOut);
            filePutString ("ESP_HDC_aktiv/ESP05;3347\n", 25, fhdlOut);
            filePutString ("ESP_Konsistenz_AWV2;3348\n", 25, fhdlOut);
            filePutString ("ESP_Konsistenz_AWV2/ESP_05;3348\n", 32, fhdlOut);
            filePutString ("ESP_Konsistenz_AWV2/ESP05;3348\n", 31, fhdlOut);
            filePutString ("ESP_Konsistenz_TSK;3349\n", 24, fhdlOut);
            filePutString ("ESP_Konsistenz_TSK/ESP_05;3349\n", 31, fhdlOut);
            filePutString ("ESP_Konsistenz_TSK/ESP05;3349\n", 30, fhdlOut);
            filePutString ("ESP_Lenkeingriff_ADS;3350\n", 26, fhdlOut);
            filePutString ("ESP_Lenkeingriff_ADS/ESP_05;3350\n", 33, fhdlOut);
            filePutString ("ESP_Lenkeingriff_ADS/ESP05;3350\n", 32, fhdlOut);
            filePutString ("ESP_Prefill_ausgeloest;3351\n", 28, fhdlOut);
            filePutString ("ESP_Prefill_ausgeloest/ESP_05;3351\n", 35, fhdlOut);
            filePutString ("ESP_Prefill_ausgeloest/ESP05;3351\n", 34, fhdlOut);
            filePutString ("ESP_QBit_Bremsdruck;3352\n", 25, fhdlOut);
            filePutString ("ESP_QBit_Bremsdruck/ESP_05;3352\n", 32, fhdlOut);
            filePutString ("ESP_QBit_Bremsdruck/ESP05;3352\n", 31, fhdlOut);
            filePutString ("ESP_QBit_Fahrer_bremst;3353\n", 28, fhdlOut);
            filePutString ("ESP_QBit_Fahrer_bremst/ESP_05;3353\n", 35, fhdlOut);
            filePutString ("ESP_QBit_Fahrer_bremst/ESP05;3353\n", 34, fhdlOut);
            filePutString ("ESP_Rueckwaertsfahrt_erkannt;3354\n", 34, fhdlOut);
            filePutString ("ESP_Rueckwaertsfahrt_erkannt/ESP_05;3354\n", 41, fhdlOut);
            filePutString ("ESP_Rueckwaertsfahrt_erkannt/ESP05;3354\n", 40, fhdlOut);
            filePutString ("ESP_Schwelle_Unterdruck;3355\n", 29, fhdlOut);
            filePutString ("ESP_Schwelle_Unterdruck/ESP_05;3355\n", 36, fhdlOut);
            filePutString ("ESP_Schwelle_Unterdruck/ESP05;3355\n", 35, fhdlOut);
            filePutString ("ESP_StartStopp_Info;3356\n", 25, fhdlOut);
            filePutString ("ESP_StartStopp_Info/ESP_05;3356\n", 32, fhdlOut);
            filePutString ("ESP_StartStopp_Info/ESP05;3356\n", 31, fhdlOut);
            filePutString ("ESP_Status_Anfahrhilfe;3357\n", 28, fhdlOut);
            filePutString ("ESP_Status_Anfahrhilfe/ESP_05;3357\n", 35, fhdlOut);
            filePutString ("ESP_Status_Anfahrhilfe/ESP05;3357\n", 34, fhdlOut);
            filePutString ("ESP_Status_Bremsdruck;3358\n", 27, fhdlOut);
            filePutString ("ESP_Status_Bremsdruck/ESP_05;3358\n", 34, fhdlOut);
            filePutString ("ESP_Status_Bremsdruck/ESP05;3358\n", 33, fhdlOut);
            filePutString ("ESP_Status_Bremsentemp;3359\n", 28, fhdlOut);
            filePutString ("ESP_Status_Bremsentemp/ESP_05;3359\n", 35, fhdlOut);
            filePutString ("ESP_Status_Bremsentemp/ESP05;3359\n", 34, fhdlOut);
            filePutString ("ESP_Verz_EPB_aktiv;3360\n", 24, fhdlOut);
            filePutString ("ESP_Verz_EPB_aktiv/ESP_05;3360\n", 31, fhdlOut);
            filePutString ("ESP_Verz_EPB_aktiv/ESP05;3360\n", 30, fhdlOut);
            filePutString ("ESP_Verz_TSK_aktiv;3361\n", 24, fhdlOut);
            filePutString ("ESP_Verz_TSK_aktiv/ESP_05;3361\n", 31, fhdlOut);
            filePutString ("ESP_Verz_TSK_aktiv/ESP05;3361\n", 30, fhdlOut);
            filePutString ("ESP_Verzoeg_EPB_verf;3362\n", 26, fhdlOut);
            filePutString ("ESP_Verzoeg_EPB_verf/ESP_05;3362\n", 33, fhdlOut);
            filePutString ("ESP_Verzoeg_EPB_verf/ESP05;3362\n", 32, fhdlOut);
            filePutString ("ESP_07_BZ;3584\n", 15, fhdlOut);
            filePutString ("ESP_07_BZ/ESP_07_FR;3584\n", 25, fhdlOut);
            filePutString ("ESP_07_BZ/ESP07FR;3584\n", 23, fhdlOut);
            filePutString ("ESP_07_CHK;3585\n", 16, fhdlOut);
            filePutString ("ESP_07_CHK/ESP_07_FR;3585\n", 26, fhdlOut);
            filePutString ("ESP_07_CHK/ESP07FR;3585\n", 24, fhdlOut);
            filePutString ("ESP_ACC_LDE;3586\n", 17, fhdlOut);
            filePutString ("ESP_ACC_LDE/ESP_07_FR;3586\n", 27, fhdlOut);
            filePutString ("ESP_ACC_LDE/ESP07FR;3586\n", 25, fhdlOut);
            filePutString ("ESP_CM_Variante;3587\n", 21, fhdlOut);
            filePutString ("ESP_CM_Variante/ESP_07_FR;3587\n", 31, fhdlOut);
            filePutString ("ESP_CM_Variante/ESP07FR;3587\n", 29, fhdlOut);
            filePutString ("ESP_Codierung_ADS;3588\n", 23, fhdlOut);
            filePutString ("ESP_Codierung_ADS/ESP_07_FR;3588\n", 33, fhdlOut);
            filePutString ("ESP_Codierung_ADS/ESP07FR;3588\n", 31, fhdlOut);
            filePutString ("ESP_MKB_Status;3589\n", 20, fhdlOut);
            filePutString ("ESP_MKB_Status/ESP_07_FR;3589\n", 30, fhdlOut);
            filePutString ("ESP_MKB_Status/ESP07FR;3589\n", 28, fhdlOut);
            filePutString ("ESP_MKB_ausloesbar;3590\n", 24, fhdlOut);
            filePutString ("ESP_MKB_ausloesbar/ESP_07_FR;3590\n", 34, fhdlOut);
            filePutString ("ESP_MKB_ausloesbar/ESP07FR;3590\n", 32, fhdlOut);
            filePutString ("ESP_OBD_Status;3591\n", 20, fhdlOut);
            filePutString ("ESP_OBD_Status/ESP_07_FR;3591\n", 30, fhdlOut);
            filePutString ("ESP_OBD_Status/ESP07FR;3591\n", 28, fhdlOut);
            filePutString ("ESP_Offroad_Modus;3592\n", 23, fhdlOut);
            filePutString ("ESP_Offroad_Modus/ESP_07_FR;3592\n", 33, fhdlOut);
            filePutString ("ESP_Offroad_Modus/ESP07FR;3592\n", 31, fhdlOut);
            filePutString ("ESP_Qualifizierung_Antriebsart;3593\n", 36, fhdlOut);
            filePutString ("ESP_Qualifizierung_Antriebsart/ESP_07_FR;3593\n", 46, fhdlOut);
            filePutString ("ESP_Qualifizierung_Antriebsart/ESP07FR;3593\n", 44, fhdlOut);
            filePutString ("ESP_Quattro_Antrieb;3594\n", 25, fhdlOut);
            filePutString ("ESP_Quattro_Antrieb/ESP_07_FR;3594\n", 35, fhdlOut);
            filePutString ("ESP_Quattro_Antrieb/ESP07FR;3594\n", 33, fhdlOut);
            filePutString ("ESP_RTA_HL;3595\n", 16, fhdlOut);
            filePutString ("ESP_RTA_HL/ESP_07_FR;3595\n", 26, fhdlOut);
            filePutString ("ESP_RTA_HL/ESP07FR;3595\n", 24, fhdlOut);
            filePutString ("ESP_RTA_HR;3596\n", 16, fhdlOut);
            filePutString ("ESP_RTA_HR/ESP_07_FR;3596\n", 26, fhdlOut);
            filePutString ("ESP_RTA_HR/ESP07FR;3596\n", 24, fhdlOut);
            filePutString ("ESP_RTA_VR;3597\n", 16, fhdlOut);
            filePutString ("ESP_RTA_VR/ESP_07_FR;3597\n", 26, fhdlOut);
            filePutString ("ESP_RTA_VR/ESP07FR;3597\n", 24, fhdlOut);
            filePutString ("ESP_Rollenmodus_Deaktivieren;3598\n", 34, fhdlOut);
            filePutString ("ESP_Rollenmodus_Deaktivieren/ESP_07_FR;3598\n", 44, fhdlOut);
            filePutString ("ESP_Rollenmodus_Deaktivieren/ESP07FR;3598\n", 42, fhdlOut);
            filePutString ("ESP_nachtr_Stopp_Anf;3599\n", 26, fhdlOut);
            filePutString ("ESP_nachtr_Stopp_Anf/ESP_07_FR;3599\n", 36, fhdlOut);
            filePutString ("ESP_nachtr_Stopp_Anf/ESP07FR;3599\n", 34, fhdlOut);
            filePutString ("OBD_Fehler_Radsensor_HL;3600\n", 29, fhdlOut);
            filePutString ("OBD_Fehler_Radsensor_HL/ESP_07_FR;3600\n", 39, fhdlOut);
            filePutString ("OBD_Fehler_Radsensor_HL/ESP07FR;3600\n", 37, fhdlOut);
            filePutString ("OBD_Fehler_Radsensor_HR;3601\n", 29, fhdlOut);
            filePutString ("OBD_Fehler_Radsensor_HR/ESP_07_FR;3601\n", 39, fhdlOut);
            filePutString ("OBD_Fehler_Radsensor_HR/ESP07FR;3601\n", 37, fhdlOut);
            filePutString ("OBD_Fehler_Radsensor_VL;3602\n", 29, fhdlOut);
            filePutString ("OBD_Fehler_Radsensor_VL/ESP_07_FR;3602\n", 39, fhdlOut);
            filePutString ("OBD_Fehler_Radsensor_VL/ESP07FR;3602\n", 37, fhdlOut);
            filePutString ("OBD_Fehler_Radsensor_VR;3603\n", 29, fhdlOut);
            filePutString ("OBD_Fehler_Radsensor_VR/ESP_07_FR;3603\n", 39, fhdlOut);
            filePutString ("OBD_Fehler_Radsensor_VR/ESP07FR;3603\n", 37, fhdlOut);
            filePutString ("ESP_16_BZ;3840\n", 15, fhdlOut);
            filePutString ("ESP_16_BZ/ESP_16;3840\n", 22, fhdlOut);
            filePutString ("ESP_16_BZ/ESP16;3840\n", 21, fhdlOut);
            filePutString ("ESP_16_CRC;3841\n", 16, fhdlOut);
            filePutString ("ESP_16_CRC/ESP_16;3841\n", 23, fhdlOut);
            filePutString ("ESP_16_CRC/ESP16;3841\n", 22, fhdlOut);
            filePutString ("ESP_Antrieb_Anf;3842\n", 21, fhdlOut);
            filePutString ("ESP_Antrieb_Anf/ESP_16;3842\n", 28, fhdlOut);
            filePutString ("ESP_Antrieb_Anf/ESP16;3842\n", 27, fhdlOut);
            filePutString ("ESP_Eingriffsmoment;3843\n", 25, fhdlOut);
            filePutString ("ESP_Eingriffsmoment/ESP_16;3843\n", 32, fhdlOut);
            filePutString ("ESP_Eingriffsmoment/ESP16;3843\n", 31, fhdlOut);
            filePutString ("ESP_KD_OBD_Fehler;3844\n", 23, fhdlOut);
            filePutString ("ESP_KD_OBD_Fehler/ESP_16;3844\n", 30, fhdlOut);
            filePutString ("ESP_KD_OBD_Fehler/ESP16;3844\n", 29, fhdlOut);
            filePutString ("ESP_KD_OBD_Readiness;3845\n", 26, fhdlOut);
            filePutString ("ESP_KD_OBD_Readiness/ESP_16;3845\n", 33, fhdlOut);
            filePutString ("ESP_KD_OBD_Readiness/ESP16;3845\n", 32, fhdlOut);
            filePutString ("ESP_Pedalweg_Bremse;3846\n", 25, fhdlOut);
            filePutString ("ESP_Pedalweg_Bremse/ESP_16;3846\n", 32, fhdlOut);
            filePutString ("ESP_Pedalweg_Bremse/ESP16;3846\n", 31, fhdlOut);
            filePutString ("ESP_Reku_Anf;3847\n", 18, fhdlOut);
            filePutString ("ESP_Reku_Anf/ESP_16;3847\n", 25, fhdlOut);
            filePutString ("ESP_Reku_Anf/ESP16;3847\n", 24, fhdlOut);
            filePutString ("ESP_Reku_Index;3848\n", 20, fhdlOut);
            filePutString ("ESP_Reku_Index/ESP_16;3848\n", 27, fhdlOut);
            filePutString ("ESP_Reku_Index/ESP16;3848\n", 26, fhdlOut);
            filePutString ("ESP_10_BZ;4096\n", 15, fhdlOut);
            filePutString ("ESP_10_BZ/ESP_K_10;4096\n", 24, fhdlOut);
            filePutString ("ESP_10_BZ/ESPK10;4096\n", 22, fhdlOut);
            filePutString ("ESP_10_CRC;4097\n", 16, fhdlOut);
            filePutString ("ESP_10_CRC/ESP_K_10;4097\n", 25, fhdlOut);
            filePutString ("ESP_10_CRC/ESPK10;4097\n", 23, fhdlOut);
            filePutString ("ESP_HL_Fahrtrichtung;4098\n", 26, fhdlOut);
            filePutString ("ESP_HL_Fahrtrichtung/ESP_K_10;4098\n", 35, fhdlOut);
            filePutString ("ESP_HL_Fahrtrichtung/ESPK10;4098\n", 33, fhdlOut);
            filePutString ("ESP_HR_Fahrtrichtung;4099\n", 26, fhdlOut);
            filePutString ("ESP_HR_Fahrtrichtung/ESP_K_10;4099\n", 35, fhdlOut);
            filePutString ("ESP_HR_Fahrtrichtung/ESPK10;4099\n", 33, fhdlOut);
            filePutString ("ESP_QBit_Wegimpuls_HL;4100\n", 27, fhdlOut);
            filePutString ("ESP_QBit_Wegimpuls_HL/ESP_K_10;4100\n", 36, fhdlOut);
            filePutString ("ESP_QBit_Wegimpuls_HL/ESPK10;4100\n", 34, fhdlOut);
            filePutString ("ESP_QBit_Wegimpuls_HR;4101\n", 27, fhdlOut);
            filePutString ("ESP_QBit_Wegimpuls_HR/ESP_K_10;4101\n", 36, fhdlOut);
            filePutString ("ESP_QBit_Wegimpuls_HR/ESPK10;4101\n", 34, fhdlOut);
            filePutString ("ESP_QBit_Wegimpuls_VL;4102\n", 27, fhdlOut);
            filePutString ("ESP_QBit_Wegimpuls_VL/ESP_K_10;4102\n", 36, fhdlOut);
            filePutString ("ESP_QBit_Wegimpuls_VL/ESPK10;4102\n", 34, fhdlOut);
            filePutString ("ESP_QBit_Wegimpuls_VR;4103\n", 27, fhdlOut);
            filePutString ("ESP_QBit_Wegimpuls_VR/ESP_K_10;4103\n", 36, fhdlOut);
            filePutString ("ESP_QBit_Wegimpuls_VR/ESPK10;4103\n", 34, fhdlOut);
            filePutString ("ESP_VL_Fahrtrichtung;4104\n", 26, fhdlOut);
            filePutString ("ESP_VL_Fahrtrichtung/ESP_K_10;4104\n", 35, fhdlOut);
            filePutString ("ESP_VL_Fahrtrichtung/ESPK10;4104\n", 33, fhdlOut);
            filePutString ("ESP_VR_Fahrtrichtung;4105\n", 26, fhdlOut);
            filePutString ("ESP_VR_Fahrtrichtung/ESP_K_10;4105\n", 35, fhdlOut);
            filePutString ("ESP_VR_Fahrtrichtung/ESPK10;4105\n", 33, fhdlOut);
            filePutString ("ESP_Wegimpuls_HL;4106\n", 22, fhdlOut);
            filePutString ("ESP_Wegimpuls_HL/ESP_K_10;4106\n", 31, fhdlOut);
            filePutString ("ESP_Wegimpuls_HL/ESPK10;4106\n", 29, fhdlOut);
            filePutString ("ESP_Wegimpuls_HR;4107\n", 22, fhdlOut);
            filePutString ("ESP_Wegimpuls_HR/ESP_K_10;4107\n", 31, fhdlOut);
            filePutString ("ESP_Wegimpuls_HR/ESPK10;4107\n", 29, fhdlOut);
            filePutString ("ESP_Wegimpuls_VL;4108\n", 22, fhdlOut);
            filePutString ("ESP_Wegimpuls_VL/ESP_K_10;4108\n", 31, fhdlOut);
            filePutString ("ESP_Wegimpuls_VL/ESPK10;4108\n", 29, fhdlOut);
            filePutString ("ESP_Wegimpuls_VR;4109\n", 22, fhdlOut);
            filePutString ("ESP_Wegimpuls_VR/ESP_K_10;4109\n", 31, fhdlOut);
            filePutString ("ESP_Wegimpuls_VR/ESPK10;4109\n", 29, fhdlOut);
            filePutString ("KBI_Einheit_Datum;4352\n", 23, fhdlOut);
            filePutString ("KBI_Einheit_Datum/Einheiten_01;4352\n", 36, fhdlOut);
            filePutString ("KBI_Einheit_Datum/EINH01;4352\n", 30, fhdlOut);
            filePutString ("KBI_Einheit_Druck;4353\n", 23, fhdlOut);
            filePutString ("KBI_Einheit_Druck/Einheiten_01;4353\n", 36, fhdlOut);
            filePutString ("KBI_Einheit_Druck/EINH01;4353\n", 30, fhdlOut);
            filePutString ("KBI_Einheit_Sprache;4354\n", 25, fhdlOut);
            filePutString ("KBI_Einheit_Sprache/Einheiten_01;4354\n", 38, fhdlOut);
            filePutString ("KBI_Einheit_Sprache/EINH01;4354\n", 32, fhdlOut);
            filePutString ("KBI_Einheit_Streckenanz;4355\n", 29, fhdlOut);
            filePutString ("KBI_Einheit_Streckenanz/Einheiten_01;4355\n", 42, fhdlOut);
            filePutString ("KBI_Einheit_Streckenanz/EINH01;4355\n", 36, fhdlOut);
            filePutString ("KBI_Einheit_Temp;4356\n", 22, fhdlOut);
            filePutString ("KBI_Einheit_Temp/Einheiten_01;4356\n", 35, fhdlOut);
            filePutString ("KBI_Einheit_Temp/EINH01;4356\n", 29, fhdlOut);
            filePutString ("KBI_Einheit_Uhrzeit;4357\n", 25, fhdlOut);
            filePutString ("KBI_Einheit_Uhrzeit/Einheiten_01;4357\n", 38, fhdlOut);
            filePutString ("KBI_Einheit_Uhrzeit/EINH01;4357\n", 32, fhdlOut);
            filePutString ("KBI_Einheit_Verbrauch;4358\n", 27, fhdlOut);
            filePutString ("KBI_Einheit_Verbrauch/Einheiten_01;4358\n", 40, fhdlOut);
            filePutString ("KBI_Einheit_Verbrauch/EINH01;4358\n", 34, fhdlOut);
            filePutString ("KBI_Einheit_Volumen;4359\n", 25, fhdlOut);
            filePutString ("KBI_Einheit_Volumen/Einheiten_01;4359\n", 38, fhdlOut);
            filePutString ("KBI_Einheit_Volumen/EINH01;4359\n", 32, fhdlOut);
            filePutString ("KBI_MFA_v_Einheit_02;4360\n", 26, fhdlOut);
            filePutString ("KBI_MFA_v_Einheit_02/Einheiten_01;4360\n", 39, fhdlOut);
            filePutString ("KBI_MFA_v_Einheit_02/EINH01;4360\n", 33, fhdlOut);
            filePutString ("FA_MSG_Einschraenkung;4608\n", 27, fhdlOut);
            filePutString ("FA_MSG_Einschraenkung/Fahrwerk_02;4608\n", 39, fhdlOut);
            filePutString ("FA_MSG_Einschraenkung/LVL02;4608\n", 33, fhdlOut);
            filePutString ("Fahrwerk_02_BZ;4609\n", 20, fhdlOut);
            filePutString ("Fahrwerk_02_BZ/Fahrwerk_02;4609\n", 32, fhdlOut);
            filePutString ("Fahrwerk_02_BZ/LVL02;4609\n", 26, fhdlOut);
            filePutString ("Fahrwerk_02_CHK;4610\n", 21, fhdlOut);
            filePutString ("Fahrwerk_02_CHK/Fahrwerk_02;4610\n", 33, fhdlOut);
            filePutString ("Fahrwerk_02_CHK/LVL02;4610\n", 27, fhdlOut);
            filePutString ("ESP_Gierrate_Offset;4864\n", 25, fhdlOut);
            filePutString ("ESP_Gierrate_Offset/GW_Fwk_01_Ant_PAG;4864\n", 43, fhdlOut);
            filePutString ("ESP_Gierrate_Offset/GWFWK01;4864\n", 33, fhdlOut);
            filePutString ("ESP_Rollenmodus;4865\n", 21, fhdlOut);
            filePutString ("ESP_Rollenmodus/GW_Fwk_01_Ant_PAG;4865\n", 39, fhdlOut);
            filePutString ("ESP_Rollenmodus/GWFWK01;4865\n", 29, fhdlOut);
            filePutString ("FAS_Status_Anzeige;4866\n", 24, fhdlOut);
            filePutString ("FAS_Status_Anzeige/GW_Fwk_01_Ant_PAG;4866\n", 42, fhdlOut);
            filePutString ("FAS_Status_Anzeige/GWFWK01;4866\n", 32, fhdlOut);
            filePutString ("FSM_Status;4867\n", 16, fhdlOut);
            filePutString ("FSM_Status/GW_Fwk_01_Ant_PAG;4867\n", 34, fhdlOut);
            filePutString ("FSM_Status/GWFWK01;4867\n", 24, fhdlOut);
            filePutString ("F_ESP_11_Ant;4868\n", 18, fhdlOut);
            filePutString ("F_ESP_11_Ant/GW_Fwk_01_Ant_PAG;4868\n", 36, fhdlOut);
            filePutString ("F_ESP_11_Ant/GWFWK01;4868\n", 26, fhdlOut);
            filePutString ("F_ESP_13_Ant;4869\n", 18, fhdlOut);
            filePutString ("F_ESP_13_Ant/GW_Fwk_01_Ant_PAG;4869\n", 36, fhdlOut);
            filePutString ("F_ESP_13_Ant/GWFWK01;4869\n", 26, fhdlOut);
            filePutString ("F_Getriebe_07_PAG_Fwk;4870\n", 27, fhdlOut);
            filePutString ("F_Getriebe_07_PAG_Fwk/GW_Fwk_01_Ant_PAG;4870\n", 45, fhdlOut);
            filePutString ("F_Getriebe_07_PAG_Fwk/GWFWK01;4870\n", 35, fhdlOut);
            filePutString ("F_Klima_03_Fwk_Ant;4871\n", 24, fhdlOut);
            filePutString ("F_Klima_03_Fwk_Ant/GW_Fwk_01_Ant_PAG;4871\n", 42, fhdlOut);
            filePutString ("F_Klima_03_Fwk_Ant/GWFWK01;4871\n", 32, fhdlOut);
            filePutString ("F_Klima_08_PAG_Fwk;4872\n", 24, fhdlOut);
            filePutString ("F_Klima_08_PAG_Fwk/GW_Fwk_01_Ant_PAG;4872\n", 42, fhdlOut);
            filePutString ("F_Klima_08_PAG_Fwk/GWFWK01;4872\n", 32, fhdlOut);
            filePutString ("F_LS_01_Fwk;4873\n", 17, fhdlOut);
            filePutString ("F_LS_01_Fwk/GW_Fwk_01_Ant_PAG;4873\n", 35, fhdlOut);
            filePutString ("F_LS_01_Fwk/GWFWK01;4873\n", 25, fhdlOut);
            filePutString ("F_TSK_03_Fwk;4874\n", 18, fhdlOut);
            filePutString ("F_TSK_03_Fwk/GW_Fwk_01_Ant_PAG;4874\n", 36, fhdlOut);
            filePutString ("F_TSK_03_Fwk/GWFWK01;4874\n", 26, fhdlOut);
            filePutString ("F_Wischer_01_Fwk;4875\n", 22, fhdlOut);
            filePutString ("F_Wischer_01_Fwk/GW_Fwk_01_Ant_PAG;4875\n", 40, fhdlOut);
            filePutString ("F_Wischer_01_Fwk/GWFWK01;4875\n", 30, fhdlOut);
            filePutString ("GE_Getriebestatus;4876\n", 23, fhdlOut);
            filePutString ("GE_Getriebestatus/GW_Fwk_01_Ant_PAG;4876\n", 41, fhdlOut);
            filePutString ("GE_Getriebestatus/GWFWK01;4876\n", 31, fhdlOut);
            filePutString ("KL_AussenTemp_WK;4877\n", 22, fhdlOut);
            filePutString ("KL_AussenTemp_WK/GW_Fwk_01_Ant_PAG;4877\n", 40, fhdlOut);
            filePutString ("KL_AussenTemp_WK/GWFWK01;4877\n", 30, fhdlOut);
            filePutString ("KL_Magnetventil;4878\n", 21, fhdlOut);
            filePutString ("KL_Magnetventil/GW_Fwk_01_Ant_PAG;4878\n", 39, fhdlOut);
            filePutString ("KL_Magnetventil/GWFWK01;4878\n", 29, fhdlOut);
            filePutString ("KL_Niv_down;4879\n", 17, fhdlOut);
            filePutString ("KL_Niv_down/GW_Fwk_01_Ant_PAG;4879\n", 35, fhdlOut);
            filePutString ("KL_Niv_down/GWFWK01;4879\n", 25, fhdlOut);
            filePutString ("KL_Niv_up;4880\n", 15, fhdlOut);
            filePutString ("KL_Niv_up/GW_Fwk_01_Ant_PAG;4880\n", 33, fhdlOut);
            filePutString ("KL_Niv_up/GWFWK01;4880\n", 23, fhdlOut);
            filePutString ("KL_T_Abgasklappe;4881\n", 22, fhdlOut);
            filePutString ("KL_T_Abgasklappe/GW_Fwk_01_Ant_PAG;4881\n", 40, fhdlOut);
            filePutString ("KL_T_Abgasklappe/GWFWK01;4881\n", 30, fhdlOut);
            filePutString ("KL_T_HDC;4882\n", 14, fhdlOut);
            filePutString ("KL_T_HDC/GW_Fwk_01_Ant_PAG;4882\n", 32, fhdlOut);
            filePutString ("KL_T_HDC/GWFWK01;4882\n", 22, fhdlOut);
            filePutString ("KL_T_PASM_1;4883\n", 17, fhdlOut);
            filePutString ("KL_T_PASM_1/GW_Fwk_01_Ant_PAG;4883\n", 35, fhdlOut);
            filePutString ("KL_T_PASM_1/GWFWK01;4883\n", 25, fhdlOut);
            filePutString ("KL_T_PASM_2;4884\n", 17, fhdlOut);
            filePutString ("KL_T_PASM_2/GW_Fwk_01_Ant_PAG;4884\n", 35, fhdlOut);
            filePutString ("KL_T_PASM_2/GWFWK01;4884\n", 25, fhdlOut);
            filePutString ("KL_T_PASM_3;4885\n", 17, fhdlOut);
            filePutString ("KL_T_PASM_3/GW_Fwk_01_Ant_PAG;4885\n", 35, fhdlOut);
            filePutString ("KL_T_PASM_3/GWFWK01;4885\n", 25, fhdlOut);
            filePutString ("KL_T_PSM_off;4886\n", 18, fhdlOut);
            filePutString ("KL_T_PSM_off/GW_Fwk_01_Ant_PAG;4886\n", 36, fhdlOut);
            filePutString ("KL_T_PSM_off/GWFWK01;4886\n", 26, fhdlOut);
            filePutString ("LS_Fehler;4887\n", 15, fhdlOut);
            filePutString ("LS_Fehler/GW_Fwk_01_Ant_PAG;4887\n", 33, fhdlOut);
            filePutString ("LS_Fehler/GWFWK01;4887\n", 23, fhdlOut);
            filePutString ("LS_Tip_Hoch;4888\n", 17, fhdlOut);
            filePutString ("LS_Tip_Hoch/GW_Fwk_01_Ant_PAG;4888\n", 35, fhdlOut);
            filePutString ("LS_Tip_Hoch/GWFWK01;4888\n", 25, fhdlOut);
            filePutString ("LS_Tip_Runter;4889\n", 19, fhdlOut);
            filePutString ("LS_Tip_Runter/GW_Fwk_01_Ant_PAG;4889\n", 37, fhdlOut);
            filePutString ("LS_Tip_Runter/GWFWK01;4889\n", 27, fhdlOut);
            filePutString ("TV_Eingriff;4890\n", 17, fhdlOut);
            filePutString ("TV_Eingriff/GW_Fwk_01_Ant_PAG;4890\n", 35, fhdlOut);
            filePutString ("TV_Eingriff/GWFWK01;4890\n", 25, fhdlOut);
            filePutString ("Wischer_vorne_Normal;4891\n", 26, fhdlOut);
            filePutString ("Wischer_vorne_Normal/GW_Fwk_01_Ant_PAG;4891\n", 44, fhdlOut);
            filePutString ("Wischer_vorne_Normal/GWFWK01;4891\n", 34, fhdlOut);
            filePutString ("Wischer_vorne_Schnell;4892\n", 27, fhdlOut);
            filePutString ("Wischer_vorne_Schnell/GW_Fwk_01_Ant_PAG;4892\n", 45, fhdlOut);
            filePutString ("Wischer_vorne_Schnell/GWFWK01;4892\n", 35, fhdlOut);
            filePutString ("BCM1_01_alt;5120\n", 17, fhdlOut);
            filePutString ("BCM1_01_alt/Gateway_05;5120\n", 28, fhdlOut);
            filePutString ("BCM1_01_alt/GW05;5120\n", 22, fhdlOut);
            filePutString ("BCM1_02_alt;5121\n", 17, fhdlOut);
            filePutString ("BCM1_02_alt/Gateway_05;5121\n", 28, fhdlOut);
            filePutString ("BCM1_02_alt/GW05;5121\n", 22, fhdlOut);
            filePutString ("BCM1_Adaptive_Lichtvert_Anf;5122\n", 33, fhdlOut);
            filePutString ("BCM1_Adaptive_Lichtvert_Anf/Gateway_05;5122\n", 44, fhdlOut);
            filePutString ("BCM1_Adaptive_Lichtvert_Anf/GW05;5122\n", 38, fhdlOut);
            filePutString ("BCM1_Aussen_Temp_ungef;5123\n", 28, fhdlOut);
            filePutString ("BCM1_Aussen_Temp_ungef/Gateway_05;5123\n", 39, fhdlOut);
            filePutString ("BCM1_Aussen_Temp_ungef/GW05;5123\n", 33, fhdlOut);
            filePutString ("BCM1_Gleitende_Leuchtw_Anf;5124\n", 32, fhdlOut);
            filePutString ("BCM1_Gleitende_Leuchtw_Anf/Gateway_05;5124\n", 43, fhdlOut);
            filePutString ("BCM1_Gleitende_Leuchtw_Anf/GW05;5124\n", 37, fhdlOut);
            filePutString ("BCM1_MH_WIV_Schalter;5125\n", 26, fhdlOut);
            filePutString ("BCM1_MH_WIV_Schalter/Gateway_05;5125\n", 37, fhdlOut);
            filePutString ("BCM1_MH_WIV_Schalter/GW05;5125\n", 31, fhdlOut);
            filePutString ("BCM1_OBD_FStatus_ATemp;5126\n", 28, fhdlOut);
            filePutString ("BCM1_OBD_FStatus_ATemp/Gateway_05;5126\n", 39, fhdlOut);
            filePutString ("BCM1_OBD_FStatus_ATemp/GW05;5126\n", 33, fhdlOut);
            filePutString ("BCM1_Oeldruck_Schalter;5127\n", 28, fhdlOut);
            filePutString ("BCM1_Oeldruck_Schalter/Gateway_05;5127\n", 39, fhdlOut);
            filePutString ("BCM1_Oeldruck_Schalter/GW05;5127\n", 33, fhdlOut);
            filePutString ("BCM1_Oeldruck_Schalter_2;5128\n", 30, fhdlOut);
            filePutString ("BCM1_Oeldruck_Schalter_2/Gateway_05;5128\n", 41, fhdlOut);
            filePutString ("BCM1_Oeldruck_Schalter_2/GW05;5128\n", 35, fhdlOut);
            filePutString ("BCM1_RFahrlicht_Fzg_Anf;5129\n", 29, fhdlOut);
            filePutString ("BCM1_RFahrlicht_Fzg_Anf/Gateway_05;5129\n", 40, fhdlOut);
            filePutString ("BCM1_RFahrlicht_Fzg_Anf/GW05;5129\n", 34, fhdlOut);
            filePutString ("BCM1_Rueckfahrlicht_Schalter;5130\n", 34, fhdlOut);
            filePutString ("BCM1_Rueckfahrlicht_Schalter/Gateway_05;5130\n", 45, fhdlOut);
            filePutString ("BCM1_Rueckfahrlicht_Schalter/GW05;5130\n", 39, fhdlOut);
            filePutString ("BCM1_Schalter_StartStopp;5131\n", 30, fhdlOut);
            filePutString ("BCM1_Schalter_StartStopp/Gateway_05;5131\n", 41, fhdlOut);
            filePutString ("BCM1_Schalter_StartStopp/GW05;5131\n", 35, fhdlOut);
            filePutString ("BCM1_Vorwaertsgang_eingelegt;5132\n", 34, fhdlOut);
            filePutString ("BCM1_Vorwaertsgang_eingelegt/Gateway_05;5132\n", 45, fhdlOut);
            filePutString ("BCM1_Vorwaertsgang_eingelegt/GW05;5132\n", 39, fhdlOut);
            filePutString ("BT_Tuer_geoeffnet;5133\n", 23, fhdlOut);
            filePutString ("BT_Tuer_geoeffnet/Gateway_05;5133\n", 34, fhdlOut);
            filePutString ("BT_Tuer_geoeffnet/GW05;5133\n", 28, fhdlOut);
            filePutString ("ESP_07_alt;5134\n", 16, fhdlOut);
            filePutString ("ESP_07_alt/Gateway_05;5134\n", 27, fhdlOut);
            filePutString ("ESP_07_alt/GW05;5134\n", 21, fhdlOut);
            filePutString ("ESP_Codierung_ADS;5135\n", 23, fhdlOut);
            filePutString ("ESP_Codierung_ADS/Gateway_05;5135\n", 34, fhdlOut);
            filePutString ("ESP_Codierung_ADS/GW05;5135\n", 28, fhdlOut);
            filePutString ("FA_StartStopp_Info;5136\n", 24, fhdlOut);
            filePutString ("FA_StartStopp_Info/Gateway_05;5136\n", 35, fhdlOut);
            filePutString ("FA_StartStopp_Info/GW05;5136\n", 29, fhdlOut);
            filePutString ("FT_Sperrklinke;5137\n", 20, fhdlOut);
            filePutString ("FT_Sperrklinke/Gateway_05;5137\n", 31, fhdlOut);
            filePutString ("FT_Sperrklinke/GW05;5137\n", 25, fhdlOut);
            filePutString ("FT_Tuer_geoeffnet;5138\n", 23, fhdlOut);
            filePutString ("FT_Tuer_geoeffnet/Gateway_05;5138\n", 34, fhdlOut);
            filePutString ("FT_Tuer_geoeffnet/GW05;5138\n", 28, fhdlOut);
            filePutString ("Fahrwerk_02_alt;5139\n", 21, fhdlOut);
            filePutString ("Fahrwerk_02_alt/Gateway_05;5139\n", 32, fhdlOut);
            filePutString ("Fahrwerk_02_alt/GW05;5139\n", 26, fhdlOut);
            filePutString ("GW_05_va_27;5140\n", 17, fhdlOut);
            filePutString ("GW_05_va_27/Gateway_05;5140\n", 28, fhdlOut);
            filePutString ("GW_05_va_27/GW05;5140\n", 22, fhdlOut);
            filePutString ("HL_Tuer_geoeffnet;5141\n", 23, fhdlOut);
            filePutString ("HL_Tuer_geoeffnet/Gateway_05;5141\n", 34, fhdlOut);
            filePutString ("HL_Tuer_geoeffnet/GW05;5141\n", 28, fhdlOut);
            filePutString ("HR_Tuer_geoeffnet;5142\n", 23, fhdlOut);
            filePutString ("HR_Tuer_geoeffnet/Gateway_05;5142\n", 34, fhdlOut);
            filePutString ("HR_Tuer_geoeffnet/GW05;5142\n", 28, fhdlOut);
            filePutString ("KL_HSH_ein_Soll;5143\n", 21, fhdlOut);
            filePutString ("KL_HSH_ein_Soll/Gateway_05;5143\n", 32, fhdlOut);
            filePutString ("KL_HSH_ein_Soll/GW05;5143\n", 26, fhdlOut);
            filePutString ("KL_Zuheizer_Freigabe;5144\n", 26, fhdlOut);
            filePutString ("KL_Zuheizer_Freigabe/Gateway_05;5144\n", 37, fhdlOut);
            filePutString ("KL_Zuheizer_Freigabe/GW05;5144\n", 31, fhdlOut);
            filePutString ("Klima_02_alt;5145\n", 18, fhdlOut);
            filePutString ("Klima_02_alt/Gateway_05;5145\n", 29, fhdlOut);
            filePutString ("Klima_02_alt/GW05;5145\n", 23, fhdlOut);
            filePutString ("Klima_Sensor_02_alt;5146\n", 25, fhdlOut);
            filePutString ("Klima_Sensor_02_alt/Gateway_05;5146\n", 36, fhdlOut);
            filePutString ("Klima_Sensor_02_alt/GW05;5146\n", 30, fhdlOut);
            filePutString ("MO_Handshake_STH;5147\n", 22, fhdlOut);
            filePutString ("MO_Handshake_STH/Gateway_05;5147\n", 33, fhdlOut);
            filePutString ("MO_Handshake_STH/GW05;5147\n", 27, fhdlOut);
            filePutString ("MO_Status_Normalbetrieb_01;5148\n", 32, fhdlOut);
            filePutString ("MO_Status_Normalbetrieb_01/Gateway_05;5148\n", 43, fhdlOut);
            filePutString ("MO_Status_Normalbetrieb_01/GW05;5148\n", 37, fhdlOut);
            filePutString ("Motor_02_alt;5149\n", 18, fhdlOut);
            filePutString ("Motor_02_alt/Gateway_05;5149\n", 29, fhdlOut);
            filePutString ("Motor_02_alt/GW05;5149\n", 23, fhdlOut);
            filePutString ("Motor_05_alt;5150\n", 18, fhdlOut);
            filePutString ("Motor_05_alt/Gateway_05;5150\n", 29, fhdlOut);
            filePutString ("Motor_05_alt/GW05;5150\n", 23, fhdlOut);
            filePutString ("PH_StartStopp_Info;5151\n", 24, fhdlOut);
            filePutString ("PH_StartStopp_Info/Gateway_05;5151\n", 35, fhdlOut);
            filePutString ("PH_StartStopp_Info/GW05;5151\n", 29, fhdlOut);
            filePutString ("Parkhilfe_01_alt;5152\n", 22, fhdlOut);
            filePutString ("Parkhilfe_01_alt/Gateway_05;5152\n", 33, fhdlOut);
            filePutString ("Parkhilfe_01_alt/GW05;5152\n", 27, fhdlOut);
            filePutString ("QSP_01_alt;5153\n", 16, fhdlOut);
            filePutString ("QSP_01_alt/Gateway_05;5153\n", 27, fhdlOut);
            filePutString ("QSP_01_alt/GW05;5153\n", 21, fhdlOut);
            filePutString ("QSP_StartStopp_Info;5154\n", 25, fhdlOut);
            filePutString ("QSP_StartStopp_Info/Gateway_05;5154\n", 36, fhdlOut);
            filePutString ("QSP_StartStopp_Info/GW05;5154\n", 30, fhdlOut);
            filePutString ("TSG_BT_1_alt;5155\n", 18, fhdlOut);
            filePutString ("TSG_BT_1_alt/Gateway_05;5155\n", 29, fhdlOut);
            filePutString ("TSG_BT_1_alt/GW05;5155\n", 23, fhdlOut);
            filePutString ("TSG_FT_1_alt;5156\n", 18, fhdlOut);
            filePutString ("TSG_FT_1_alt/Gateway_05;5156\n", 29, fhdlOut);
            filePutString ("TSG_FT_1_alt/GW05;5156\n", 23, fhdlOut);
            filePutString ("TSG_HL_1_alt;5157\n", 18, fhdlOut);
            filePutString ("TSG_HL_1_alt/Gateway_05;5157\n", 29, fhdlOut);
            filePutString ("TSG_HL_1_alt/GW05;5157\n", 23, fhdlOut);
            filePutString ("TSG_HR_1_alt;5158\n", 18, fhdlOut);
            filePutString ("TSG_HR_1_alt/Gateway_05;5158\n", 29, fhdlOut);
            filePutString ("TSG_HR_1_alt/GW05;5158\n", 23, fhdlOut);
            filePutString ("Wischer_01_alt;5159\n", 20, fhdlOut);
            filePutString ("Wischer_01_alt/Gateway_05;5159\n", 31, fhdlOut);
            filePutString ("Wischer_01_alt/GW05;5159\n", 25, fhdlOut);
            filePutString ("Wischer_vorne_aktiv;5160\n", 25, fhdlOut);
            filePutString ("Wischer_vorne_aktiv/Gateway_05;5160\n", 36, fhdlOut);
            filePutString ("Wischer_vorne_aktiv/GW05;5160\n", 30, fhdlOut);
            filePutString ("BCM1_01_alt;5376\n", 17, fhdlOut);
            filePutString ("BCM1_01_alt/Gateway_11;5376\n", 28, fhdlOut);
            filePutString ("BCM1_01_alt/GW11;5376\n", 22, fhdlOut);
            filePutString ("BCM1_02_alt;5377\n", 17, fhdlOut);
            filePutString ("BCM1_02_alt/Gateway_11;5377\n", 28, fhdlOut);
            filePutString ("BCM1_02_alt/GW11;5377\n", 22, fhdlOut);
            filePutString ("BCM1_04_alt;5378\n", 17, fhdlOut);
            filePutString ("BCM1_04_alt/Gateway_11;5378\n", 28, fhdlOut);
            filePutString ("BCM1_04_alt/GW11;5378\n", 22, fhdlOut);
            filePutString ("BCM1_Allwetterlicht_Anf;5379\n", 29, fhdlOut);
            filePutString ("BCM1_Allwetterlicht_Anf/Gateway_11;5379\n", 40, fhdlOut);
            filePutString ("BCM1_Allwetterlicht_Anf/GW11;5379\n", 34, fhdlOut);
            filePutString ("BCM1_LDS_Stellung;5380\n", 23, fhdlOut);
            filePutString ("BCM1_LDS_Stellung/Gateway_11;5380\n", 34, fhdlOut);
            filePutString ("BCM1_LDS_Stellung/GW11;5380\n", 28, fhdlOut);
            filePutString ("BCM1_Licht_Dunkelheit_aktiv;5381\n", 33, fhdlOut);
            filePutString ("BCM1_Licht_Dunkelheit_aktiv/Gateway_11;5381\n", 44, fhdlOut);
            filePutString ("BCM1_Licht_Dunkelheit_aktiv/GW11;5381\n", 38, fhdlOut);
            filePutString ("BCM1_Linksverkehr;5382\n", 23, fhdlOut);
            filePutString ("BCM1_Linksverkehr/Gateway_11;5382\n", 34, fhdlOut);
            filePutString ("BCM1_Linksverkehr/GW11;5382\n", 28, fhdlOut);
            filePutString ("BCM1_MH_Schalter;5383\n", 22, fhdlOut);
            filePutString ("BCM1_MH_Schalter/Gateway_11;5383\n", 33, fhdlOut);
            filePutString ("BCM1_MH_Schalter/GW11;5383\n", 27, fhdlOut);
            filePutString ("BCM1_Touristen_Licht_Anf;5384\n", 30, fhdlOut);
            filePutString ("BCM1_Touristen_Licht_Anf/Gateway_11;5384\n", 41, fhdlOut);
            filePutString ("BCM1_Touristen_Licht_Anf/GW11;5384\n", 35, fhdlOut);
            filePutString ("BCM2_02_alt;5385\n", 17, fhdlOut);
            filePutString ("BCM2_02_alt/Gateway_11;5385\n", 28, fhdlOut);
            filePutString ("BCM2_02_alt/GW11;5385\n", 22, fhdlOut);
            filePutString ("BCM2_P_verriegelt;5386\n", 23, fhdlOut);
            filePutString ("BCM2_P_verriegelt/Gateway_11;5386\n", 34, fhdlOut);
            filePutString ("BCM2_P_verriegelt/GW11;5386\n", 28, fhdlOut);
            filePutString ("BCM_Tankwunsch;5387\n", 20, fhdlOut);
            filePutString ("BCM_Tankwunsch/Gateway_11;5387\n", 31, fhdlOut);
            filePutString ("BCM_Tankwunsch/GW11;5387\n", 25, fhdlOut);
            filePutString ("BH_Blinker_li;5388\n", 19, fhdlOut);
            filePutString ("BH_Blinker_li/Gateway_11;5388\n", 30, fhdlOut);
            filePutString ("BH_Blinker_li/GW11;5388\n", 24, fhdlOut);
            filePutString ("BH_Blinker_re;5389\n", 19, fhdlOut);
            filePutString ("BH_Blinker_re/Gateway_11;5389\n", 30, fhdlOut);
            filePutString ("BH_Blinker_re/GW11;5389\n", 24, fhdlOut);
            filePutString ("BH_Fernlicht;5390\n", 18, fhdlOut);
            filePutString ("BH_Fernlicht/Gateway_11;5390\n", 29, fhdlOut);
            filePutString ("BH_Fernlicht/GW11;5390\n", 23, fhdlOut);
            filePutString ("BH_Lichthupe;5391\n", 18, fhdlOut);
            filePutString ("BH_Lichthupe/Gateway_11;5391\n", 29, fhdlOut);
            filePutString ("BH_Lichthupe/GW11;5391\n", 23, fhdlOut);
            filePutString ("BM_Autobahn;5392\n", 17, fhdlOut);
            filePutString ("BM_Autobahn/Gateway_11;5392\n", 28, fhdlOut);
            filePutString ("BM_Autobahn/GW11;5392\n", 22, fhdlOut);
            filePutString ("ESP_04_alt;5393\n", 16, fhdlOut);
            filePutString ("ESP_04_alt/Gateway_11;5393\n", 27, fhdlOut);
            filePutString ("ESP_04_alt/GW11;5393\n", 21, fhdlOut);
            filePutString ("ESP_Diagnose;5394\n", 18, fhdlOut);
            filePutString ("ESP_Diagnose/Gateway_11;5394\n", 29, fhdlOut);
            filePutString ("ESP_Diagnose/GW11;5394\n", 23, fhdlOut);
            filePutString ("GW_11_va_20;5395\n", 17, fhdlOut);
            filePutString ("GW_11_va_20/Gateway_11;5395\n", 28, fhdlOut);
            filePutString ("GW_11_va_20/GW11;5395\n", 22, fhdlOut);
            filePutString ("GW_11_va_21;5396\n", 17, fhdlOut);
            filePutString ("GW_11_va_21/Gateway_11;5396\n", 28, fhdlOut);
            filePutString ("GW_11_va_21/GW11;5396\n", 22, fhdlOut);
            filePutString ("GW_11_va_22;5397\n", 17, fhdlOut);
            filePutString ("GW_11_va_22/Gateway_11;5397\n", 28, fhdlOut);
            filePutString ("GW_11_va_22/GW11;5397\n", 22, fhdlOut);
            filePutString ("GW_11_va_23;5398\n", 17, fhdlOut);
            filePutString ("GW_11_va_23/Gateway_11;5398\n", 28, fhdlOut);
            filePutString ("GW_11_va_23/GW11;5398\n", 22, fhdlOut);
            filePutString ("GW_11_va_24;5399\n", 17, fhdlOut);
            filePutString ("GW_11_va_24/Gateway_11;5399\n", 28, fhdlOut);
            filePutString ("GW_11_va_24/GW11;5399\n", 22, fhdlOut);
            filePutString ("GW_11_va_25;5400\n", 17, fhdlOut);
            filePutString ("GW_11_va_25/Gateway_11;5400\n", 28, fhdlOut);
            filePutString ("GW_11_va_25/GW11;5400\n", 22, fhdlOut);
            filePutString ("GW_11_va_26;5401\n", 17, fhdlOut);
            filePutString ("GW_11_va_26/Gateway_11;5401\n", 28, fhdlOut);
            filePutString ("GW_11_va_26/GW11;5401\n", 22, fhdlOut);
            filePutString ("GW_11_va_27;5402\n", 17, fhdlOut);
            filePutString ("GW_11_va_27/Gateway_11;5402\n", 28, fhdlOut);
            filePutString ("GW_11_va_27/GW11;5402\n", 22, fhdlOut);
            filePutString ("HUD_01_alt;5403\n", 16, fhdlOut);
            filePutString ("HUD_01_alt/Gateway_11;5403\n", 27, fhdlOut);
            filePutString ("HUD_01_alt/GW11;5403\n", 21, fhdlOut);
            filePutString ("HUD_Anzeigefehler_NV;5404\n", 26, fhdlOut);
            filePutString ("HUD_Anzeigefehler_NV/Gateway_11;5404\n", 37, fhdlOut);
            filePutString ("HUD_Anzeigefehler_NV/GW11;5404\n", 31, fhdlOut);
            filePutString ("HUD_NV_in_Anzeige;5405\n", 23, fhdlOut);
            filePutString ("HUD_NV_in_Anzeige/Gateway_11;5405\n", 34, fhdlOut);
            filePutString ("HUD_NV_in_Anzeige/GW11;5405\n", 28, fhdlOut);
            filePutString ("HYB_Anf_E_Mode;5406\n", 20, fhdlOut);
            filePutString ("HYB_Anf_E_Mode/Gateway_11;5406\n", 31, fhdlOut);
            filePutString ("HYB_Anf_E_Mode/GW11;5406\n", 25, fhdlOut);
            filePutString ("HYB_Anf_E_Mode_alt;5407\n", 24, fhdlOut);
            filePutString ("HYB_Anf_E_Mode_alt/Gateway_11;5407\n", 35, fhdlOut);
            filePutString ("HYB_Anf_E_Mode_alt/GW11;5407\n", 29, fhdlOut);
            filePutString ("LV_AFL_aktiv_Anzeige;5408\n", 26, fhdlOut);
            filePutString ("LV_AFL_aktiv_Anzeige/Gateway_11;5408\n", 37, fhdlOut);
            filePutString ("LV_AFL_aktiv_Anzeige/GW11;5408\n", 31, fhdlOut);
            filePutString ("LV_Abblendlicht_Anzeige;5409\n", 29, fhdlOut);
            filePutString ("LV_Abblendlicht_Anzeige/Gateway_11;5409\n", 40, fhdlOut);
            filePutString ("LV_Abblendlicht_Anzeige/GW11;5409\n", 34, fhdlOut);
            filePutString ("LV_Abblendlicht_li_def;5410\n", 28, fhdlOut);
            filePutString ("LV_Abblendlicht_li_def/Gateway_11;5410\n", 39, fhdlOut);
            filePutString ("LV_Abblendlicht_li_def/GW11;5410\n", 33, fhdlOut);
            filePutString ("LV_Abblendlicht_re_def;5411\n", 28, fhdlOut);
            filePutString ("LV_Abblendlicht_re_def/Gateway_11;5411\n", 39, fhdlOut);
            filePutString ("LV_Abblendlicht_re_def/GW11;5411\n", 33, fhdlOut);
            filePutString ("LV_Nebelschlusslicht_Anzeige;5412\n", 34, fhdlOut);
            filePutString ("LV_Nebelschlusslicht_Anzeige/Gateway_11;5412\n", 45, fhdlOut);
            filePutString ("LV_Nebelschlusslicht_Anzeige/GW11;5412\n", 39, fhdlOut);
            filePutString ("SMLS_01_alt;5413\n", 17, fhdlOut);
            filePutString ("SMLS_01_alt/Gateway_11;5413\n", 28, fhdlOut);
            filePutString ("SMLS_01_alt/GW11;5413\n", 22, fhdlOut);
            filePutString ("ZV_Tankklappenstatus;5414\n", 26, fhdlOut);
            filePutString ("ZV_Tankklappenstatus/Gateway_11;5414\n", 37, fhdlOut);
            filePutString ("ZV_Tankklappenstatus/GW11;5414\n", 31, fhdlOut);
            filePutString ("GE_Freig_MMom_Vorhalt;5632\n", 27, fhdlOut);
            filePutString ("GE_Freig_MMom_Vorhalt/Getriebe_01;5632\n", 39, fhdlOut);
            filePutString ("GE_Freig_MMom_Vorhalt/GBX01;5632\n", 33, fhdlOut);
            filePutString ("GE_Freig_Mmom_Soll;5633\n", 24, fhdlOut);
            filePutString ("GE_Freig_Mmom_Soll/Getriebe_01;5633\n", 36, fhdlOut);
            filePutString ("GE_Freig_Mmom_Soll/GBX01;5633\n", 30, fhdlOut);
            filePutString ("GE_Freig_Mom_Eingriff;5634\n", 27, fhdlOut);
            filePutString ("GE_Freig_Mom_Eingriff/Getriebe_01;5634\n", 39, fhdlOut);
            filePutString ("GE_Freig_Mom_Eingriff/GBX01;5634\n", 33, fhdlOut);
            filePutString ("GE_KD_Fehler;5635\n", 18, fhdlOut);
            filePutString ("GE_KD_Fehler/Getriebe_01;5635\n", 30, fhdlOut);
            filePutString ("GE_KD_Fehler/GBX01;5635\n", 24, fhdlOut);
            filePutString ("GE_MMom_Soll;5636\n", 18, fhdlOut);
            filePutString ("GE_MMom_Soll/Getriebe_01;5636\n", 30, fhdlOut);
            filePutString ("GE_MMom_Soll/GBX01;5636\n", 24, fhdlOut);
            filePutString ("GE_MMom_Status;5637\n", 20, fhdlOut);
            filePutString ("GE_MMom_Status/Getriebe_01;5637\n", 32, fhdlOut);
            filePutString ("GE_MMom_Status/GBX01;5637\n", 26, fhdlOut);
            filePutString ("GE_MMom_Vorhalt;5638\n", 21, fhdlOut);
            filePutString ("GE_MMom_Vorhalt/Getriebe_01;5638\n", 33, fhdlOut);
            filePutString ("GE_MMom_Vorhalt/GBX01;5638\n", 27, fhdlOut);
            filePutString ("GE_Mom_Ident;5639\n", 18, fhdlOut);
            filePutString ("GE_Mom_Ident/Getriebe_01;5639\n", 30, fhdlOut);
            filePutString ("GE_Mom_Ident/GBX01;5639\n", 24, fhdlOut);
            filePutString ("GE_Mom_MZP;5640\n", 16, fhdlOut);
            filePutString ("GE_Mom_MZP/Getriebe_01;5640\n", 28, fhdlOut);
            filePutString ("GE_Mom_MZP/GBX01;5640\n", 22, fhdlOut);
            filePutString ("GE_Schaltvorgang;5641\n", 22, fhdlOut);
            filePutString ("GE_Schaltvorgang/Getriebe_01;5641\n", 34, fhdlOut);
            filePutString ("GE_Schaltvorgang/GBX01;5641\n", 28, fhdlOut);
            filePutString ("GE_Status_Kupplung;5642\n", 24, fhdlOut);
            filePutString ("GE_Status_Kupplung/Getriebe_01;5642\n", 36, fhdlOut);
            filePutString ("GE_Status_Kupplung/GBX01;5642\n", 30, fhdlOut);
            filePutString ("GE_Status_Schaltablauf;5643\n", 28, fhdlOut);
            filePutString ("GE_Status_Schaltablauf/Getriebe_01;5643\n", 40, fhdlOut);
            filePutString ("GE_Status_Schaltablauf/GBX01;5643\n", 34, fhdlOut);
            filePutString ("GE_Verbot_Ausblendung;5644\n", 27, fhdlOut);
            filePutString ("GE_Verbot_Ausblendung/Getriebe_01;5644\n", 39, fhdlOut);
            filePutString ("GE_Verbot_Ausblendung/GBX01;5644\n", 33, fhdlOut);
            filePutString ("GE_Zeit_MZP;5645\n", 17, fhdlOut);
            filePutString ("GE_Zeit_MZP/Getriebe_01;5645\n", 29, fhdlOut);
            filePutString ("GE_Zeit_MZP/GBX01;5645\n", 23, fhdlOut);
            filePutString ("Getriebe_01_BZ;5646\n", 20, fhdlOut);
            filePutString ("Getriebe_01_BZ/Getriebe_01;5646\n", 32, fhdlOut);
            filePutString ("Getriebe_01_BZ/GBX01;5646\n", 26, fhdlOut);
            filePutString ("Getriebe_01_CHK;5647\n", 21, fhdlOut);
            filePutString ("Getriebe_01_CHK/Getriebe_01;5647\n", 33, fhdlOut);
            filePutString ("Getriebe_01_CHK/GBX01;5647\n", 27, fhdlOut);
            filePutString ("GE_Anf_Zylabsch;5888\n", 21, fhdlOut);
            filePutString ("GE_Anf_Zylabsch/Getriebe_02;5888\n", 33, fhdlOut);
            filePutString ("GE_Anf_Zylabsch/GBX02;5888\n", 27, fhdlOut);
            filePutString ("GE_Anheb_Solldrehz_Leerlauf;5889\n", 33, fhdlOut);
            filePutString ("GE_Anheb_Solldrehz_Leerlauf/Getriebe_02;5889\n", 45, fhdlOut);
            filePutString ("GE_Anheb_Solldrehz_Leerlauf/GBX02;5889\n", 39, fhdlOut);
            filePutString ("GE_Drehzahlmesser_Daempfung;5890\n", 33, fhdlOut);
            filePutString ("GE_Drehzahlmesser_Daempfung/Getriebe_02;5890\n", 45, fhdlOut);
            filePutString ("GE_Drehzahlmesser_Daempfung/GBX02;5890\n", 39, fhdlOut);
            filePutString ("GE_Freigabe_Synchro;5891\n", 25, fhdlOut);
            filePutString ("GE_Freigabe_Synchro/Getriebe_02;5891\n", 37, fhdlOut);
            filePutString ("GE_Freigabe_Synchro/GBX02;5891\n", 31, fhdlOut);
            filePutString ("GE_HYB_DZ_Eingriff;5892\n", 24, fhdlOut);
            filePutString ("GE_HYB_DZ_Eingriff/Getriebe_02;5892\n", 36, fhdlOut);
            filePutString ("GE_HYB_DZ_Eingriff/GBX02;5892\n", 30, fhdlOut);
            filePutString ("GE_Mom_Begr_Gradient;5893\n", 26, fhdlOut);
            filePutString ("GE_Mom_Begr_Gradient/Getriebe_02;5893\n", 38, fhdlOut);
            filePutString ("GE_Mom_Begr_Gradient/GBX02;5893\n", 32, fhdlOut);
            filePutString ("GE_Schubabschalt_Unt;5894\n", 26, fhdlOut);
            filePutString ("GE_Schubabschalt_Unt/Getriebe_02;5894\n", 38, fhdlOut);
            filePutString ("GE_Schubabschalt_Unt/GBX02;5894\n", 32, fhdlOut);
            filePutString ("GE_Synchro_Wunschdrehz;5895\n", 28, fhdlOut);
            filePutString ("GE_Synchro_Wunschdrehz/Getriebe_02;5895\n", 40, fhdlOut);
            filePutString ("GE_Synchro_Wunschdrehz/GBX02;5895\n", 34, fhdlOut);
            filePutString ("GE_Synchro_Zeit;5896\n", 21, fhdlOut);
            filePutString ("GE_Synchro_Zeit/Getriebe_02;5896\n", 33, fhdlOut);
            filePutString ("GE_Synchro_Zeit/GBX02;5896\n", 27, fhdlOut);
            filePutString ("GE_Vorsteuermoment;5897\n", 24, fhdlOut);
            filePutString ("GE_Vorsteuermoment/Getriebe_02;5897\n", 36, fhdlOut);
            filePutString ("GE_Vorsteuermoment/GBX02;5897\n", 30, fhdlOut);
            filePutString ("Getriebe_02_BZ;5898\n", 20, fhdlOut);
            filePutString ("Getriebe_02_BZ/Getriebe_02;5898\n", 32, fhdlOut);
            filePutString ("Getriebe_02_BZ/GBX02;5898\n", 26, fhdlOut);
            filePutString ("Getriebe_02_CHK;5899\n", 21, fhdlOut);
            filePutString ("Getriebe_02_CHK/Getriebe_02;5899\n", 33, fhdlOut);
            filePutString ("Getriebe_02_CHK/GBX02;5899\n", 27, fhdlOut);
            filePutString ("GE_Codierung_MSG;6144\n", 22, fhdlOut);
            filePutString ("GE_Codierung_MSG/Getriebe_03;6144\n", 34, fhdlOut);
            filePutString ("GE_Codierung_MSG/GBX03;6144\n", 28, fhdlOut);
            filePutString ("GE_Eingangsdrehz;6145\n", 22, fhdlOut);
            filePutString ("GE_Eingangsdrehz/Getriebe_03;6145\n", 34, fhdlOut);
            filePutString ("GE_Eingangsdrehz/GBX03;6145\n", 28, fhdlOut);
            filePutString ("GE_Freig_Langfr_Schutzmom;6146\n", 31, fhdlOut);
            filePutString ("GE_Freig_Langfr_Schutzmom/Getriebe_03;6146\n", 43, fhdlOut);
            filePutString ("GE_Freig_Langfr_Schutzmom/GBX03;6146\n", 37, fhdlOut);
            filePutString ("GE_Langfr_Schutzmom;6147\n", 25, fhdlOut);
            filePutString ("GE_Langfr_Schutzmom/Getriebe_03;6147\n", 37, fhdlOut);
            filePutString ("GE_Langfr_Schutzmom/GBX03;6147\n", 31, fhdlOut);
            filePutString ("GE_Notlauf;6148\n", 16, fhdlOut);
            filePutString ("GE_Notlauf/Getriebe_03;6148\n", 28, fhdlOut);
            filePutString ("GE_Notlauf/GBX03;6148\n", 22, fhdlOut);
            filePutString ("GE_Performance_Start_LB;6149\n", 29, fhdlOut);
            filePutString ("GE_Performance_Start_LB/Getriebe_03;6149\n", 41, fhdlOut);
            filePutString ("GE_Performance_Start_LB/GBX03;6149\n", 35, fhdlOut);
            filePutString ("GE_StartStopp_Info;6150\n", 24, fhdlOut);
            filePutString ("GE_StartStopp_Info/Getriebe_03;6150\n", 36, fhdlOut);
            filePutString ("GE_StartStopp_Info/GBX03;6150\n", 30, fhdlOut);
            filePutString ("GE_Uefkt;6151\n", 14, fhdlOut);
            filePutString ("GE_Uefkt/Getriebe_03;6151\n", 26, fhdlOut);
            filePutString ("GE_Uefkt/GBX03;6151\n", 20, fhdlOut);
            filePutString ("GE_Waehlhebel;6152\n", 19, fhdlOut);
            filePutString ("GE_Waehlhebel/Getriebe_03;6152\n", 31, fhdlOut);
            filePutString ("GE_Waehlhebel/GBX03;6152\n", 25, fhdlOut);
            filePutString ("GE_Zielgang;6153\n", 17, fhdlOut);
            filePutString ("GE_Zielgang/Getriebe_03;6153\n", 29, fhdlOut);
            filePutString ("GE_Zielgang/GBX03;6153\n", 23, fhdlOut);
            filePutString ("GE_reserv_Waehlhebel;6154\n", 26, fhdlOut);
            filePutString ("GE_reserv_Waehlhebel/Getriebe_03;6154\n", 38, fhdlOut);
            filePutString ("GE_reserv_Waehlhebel/GBX03;6154\n", 32, fhdlOut);
            filePutString ("Getriebe_03_BZ;6155\n", 20, fhdlOut);
            filePutString ("Getriebe_03_BZ/Getriebe_03;6155\n", 32, fhdlOut);
            filePutString ("Getriebe_03_BZ/GBX03;6155\n", 26, fhdlOut);
            filePutString ("Getriebe_03_CHK;6156\n", 21, fhdlOut);
            filePutString ("Getriebe_03_CHK/Getriebe_03;6156\n", 33, fhdlOut);
            filePutString ("Getriebe_03_CHK/GBX03;6156\n", 27, fhdlOut);
            filePutString ("GE_Charisma_FahrPr;6400\n", 24, fhdlOut);
            filePutString ("GE_Charisma_FahrPr/Getriebe_04;6400\n", 36, fhdlOut);
            filePutString ("GE_Charisma_FahrPr/GBX04;6400\n", 30, fhdlOut);
            filePutString ("GE_Charisma_Status;6401\n", 24, fhdlOut);
            filePutString ("GE_Charisma_Status/Getriebe_04;6401\n", 36, fhdlOut);
            filePutString ("GE_Charisma_Status/GBX04;6401\n", 30, fhdlOut);
            filePutString ("GE_Charisma_Umschaltung;6402\n", 29, fhdlOut);
            filePutString ("GE_Charisma_Umschaltung/Getriebe_04;6402\n", 41, fhdlOut);
            filePutString ("GE_Charisma_Umschaltung/GBX04;6402\n", 35, fhdlOut);
            filePutString ("GE_Freigabe_Verfallsinfo_WFS;6403\n", 34, fhdlOut);
            filePutString ("GE_Freigabe_Verfallsinfo_WFS/Getriebe_04;6403\n", 46, fhdlOut);
            filePutString ("GE_Freigabe_Verfallsinfo_WFS/GBX04;6403\n", 40, fhdlOut);
            filePutString ("GE_Grenzkriechmoment;6404\n", 26, fhdlOut);
            filePutString ("GE_Grenzkriechmoment/Getriebe_04;6404\n", 38, fhdlOut);
            filePutString ("GE_Grenzkriechmoment/GBX04;6404\n", 32, fhdlOut);
            filePutString ("GE_Heizwunsch;6405\n", 19, fhdlOut);
            filePutString ("GE_Heizwunsch/Getriebe_04;6405\n", 31, fhdlOut);
            filePutString ("GE_Heizwunsch/GBX04;6405\n", 25, fhdlOut);
            filePutString ("GE_Index_Fahrwid;6406\n", 22, fhdlOut);
            filePutString ("GE_Index_Fahrwid/Getriebe_04;6406\n", 34, fhdlOut);
            filePutString ("GE_Index_Fahrwid/GBX04;6406\n", 28, fhdlOut);
            filePutString ("GE_LFR_Adaption;6407\n", 21, fhdlOut);
            filePutString ("GE_LFR_Adaption/Getriebe_04;6407\n", 33, fhdlOut);
            filePutString ("GE_LFR_Adaption/GBX04;6407\n", 27, fhdlOut);
            filePutString ("GE_OBD_AbsperrVent;6408\n", 24, fhdlOut);
            filePutString ("GE_OBD_AbsperrVent/Getriebe_04;6408\n", 36, fhdlOut);
            filePutString ("GE_OBD_AbsperrVent/GBX04;6408\n", 30, fhdlOut);
            filePutString ("GE_OBD_Status;6409\n", 19, fhdlOut);
            filePutString ("GE_OBD_Status/Getriebe_04;6409\n", 31, fhdlOut);
            filePutString ("GE_OBD_Status/GBX04;6409\n", 25, fhdlOut);
            filePutString ("GE_Sumpftemperatur;6410\n", 24, fhdlOut);
            filePutString ("GE_Sumpftemperatur/Getriebe_04;6410\n", 36, fhdlOut);
            filePutString ("GE_Sumpftemperatur/GBX04;6410\n", 30, fhdlOut);
            filePutString ("GE_Verlustmoment;6411\n", 22, fhdlOut);
            filePutString ("GE_Verlustmoment/Getriebe_04;6411\n", 34, fhdlOut);
            filePutString ("GE_Verlustmoment/GBX04;6411\n", 28, fhdlOut);
            filePutString ("GE_amax_moeglich;6412\n", 22, fhdlOut);
            filePutString ("GE_amax_moeglich/Getriebe_04;6412\n", 34, fhdlOut);
            filePutString ("GE_amax_moeglich/GBX04;6412\n", 28, fhdlOut);
            filePutString ("FBS_KD_Fehler;6656\n", 19, fhdlOut);
            filePutString ("FBS_KD_Fehler/Kessy_02;6656\n", 28, fhdlOut);
            filePutString ("FBS_KD_Fehler/KSY02;6656\n", 25, fhdlOut);
            filePutString ("FBS_Prio_Warn_04;6657\n", 22, fhdlOut);
            filePutString ("FBS_Prio_Warn_04/Kessy_02;6657\n", 31, fhdlOut);
            filePutString ("FBS_Prio_Warn_04/KSY02;6657\n", 28, fhdlOut);
            filePutString ("FBS_Prio_Warn_05;6658\n", 22, fhdlOut);
            filePutString ("FBS_Prio_Warn_05/Kessy_02;6658\n", 31, fhdlOut);
            filePutString ("FBS_Prio_Warn_05/KSY02;6658\n", 28, fhdlOut);
            filePutString ("FBS_Warn_LenkVerriegelung_def;6659\n", 35, fhdlOut);
            filePutString ("FBS_Warn_LenkVerriegelung_def/Kessy_02;6659\n", 44, fhdlOut);
            filePutString ("FBS_Warn_LenkVerriegelung_def/KSY02;6659\n", 41, fhdlOut);
            filePutString ("FBS_Warn_Lenkung_def;6660\n", 26, fhdlOut);
            filePutString ("FBS_Warn_Lenkung_def/Kessy_02;6660\n", 35, fhdlOut);
            filePutString ("FBS_Warn_Lenkung_def/KSY02;6660\n", 32, fhdlOut);
            filePutString ("FBS_Warn_Schluessel_Batt;6661\n", 30, fhdlOut);
            filePutString ("FBS_Warn_Schluessel_Batt/Kessy_02;6661\n", 39, fhdlOut);
            filePutString ("FBS_Warn_Schluessel_Batt/KSY02;6661\n", 36, fhdlOut);
            filePutString ("KYL_Warn_Kessy_defekt;6662\n", 27, fhdlOut);
            filePutString ("KYL_Warn_Kessy_defekt/Kessy_02;6662\n", 36, fhdlOut);
            filePutString ("KYL_Warn_Kessy_defekt/KSY02;6662\n", 33, fhdlOut);
            filePutString ("KYL_Warn_kein_Schuessel;6663\n", 29, fhdlOut);
            filePutString ("KYL_Warn_kein_Schuessel/Kessy_02;6663\n", 38, fhdlOut);
            filePutString ("KYL_Warn_kein_Schuessel/KSY02;6663\n", 35, fhdlOut);
            filePutString ("KY_ELV_enable_Anforderung;6664\n", 31, fhdlOut);
            filePutString ("KY_ELV_enable_Anforderung/Kessy_02;6664\n", 40, fhdlOut);
            filePutString ("KY_ELV_enable_Anforderung/KSY02;6664\n", 37, fhdlOut);
            filePutString ("KY_ELV_entr;6665\n", 17, fhdlOut);
            filePutString ("KY_ELV_entr/Kessy_02;6665\n", 26, fhdlOut);
            filePutString ("KY_ELV_entr/KSY02;6665\n", 23, fhdlOut);
            filePutString ("KY_ELV_verr;6666\n", 17, fhdlOut);
            filePutString ("KY_ELV_verr/Kessy_02;6666\n", 26, fhdlOut);
            filePutString ("KY_ELV_verr/KSY02;6666\n", 23, fhdlOut);
            filePutString ("KY_FBS_Fahrer_Hinweise;6667\n", 28, fhdlOut);
            filePutString ("KY_FBS_Fahrer_Hinweise/Kessy_02;6667\n", 37, fhdlOut);
            filePutString ("KY_FBS_Fahrer_Hinweise/KSY02;6667\n", 34, fhdlOut);
            filePutString ("KY_FFB_Frequenz;6668\n", 21, fhdlOut);
            filePutString ("KY_FFB_Frequenz/Kessy_02;6668\n", 30, fhdlOut);
            filePutString ("KY_FFB_Frequenz/KSY02;6668\n", 27, fhdlOut);
            filePutString ("KY_Funkschl_Nr;6669\n", 20, fhdlOut);
            filePutString ("KY_Funkschl_Nr/Kessy_02;6669\n", 29, fhdlOut);
            filePutString ("KY_Funkschl_Nr/KSY02;6669\n", 26, fhdlOut);
            filePutString ("KY_HF_Aktiv;6670\n", 17, fhdlOut);
            filePutString ("KY_HF_Aktiv/Kessy_02;6670\n", 26, fhdlOut);
            filePutString ("KY_HF_Aktiv/KSY02;6670\n", 23, fhdlOut);
            filePutString ("KY_ID_Geb_autorisiert;6671\n", 27, fhdlOut);
            filePutString ("KY_ID_Geb_autorisiert/Kessy_02;6671\n", 36, fhdlOut);
            filePutString ("KY_ID_Geb_autorisiert/KSY02;6671\n", 33, fhdlOut);
            filePutString ("KY_ID_Geb_steckt;6672\n", 22, fhdlOut);
            filePutString ("KY_ID_Geb_steckt/Kessy_02;6672\n", 31, fhdlOut);
            filePutString ("KY_ID_Geb_steckt/KSY02;6672\n", 28, fhdlOut);
            filePutString ("KY_KYL_Fahrer_Hinweise;6673\n", 28, fhdlOut);
            filePutString ("KY_KYL_Fahrer_Hinweise/Kessy_02;6673\n", 37, fhdlOut);
            filePutString ("KY_KYL_Fahrer_Hinweise/KSY02;6673\n", 34, fhdlOut);
            filePutString ("KY_KYL_Prio_Warn_03;6674\n", 25, fhdlOut);
            filePutString ("KY_KYL_Prio_Warn_03/Kessy_02;6674\n", 34, fhdlOut);
            filePutString ("KY_KYL_Prio_Warn_03/KSY02;6674\n", 31, fhdlOut);
            filePutString ("KY_KYL_Prio_Warn_04;6675\n", 25, fhdlOut);
            filePutString ("KY_KYL_Prio_Warn_04/Kessy_02;6675\n", 34, fhdlOut);
            filePutString ("KY_KYL_Prio_Warn_04/KSY02;6675\n", 31, fhdlOut);
            filePutString ("KY_KYL_Prio_Warn_05;6676\n", 25, fhdlOut);
            filePutString ("KY_KYL_Prio_Warn_05/Kessy_02;6676\n", 34, fhdlOut);
            filePutString ("KY_KYL_Prio_Warn_05/KSY02;6676\n", 31, fhdlOut);
            filePutString ("KY_Keyless_Verbau;6677\n", 23, fhdlOut);
            filePutString ("KY_Keyless_Verbau/Kessy_02;6677\n", 32, fhdlOut);
            filePutString ("KY_Keyless_Verbau/KSY02;6677\n", 29, fhdlOut);
            filePutString ("KY_LF_Aktiv;6678\n", 17, fhdlOut);
            filePutString ("KY_LF_Aktiv/Kessy_02;6678\n", 26, fhdlOut);
            filePutString ("KY_LF_Aktiv/KSY02;6678\n", 23, fhdlOut);
            filePutString ("KY_Schluessel_Ist;6679\n", 23, fhdlOut);
            filePutString ("KY_Schluessel_Ist/Kessy_02;6679\n", 32, fhdlOut);
            filePutString ("KY_Schluessel_Ist/KSY02;6679\n", 29, fhdlOut);
            filePutString ("KY_Schluessel_Soll;6680\n", 24, fhdlOut);
            filePutString ("KY_Schluessel_Soll/Kessy_02;6680\n", 33, fhdlOut);
            filePutString ("KY_Schluessel_Soll/KSY02;6680\n", 30, fhdlOut);
            filePutString ("KY_StartStopp_Info;6681\n", 24, fhdlOut);
            filePutString ("KY_StartStopp_Info/Kessy_02;6681\n", 33, fhdlOut);
            filePutString ("KY_StartStopp_Info/KSY02;6681\n", 30, fhdlOut);
            filePutString ("KY_Valet_Parking;6682\n", 22, fhdlOut);
            filePutString ("KY_Valet_Parking/Kessy_02;6682\n", 31, fhdlOut);
            filePutString ("KY_Valet_Parking/KSY02;6682\n", 28, fhdlOut);
            filePutString ("KY_WFS_LZ;6683\n", 15, fhdlOut);
            filePutString ("KY_WFS_LZ/Kessy_02;6683\n", 24, fhdlOut);
            filePutString ("KY_WFS_LZ/KSY02;6683\n", 21, fhdlOut);
            filePutString ("KY_WFS_Safe;6684\n", 17, fhdlOut);
            filePutString ("KY_WFS_Safe/Kessy_02;6684\n", 26, fhdlOut);
            filePutString ("KY_WFS_Safe/KSY02;6684\n", 23, fhdlOut);
            filePutString ("Klemmen_Status_01_BZ;6912\n", 26, fhdlOut);
            filePutString ("Klemmen_Status_01_BZ/Klemmen_Status_01;6912\n", 44, fhdlOut);
            filePutString ("Klemmen_Status_01_BZ/STIGN01;6912\n", 34, fhdlOut);
            filePutString ("Klemmen_Status_01_CHK;6913\n", 27, fhdlOut);
            filePutString ("Klemmen_Status_01_CHK/Klemmen_Status_01;6913\n", 45, fhdlOut);
            filePutString ("Klemmen_Status_01_CHK/STIGN01;6913\n", 35, fhdlOut);
            filePutString ("ZAS_Kl_15;6914\n", 15, fhdlOut);
            filePutString ("ZAS_Kl_15/Klemmen_Status_01;6914\n", 33, fhdlOut);
            filePutString ("ZAS_Kl_15/STIGN01;6914\n", 23, fhdlOut);
            filePutString ("ZAS_Kl_50;6915\n", 15, fhdlOut);
            filePutString ("ZAS_Kl_50/Klemmen_Status_01;6915\n", 33, fhdlOut);
            filePutString ("ZAS_Kl_50/STIGN01;6915\n", 23, fhdlOut);
            filePutString ("ZAS_Kl_S;6916\n", 14, fhdlOut);
            filePutString ("ZAS_Kl_S/Klemmen_Status_01;6916\n", 32, fhdlOut);
            filePutString ("ZAS_Kl_S/STIGN01;6916\n", 22, fhdlOut);
            filePutString ("ZAS_Kl_X;6917\n", 14, fhdlOut);
            filePutString ("ZAS_Kl_X/Klemmen_Status_01;6917\n", 32, fhdlOut);
            filePutString ("ZAS_Kl_X/STIGN01;6917\n", 22, fhdlOut);
            filePutString ("KL_4_Zonen;7168\n", 16, fhdlOut);
            filePutString ("KL_4_Zonen/Klima_01;7168\n", 25, fhdlOut);
            filePutString ("KL_4_Zonen/AC01;7168\n", 21, fhdlOut);
            filePutString ("KL_AC_Schalter;7169\n", 20, fhdlOut);
            filePutString ("KL_AC_Schalter/Klima_01;7169\n", 29, fhdlOut);
            filePutString ("KL_AC_Schalter/AC01;7169\n", 25, fhdlOut);
            filePutString ("KL_Anf_KL;7170\n", 15, fhdlOut);
            filePutString ("KL_Anf_KL/Klima_01;7170\n", 24, fhdlOut);
            filePutString ("KL_Anf_KL/AC01;7170\n", 20, fhdlOut);
            filePutString ("KL_Charisma_FahrPr;7171\n", 24, fhdlOut);
            filePutString ("KL_Charisma_FahrPr/Klima_01;7171\n", 33, fhdlOut);
            filePutString ("KL_Charisma_FahrPr/AC01;7171\n", 29, fhdlOut);
            filePutString ("KL_Charisma_Status;7172\n", 24, fhdlOut);
            filePutString ("KL_Charisma_Status/Klima_01;7172\n", 33, fhdlOut);
            filePutString ("KL_Charisma_Status/AC01;7172\n", 29, fhdlOut);
            filePutString ("KL_Charisma_Umschaltung;7173\n", 29, fhdlOut);
            filePutString ("KL_Charisma_Umschaltung/Klima_01;7173\n", 38, fhdlOut);
            filePutString ("KL_Charisma_Umschaltung/AC01;7173\n", 34, fhdlOut);
            filePutString ("KL_Comp_enable;7174\n", 20, fhdlOut);
            filePutString ("KL_Comp_enable/Klima_01;7174\n", 29, fhdlOut);
            filePutString ("KL_Comp_enable/AC01;7174\n", 25, fhdlOut);
            filePutString ("KL_Comp_rev_rq;7175\n", 20, fhdlOut);
            filePutString ("KL_Comp_rev_rq/Klima_01;7175\n", 29, fhdlOut);
            filePutString ("KL_Comp_rev_rq/AC01;7175\n", 25, fhdlOut);
            filePutString ("KL_Diag_Absperrvent;7176\n", 25, fhdlOut);
            filePutString ("KL_Diag_Absperrvent/Klima_01;7176\n", 34, fhdlOut);
            filePutString ("KL_Diag_Absperrvent/AC01;7176\n", 30, fhdlOut);
            filePutString ("KL_Drehz_Anh;7177\n", 18, fhdlOut);
            filePutString ("KL_Drehz_Anh/Klima_01;7177\n", 27, fhdlOut);
            filePutString ("KL_Drehz_Anh/AC01;7177\n", 23, fhdlOut);
            filePutString ("KL_Handshake_BEM;7178\n", 22, fhdlOut);
            filePutString ("KL_Handshake_BEM/Klima_01;7178\n", 31, fhdlOut);
            filePutString ("KL_Handshake_BEM/AC01;7178\n", 27, fhdlOut);
            filePutString ("KL_KD_Fehler;7179\n", 18, fhdlOut);
            filePutString ("KL_KD_Fehler/Klima_01;7179\n", 27, fhdlOut);
            filePutString ("KL_KD_Fehler/AC01;7179\n", 23, fhdlOut);
            filePutString ("KL_Komp_Moment_alt;7180\n", 24, fhdlOut);
            filePutString ("KL_Komp_Moment_alt/Klima_01;7180\n", 33, fhdlOut);
            filePutString ("KL_Komp_Moment_alt/AC01;7180\n", 29, fhdlOut);
            filePutString ("KL_Last_Kompr;7181\n", 19, fhdlOut);
            filePutString ("KL_Last_Kompr/Klima_01;7181\n", 28, fhdlOut);
            filePutString ("KL_Last_Kompr/AC01;7181\n", 24, fhdlOut);
            filePutString ("KL_Leistung_Hzg_Soll;7182\n", 26, fhdlOut);
            filePutString ("KL_Leistung_Hzg_Soll/Klima_01;7182\n", 35, fhdlOut);
            filePutString ("KL_Leistung_Hzg_Soll/AC01;7182\n", 31, fhdlOut);
            filePutString ("KL_StartStopp_Info;7183\n", 24, fhdlOut);
            filePutString ("KL_StartStopp_Info/Klima_01;7183\n", 33, fhdlOut);
            filePutString ("KL_StartStopp_Info/AC01;7183\n", 29, fhdlOut);
            filePutString ("KL_Thermomanagement;7184\n", 25, fhdlOut);
            filePutString ("KL_Thermomanagement/Klima_01;7184\n", 34, fhdlOut);
            filePutString ("KL_Thermomanagement/AC01;7184\n", 30, fhdlOut);
            filePutString ("KL_Vorwarn_HFS_ein;7185\n", 24, fhdlOut);
            filePutString ("KL_Vorwarn_HFS_ein/Klima_01;7185\n", 33, fhdlOut);
            filePutString ("KL_Vorwarn_HFS_ein/AC01;7185\n", 29, fhdlOut);
            filePutString ("KL_Vorwarn_HHS_ein;7186\n", 24, fhdlOut);
            filePutString ("KL_Vorwarn_HHS_ein/Klima_01;7186\n", 33, fhdlOut);
            filePutString ("KL_Vorwarn_HHS_ein/AC01;7186\n", 29, fhdlOut);
            filePutString ("KL_Vorwarn_Komp_ein;7187\n", 25, fhdlOut);
            filePutString ("KL_Vorwarn_Komp_ein/Klima_01;7187\n", 34, fhdlOut);
            filePutString ("KL_Vorwarn_Komp_ein/AC01;7187\n", 30, fhdlOut);
            filePutString ("KL_Vorwarn_Zuheizer_ein;7188\n", 29, fhdlOut);
            filePutString ("KL_Vorwarn_Zuheizer_ein/Klima_01;7188\n", 38, fhdlOut);
            filePutString ("KL_Vorwarn_Zuheizer_ein/AC01;7188\n", 34, fhdlOut);
            filePutString ("KL_Zustand;7189\n", 16, fhdlOut);
            filePutString ("KL_Zustand/Klima_01;7189\n", 25, fhdlOut);
            filePutString ("KL_Zustand/AC01;7189\n", 21, fhdlOut);
            filePutString ("KL_el_Zuheizer_Stufe;7190\n", 26, fhdlOut);
            filePutString ("KL_el_Zuheizer_Stufe/Klima_01;7190\n", 35, fhdlOut);
            filePutString ("KL_el_Zuheizer_Stufe/AC01;7190\n", 31, fhdlOut);
            filePutString ("KBI_ABS_Lampe;7424\n", 19, fhdlOut);
            filePutString ("KBI_ABS_Lampe/Kombi_01;7424\n", 28, fhdlOut);
            filePutString ("KBI_ABS_Lampe/DSP01;7424\n", 25, fhdlOut);
            filePutString ("KBI_Airbag_Lampe;7425\n", 22, fhdlOut);
            filePutString ("KBI_Airbag_Lampe/Kombi_01;7425\n", 31, fhdlOut);
            filePutString ("KBI_Airbag_Lampe/DSP01;7425\n", 28, fhdlOut);
            filePutString ("KBI_Anzeigefehler_LDW;7426\n", 27, fhdlOut);
            filePutString ("KBI_Anzeigefehler_LDW/Kombi_01;7426\n", 36, fhdlOut);
            filePutString ("KBI_Anzeigefehler_LDW/DSP01;7426\n", 33, fhdlOut);
            filePutString ("KBI_Anzeigefehler_SWA;7427\n", 27, fhdlOut);
            filePutString ("KBI_Anzeigefehler_SWA/Kombi_01;7427\n", 36, fhdlOut);
            filePutString ("KBI_Anzeigefehler_SWA/DSP01;7427\n", 33, fhdlOut);
            filePutString ("KBI_BKL_Lampe;7428\n", 19, fhdlOut);
            filePutString ("KBI_BKL_Lampe/Kombi_01;7428\n", 28, fhdlOut);
            filePutString ("KBI_BKL_Lampe/DSP01;7428\n", 25, fhdlOut);
            filePutString ("KBI_ESP_Lampe;7429\n", 19, fhdlOut);
            filePutString ("KBI_ESP_Lampe/Kombi_01;7429\n", 28, fhdlOut);
            filePutString ("KBI_ESP_Lampe/DSP01;7429\n", 25, fhdlOut);
            filePutString ("KBI_Einheit_Tacho;7430\n", 23, fhdlOut);
            filePutString ("KBI_Einheit_Tacho/Kombi_01;7430\n", 32, fhdlOut);
            filePutString ("KBI_Einheit_Tacho/DSP01;7430\n", 29, fhdlOut);
            filePutString ("KBI_Fehler_Anzeige_ACC;7431\n", 28, fhdlOut);
            filePutString ("KBI_Fehler_Anzeige_ACC/Kombi_01;7431\n", 37, fhdlOut);
            filePutString ("KBI_Fehler_Anzeige_ACC/DSP01;7431\n", 34, fhdlOut);
            filePutString ("KBI_Handbremse;7432\n", 20, fhdlOut);
            filePutString ("KBI_Handbremse/Kombi_01;7432\n", 29, fhdlOut);
            filePutString ("KBI_Handbremse/DSP01;7432\n", 26, fhdlOut);
            filePutString ("KBI_KD_Fehler;7433\n", 19, fhdlOut);
            filePutString ("KBI_KD_Fehler/Kombi_01;7433\n", 28, fhdlOut);
            filePutString ("KBI_KD_Fehler/DSP01;7433\n", 25, fhdlOut);
            filePutString ("KBI_Konsistenz_ACC;7434\n", 24, fhdlOut);
            filePutString ("KBI_Konsistenz_ACC/Kombi_01;7434\n", 33, fhdlOut);
            filePutString ("KBI_Konsistenz_ACC/DSP01;7434\n", 30, fhdlOut);
            filePutString ("KBI_Lenkung_Lampe;7435\n", 23, fhdlOut);
            filePutString ("KBI_Lenkung_Lampe/Kombi_01;7435\n", 32, fhdlOut);
            filePutString ("KBI_Lenkung_Lampe/DSP01;7435\n", 29, fhdlOut);
            filePutString ("KBI_MFA_v_Einheit_01;7436\n", 26, fhdlOut);
            filePutString ("KBI_MFA_v_Einheit_01/Kombi_01;7436\n", 35, fhdlOut);
            filePutString ("KBI_MFA_v_Einheit_01/DSP01;7436\n", 32, fhdlOut);
            filePutString ("KBI_Oeldruck_Schalter;7437\n", 27, fhdlOut);
            filePutString ("KBI_Oeldruck_Schalter/Kombi_01;7437\n", 36, fhdlOut);
            filePutString ("KBI_Oeldruck_Schalter/DSP01;7437\n", 33, fhdlOut);
            filePutString ("KBI_Oeldruckwarnung;7438\n", 25, fhdlOut);
            filePutString ("KBI_Oeldruckwarnung/Kombi_01;7438\n", 34, fhdlOut);
            filePutString ("KBI_Oeldruckwarnung/DSP01;7438\n", 31, fhdlOut);
            filePutString ("KBI_SILA_gueltig;7439\n", 22, fhdlOut);
            filePutString ("KBI_SILA_gueltig/Kombi_01;7439\n", 31, fhdlOut);
            filePutString ("KBI_SILA_gueltig/DSP01;7439\n", 28, fhdlOut);
            filePutString ("KBI_Tankwarnung;7440\n", 21, fhdlOut);
            filePutString ("KBI_Tankwarnung/Kombi_01;7440\n", 30, fhdlOut);
            filePutString ("KBI_Tankwarnung/DSP01;7440\n", 27, fhdlOut);
            filePutString ("KBI_Variante_USA;7441\n", 22, fhdlOut);
            filePutString ("KBI_Variante_USA/Kombi_01;7441\n", 31, fhdlOut);
            filePutString ("KBI_Variante_USA/DSP01;7441\n", 28, fhdlOut);
            filePutString ("KBI_Vorglueh_System_Lampe;7442\n", 31, fhdlOut);
            filePutString ("KBI_Vorglueh_System_Lampe/Kombi_01;7442\n", 40, fhdlOut);
            filePutString ("KBI_Vorglueh_System_Lampe/DSP01;7442\n", 37, fhdlOut);
            filePutString ("KBI_angez_Geschw;7443\n", 22, fhdlOut);
            filePutString ("KBI_angez_Geschw/Kombi_01;7443\n", 31, fhdlOut);
            filePutString ("KBI_angez_Geschw/DSP01;7443\n", 28, fhdlOut);
            filePutString ("KBI_im_Stellgliedtest;7444\n", 27, fhdlOut);
            filePutString ("KBI_im_Stellgliedtest/Kombi_01;7444\n", 36, fhdlOut);
            filePutString ("KBI_im_Stellgliedtest/DSP01;7444\n", 33, fhdlOut);
            filePutString ("KBI_Aussen_Temp_gef;7680\n", 25, fhdlOut);
            filePutString ("KBI_Aussen_Temp_gef/Kombi_02;7680\n", 34, fhdlOut);
            filePutString ("KBI_Aussen_Temp_gef/DSP02;7680\n", 31, fhdlOut);
            filePutString ("KBI_FStatus_Tank;7681\n", 22, fhdlOut);
            filePutString ("KBI_FStatus_Tank/Kombi_02;7681\n", 31, fhdlOut);
            filePutString ("KBI_FStatus_Tank/DSP02;7681\n", 28, fhdlOut);
            filePutString ("KBI_Inhalt_Tank;7682\n", 21, fhdlOut);
            filePutString ("KBI_Inhalt_Tank/Kombi_02;7682\n", 30, fhdlOut);
            filePutString ("KBI_Inhalt_Tank/DSP02;7682\n", 27, fhdlOut);
            filePutString ("KBI_Kilometerstand;7683\n", 24, fhdlOut);
            filePutString ("KBI_Kilometerstand/Kombi_02;7683\n", 33, fhdlOut);
            filePutString ("KBI_Kilometerstand/DSP02;7683\n", 30, fhdlOut);
            filePutString ("KBI_Oelwechsel_durchgefuehrt;7684\n", 34, fhdlOut);
            filePutString ("KBI_Oelwechsel_durchgefuehrt/Kombi_02;7684\n", 43, fhdlOut);
            filePutString ("KBI_Oelwechsel_durchgefuehrt/DSP02;7684\n", 40, fhdlOut);
            filePutString ("KBI_QBit_Aussen_Temp_gef;7685\n", 30, fhdlOut);
            filePutString ("KBI_QBit_Aussen_Temp_gef/Kombi_02;7685\n", 39, fhdlOut);
            filePutString ("KBI_QBit_Aussen_Temp_gef/DSP02;7685\n", 36, fhdlOut);
            filePutString ("KBI_Reset_Standzeit;7686\n", 25, fhdlOut);
            filePutString ("KBI_Reset_Standzeit/Kombi_02;7686\n", 34, fhdlOut);
            filePutString ("KBI_Reset_Standzeit/DSP02;7686\n", 31, fhdlOut);
            filePutString ("KBI_Standzeit;7687\n", 19, fhdlOut);
            filePutString ("KBI_Standzeit/Kombi_02;7687\n", 28, fhdlOut);
            filePutString ("KBI_Standzeit/DSP02;7687\n", 25, fhdlOut);
            filePutString ("KBI_Reifenumfang;7936\n", 22, fhdlOut);
            filePutString ("KBI_Reifenumfang/Kombi_03;7936\n", 31, fhdlOut);
            filePutString ("KBI_Reifenumfang/DSP03;7936\n", 28, fhdlOut);
            filePutString ("EPS_02_BZ;8192\n", 15, fhdlOut);
            filePutString ("EPS_02_BZ/LH_EPS_02;8192\n", 25, fhdlOut);
            filePutString ("EPS_02_BZ/LHEPS02;8192\n", 23, fhdlOut);
            filePutString ("EPS_02_CRC;8193\n", 16, fhdlOut);
            filePutString ("EPS_02_CRC/LH_EPS_02;8193\n", 26, fhdlOut);
            filePutString ("EPS_02_CRC/LHEPS02;8193\n", 24, fhdlOut);
            filePutString ("EPS_Drehzahlreserve;8194\n", 25, fhdlOut);
            filePutString ("EPS_Drehzahlreserve/LH_EPS_02;8194\n", 35, fhdlOut);
            filePutString ("EPS_Drehzahlreserve/LHEPS02;8194\n", 33, fhdlOut);
            filePutString ("EPS_Lastinfo;8195\n", 18, fhdlOut);
            filePutString ("EPS_Lastinfo/LH_EPS_02;8195\n", 28, fhdlOut);
            filePutString ("EPS_Lastinfo/LHEPS02;8195\n", 26, fhdlOut);
            filePutString ("EPS_Leistungsanforderung;8196\n", 30, fhdlOut);
            filePutString ("EPS_Leistungsanforderung/LH_EPS_02;8196\n", 40, fhdlOut);
            filePutString ("EPS_Leistungsanforderung/LHEPS02;8196\n", 38, fhdlOut);
            filePutString ("EPS_Motorstartverzoegerung;8197\n", 32, fhdlOut);
            filePutString ("EPS_Motorstartverzoegerung/LH_EPS_02;8197\n", 42, fhdlOut);
            filePutString ("EPS_Motorstartverzoegerung/LHEPS02;8197\n", 40, fhdlOut);
            filePutString ("EPS_Notlauf;8198\n", 17, fhdlOut);
            filePutString ("EPS_Notlauf/LH_EPS_02;8198\n", 27, fhdlOut);
            filePutString ("EPS_Notlauf/LHEPS02;8198\n", 25, fhdlOut);
            filePutString ("EPS_StartStopp_Info;8199\n", 25, fhdlOut);
            filePutString ("EPS_StartStopp_Info/LH_EPS_02;8199\n", 35, fhdlOut);
            filePutString ("EPS_StartStopp_Info/LHEPS02;8199\n", 33, fhdlOut);
            filePutString ("EPS_Unterstuetzungsleistung;8200\n", 33, fhdlOut);
            filePutString ("EPS_Unterstuetzungsleistung/LH_EPS_02;8200\n", 43, fhdlOut);
            filePutString ("EPS_Unterstuetzungsleistung/LHEPS02;8200\n", 41, fhdlOut);
            filePutString ("EPS_VZ_Drehzahlreserve;8201\n", 28, fhdlOut);
            filePutString ("EPS_VZ_Drehzahlreserve/LH_EPS_02;8201\n", 38, fhdlOut);
            filePutString ("EPS_VZ_Drehzahlreserve/LHEPS02;8201\n", 36, fhdlOut);
            filePutString ("LS_01_BZ;8448\n", 14, fhdlOut);
            filePutString ("LS_01_BZ/LS_01;8448\n", 20, fhdlOut);
            filePutString ("LS_01_BZ/LS01;8448\n", 19, fhdlOut);
            filePutString ("LS_01_CHK;8449\n", 15, fhdlOut);
            filePutString ("LS_01_CHK/LS_01;8449\n", 21, fhdlOut);
            filePutString ("LS_01_CHK/LS01;8449\n", 20, fhdlOut);
            filePutString ("LS_Abbrechen;8450\n", 18, fhdlOut);
            filePutString ("LS_Abbrechen/LS_01;8450\n", 24, fhdlOut);
            filePutString ("LS_Abbrechen/LS01;8450\n", 23, fhdlOut);
            filePutString ("LS_Codierung;8451\n", 18, fhdlOut);
            filePutString ("LS_Codierung/LS_01;8451\n", 24, fhdlOut);
            filePutString ("LS_Codierung/LS01;8451\n", 23, fhdlOut);
            filePutString ("LS_Fehler;8452\n", 15, fhdlOut);
            filePutString ("LS_Fehler/LS_01;8452\n", 21, fhdlOut);
            filePutString ("LS_Fehler/LS01;8452\n", 20, fhdlOut);
            filePutString ("LS_GRA_ACC_2stufig;8453\n", 24, fhdlOut);
            filePutString ("LS_GRA_ACC_2stufig/LS_01;8453\n", 30, fhdlOut);
            filePutString ("LS_GRA_ACC_2stufig/LS01;8453\n", 29, fhdlOut);
            filePutString ("LS_Hauptschalter;8454\n", 22, fhdlOut);
            filePutString ("LS_Hauptschalter/LS_01;8454\n", 28, fhdlOut);
            filePutString ("LS_Hauptschalter/LS01;8454\n", 27, fhdlOut);
            filePutString ("LS_Limiter;8455\n", 16, fhdlOut);
            filePutString ("LS_Limiter/LS_01;8455\n", 22, fhdlOut);
            filePutString ("LS_Limiter/LS01;8455\n", 21, fhdlOut);
            filePutString ("LS_Tip_Hoch;8456\n", 17, fhdlOut);
            filePutString ("LS_Tip_Hoch/LS_01;8456\n", 23, fhdlOut);
            filePutString ("LS_Tip_Hoch/LS01;8456\n", 22, fhdlOut);
            filePutString ("LS_Tip_Runter;8457\n", 19, fhdlOut);
            filePutString ("LS_Tip_Runter/LS_01;8457\n", 25, fhdlOut);
            filePutString ("LS_Tip_Runter/LS01;8457\n", 24, fhdlOut);
            filePutString ("LS_Tip_Setzen;8458\n", 19, fhdlOut);
            filePutString ("LS_Tip_Setzen/LS_01;8458\n", 25, fhdlOut);
            filePutString ("LS_Tip_Setzen/LS01;8458\n", 24, fhdlOut);
            filePutString ("LS_Tip_Stufe_2;8459\n", 20, fhdlOut);
            filePutString ("LS_Tip_Stufe_2/LS_01;8459\n", 26, fhdlOut);
            filePutString ("LS_Tip_Stufe_2/LS01;8459\n", 25, fhdlOut);
            filePutString ("LS_Tip_Wiederaufnahme;8460\n", 27, fhdlOut);
            filePutString ("LS_Tip_Wiederaufnahme/LS_01;8460\n", 33, fhdlOut);
            filePutString ("LS_Tip_Wiederaufnahme/LS01;8460\n", 32, fhdlOut);
            filePutString ("LS_Tiptronic_Fehler;8461\n", 25, fhdlOut);
            filePutString ("LS_Tiptronic_Fehler/LS_01;8461\n", 31, fhdlOut);
            filePutString ("LS_Tiptronic_Fehler/LS01;8461\n", 30, fhdlOut);
            filePutString ("LS_Typ_Hauptschalter;8462\n", 26, fhdlOut);
            filePutString ("LS_Typ_Hauptschalter/LS_01;8462\n", 32, fhdlOut);
            filePutString ("LS_Typ_Hauptschalter/LS01;8462\n", 31, fhdlOut);
            filePutString ("LS_Verstellung_Zeitluecke;8463\n", 31, fhdlOut);
            filePutString ("LS_Verstellung_Zeitluecke/LS_01;8463\n", 37, fhdlOut);
            filePutString ("LS_Verstellung_Zeitluecke/LS01;8463\n", 36, fhdlOut);
            filePutString ("MFL_Tip_Down;8464\n", 18, fhdlOut);
            filePutString ("MFL_Tip_Down/LS_01;8464\n", 24, fhdlOut);
            filePutString ("MFL_Tip_Down/LS01;8464\n", 23, fhdlOut);
            filePutString ("MFL_Tip_Up;8465\n", 16, fhdlOut);
            filePutString ("MFL_Tip_Up/LS_01;8465\n", 22, fhdlOut);
            filePutString ("MFL_Tip_Up/LS01;8465\n", 21, fhdlOut);
            filePutString ("LWI_01_BZ;8704\n", 15, fhdlOut);
            filePutString ("LWI_01_BZ/LWI_01;8704\n", 22, fhdlOut);
            filePutString ("LWI_01_BZ/LWI01;8704\n", 21, fhdlOut);
            filePutString ("LWI_01_CHK;8705\n", 16, fhdlOut);
            filePutString ("LWI_01_CHK/LWI_01;8705\n", 23, fhdlOut);
            filePutString ("LWI_01_CHK/LWI01;8705\n", 22, fhdlOut);
            filePutString ("LWI_01_CRC;8706\n", 16, fhdlOut);
            filePutString ("LWI_01_CRC/LWI_01;8706\n", 23, fhdlOut);
            filePutString ("LWI_01_CRC/LWI01;8706\n", 22, fhdlOut);
            filePutString ("LWI_Lenkradw_Geschw;8707\n", 25, fhdlOut);
            filePutString ("LWI_Lenkradw_Geschw/LWI_01;8707\n", 32, fhdlOut);
            filePutString ("LWI_Lenkradw_Geschw/LWI01;8707\n", 31, fhdlOut);
            filePutString ("LWI_Lenkradwinkel;8708\n", 23, fhdlOut);
            filePutString ("LWI_Lenkradwinkel/LWI_01;8708\n", 30, fhdlOut);
            filePutString ("LWI_Lenkradwinkel/LWI01;8708\n", 29, fhdlOut);
            filePutString ("LWI_QBit_Lenkradwinkel;8709\n", 28, fhdlOut);
            filePutString ("LWI_QBit_Lenkradwinkel/LWI_01;8709\n", 35, fhdlOut);
            filePutString ("LWI_QBit_Lenkradwinkel/LWI01;8709\n", 34, fhdlOut);
            filePutString ("LWI_QBit_Sub_Daten;8710\n", 24, fhdlOut);
            filePutString ("LWI_QBit_Sub_Daten/LWI_01;8710\n", 31, fhdlOut);
            filePutString ("LWI_QBit_Sub_Daten/LWI01;8710\n", 30, fhdlOut);
            filePutString ("LWI_Sensorstatus;8711\n", 22, fhdlOut);
            filePutString ("LWI_Sensorstatus/LWI_01;8711\n", 29, fhdlOut);
            filePutString ("LWI_Sensorstatus/LWI01;8711\n", 28, fhdlOut);
            filePutString ("LWI_Sub_Daten;8712\n", 19, fhdlOut);
            filePutString ("LWI_Sub_Daten/LWI_01;8712\n", 26, fhdlOut);
            filePutString ("LWI_Sub_Daten/LWI01;8712\n", 25, fhdlOut);
            filePutString ("LWI_VZ_Lenkradw_Geschw;8713\n", 28, fhdlOut);
            filePutString ("LWI_VZ_Lenkradw_Geschw/LWI_01;8713\n", 35, fhdlOut);
            filePutString ("LWI_VZ_Lenkradw_Geschw/LWI01;8713\n", 34, fhdlOut);
            filePutString ("LWI_VZ_Lenkradwinkel;8714\n", 26, fhdlOut);
            filePutString ("LWI_VZ_Lenkradwinkel/LWI_01;8714\n", 33, fhdlOut);
            filePutString ("LWI_VZ_Lenkradwinkel/LWI01;8714\n", 32, fhdlOut);
            filePutString ("BCM2_Bremsl_durch_ECD;8960\n", 27, fhdlOut);
            filePutString ("BCM2_Bremsl_durch_ECD/Licht_hinten_01;8960\n", 43, fhdlOut);
            filePutString ("BCM2_Bremsl_durch_ECD/LH01;8960\n", 32, fhdlOut);
            filePutString ("LH_3_Bremsl_def;8961\n", 21, fhdlOut);
            filePutString ("LH_3_Bremsl_def/Licht_hinten_01;8961\n", 37, fhdlOut);
            filePutString ("LH_3_Bremsl_def/LH01;8961\n", 26, fhdlOut);
            filePutString ("LH_Aussenlicht_def;8962\n", 24, fhdlOut);
            filePutString ("LH_Aussenlicht_def/Licht_hinten_01;8962\n", 40, fhdlOut);
            filePutString ("LH_Aussenlicht_def/LH01;8962\n", 29, fhdlOut);
            filePutString ("LH_Blinker_HL_akt;8963\n", 23, fhdlOut);
            filePutString ("LH_Blinker_HL_akt/Licht_hinten_01;8963\n", 39, fhdlOut);
            filePutString ("LH_Blinker_HL_akt/LH01;8963\n", 28, fhdlOut);
            filePutString ("LH_Blinker_HR_akt;8964\n", 23, fhdlOut);
            filePutString ("LH_Blinker_HR_akt/Licht_hinten_01;8964\n", 39, fhdlOut);
            filePutString ("LH_Blinker_HR_akt/LH01;8964\n", 28, fhdlOut);
            filePutString ("LH_Blinker_li_def;8965\n", 23, fhdlOut);
            filePutString ("LH_Blinker_li_def/Licht_hinten_01;8965\n", 39, fhdlOut);
            filePutString ("LH_Blinker_li_def/LH01;8965\n", 28, fhdlOut);
            filePutString ("LH_Blinker_re_def;8966\n", 23, fhdlOut);
            filePutString ("LH_Blinker_re_def/Licht_hinten_01;8966\n", 39, fhdlOut);
            filePutString ("LH_Blinker_re_def/LH01;8966\n", 28, fhdlOut);
            filePutString ("LH_Brems_Blk_li_def;8967\n", 25, fhdlOut);
            filePutString ("LH_Brems_Blk_li_def/Licht_hinten_01;8967\n", 41, fhdlOut);
            filePutString ("LH_Brems_Blk_li_def/LH01;8967\n", 30, fhdlOut);
            filePutString ("LH_Brems_Blk_re_def;8968\n", 25, fhdlOut);
            filePutString ("LH_Brems_Blk_re_def/Licht_hinten_01;8968\n", 41, fhdlOut);
            filePutString ("LH_Brems_Blk_re_def/LH01;8968\n", 30, fhdlOut);
            filePutString ("LH_Bremsl_li_def;8969\n", 22, fhdlOut);
            filePutString ("LH_Bremsl_li_def/Licht_hinten_01;8969\n", 38, fhdlOut);
            filePutString ("LH_Bremsl_li_def/LH01;8969\n", 27, fhdlOut);
            filePutString ("LH_Bremsl_li_ges_def;8970\n", 26, fhdlOut);
            filePutString ("LH_Bremsl_li_ges_def/Licht_hinten_01;8970\n", 42, fhdlOut);
            filePutString ("LH_Bremsl_li_ges_def/LH01;8970\n", 31, fhdlOut);
            filePutString ("LH_Bremsl_re_def;8971\n", 22, fhdlOut);
            filePutString ("LH_Bremsl_re_def/Licht_hinten_01;8971\n", 38, fhdlOut);
            filePutString ("LH_Bremsl_re_def/LH01;8971\n", 27, fhdlOut);
            filePutString ("LH_Bremsl_re_ges_def;8972\n", 26, fhdlOut);
            filePutString ("LH_Bremsl_re_ges_def/Licht_hinten_01;8972\n", 42, fhdlOut);
            filePutString ("LH_Bremsl_re_ges_def/LH01;8972\n", 31, fhdlOut);
            filePutString ("LH_Bremslicht_H_aktiv;8973\n", 27, fhdlOut);
            filePutString ("LH_Bremslicht_H_aktiv/Licht_hinten_01;8973\n", 43, fhdlOut);
            filePutString ("LH_Bremslicht_H_aktiv/LH01;8973\n", 32, fhdlOut);
            filePutString ("LH_Kennzl_def;8974\n", 19, fhdlOut);
            filePutString ("LH_Kennzl_def/Licht_hinten_01;8974\n", 35, fhdlOut);
            filePutString ("LH_Kennzl_def/LH01;8974\n", 24, fhdlOut);
            filePutString ("LH_Nebel_li_def;8975\n", 21, fhdlOut);
            filePutString ("LH_Nebel_li_def/Licht_hinten_01;8975\n", 37, fhdlOut);
            filePutString ("LH_Nebel_li_def/LH01;8975\n", 26, fhdlOut);
            filePutString ("LH_Nebel_mi_def;8976\n", 21, fhdlOut);
            filePutString ("LH_Nebel_mi_def/Licht_hinten_01;8976\n", 37, fhdlOut);
            filePutString ("LH_Nebel_mi_def/LH01;8976\n", 26, fhdlOut);
            filePutString ("LH_Nebel_re_def;8977\n", 21, fhdlOut);
            filePutString ("LH_Nebel_re_def/Licht_hinten_01;8977\n", 37, fhdlOut);
            filePutString ("LH_Nebel_re_def/LH01;8977\n", 26, fhdlOut);
            filePutString ("LH_Nebelschluss_aktiv;8978\n", 27, fhdlOut);
            filePutString ("LH_Nebelschluss_aktiv/Licht_hinten_01;8978\n", 43, fhdlOut);
            filePutString ("LH_Nebelschluss_aktiv/LH01;8978\n", 32, fhdlOut);
            filePutString ("LH_Parklicht_HL_aktiv;8979\n", 27, fhdlOut);
            filePutString ("LH_Parklicht_HL_aktiv/Licht_hinten_01;8979\n", 43, fhdlOut);
            filePutString ("LH_Parklicht_HL_aktiv/LH01;8979\n", 32, fhdlOut);
            filePutString ("LH_Parklicht_HR_aktiv;8980\n", 27, fhdlOut);
            filePutString ("LH_Parklicht_HR_aktiv/Licht_hinten_01;8980\n", 43, fhdlOut);
            filePutString ("LH_Parklicht_HR_aktiv/LH01;8980\n", 32, fhdlOut);
            filePutString ("LH_Rueckf_li_def;8981\n", 22, fhdlOut);
            filePutString ("LH_Rueckf_li_def/Licht_hinten_01;8981\n", 38, fhdlOut);
            filePutString ("LH_Rueckf_li_def/LH01;8981\n", 27, fhdlOut);
            filePutString ("LH_Rueckf_mi_def;8982\n", 22, fhdlOut);
            filePutString ("LH_Rueckf_mi_def/Licht_hinten_01;8982\n", 38, fhdlOut);
            filePutString ("LH_Rueckf_mi_def/LH01;8982\n", 27, fhdlOut);
            filePutString ("LH_Rueckf_re_def;8983\n", 22, fhdlOut);
            filePutString ("LH_Rueckf_re_def/Licht_hinten_01;8983\n", 38, fhdlOut);
            filePutString ("LH_Rueckf_re_def/LH01;8983\n", 27, fhdlOut);
            filePutString ("LH_Rueckfahrlicht_aktiv;8984\n", 29, fhdlOut);
            filePutString ("LH_Rueckfahrlicht_aktiv/Licht_hinten_01;8984\n", 45, fhdlOut);
            filePutString ("LH_Rueckfahrlicht_aktiv/LH01;8984\n", 34, fhdlOut);
            filePutString ("LH_SL_BRL_BLK_li_def;8985\n", 26, fhdlOut);
            filePutString ("LH_SL_BRL_BLK_li_def/Licht_hinten_01;8985\n", 42, fhdlOut);
            filePutString ("LH_SL_BRL_BLK_li_def/LH01;8985\n", 31, fhdlOut);
            filePutString ("LH_SL_BRL_BLK_re_def;8986\n", 26, fhdlOut);
            filePutString ("LH_SL_BRL_BLK_re_def/Licht_hinten_01;8986\n", 42, fhdlOut);
            filePutString ("LH_SL_BRL_BLK_re_def/LH01;8986\n", 31, fhdlOut);
            filePutString ("LH_Schluss_Brems_li_def;8987\n", 29, fhdlOut);
            filePutString ("LH_Schluss_Brems_li_def/Licht_hinten_01;8987\n", 45, fhdlOut);
            filePutString ("LH_Schluss_Brems_li_def/LH01;8987\n", 34, fhdlOut);
            filePutString ("LH_Schluss_Brems_re_def;8988\n", 29, fhdlOut);
            filePutString ("LH_Schluss_Brems_re_def/Licht_hinten_01;8988\n", 45, fhdlOut);
            filePutString ("LH_Schluss_Brems_re_def/LH01;8988\n", 34, fhdlOut);
            filePutString ("LH_Schluss_Nebel_li_def;8989\n", 29, fhdlOut);
            filePutString ("LH_Schluss_Nebel_li_def/Licht_hinten_01;8989\n", 45, fhdlOut);
            filePutString ("LH_Schluss_Nebel_li_def/LH01;8989\n", 34, fhdlOut);
            filePutString ("LH_Schluss_Nebel_re_def;8990\n", 29, fhdlOut);
            filePutString ("LH_Schluss_Nebel_re_def/Licht_hinten_01;8990\n", 45, fhdlOut);
            filePutString ("LH_Schluss_Nebel_re_def/LH01;8990\n", 34, fhdlOut);
            filePutString ("LH_Schlusslicht_li_def;8991\n", 28, fhdlOut);
            filePutString ("LH_Schlusslicht_li_def/Licht_hinten_01;8991\n", 44, fhdlOut);
            filePutString ("LH_Schlusslicht_li_def/LH01;8991\n", 33, fhdlOut);
            filePutString ("LH_Schlusslicht_re_def;8992\n", 28, fhdlOut);
            filePutString ("LH_Schlusslicht_re_def/Licht_hinten_01;8992\n", 44, fhdlOut);
            filePutString ("LH_Schlusslicht_re_def/LH01;8992\n", 33, fhdlOut);
            filePutString ("LH_Standlicht_H_aktiv;8993\n", 27, fhdlOut);
            filePutString ("LH_Standlicht_H_aktiv/Licht_hinten_01;8993\n", 43, fhdlOut);
            filePutString ("LH_Standlicht_H_aktiv/LH01;8993\n", 32, fhdlOut);
            filePutString ("Licht_hinten_01_BZ;8994\n", 24, fhdlOut);
            filePutString ("Licht_hinten_01_BZ/Licht_hinten_01;8994\n", 40, fhdlOut);
            filePutString ("Licht_hinten_01_BZ/LH01;8994\n", 29, fhdlOut);
            filePutString ("NMH_GW_ACAN;9216\n", 17, fhdlOut);
            filePutString ("NMH_GW_ACAN/NMH_Gateway;9216\n", 29, fhdlOut);
            filePutString ("NMH_GW_ACAN/NMH_Gateway;9216\n", 29, fhdlOut);
            filePutString ("NMH_GW_Abschaltstufe_3;9217\n", 28, fhdlOut);
            filePutString ("NMH_GW_Abschaltstufe_3/NMH_Gateway;9217\n", 40, fhdlOut);
            filePutString ("NMH_GW_Abschaltstufe_3/NMH_Gateway;9217\n", 40, fhdlOut);
            filePutString ("NMH_GW_Abschaltstufe_aktiv;9218\n", 32, fhdlOut);
            filePutString ("NMH_GW_Abschaltstufe_aktiv/NMH_Gateway;9218\n", 44, fhdlOut);
            filePutString ("NMH_GW_Abschaltstufe_aktiv/NMH_Gateway;9218\n", 44, fhdlOut);
            filePutString ("NMH_GW_CAN_Diag_deaktiv;9219\n", 29, fhdlOut);
            filePutString ("NMH_GW_CAN_Diag_deaktiv/NMH_Gateway;9219\n", 41, fhdlOut);
            filePutString ("NMH_GW_CAN_Diag_deaktiv/NMH_Gateway;9219\n", 41, fhdlOut);
            filePutString ("NMH_GW_Car_WakeUp;9220\n", 23, fhdlOut);
            filePutString ("NMH_GW_Car_WakeUp/NMH_Gateway;9220\n", 35, fhdlOut);
            filePutString ("NMH_GW_Car_WakeUp/NMH_Gateway;9220\n", 35, fhdlOut);
            filePutString ("NMH_GW_Eindraht_Fehler;9221\n", 28, fhdlOut);
            filePutString ("NMH_GW_Eindraht_Fehler/NMH_Gateway;9221\n", 40, fhdlOut);
            filePutString ("NMH_GW_Eindraht_Fehler/NMH_Gateway;9221\n", 40, fhdlOut);
            filePutString ("NMH_GW_Fkt_WakeUp;9222\n", 23, fhdlOut);
            filePutString ("NMH_GW_Fkt_WakeUp/NMH_Gateway;9222\n", 35, fhdlOut);
            filePutString ("NMH_GW_Fkt_WakeUp/NMH_Gateway;9222\n", 35, fhdlOut);
            filePutString ("NMH_GW_Infotainment;9223\n", 25, fhdlOut);
            filePutString ("NMH_GW_Infotainment/NMH_Gateway;9223\n", 37, fhdlOut);
            filePutString ("NMH_GW_Infotainment/NMH_Gateway;9223\n", 37, fhdlOut);
            filePutString ("NMH_GW_KombiCAN;9224\n", 21, fhdlOut);
            filePutString ("NMH_GW_KombiCAN/NMH_Gateway;9224\n", 33, fhdlOut);
            filePutString ("NMH_GW_KombiCAN/NMH_Gateway;9224\n", 33, fhdlOut);
            filePutString ("NMH_GW_KomfortCAN;9225\n", 23, fhdlOut);
            filePutString ("NMH_GW_KomfortCAN/NMH_Gateway;9225\n", 35, fhdlOut);
            filePutString ("NMH_GW_KomfortCAN/NMH_Gateway;9225\n", 35, fhdlOut);
            filePutString ("NMH_GW_KompSchutz;9226\n", 23, fhdlOut);
            filePutString ("NMH_GW_KompSchutz/NMH_Gateway;9226\n", 35, fhdlOut);
            filePutString ("NMH_GW_KompSchutz/NMH_Gateway;9226\n", 35, fhdlOut);
            filePutString ("NMH_GW_Mute_Mode;9227\n", 22, fhdlOut);
            filePutString ("NMH_GW_Mute_Mode/NMH_Gateway;9227\n", 34, fhdlOut);
            filePutString ("NMH_GW_Mute_Mode/NMH_Gateway;9227\n", 34, fhdlOut);
            filePutString ("NMH_GW_NM_aktiv_BDM;9228\n", 25, fhdlOut);
            filePutString ("NMH_GW_NM_aktiv_BDM/NMH_Gateway;9228\n", 37, fhdlOut);
            filePutString ("NMH_GW_NM_aktiv_BDM/NMH_Gateway;9228\n", 37, fhdlOut);
            filePutString ("NMH_GW_NM_aktiv_Diagnose;9229\n", 30, fhdlOut);
            filePutString ("NMH_GW_NM_aktiv_Diagnose/NMH_Gateway;9229\n", 42, fhdlOut);
            filePutString ("NMH_GW_NM_aktiv_Diagnose/NMH_Gateway;9229\n", 42, fhdlOut);
            filePutString ("NMH_GW_NM_aktiv_ESP;9230\n", 25, fhdlOut);
            filePutString ("NMH_GW_NM_aktiv_ESP/NMH_Gateway;9230\n", 37, fhdlOut);
            filePutString ("NMH_GW_NM_aktiv_ESP/NMH_Gateway;9230\n", 37, fhdlOut);
            filePutString ("NMH_GW_NM_aktiv_Klemme_15;9231\n", 31, fhdlOut);
            filePutString ("NMH_GW_NM_aktiv_Klemme_15/NMH_Gateway;9231\n", 43, fhdlOut);
            filePutString ("NMH_GW_NM_aktiv_Klemme_15/NMH_Gateway;9231\n", 43, fhdlOut);
            filePutString ("NMH_GW_NM_aktiv_Start;9232\n", 27, fhdlOut);
            filePutString ("NMH_GW_NM_aktiv_Start/NMH_Gateway;9232\n", 39, fhdlOut);
            filePutString ("NMH_GW_NM_aktiv_Start/NMH_Gateway;9232\n", 39, fhdlOut);
            filePutString ("NMH_GW_NM_aktiv_Warnblinken;9233\n", 33, fhdlOut);
            filePutString ("NMH_GW_NM_aktiv_Warnblinken/NMH_Gateway;9233\n", 45, fhdlOut);
            filePutString ("NMH_GW_NM_aktiv_Warnblinken/NMH_Gateway;9233\n", 45, fhdlOut);
            filePutString ("NMH_GW_Normal_Mode_1;9234\n", 26, fhdlOut);
            filePutString ("NMH_GW_Normal_Mode_1/NMH_Gateway;9234\n", 38, fhdlOut);
            filePutString ("NMH_GW_Normal_Mode_1/NMH_Gateway;9234\n", 38, fhdlOut);
            filePutString ("NMH_GW_Normal_Mode_2;9235\n", 26, fhdlOut);
            filePutString ("NMH_GW_Normal_Mode_2/NMH_Gateway;9235\n", 38, fhdlOut);
            filePutString ("NMH_GW_Normal_Mode_2/NMH_Gateway;9235\n", 38, fhdlOut);
            filePutString ("NMH_GW_Per_WakeUp;9236\n", 23, fhdlOut);
            filePutString ("NMH_GW_Per_WakeUp/NMH_Gateway;9236\n", 35, fhdlOut);
            filePutString ("NMH_GW_Per_WakeUp/NMH_Gateway;9236\n", 35, fhdlOut);
            filePutString ("NMH_GW_SG_Fehlerdauer;9237\n", 27, fhdlOut);
            filePutString ("NMH_GW_SG_Fehlerdauer/NMH_Gateway;9237\n", 39, fhdlOut);
            filePutString ("NMH_GW_SG_Fehlerdauer/NMH_Gateway;9237\n", 39, fhdlOut);
            filePutString ("NMH_GW_STH_Wakeup;9238\n", 23, fhdlOut);
            filePutString ("NMH_GW_STH_Wakeup/NMH_Gateway;9238\n", 35, fhdlOut);
            filePutString ("NMH_GW_STH_Wakeup/NMH_Gateway;9238\n", 35, fhdlOut);
            filePutString ("NMH_GW_Start_1;9239\n", 20, fhdlOut);
            filePutString ("NMH_GW_Start_1/NMH_Gateway;9239\n", 32, fhdlOut);
            filePutString ("NMH_GW_Start_1/NMH_Gateway;9239\n", 32, fhdlOut);
            filePutString ("NMH_GW_Start_2;9240\n", 20, fhdlOut);
            filePutString ("NMH_GW_Start_2/NMH_Gateway;9240\n", 32, fhdlOut);
            filePutString ("NMH_GW_Start_2/NMH_Gateway;9240\n", 32, fhdlOut);
            filePutString ("NMH_GW_TimeOut_Fehler;9241\n", 27, fhdlOut);
            filePutString ("NMH_GW_TimeOut_Fehler/NMH_Gateway;9241\n", 39, fhdlOut);
            filePutString ("NMH_GW_TimeOut_Fehler/NMH_Gateway;9241\n", 39, fhdlOut);
            filePutString ("NMH_GW_Transport_Mode;9242\n", 27, fhdlOut);
            filePutString ("NMH_GW_Transport_Mode/NMH_Gateway;9242\n", 39, fhdlOut);
            filePutString ("NMH_GW_Transport_Mode/NMH_Gateway;9242\n", 39, fhdlOut);
            filePutString ("NMH_GW_WakeUp_CAN_Bus;9243\n", 27, fhdlOut);
            filePutString ("NMH_GW_WakeUp_CAN_Bus/NMH_Gateway;9243\n", 39, fhdlOut);
            filePutString ("NMH_GW_WakeUp_CAN_Bus/NMH_Gateway;9243\n", 39, fhdlOut);
            filePutString ("OBD_TG_F_Status_1;9472\n", 23, fhdlOut);
            filePutString ("OBD_TG_F_Status_1/OBD_Tankgeber_01;9472\n", 40, fhdlOut);
            filePutString ("OBD_TG_F_Status_1/FLS01;9472\n", 29, fhdlOut);
            filePutString ("OBD_TG_F_Status_2;9473\n", 23, fhdlOut);
            filePutString ("OBD_TG_F_Status_2/OBD_Tankgeber_01;9473\n", 40, fhdlOut);
            filePutString ("OBD_TG_F_Status_2/FLS01;9473\n", 29, fhdlOut);
            filePutString ("OBD_TG_F_Status_3;9474\n", 23, fhdlOut);
            filePutString ("OBD_TG_F_Status_3/OBD_Tankgeber_01;9474\n", 40, fhdlOut);
            filePutString ("OBD_TG_F_Status_3/FLS01;9474\n", 29, fhdlOut);
            filePutString ("OBD_TG_F_Status_4;9475\n", 23, fhdlOut);
            filePutString ("OBD_TG_F_Status_4/OBD_Tankgeber_01;9475\n", 40, fhdlOut);
            filePutString ("OBD_TG_F_Status_4/FLS01;9475\n", 29, fhdlOut);
            filePutString ("OBD_TG_Sens_Rohwert_1;9476\n", 27, fhdlOut);
            filePutString ("OBD_TG_Sens_Rohwert_1/OBD_Tankgeber_01;9476\n", 44, fhdlOut);
            filePutString ("OBD_TG_Sens_Rohwert_1/FLS01;9476\n", 33, fhdlOut);
            filePutString ("OBD_TG_Sens_Rohwert_2;9477\n", 27, fhdlOut);
            filePutString ("OBD_TG_Sens_Rohwert_2/OBD_Tankgeber_01;9477\n", 44, fhdlOut);
            filePutString ("OBD_TG_Sens_Rohwert_2/FLS01;9477\n", 33, fhdlOut);
            filePutString ("OBD_TG_Sens_Rohwert_3;9478\n", 27, fhdlOut);
            filePutString ("OBD_TG_Sens_Rohwert_3/OBD_Tankgeber_01;9478\n", 44, fhdlOut);
            filePutString ("OBD_TG_Sens_Rohwert_3/FLS01;9478\n", 33, fhdlOut);
            filePutString ("OBD_TG_Sens_Rohwert_4;9479\n", 27, fhdlOut);
            filePutString ("OBD_TG_Sens_Rohwert_4/OBD_Tankgeber_01;9479\n", 44, fhdlOut);
            filePutString ("OBD_TG_Sens_Rohwert_4/FLS01;9479\n", 33, fhdlOut);
            filePutString ("SCR_01_BZ;9728\n", 15, fhdlOut);
            filePutString ("SCR_01_BZ/SCR_01;9728\n", 22, fhdlOut);
            filePutString ("SCR_01_BZ/SCR01;9728\n", 21, fhdlOut);
            filePutString ("SCR_Dosierpumpe_Drehzahl;9729\n", 30, fhdlOut);
            filePutString ("SCR_Dosierpumpe_Drehzahl/SCR_01;9729\n", 37, fhdlOut);
            filePutString ("SCR_Dosierpumpe_Drehzahl/SCR01;9729\n", 36, fhdlOut);
            filePutString ("SCR_Druck;9730\n", 15, fhdlOut);
            filePutString ("SCR_Druck/SCR_01;9730\n", 22, fhdlOut);
            filePutString ("SCR_Druck/SCR01;9730\n", 21, fhdlOut);
            filePutString ("SCR_Level_Aktivtank;9731\n", 25, fhdlOut);
            filePutString ("SCR_Level_Aktivtank/SCR_01;9731\n", 32, fhdlOut);
            filePutString ("SCR_Level_Aktivtank/SCR01;9731\n", 31, fhdlOut);
            filePutString ("SCR_Level_Passivtank;9732\n", 26, fhdlOut);
            filePutString ("SCR_Level_Passivtank/SCR_01;9732\n", 33, fhdlOut);
            filePutString ("SCR_Level_Passivtank/SCR01;9732\n", 32, fhdlOut);
            filePutString ("SCR_02_BZ;9984\n", 15, fhdlOut);
            filePutString ("SCR_02_BZ/SCR_02;9984\n", 22, fhdlOut);
            filePutString ("SCR_02_BZ/SCR02;9984\n", 21, fhdlOut);
            filePutString ("SCR_Guetesensor;9985\n", 21, fhdlOut);
            filePutString ("SCR_Guetesensor/SCR_02;9985\n", 28, fhdlOut);
            filePutString ("SCR_Guetesensor/SCR02;9985\n", 27, fhdlOut);
            filePutString ("SCR_Heizkreis_3_Strom;9986\n", 27, fhdlOut);
            filePutString ("SCR_Heizkreis_3_Strom/SCR_02;9986\n", 34, fhdlOut);
            filePutString ("SCR_Heizkreis_3_Strom/SCR02;9986\n", 33, fhdlOut);
            filePutString ("SCR_KD_Fehler;9987\n", 19, fhdlOut);
            filePutString ("SCR_KD_Fehler/SCR_02;9987\n", 26, fhdlOut);
            filePutString ("SCR_KD_Fehler/SCR02;9987\n", 25, fhdlOut);
            filePutString ("SCR_Leitungsheizung_Strom;9988\n", 31, fhdlOut);
            filePutString ("SCR_Leitungsheizung_Strom/SCR_02;9988\n", 38, fhdlOut);
            filePutString ("SCR_Leitungsheizung_Strom/SCR02;9988\n", 37, fhdlOut);
            filePutString ("SCR_Tankheizung_Strom;9989\n", 27, fhdlOut);
            filePutString ("SCR_Tankheizung_Strom/SCR_02;9989\n", 34, fhdlOut);
            filePutString ("SCR_Tankheizung_Strom/SCR02;9989\n", 33, fhdlOut);
            filePutString ("SCR_Temp_Aktivtank;9990\n", 24, fhdlOut);
            filePutString ("SCR_Temp_Aktivtank/SCR_02;9990\n", 31, fhdlOut);
            filePutString ("SCR_Temp_Aktivtank/SCR02;9990\n", 30, fhdlOut);
            filePutString ("SCR_Temp_Passivtank;9991\n", 25, fhdlOut);
            filePutString ("SCR_Temp_Passivtank/SCR_02;9991\n", 32, fhdlOut);
            filePutString ("SCR_Temp_Passivtank/SCR02;9991\n", 31, fhdlOut);
            filePutString ("SCR_Transferpumpe_Strom;9992\n", 29, fhdlOut);
            filePutString ("SCR_Transferpumpe_Strom/SCR_02;9992\n", 36, fhdlOut);
            filePutString ("SCR_Transferpumpe_Strom/SCR02;9992\n", 35, fhdlOut);
            filePutString ("SCR_03_BZ;10240\n", 16, fhdlOut);
            filePutString ("SCR_03_BZ/SCR_03;10240\n", 23, fhdlOut);
            filePutString ("SCR_03_BZ/SCR03;10240\n", 22, fhdlOut);
            filePutString ("SCR_Dosierpumpe_Status_Spule;10241\n", 35, fhdlOut);
            filePutString ("SCR_Dosierpumpe_Status_Spule/SCR_03;10241\n", 42, fhdlOut);
            filePutString ("SCR_Dosierpumpe_Status_Spule/SCR03;10241\n", 41, fhdlOut);
            filePutString ("SCR_Druck_Status;10242\n", 23, fhdlOut);
            filePutString ("SCR_Druck_Status/SCR_03;10242\n", 30, fhdlOut);
            filePutString ("SCR_Druck_Status/SCR03;10242\n", 29, fhdlOut);
            filePutString ("SCR_Guetesensor_Status;10243\n", 29, fhdlOut);
            filePutString ("SCR_Guetesensor_Status/SCR_03;10243\n", 36, fhdlOut);
            filePutString ("SCR_Guetesensor_Status/SCR03;10243\n", 35, fhdlOut);
            filePutString ("SCR_Heizkreis_3_Status;10244\n", 29, fhdlOut);
            filePutString ("SCR_Heizkreis_3_Status/SCR_03;10244\n", 36, fhdlOut);
            filePutString ("SCR_Heizkreis_3_Status/SCR03;10244\n", 35, fhdlOut);
            filePutString ("SCR_Leitungsheizung_Status;10245\n", 33, fhdlOut);
            filePutString ("SCR_Leitungsheizung_Status/SCR_03;10245\n", 40, fhdlOut);
            filePutString ("SCR_Leitungsheizung_Status/SCR03;10245\n", 39, fhdlOut);
            filePutString ("SCR_Level_Aktivtank_Status;10246\n", 33, fhdlOut);
            filePutString ("SCR_Level_Aktivtank_Status/SCR_03;10246\n", 40, fhdlOut);
            filePutString ("SCR_Level_Aktivtank_Status/SCR03;10246\n", 39, fhdlOut);
            filePutString ("SCR_Level_Passivtank_Status;10247\n", 34, fhdlOut);
            filePutString ("SCR_Level_Passivtank_Status/SCR_03;10247\n", 41, fhdlOut);
            filePutString ("SCR_Level_Passivtank_Status/SCR03;10247\n", 40, fhdlOut);
            filePutString ("SCR_Spannungsversorgung_Status;10248\n", 37, fhdlOut);
            filePutString ("SCR_Spannungsversorgung_Status/SCR_03;10248\n", 44, fhdlOut);
            filePutString ("SCR_Spannungsversorgung_Status/SCR03;10248\n", 43, fhdlOut);
            filePutString ("SCR_Tankheizung_Status;10249\n", 29, fhdlOut);
            filePutString ("SCR_Tankheizung_Status/SCR_03;10249\n", 36, fhdlOut);
            filePutString ("SCR_Tankheizung_Status/SCR03;10249\n", 35, fhdlOut);
            filePutString ("SCR_Temp_Aktivtank_Status;10250\n", 32, fhdlOut);
            filePutString ("SCR_Temp_Aktivtank_Status/SCR_03;10250\n", 39, fhdlOut);
            filePutString ("SCR_Temp_Aktivtank_Status/SCR03;10250\n", 38, fhdlOut);
            filePutString ("SCR_Temp_Passivtank_Status;10251\n", 33, fhdlOut);
            filePutString ("SCR_Temp_Passivtank_Status/SCR_03;10251\n", 40, fhdlOut);
            filePutString ("SCR_Temp_Passivtank_Status/SCR03;10251\n", 39, fhdlOut);
            filePutString ("SCR_Transferpumpe_Status;10252\n", 31, fhdlOut);
            filePutString ("SCR_Transferpumpe_Status/SCR_03;10252\n", 38, fhdlOut);
            filePutString ("SCR_Transferpumpe_Status/SCR03;10252\n", 37, fhdlOut);
            filePutString ("SCR_VersorgungSensoren_Status;10253\n", 36, fhdlOut);
            filePutString ("SCR_VersorgungSensoren_Status/SCR_03;10253\n", 43, fhdlOut);
            filePutString ("SCR_VersorgungSensoren_Status/SCR03;10253\n", 42, fhdlOut);
            filePutString ("SCR_04_BZ;10496\n", 16, fhdlOut);
            filePutString ("SCR_04_BZ/SCR_04;10496\n", 23, fhdlOut);
            filePutString ("SCR_04_BZ/SCR04;10496\n", 22, fhdlOut);
            filePutString ("SCR_Ansteuerung_Dosierpumpe;10497\n", 34, fhdlOut);
            filePutString ("SCR_Ansteuerung_Dosierpumpe/SCR_04;10497\n", 41, fhdlOut);
            filePutString ("SCR_Ansteuerung_Dosierpumpe/SCR04;10497\n", 40, fhdlOut);
            filePutString ("SCR_Ansteuerung_Heizkreis_3;10498\n", 34, fhdlOut);
            filePutString ("SCR_Ansteuerung_Heizkreis_3/SCR_04;10498\n", 41, fhdlOut);
            filePutString ("SCR_Ansteuerung_Heizkreis_3/SCR04;10498\n", 40, fhdlOut);
            filePutString ("SCR_Ansteuerung_Leitungsheizung;10499\n", 38, fhdlOut);
            filePutString ("SCR_Ansteuerung_Leitungsheizung/SCR_04;10499\n", 45, fhdlOut);
            filePutString ("SCR_Ansteuerung_Leitungsheizung/SCR04;10499\n", 44, fhdlOut);
            filePutString ("SCR_Ansteuerung_Tankheizung;10500\n", 34, fhdlOut);
            filePutString ("SCR_Ansteuerung_Tankheizung/SCR_04;10500\n", 41, fhdlOut);
            filePutString ("SCR_Ansteuerung_Tankheizung/SCR04;10500\n", 40, fhdlOut);
            filePutString ("SCR_Ansteuerung_Transferpumpe;10501\n", 36, fhdlOut);
            filePutString ("SCR_Ansteuerung_Transferpumpe/SCR_04;10501\n", 43, fhdlOut);
            filePutString ("SCR_Ansteuerung_Transferpumpe/SCR04;10501\n", 42, fhdlOut);
            filePutString ("SCR_CAL_CVN_CRC_32;10502\n", 25, fhdlOut);
            filePutString ("SCR_CAL_CVN_CRC_32/SCR_04;10502\n", 32, fhdlOut);
            filePutString ("SCR_CAL_CVN_CRC_32/SCR04;10502\n", 31, fhdlOut);
            filePutString ("SCR_05_BZ;10752\n", 16, fhdlOut);
            filePutString ("SCR_05_BZ/SCR_05;10752\n", 23, fhdlOut);
            filePutString ("SCR_05_BZ/SCR05;10752\n", 22, fhdlOut);
            filePutString ("SCR_Steuergeraet_Bus_Status;10753\n", 34, fhdlOut);
            filePutString ("SCR_Steuergeraet_Bus_Status/SCR_05;10753\n", 41, fhdlOut);
            filePutString ("SCR_Steuergeraet_Bus_Status/SCR05;10753\n", 40, fhdlOut);
            filePutString ("SCR_Steuergeraet_Codierung_Status;10754\n", 40, fhdlOut);
            filePutString ("SCR_Steuergeraet_Codierung_Status/SCR_05;10754\n", 47, fhdlOut);
            filePutString ("SCR_Steuergeraet_Codierung_Status/SCR05;10754\n", 46, fhdlOut);
            filePutString ("SCR_Steuergeraet_Datensatz_Status;10755\n", 40, fhdlOut);
            filePutString ("SCR_Steuergeraet_Datensatz_Status/SCR_05;10755\n", 47, fhdlOut);
            filePutString ("SCR_Steuergeraet_Datensatz_Status/SCR05;10755\n", 46, fhdlOut);
            filePutString ("SCR_Steuergeraet_Defekt_Status;10756\n", 37, fhdlOut);
            filePutString ("SCR_Steuergeraet_Defekt_Status/SCR_05;10756\n", 44, fhdlOut);
            filePutString ("SCR_Steuergeraet_Defekt_Status/SCR05;10756\n", 43, fhdlOut);
            filePutString ("SCR_Steuergeraet_Heizung_Status;10757\n", 38, fhdlOut);
            filePutString ("SCR_Steuergeraet_Heizung_Status/SCR_05;10757\n", 45, fhdlOut);
            filePutString ("SCR_Steuergeraet_Heizung_Status/SCR05;10757\n", 44, fhdlOut);
            filePutString ("SCR_Steuergeraet_Pumpe_Status;10758\n", 36, fhdlOut);
            filePutString ("SCR_Steuergeraet_Pumpe_Status/SCR_05;10758\n", 43, fhdlOut);
            filePutString ("SCR_Steuergeraet_Pumpe_Status/SCR05;10758\n", 42, fhdlOut);
            filePutString ("SCR_Steuergeraet_Relais_Status;10759\n", 37, fhdlOut);
            filePutString ("SCR_Steuergeraet_Relais_Status/SCR_05;10759\n", 44, fhdlOut);
            filePutString ("SCR_Steuergeraet_Relais_Status/SCR05;10759\n", 43, fhdlOut);
            filePutString ("SCR_CAL_ID_Index_01;11008\n", 26, fhdlOut);
            filePutString ("SCR_CAL_ID_Index_01/SCR_CAL_ID1;11008\n", 38, fhdlOut);
            filePutString ("SCR_CAL_ID_Index_01/SCRCALID1;11008\n", 36, fhdlOut);
            filePutString ("SCR_CAL_ID_Index_02;11009\n", 26, fhdlOut);
            filePutString ("SCR_CAL_ID_Index_02/SCR_CAL_ID1;11009\n", 38, fhdlOut);
            filePutString ("SCR_CAL_ID_Index_02/SCRCALID1;11009\n", 36, fhdlOut);
            filePutString ("SCR_CAL_ID_Index_03;11010\n", 26, fhdlOut);
            filePutString ("SCR_CAL_ID_Index_03/SCR_CAL_ID1;11010\n", 38, fhdlOut);
            filePutString ("SCR_CAL_ID_Index_03/SCRCALID1;11010\n", 36, fhdlOut);
            filePutString ("SCR_CAL_ID_Index_04;11011\n", 26, fhdlOut);
            filePutString ("SCR_CAL_ID_Index_04/SCR_CAL_ID1;11011\n", 38, fhdlOut);
            filePutString ("SCR_CAL_ID_Index_04/SCRCALID1;11011\n", 36, fhdlOut);
            filePutString ("SCR_CAL_ID_Index_05;11012\n", 26, fhdlOut);
            filePutString ("SCR_CAL_ID_Index_05/SCR_CAL_ID1;11012\n", 38, fhdlOut);
            filePutString ("SCR_CAL_ID_Index_05/SCRCALID1;11012\n", 36, fhdlOut);
            filePutString ("SCR_CAL_ID_Index_06;11013\n", 26, fhdlOut);
            filePutString ("SCR_CAL_ID_Index_06/SCR_CAL_ID1;11013\n", 38, fhdlOut);
            filePutString ("SCR_CAL_ID_Index_06/SCRCALID1;11013\n", 36, fhdlOut);
            filePutString ("SCR_CAL_ID_Index_07;11014\n", 26, fhdlOut);
            filePutString ("SCR_CAL_ID_Index_07/SCR_CAL_ID1;11014\n", 38, fhdlOut);
            filePutString ("SCR_CAL_ID_Index_07/SCRCALID1;11014\n", 36, fhdlOut);
            filePutString ("SCR_CAL_ID_Index_08;11015\n", 26, fhdlOut);
            filePutString ("SCR_CAL_ID_Index_08/SCR_CAL_ID1;11015\n", 38, fhdlOut);
            filePutString ("SCR_CAL_ID_Index_08/SCRCALID1;11015\n", 36, fhdlOut);
            filePutString ("SCR_CAL_ID_Index_09;11264\n", 26, fhdlOut);
            filePutString ("SCR_CAL_ID_Index_09/SCR_CAL_ID2;11264\n", 38, fhdlOut);
            filePutString ("SCR_CAL_ID_Index_09/SCRCALID2;11264\n", 36, fhdlOut);
            filePutString ("SCR_CAL_ID_Index_10;11265\n", 26, fhdlOut);
            filePutString ("SCR_CAL_ID_Index_10/SCR_CAL_ID2;11265\n", 38, fhdlOut);
            filePutString ("SCR_CAL_ID_Index_10/SCRCALID2;11265\n", 36, fhdlOut);
            filePutString ("SCR_CAL_ID_Index_11;11266\n", 26, fhdlOut);
            filePutString ("SCR_CAL_ID_Index_11/SCR_CAL_ID2;11266\n", 38, fhdlOut);
            filePutString ("SCR_CAL_ID_Index_11/SCRCALID2;11266\n", 36, fhdlOut);
            filePutString ("SCR_CAL_ID_Index_12;11267\n", 26, fhdlOut);
            filePutString ("SCR_CAL_ID_Index_12/SCR_CAL_ID2;11267\n", 38, fhdlOut);
            filePutString ("SCR_CAL_ID_Index_12/SCRCALID2;11267\n", 36, fhdlOut);
            filePutString ("SCR_CAL_ID_Index_13;11268\n", 26, fhdlOut);
            filePutString ("SCR_CAL_ID_Index_13/SCR_CAL_ID2;11268\n", 38, fhdlOut);
            filePutString ("SCR_CAL_ID_Index_13/SCRCALID2;11268\n", 36, fhdlOut);
            filePutString ("SCR_CAL_ID_Index_14;11269\n", 26, fhdlOut);
            filePutString ("SCR_CAL_ID_Index_14/SCR_CAL_ID2;11269\n", 38, fhdlOut);
            filePutString ("SCR_CAL_ID_Index_14/SCRCALID2;11269\n", 36, fhdlOut);
            filePutString ("SCR_CAL_ID_Index_15;11270\n", 26, fhdlOut);
            filePutString ("SCR_CAL_ID_Index_15/SCR_CAL_ID2;11270\n", 38, fhdlOut);
            filePutString ("SCR_CAL_ID_Index_15/SCRCALID2;11270\n", 36, fhdlOut);
            filePutString ("SCR_CAL_ID_Index_16;11271\n", 26, fhdlOut);
            filePutString ("SCR_CAL_ID_Index_16/SCR_CAL_ID2;11271\n", 38, fhdlOut);
            filePutString ("SCR_CAL_ID_Index_16/SCRCALID2;11271\n", 36, fhdlOut);
            filePutString ("SCU_01_BZ;11520\n", 16, fhdlOut);
            filePutString ("SCU_01_BZ/SCU_01;11520\n", 23, fhdlOut);
            filePutString ("SCU_01_BZ/SCU01;11520\n", 22, fhdlOut);
            filePutString ("SCU_01_CHK;11521\n", 17, fhdlOut);
            filePutString ("SCU_01_CHK/SCU_01;11521\n", 24, fhdlOut);
            filePutString ("SCU_01_CHK/SCU01;11521\n", 23, fhdlOut);
            filePutString ("SCU_01_CRC;11522\n", 17, fhdlOut);
            filePutString ("SCU_01_CRC/SCU_01;11522\n", 24, fhdlOut);
            filePutString ("SCU_01_CRC/SCU01;11522\n", 23, fhdlOut);
            filePutString ("SCU_KD_Fehler;11523\n", 20, fhdlOut);
            filePutString ("SCU_KD_Fehler/SCU_01;11523\n", 27, fhdlOut);
            filePutString ("SCU_KD_Fehler/SCU01;11523\n", 26, fhdlOut);
            filePutString ("SCU_Soll_Ue_Winkel;11524\n", 25, fhdlOut);
            filePutString ("SCU_Soll_Ue_Winkel/SCU_01;11524\n", 32, fhdlOut);
            filePutString ("SCU_Soll_Ue_Winkel/SCU01;11524\n", 31, fhdlOut);
            filePutString ("SCU_Status;11525\n", 17, fhdlOut);
            filePutString ("SCU_Status/SCU_01;11525\n", 24, fhdlOut);
            filePutString ("SCU_Status/SCU01;11525\n", 23, fhdlOut);
            filePutString ("SCU_Ue_Winkel_ADS;11526\n", 24, fhdlOut);
            filePutString ("SCU_Ue_Winkel_ADS/SCU_01;11526\n", 31, fhdlOut);
            filePutString ("SCU_Ue_Winkel_ADS/SCU01;11526\n", 30, fhdlOut);
            filePutString ("SCU_VZ_Soll_Ue_Winkel;11527\n", 28, fhdlOut);
            filePutString ("SCU_VZ_Soll_Ue_Winkel/SCU_01;11527\n", 35, fhdlOut);
            filePutString ("SCU_VZ_Soll_Ue_Winkel/SCU01;11527\n", 34, fhdlOut);
            filePutString ("SCU_VZ_Ue_Winkel_ADS;11528\n", 27, fhdlOut);
            filePutString ("SCU_VZ_Ue_Winkel_ADS/SCU_01;11528\n", 34, fhdlOut);
            filePutString ("SCU_VZ_Ue_Winkel_ADS/SCU01;11528\n", 33, fhdlOut);
            filePutString ("SCU_max_Gradient;11529\n", 23, fhdlOut);
            filePutString ("SCU_max_Gradient/SCU_01;11529\n", 30, fhdlOut);
            filePutString ("SCU_max_Gradient/SCU01;11529\n", 29, fhdlOut);
            filePutString ("STH_EKP_Anst;11776\n", 19, fhdlOut);
            filePutString ("STH_EKP_Anst/STH_01;11776\n", 26, fhdlOut);
            filePutString ("STH_EKP_Anst/STH01;11776\n", 25, fhdlOut);
            filePutString ("STH_Fehler_ElWaPu;11777\n", 24, fhdlOut);
            filePutString ("STH_Fehler_ElWaPu/STH_01;11777\n", 31, fhdlOut);
            filePutString ("STH_Fehler_ElWaPu/STH01;11777\n", 30, fhdlOut);
            filePutString ("STH_Fehlerstatus;11778\n", 23, fhdlOut);
            filePutString ("STH_Fehlerstatus/STH_01;11778\n", 30, fhdlOut);
            filePutString ("STH_Fehlerstatus/STH01;11778\n", 29, fhdlOut);
            filePutString ("STH_Funk_aus;11779\n", 19, fhdlOut);
            filePutString ("STH_Funk_aus/STH_01;11779\n", 26, fhdlOut);
            filePutString ("STH_Funk_aus/STH01;11779\n", 25, fhdlOut);
            filePutString ("STH_Funk_ein;11780\n", 19, fhdlOut);
            filePutString ("STH_Funk_ein/STH_01;11780\n", 26, fhdlOut);
            filePutString ("STH_Funk_ein/STH01;11780\n", 25, fhdlOut);
            filePutString ("STH_Geblaese;11781\n", 19, fhdlOut);
            filePutString ("STH_Geblaese/STH_01;11781\n", 26, fhdlOut);
            filePutString ("STH_Geblaese/STH01;11781\n", 25, fhdlOut);
            filePutString ("STH_Heizleistung;11782\n", 23, fhdlOut);
            filePutString ("STH_Heizleistung/STH_01;11782\n", 30, fhdlOut);
            filePutString ("STH_Heizleistung/STH01;11782\n", 29, fhdlOut);
            filePutString ("STH_KD_Fehler;11783\n", 20, fhdlOut);
            filePutString ("STH_KD_Fehler/STH_01;11783\n", 27, fhdlOut);
            filePutString ("STH_KD_Fehler/STH01;11783\n", 26, fhdlOut);
            filePutString ("STH_KVS;11784\n", 14, fhdlOut);
            filePutString ("STH_KVS/STH_01;11784\n", 21, fhdlOut);
            filePutString ("STH_KVS/STH01;11784\n", 20, fhdlOut);
            filePutString ("STH_KVS_Ueberlauf;11785\n", 24, fhdlOut);
            filePutString ("STH_KVS_Ueberlauf/STH_01;11785\n", 31, fhdlOut);
            filePutString ("STH_KVS_Ueberlauf/STH01;11785\n", 30, fhdlOut);
            filePutString ("STH_LED;11786\n", 14, fhdlOut);
            filePutString ("STH_LED/STH_01;11786\n", 21, fhdlOut);
            filePutString ("STH_LED/STH01;11786\n", 20, fhdlOut);
            filePutString ("STH_Motorvorwaermung;11787\n", 27, fhdlOut);
            filePutString ("STH_Motorvorwaermung/STH_01;11787\n", 34, fhdlOut);
            filePutString ("STH_Motorvorwaermung/STH01;11787\n", 33, fhdlOut);
            filePutString ("STH_Pumpe_ein;11788\n", 20, fhdlOut);
            filePutString ("STH_Pumpe_ein/STH_01;11788\n", 27, fhdlOut);
            filePutString ("STH_Pumpe_ein/STH01;11788\n", 26, fhdlOut);
            filePutString ("STH_Pumpen_Anf_extern;11789\n", 28, fhdlOut);
            filePutString ("STH_Pumpen_Anf_extern/STH_01;11789\n", 35, fhdlOut);
            filePutString ("STH_Pumpen_Anf_extern/STH01;11789\n", 34, fhdlOut);
            filePutString ("STH_Servicemode;11790\n", 22, fhdlOut);
            filePutString ("STH_Servicemode/STH_01;11790\n", 29, fhdlOut);
            filePutString ("STH_Servicemode/STH01;11790\n", 28, fhdlOut);
            filePutString ("STH_Ventil_Status;11791\n", 24, fhdlOut);
            filePutString ("STH_Ventil_Status/STH_01;11791\n", 31, fhdlOut);
            filePutString ("STH_Ventil_Status/STH01;11791\n", 30, fhdlOut);
            filePutString ("STH_Ventiloeffnungszeit;11792\n", 30, fhdlOut);
            filePutString ("STH_Ventiloeffnungszeit/STH_01;11792\n", 37, fhdlOut);
            filePutString ("STH_Ventiloeffnungszeit/STH01;11792\n", 36, fhdlOut);
            filePutString ("STH_Waermeeintrag;11793\n", 24, fhdlOut);
            filePutString ("STH_Waermeeintrag/STH_01;11793\n", 31, fhdlOut);
            filePutString ("STH_Waermeeintrag/STH01;11793\n", 30, fhdlOut);
            filePutString ("STH_Wassertemp;11794\n", 21, fhdlOut);
            filePutString ("STH_Wassertemp/STH_01;11794\n", 28, fhdlOut);
            filePutString ("STH_Wassertemp/STH01;11794\n", 27, fhdlOut);
            filePutString ("STH_Zusatzheizung;11795\n", 24, fhdlOut);
            filePutString ("STH_Zusatzheizung/STH_01;11795\n", 31, fhdlOut);
            filePutString ("STH_Zusatzheizung/STH01;11795\n", 30, fhdlOut);
            filePutString ("STH_war_aktiv;11796\n", 20, fhdlOut);
            filePutString ("STH_war_aktiv/STH_01;11796\n", 27, fhdlOut);
            filePutString ("STH_war_aktiv/STH01;11796\n", 26, fhdlOut);
            filePutString ("STS_01_BZ;12032\n", 16, fhdlOut);
            filePutString ("STS_01_BZ/STS_01;12032\n", 23, fhdlOut);
            filePutString ("STS_01_BZ/STS01;12032\n", 22, fhdlOut);
            filePutString ("STS_01_CHK;12033\n", 17, fhdlOut);
            filePutString ("STS_01_CHK/STS_01;12033\n", 24, fhdlOut);
            filePutString ("STS_01_CHK/STS01;12033\n", 23, fhdlOut);
            filePutString ("STS_Alarm_Blinker;12034\n", 24, fhdlOut);
            filePutString ("STS_Alarm_Blinker/STS_01;12034\n", 31, fhdlOut);
            filePutString ("STS_Alarm_Blinker/STS01;12034\n", 30, fhdlOut);
            filePutString ("STS_Anlassersperre;12035\n", 25, fhdlOut);
            filePutString ("STS_Anlassersperre/STS_01;12035\n", 32, fhdlOut);
            filePutString ("STS_Anlassersperre/STS01;12035\n", 31, fhdlOut);
            filePutString ("STS_Car_not_under_theft;12036\n", 30, fhdlOut);
            filePutString ("STS_Car_not_under_theft/STS_01;12036\n", 37, fhdlOut);
            filePutString ("STS_Car_not_under_theft/STS01;12036\n", 36, fhdlOut);
            filePutString ("STS_Car_under_theft;12037\n", 26, fhdlOut);
            filePutString ("STS_Car_under_theft/STS_01;12037\n", 33, fhdlOut);
            filePutString ("STS_Car_under_theft/STS01;12037\n", 32, fhdlOut);
            filePutString ("STS_Fahrlicht;12038\n", 20, fhdlOut);
            filePutString ("STS_Fahrlicht/STS_01;12038\n", 27, fhdlOut);
            filePutString ("STS_Fahrlicht/STS01;12038\n", 26, fhdlOut);
            filePutString ("STS_KD_Fehler;12039\n", 20, fhdlOut);
            filePutString ("STS_KD_Fehler/STS_01;12039\n", 27, fhdlOut);
            filePutString ("STS_KD_Fehler/STS01;12039\n", 26, fhdlOut);
            filePutString ("STS_LIN_aktiv;12040\n", 20, fhdlOut);
            filePutString ("STS_LIN_aktiv/STS_01;12040\n", 27, fhdlOut);
            filePutString ("STS_LIN_aktiv/STS01;12040\n", 26, fhdlOut);
            filePutString ("STS_Laderelais;12041\n", 21, fhdlOut);
            filePutString ("STS_Laderelais/STS_01;12041\n", 28, fhdlOut);
            filePutString ("STS_Laderelais/STS01;12041\n", 27, fhdlOut);
            filePutString ("STS_Leerlaufschaltung;12042\n", 28, fhdlOut);
            filePutString ("STS_Leerlaufschaltung/STS_01;12042\n", 35, fhdlOut);
            filePutString ("STS_Leerlaufschaltung/STS01;12042\n", 34, fhdlOut);
            filePutString ("STS_Notstart;12043\n", 19, fhdlOut);
            filePutString ("STS_Notstart/STS_01;12043\n", 26, fhdlOut);
            filePutString ("STS_Notstart/STS01;12043\n", 25, fhdlOut);
            filePutString ("STS_Signalhorn;12044\n", 21, fhdlOut);
            filePutString ("STS_Signalhorn/STS_01;12044\n", 28, fhdlOut);
            filePutString ("STS_Signalhorn/STS01;12044\n", 27, fhdlOut);
            filePutString ("STS_Standlicht;12045\n", 21, fhdlOut);
            filePutString ("STS_Standlicht/STS_01;12045\n", 28, fhdlOut);
            filePutString ("STS_Standlicht/STS01;12045\n", 27, fhdlOut);
            filePutString ("STS_Summer;12046\n", 17, fhdlOut);
            filePutString ("STS_Summer/STS_01;12046\n", 24, fhdlOut);
            filePutString ("STS_Summer/STS01;12046\n", 23, fhdlOut);
            filePutString ("STS_Typencodierung;12047\n", 25, fhdlOut);
            filePutString ("STS_Typencodierung/STS_01;12047\n", 32, fhdlOut);
            filePutString ("STS_Typencodierung/STS01;12047\n", 31, fhdlOut);
            filePutString ("GW_KD_Fehler;12288\n", 19, fhdlOut);
            filePutString ("GW_KD_Fehler/Systeminfo_01;12288\n", 33, fhdlOut);
            filePutString ("GW_KD_Fehler/SYS01;12288\n", 25, fhdlOut);
            filePutString ("SI_CAN_Antrieb_Sleep;12289\n", 27, fhdlOut);
            filePutString ("SI_CAN_Antrieb_Sleep/Systeminfo_01;12289\n", 41, fhdlOut);
            filePutString ("SI_CAN_Antrieb_Sleep/SYS01;12289\n", 33, fhdlOut);
            filePutString ("SI_CAN_Dashboard_Sleep;12290\n", 29, fhdlOut);
            filePutString ("SI_CAN_Dashboard_Sleep/Systeminfo_01;12290\n", 43, fhdlOut);
            filePutString ("SI_CAN_Dashboard_Sleep/SYS01;12290\n", 35, fhdlOut);
            filePutString ("SI_CAN_Extended_Sleep;12291\n", 28, fhdlOut);
            filePutString ("SI_CAN_Extended_Sleep/Systeminfo_01;12291\n", 42, fhdlOut);
            filePutString ("SI_CAN_Extended_Sleep/SYS01;12291\n", 34, fhdlOut);
            filePutString ("SI_CAN_Fahrwerk_Sleep;12292\n", 28, fhdlOut);
            filePutString ("SI_CAN_Fahrwerk_Sleep/Systeminfo_01;12292\n", 42, fhdlOut);
            filePutString ("SI_CAN_Fahrwerk_Sleep/SYS01;12292\n", 34, fhdlOut);
            filePutString ("SI_CAN_Komfort_Sleep;12293\n", 27, fhdlOut);
            filePutString ("SI_CAN_Komfort_Sleep/Systeminfo_01;12293\n", 41, fhdlOut);
            filePutString ("SI_CAN_Komfort_Sleep/SYS01;12293\n", 33, fhdlOut);
            filePutString ("SI_Diagnose_Aktiv;12294\n", 24, fhdlOut);
            filePutString ("SI_Diagnose_Aktiv/Systeminfo_01;12294\n", 38, fhdlOut);
            filePutString ("SI_Diagnose_Aktiv/SYS01;12294\n", 30, fhdlOut);
            filePutString ("SI_Fahrwerk_Sleep;12295\n", 24, fhdlOut);
            filePutString ("SI_Fahrwerk_Sleep/Systeminfo_01;12295\n", 38, fhdlOut);
            filePutString ("SI_Fahrwerk_Sleep/SYS01;12295\n", 30, fhdlOut);
            filePutString ("SI_Infotainment_Sleep;12296\n", 28, fhdlOut);
            filePutString ("SI_Infotainment_Sleep/Systeminfo_01;12296\n", 42, fhdlOut);
            filePutString ("SI_Infotainment_Sleep/SYS01;12296\n", 34, fhdlOut);
            filePutString ("SI_Int_CAN_gespiegelt;12297\n", 28, fhdlOut);
            filePutString ("SI_Int_CAN_gespiegelt/Systeminfo_01;12297\n", 42, fhdlOut);
            filePutString ("SI_Int_CAN_gespiegelt/SYS01;12297\n", 34, fhdlOut);
            filePutString ("SI_MOST_Status;12298\n", 21, fhdlOut);
            filePutString ("SI_MOST_Status/Systeminfo_01;12298\n", 35, fhdlOut);
            filePutString ("SI_MOST_Status/SYS01;12298\n", 27, fhdlOut);
            filePutString ("SI_MO_WU;12299\n", 15, fhdlOut);
            filePutString ("SI_MO_WU/Systeminfo_01;12299\n", 29, fhdlOut);
            filePutString ("SI_MO_WU/SYS01;12299\n", 21, fhdlOut);
            filePutString ("SI_NWDF;12300\n", 14, fhdlOut);
            filePutString ("SI_NWDF/Systeminfo_01;12300\n", 28, fhdlOut);
            filePutString ("SI_NWDF/SYS01;12300\n", 20, fhdlOut);
            filePutString ("SI_NWDF_gueltig;12301\n", 22, fhdlOut);
            filePutString ("SI_NWDF_gueltig/Systeminfo_01;12301\n", 36, fhdlOut);
            filePutString ("SI_NWDF_gueltig/SYS01;12301\n", 28, fhdlOut);
            filePutString ("SI_QRS_Mode;12302\n", 18, fhdlOut);
            filePutString ("SI_QRS_Mode/Systeminfo_01;12302\n", 32, fhdlOut);
            filePutString ("SI_QRS_Mode/SYS01;12302\n", 24, fhdlOut);
            filePutString ("SI_Sammel_SG_Fehler;12303\n", 26, fhdlOut);
            filePutString ("SI_Sammel_SG_Fehler/Systeminfo_01;12303\n", 40, fhdlOut);
            filePutString ("SI_Sammel_SG_Fehler/SYS01;12303\n", 32, fhdlOut);
            filePutString ("SI_Sammelfehler;12304\n", 22, fhdlOut);
            filePutString ("SI_Sammelfehler/Systeminfo_01;12304\n", 36, fhdlOut);
            filePutString ("SI_Sammelfehler/SYS01;12304\n", 28, fhdlOut);
            filePutString ("SI_T_Mode;12305\n", 16, fhdlOut);
            filePutString ("SI_T_Mode/Systeminfo_01;12305\n", 30, fhdlOut);
            filePutString ("SI_T_Mode/SYS01;12305\n", 22, fhdlOut);

            fileClose(fhdlOut);
        }
    }

    /* ------------------------------------------------------------------------------------------ */
    /*  END frame and signal handle export for remote control of CAPL by Perl script              */
    /* ------------------------------------------------------------------------------------------ */
}
/*@@end*/

/*@@startStart:Start:*/
on start
{
    int FrmIdx;
    int LoopCnt;

    /* start 10ms timer */
    setTimer(Timer_10ms,TIMER_DURATION_10MS);

    for (FrmIdx = 0; FrmIdx < FRM_NUM_MAX; FrmIdx++)
    {
        /* init frame schedule timer */
        FrmSched_SchedTmr[FrmIdx] = 0;
        
        /* enable scheduler for all frames */
        FrmSched_FrmEna[FrmIdx] = 1;

        /* init message counter values */
        Frm_MsgCounter[FrmIdx] = 0;

        /* enable message counter increment */
        Frm_MsgCounterEna[FrmIdx] = 1;

        /* enable checksum calculation */
        Frm_MsgChksmEna[FrmIdx] = 1;

        /* init DLC error status to OK */
        Frm_DLCOk[FrmIdx] = 1;
    }

    
    /* init CAPL control related variables */
    for (LoopCnt = 0; LoopCnt < CAPLCTRL_INPUTBUF_LEN; LoopCnt ++)
    {
        CaplCtrl_InputBuf[LoopCnt] = 0;
    }

    /* ------------------------------------------------------------------------------------------ */
    /*  BEGIN variable initialization                                                             */
    /* ------------------------------------------------------------------------------------------ */

    FrmSched_CycleTime[FRM_HANDLE_ACC_01] = 20;
    FrmSched_CycleTime[FRM_HANDLE_ACC_05] = 20;
    FrmSched_CycleTime[FRM_HANDLE_Airbag_01] = 50;
    FrmSched_CycleTime[FRM_HANDLE_Airbag_02] = 100;
    FrmSched_CycleTime[FRM_HANDLE_Allrad_02] = 10;
    FrmSched_CycleTime[FRM_HANDLE_Anhaenger_01] = 100;
    FrmSched_CycleTime[FRM_HANDLE_BEM_01] = 50;
    FrmSched_CycleTime[FRM_HANDLE_Charisma_01] = 10;
    FrmSched_CycleTime[FRM_HANDLE_Diagnose_01] = 1000;
    FrmSched_CycleTime[FRM_HANDLE_EPB_01] = 20;
    FrmSched_CycleTime[FRM_HANDLE_ESP_01] = 20;
    FrmSched_CycleTime[FRM_HANDLE_ESP_02] = 20;
    FrmSched_CycleTime[FRM_HANDLE_ESP_03] = 20;
    FrmSched_CycleTime[FRM_HANDLE_ESP_05] = 20;
    FrmSched_CycleTime[FRM_HANDLE_ESP_07_FR] = 80;
    FrmSched_CycleTime[FRM_HANDLE_ESP_16] = 10;
    FrmSched_CycleTime[FRM_HANDLE_ESP_K_10] = 100;
    FrmSched_CycleTime[FRM_HANDLE_Einheiten_01] = 1000;
    FrmSched_CycleTime[FRM_HANDLE_Fahrwerk_02] = 20;
    FrmSched_CycleTime[FRM_HANDLE_GW_Fwk_01_Ant_PAG] = 100;
    FrmSched_CycleTime[FRM_HANDLE_Gateway_05] = 100;
    FrmSched_CycleTime[FRM_HANDLE_Gateway_11] = 1000;
    FrmSched_CycleTime[FRM_HANDLE_Getriebe_01] = 10;
    FrmSched_CycleTime[FRM_HANDLE_Getriebe_02] = 10;
    FrmSched_CycleTime[FRM_HANDLE_Getriebe_03] = 20;
    FrmSched_CycleTime[FRM_HANDLE_Getriebe_04] = 100;
    FrmSched_CycleTime[FRM_HANDLE_Kessy_02] = 400;
    FrmSched_CycleTime[FRM_HANDLE_Klemmen_Status_01] = 100;
    FrmSched_CycleTime[FRM_HANDLE_Klima_01] = 100;
    FrmSched_CycleTime[FRM_HANDLE_Kombi_01] = 50;
    FrmSched_CycleTime[FRM_HANDLE_Kombi_02] = 1000;
    FrmSched_CycleTime[FRM_HANDLE_Kombi_03] = 1000;
    FrmSched_CycleTime[FRM_HANDLE_LH_EPS_02] = 20;
    FrmSched_CycleTime[FRM_HANDLE_LS_01] = 100;
    FrmSched_CycleTime[FRM_HANDLE_LWI_01] = 10;
    FrmSched_CycleTime[FRM_HANDLE_Licht_hinten_01] = 100;
    FrmSched_CycleTime[FRM_HANDLE_NMH_Gateway] = 200;
    FrmSched_CycleTime[FRM_HANDLE_OBD_Tankgeber_01] = 500;
    FrmSched_CycleTime[FRM_HANDLE_SCR_01] = 100;
    FrmSched_CycleTime[FRM_HANDLE_SCR_02] = 500;
    FrmSched_CycleTime[FRM_HANDLE_SCR_03] = 500;
    FrmSched_CycleTime[FRM_HANDLE_SCR_04] = 1000;
    FrmSched_CycleTime[FRM_HANDLE_SCR_05] = 1000;
    FrmSched_CycleTime[FRM_HANDLE_SCR_CAL_ID1] = 1000;
    FrmSched_CycleTime[FRM_HANDLE_SCR_CAL_ID2] = 1000;
    FrmSched_CycleTime[FRM_HANDLE_SCU_01] = 10;
    FrmSched_CycleTime[FRM_HANDLE_STH_01] = 200;
    FrmSched_CycleTime[FRM_HANDLE_STS_01] = 200;
    FrmSched_CycleTime[FRM_HANDLE_Systeminfo_01] = 100;

    Frm_DLC[FRM_HANDLE_ACC_01] = 8;
    Frm_DLC[FRM_HANDLE_ACC_05] = 8;
    Frm_DLC[FRM_HANDLE_Airbag_01] = 8;
    Frm_DLC[FRM_HANDLE_Airbag_02] = 8;
    Frm_DLC[FRM_HANDLE_Allrad_02] = 8;
    Frm_DLC[FRM_HANDLE_Anhaenger_01] = 3;
    Frm_DLC[FRM_HANDLE_BEM_01] = 4;
    Frm_DLC[FRM_HANDLE_Charisma_01] = 8;
    Frm_DLC[FRM_HANDLE_Diagnose_01] = 8;
    Frm_DLC[FRM_HANDLE_EPB_01] = 8;
    Frm_DLC[FRM_HANDLE_ESP_01] = 8;
    Frm_DLC[FRM_HANDLE_ESP_02] = 8;
    Frm_DLC[FRM_HANDLE_ESP_03] = 8;
    Frm_DLC[FRM_HANDLE_ESP_05] = 8;
    Frm_DLC[FRM_HANDLE_ESP_07_FR] = 8;
    Frm_DLC[FRM_HANDLE_ESP_16] = 8;
    Frm_DLC[FRM_HANDLE_ESP_K_10] = 8;
    Frm_DLC[FRM_HANDLE_Einheiten_01] = 3;
    Frm_DLC[FRM_HANDLE_Fahrwerk_02] = 8;
    Frm_DLC[FRM_HANDLE_GW_Fwk_01_Ant_PAG] = 8;
    Frm_DLC[FRM_HANDLE_Gateway_05] = 8;
    Frm_DLC[FRM_HANDLE_Gateway_11] = 8;
    Frm_DLC[FRM_HANDLE_Getriebe_01] = 8;
    Frm_DLC[FRM_HANDLE_Getriebe_02] = 8;
    Frm_DLC[FRM_HANDLE_Getriebe_03] = 8;
    Frm_DLC[FRM_HANDLE_Getriebe_04] = 8;
    Frm_DLC[FRM_HANDLE_Kessy_02] = 8;
    Frm_DLC[FRM_HANDLE_Klemmen_Status_01] = 4;
    Frm_DLC[FRM_HANDLE_Klima_01] = 8;
    Frm_DLC[FRM_HANDLE_Kombi_01] = 8;
    Frm_DLC[FRM_HANDLE_Kombi_02] = 8;
    Frm_DLC[FRM_HANDLE_Kombi_03] = 8;
    Frm_DLC[FRM_HANDLE_LH_EPS_02] = 8;
    Frm_DLC[FRM_HANDLE_LS_01] = 4;
    Frm_DLC[FRM_HANDLE_LWI_01] = 8;
    Frm_DLC[FRM_HANDLE_Licht_hinten_01] = 8;
    Frm_DLC[FRM_HANDLE_NMH_Gateway] = 7;
    Frm_DLC[FRM_HANDLE_OBD_Tankgeber_01] = 8;
    Frm_DLC[FRM_HANDLE_SCR_01] = 8;
    Frm_DLC[FRM_HANDLE_SCR_02] = 8;
    Frm_DLC[FRM_HANDLE_SCR_03] = 8;
    Frm_DLC[FRM_HANDLE_SCR_04] = 8;
    Frm_DLC[FRM_HANDLE_SCR_05] = 8;
    Frm_DLC[FRM_HANDLE_SCR_CAL_ID1] = 8;
    Frm_DLC[FRM_HANDLE_SCR_CAL_ID2] = 8;
    Frm_DLC[FRM_HANDLE_SCU_01] = 8;
    Frm_DLC[FRM_HANDLE_STH_01] = 8;
    Frm_DLC[FRM_HANDLE_STS_01] = 8;
    Frm_DLC[FRM_HANDLE_Systeminfo_01] = 8;


    /* ------------------------------------------------------------------------------------------ */
    /*  END variable initialization                                                               */
    /* ------------------------------------------------------------------------------------------ */


    /* ------------------------------------------------------------------------------------------ */
    /*  BEGIN OnStart                                                                             */
    /* ------------------------------------------------------------------------------------------ */

    write("");
    write("#===================================================================");
    write("# CAPL program can_db_v6x.can");
    write("# Generated by:  dbc2capl.pl v1.4.6 (dbcparser.pm 1.3.0)");
    write("# CAPL template: dbc2capl_template.can v1.0.2");
    write("# Generated on:  08.11.2011 09:49:11");
    write("# DBC file:      can_db_v6x.dbc");
    write("#===================================================================");
    write("");


    /* ------------------------------------------------------------------------------------------ */
    /*  END OnStart                                                                               */
    /* ------------------------------------------------------------------------------------------ */

    /* HelpFrameList(); */

    write("Hit '?' to get list of all available frames ...");
    ShowPrompt();
}
/*@@end*/

/*@@key:*:*/
on key *
{
    long InputVal = 0;
    int LevelActvOld;
    char CharBufTmp[CAPLCTRL_CHARBUF_LEN];
    
    /* store current input level to be able to check for level change */
    LevelActvOld = CaplCtrl_LevelActv;

    /* empty string */
    CharBufTmp[0] = 0;


    switch (this)
    {
        /* --- numeric input -------------------------------------------------------------------- */
        case '0':
        case '1':
        case '2':
        case '3':
        case '4':
        case '5':
        case '6':
        case '7':
        case '8':
        case '9':
        {
            /* copy input to input buffer */
            CaplCtrl_InputBuf[CaplCtrl_InputIdx] = this;
            
            /* increment to next buffer value */
            CaplCtrl_InputIdx ++;

            /* limit input to buffer length */
            if (CaplCtrl_InputIdx >= CAPLCTRL_INPUTBUF_LEN)
            {
                CaplCtrl_InputIdx = CAPLCTRL_INPUTBUF_LEN - 1;
            }

            /* make sure that string is terminated properly */
            CaplCtrl_InputBuf[CaplCtrl_InputIdx] = 0;
        }
        break;

        /* --- numeric input -------------------------------------------------------------------- */
        case KEY_ENTER:
        {
            if (CaplCtrl_InputIdx > 0)
            {
                InputVal = atol(CaplCtrl_InputBuf);
            
                /* reset input variables */
                CaplCtrl_InputIdx = 0;
                CaplCtrl_InputBuf[0] = 0;

                switch (CaplCtrl_LevelActv)
                {
                    /* currently no level selected */
                    case CAPLCTRL_LEVEL_NOSEL:
                    {
                        /* select frame only if selection was valid */
                        if (InputVal < FRM_NUM_MAX)
                        {
                            /* switch to next level */
                            CaplCtrl_LevelActv = CAPLCTRL_LEVEL_FRAME;

                            /* select frame */
                            CaplCtrl_FrameActv = InputVal;
                        }
                        break;
                    }

                    case CAPLCTRL_LEVEL_FRAME:
                    {
                        /* switch to next level */
                        CaplCtrl_LevelActv = CAPLCTRL_LEVEL_SIGNAL;
                
                        /* select signal */
                        CaplCtrl_SignalActv = InputVal;
                        break;
                    }
            
                    case CAPLCTRL_LEVEL_SIGNAL:
                    {
                        /* set signal to input value */
                        CaplCtrl_InputValue = InputVal;
                        Frm_SetSignal(CaplCtrl_FrameActv, CaplCtrl_SignalActv, CaplCtrl_InputValue);
                        break;
                    }
                }
            }
        }
        break;

        case KEY_LEVEL_DOWN:
        {
            switch (CaplCtrl_LevelActv)
            {
                /* currently no level selected */
                case CAPLCTRL_LEVEL_NOSEL:
                {
                    /* keep level, do nothing */
                    break;
                }

                case CAPLCTRL_LEVEL_FRAME:
                {
                    /* switch back to above level */
                    CaplCtrl_LevelActv = CAPLCTRL_LEVEL_NOSEL;
                    break;
                }
        
                case CAPLCTRL_LEVEL_SIGNAL:
                {
                    /* switch back to above level */
                    CaplCtrl_LevelActv = CAPLCTRL_LEVEL_FRAME;
                    break;
                }
            }
        }
        break;

        case KEY_BACKSPACE:
        {
            /* update index */
            if (CaplCtrl_InputIdx > 0)
            {
                CaplCtrl_InputIdx --;
            }
            else
            {
                CaplCtrl_InputIdx = 0;
            }

            /* remove last character */
            CaplCtrl_InputBuf[CaplCtrl_InputIdx] = 0;
        }
        break;

        case KEY_TIMEOUT:
        {
            switch (CaplCtrl_LevelActv)
            {
                /* currently no level selected */
                case CAPLCTRL_LEVEL_NOSEL:
                {
                    /* enable/disable all frames */
                    if (FrmSched_FrmEna[0] != 0)
                    {
                        FrmSch_DisableAllFrames();
                        snprintf(CaplCtrl_CharBuf,
                                 CAPLCTRL_CHARBUF_LEN,
                                 "all frames disabled!");
                    }
                    else
                    {
                        FrmSch_EnableAllFrames();
                        snprintf(CaplCtrl_CharBuf,
                                 CAPLCTRL_CHARBUF_LEN,
                                 "all frames enabled!");
                    }
                    CaplCtrl_PromptMode = CAPLCTRL_PROMPTMODE_CHAR;
                    break;
                }

                case CAPLCTRL_LEVEL_FRAME:
                case CAPLCTRL_LEVEL_SIGNAL:
                {
                    /* toggle timeout status for selected frame */
                    FrmSched_FrmEna[CaplCtrl_FrameActv] ^= 1;
                    
                    /* get current frame status */
                    snprintf(CharBufTmp,
                             CAPLCTRL_CHARBUF_LEN,
                             "[tx=%d dlc=%d cs=%d cnt=%d]",
                             FrmSched_FrmEna[CaplCtrl_FrameActv],
                             Frm_DLCOk[CaplCtrl_FrameActv],
                             Frm_MsgChksmEna[CaplCtrl_FrameActv],
                             Frm_MsgCounterEna[CaplCtrl_FrameActv]);

                    if (FrmSched_FrmEna[CaplCtrl_FrameActv] != 0)
                    {
                        snprintf(CaplCtrl_CharBuf,
                                 CAPLCTRL_CHARBUF_LEN,
                                 "%s TX enabled!",
                                 CharBufTmp);
                    }
                    else
                    {
                        snprintf(CaplCtrl_CharBuf,
                                 CAPLCTRL_CHARBUF_LEN,
                                 "%s TX disabled!",
                                 CharBufTmp);
                    }

                    CaplCtrl_PromptMode = CAPLCTRL_PROMPTMODE_CHAR;
                    break;
                }
            }
            break;
        }

        case KEY_MSGCNT:
        {
            switch (CaplCtrl_LevelActv)
            {
                /* currently no level selected */
                case CAPLCTRL_LEVEL_NOSEL:
                {
                    /* keep level, do nothing */
                    break;
                }

                case CAPLCTRL_LEVEL_FRAME:
                case CAPLCTRL_LEVEL_SIGNAL:
                {
                    /* toggle message counter enable status */
                    Frm_MsgCounterEna[CaplCtrl_FrameActv] ^= 1;

                    /* get current frame status */
                    snprintf(CharBufTmp,
                             CAPLCTRL_CHARBUF_LEN,
                             "[tx=%d dlc=%d cs=%d cnt=%d]",
                             FrmSched_FrmEna[CaplCtrl_FrameActv],
                             Frm_DLCOk[CaplCtrl_FrameActv],
                             Frm_MsgChksmEna[CaplCtrl_FrameActv],
                             Frm_MsgCounterEna[CaplCtrl_FrameActv]);

                    if (Frm_MsgCounterEna[CaplCtrl_FrameActv] != 0)
                    {
                        snprintf(CaplCtrl_CharBuf,
                                 CAPLCTRL_CHARBUF_LEN,
                                 "%s Message counter running!",
                                 CharBufTmp);
                    }
                    else
                    {
                        snprintf(CaplCtrl_CharBuf,
                                 CAPLCTRL_CHARBUF_LEN,
                                 "%s Message counter stopped!",
                                 CharBufTmp);
                    }

                    CaplCtrl_PromptMode = CAPLCTRL_PROMPTMODE_CHAR;
                    break;
                }
            }
            break;
        }

        case KEY_CHKSM:
        {
            switch (CaplCtrl_LevelActv)
            {
                /* currently no level selected */
                case CAPLCTRL_LEVEL_NOSEL:
                {
                    /* keep level, do nothing */
                    break;
                }

                case CAPLCTRL_LEVEL_FRAME:
                case CAPLCTRL_LEVEL_SIGNAL:
                {
                    /* toggle checksum enable status */
                    Frm_MsgChksmEna[CaplCtrl_FrameActv] ^= 1;

                    /* get current frame status */
                    snprintf(CharBufTmp,
                             CAPLCTRL_CHARBUF_LEN,
                             "[tx=%d dlc=%d cs=%d cnt=%d]",
                             FrmSched_FrmEna[CaplCtrl_FrameActv],
                             Frm_DLCOk[CaplCtrl_FrameActv],
                             Frm_MsgChksmEna[CaplCtrl_FrameActv],
                             Frm_MsgCounterEna[CaplCtrl_FrameActv]);

                    if (Frm_MsgChksmEna[CaplCtrl_FrameActv] != 0)
                    {
                        snprintf(CaplCtrl_CharBuf,
                                 CAPLCTRL_CHARBUF_LEN,
                                 "%s Checksum calculation enabled!",
                                 CharBufTmp);
                    }
                    else
                    {
                        snprintf(CaplCtrl_CharBuf,
                                 CAPLCTRL_CHARBUF_LEN,
                                 "%s Checksum calculation disabled!",
                                 CharBufTmp);
                    }

                    CaplCtrl_PromptMode = CAPLCTRL_PROMPTMODE_CHAR;
                    break;
                }
            }
            break;
        }

        case KEY_DLC:
        {
            switch (CaplCtrl_LevelActv)
            {
                /* currently no level selected */
                case CAPLCTRL_LEVEL_NOSEL:
                {
                    /* keep level, do nothing */
                    break;
                }

                case CAPLCTRL_LEVEL_FRAME:
                case CAPLCTRL_LEVEL_SIGNAL:
                {
                    /* toggle DLC ok status */
                    Frm_DLCOk[CaplCtrl_FrameActv] ^= 1;

                    /* get current frame status */
                    snprintf(CharBufTmp,
                             CAPLCTRL_CHARBUF_LEN,
                             "[tx=%d dlc=%d cs=%d cnt=%d]",
                             FrmSched_FrmEna[CaplCtrl_FrameActv],
                             Frm_DLCOk[CaplCtrl_FrameActv],
                             Frm_MsgChksmEna[CaplCtrl_FrameActv],
                             Frm_MsgCounterEna[CaplCtrl_FrameActv]);

                    if (Frm_DLCOk[CaplCtrl_FrameActv] != 0)
                    {
                        snprintf(CaplCtrl_CharBuf,
                                 CAPLCTRL_CHARBUF_LEN,
                                 "%s correct DLC!",
                                 CharBufTmp);

                        Frm_SetDLC (CaplCtrl_FrameActv, Frm_DLC[CaplCtrl_FrameActv]);
                    }
                    else
                    {
                        snprintf(CaplCtrl_CharBuf,
                                 CAPLCTRL_CHARBUF_LEN,
                                 "%s incorrect DLC!",
                                 CharBufTmp);

                        Frm_SetDLC (CaplCtrl_FrameActv, 0);
                    }


                    CaplCtrl_PromptMode = CAPLCTRL_PROMPTMODE_CHAR;
                    break;
                }
            }
            break;
        }
        
        case KEY_HELP:
        {
            CaplCtrl_LevelChanged();
            break;
        }

        default:
        {
            break;
        }
    }

    if (LevelActvOld != CaplCtrl_LevelActv)
    {
        //CaplCtrl_LevelChanged();
    }

    ShowPrompt();
    CaplCtrl_PromptMode = CAPLCTRL_PROMPTMODE_NUM;
}
/*@@end*/

/*@@caplFunc:CaplCtrl_LevelChanged():*/
CaplCtrl_LevelChanged ()
{
    switch(CaplCtrl_LevelActv)
    {
        case CAPLCTRL_LEVEL_NOSEL:
        {
           HelpFrameList();
        }
        break;

        case CAPLCTRL_LEVEL_FRAME:
        {
            HelpSignalList();
        }
        break;

        case CAPLCTRL_LEVEL_SIGNAL:
        {
           
        }
        break;
    }
}
/*@@end*/

/*@@msg:*:*/
on message *
{
   output(this);
}
/*@@end*/

/*@@caplFunc:FrmSched_SendFrame(int):*/
FrmSched_SendFrame (int FrmIdx)
{
    switch (FrmIdx)
    {
        case FRM_HANDLE_ACC_01:
            MsgObj_ACC_01.ACC_01_BZ = Frm_CalcMsgCounter(FRM_HANDLE_ACC_01);
            MsgObj_ACC_01.ACC_01_CHK = Frm_CalcChecksumXORID(FRM_HANDLE_ACC_01, MsgObj_ACC_01, 0);
            output(MsgObj_ACC_01);
            break;
        case FRM_HANDLE_ACC_05:
            MsgObj_ACC_05.ACC_05_BZ = Frm_CalcMsgCounter(FRM_HANDLE_ACC_05);
            MsgObj_ACC_05.ACC_05_CHK = Frm_CalcChecksumXORID(FRM_HANDLE_ACC_05, MsgObj_ACC_05, 0);
            output(MsgObj_ACC_05);
            break;
        case FRM_HANDLE_Airbag_01:
            MsgObj_Airbag_01.Airbag_01_BZ = Frm_CalcMsgCounter(FRM_HANDLE_Airbag_01);
            MsgObj_Airbag_01.Airbag_01_CHK = Frm_CalcChecksumXORID(FRM_HANDLE_Airbag_01, MsgObj_Airbag_01, 0);
            output(MsgObj_Airbag_01);
            break;
        case FRM_HANDLE_Airbag_02:
            output(MsgObj_Airbag_02);
            break;
        case FRM_HANDLE_Allrad_02:
            output(MsgObj_Allrad_02);
            break;
        case FRM_HANDLE_Anhaenger_01:
            MsgObj_Anhaenger_01.AAG_BZ = Frm_CalcMsgCounter(FRM_HANDLE_Anhaenger_01);
            output(MsgObj_Anhaenger_01);
            break;
        case FRM_HANDLE_BEM_01:
            MsgObj_BEM_01.BEM_01_BZ = Frm_CalcMsgCounter(FRM_HANDLE_BEM_01);
            MsgObj_BEM_01.BEM_01_CHK = Frm_CalcChecksumXORID(FRM_HANDLE_BEM_01, MsgObj_BEM_01, 0);
            output(MsgObj_BEM_01);
            break;
        case FRM_HANDLE_Charisma_01:
            MsgObj_Charisma_01.CHA_01_BZ = Frm_CalcMsgCounter(FRM_HANDLE_Charisma_01);
            MsgObj_Charisma_01.CHA_01_CHK = Frm_CalcChecksumXORID(FRM_HANDLE_Charisma_01, MsgObj_Charisma_01, 0);
            output(MsgObj_Charisma_01);
            break;
        case FRM_HANDLE_Diagnose_01:
            output(MsgObj_Diagnose_01);
            break;
        case FRM_HANDLE_EPB_01:
            MsgObj_EPB_01.EPB_01_BZ = Frm_CalcMsgCounter(FRM_HANDLE_EPB_01);
            MsgObj_EPB_01.EPB_01_CHK = Frm_CalcChecksumXORID(FRM_HANDLE_EPB_01, MsgObj_EPB_01, 0);
            output(MsgObj_EPB_01);
            break;
        case FRM_HANDLE_ESP_01:
            MsgObj_ESP_01.ESP_01_BZ = Frm_CalcMsgCounter(FRM_HANDLE_ESP_01);
            MsgObj_ESP_01.ESP_01_CHK = Frm_CalcChecksumXORID(FRM_HANDLE_ESP_01, MsgObj_ESP_01, 0) ^ 0xAA;
            output(MsgObj_ESP_01);
            break;
        case FRM_HANDLE_ESP_02:
            MsgObj_ESP_02.ESP_02_BZ = Frm_CalcMsgCounter(FRM_HANDLE_ESP_02);
            MsgObj_ESP_02.ESP_02_CHK = Frm_CalcChecksumXORID(FRM_HANDLE_ESP_02, MsgObj_ESP_02, 0) ^ 0xAA;
            output(MsgObj_ESP_02);
            break;
        case FRM_HANDLE_ESP_03:
            MsgObj_ESP_03.ESP_03_BZ = Frm_CalcMsgCounter(FRM_HANDLE_ESP_03);
            MsgObj_ESP_03.ESP_03_CHK = Frm_CalcChecksumXORID(FRM_HANDLE_ESP_03, MsgObj_ESP_03, 0);
            output(MsgObj_ESP_03);
            break;
        case FRM_HANDLE_ESP_05:
            MsgObj_ESP_05.ESP_05_BZ = Frm_CalcMsgCounter(FRM_HANDLE_ESP_05);
            MsgObj_ESP_05.ESP_05_CHK = Frm_CalcChecksumXORID(FRM_HANDLE_ESP_05, MsgObj_ESP_05, 0);
            output(MsgObj_ESP_05);
            break;
        case FRM_HANDLE_ESP_07_FR:
            MsgObj_ESP_07_FR.ESP_07_BZ = Frm_CalcMsgCounter(FRM_HANDLE_ESP_07_FR);
            MsgObj_ESP_07_FR.ESP_07_CHK = Frm_CalcChecksumXORID(FRM_HANDLE_ESP_07_FR, MsgObj_ESP_07_FR, 0);
            output(MsgObj_ESP_07_FR);
            break;
        case FRM_HANDLE_ESP_16:
            MsgObj_ESP_16.ESP_16_BZ = Frm_CalcMsgCounter(FRM_HANDLE_ESP_16);
            MsgObj_ESP_16.ESP_16_CRC = Frm_CalcChecksumCRC8(FRM_HANDLE_ESP_16, MsgObj_ESP_16, 0xA9);
            output(MsgObj_ESP_16);
            break;
        case FRM_HANDLE_ESP_K_10:
            MsgObj_ESP_K_10.ESP_10_BZ = Frm_CalcMsgCounter(FRM_HANDLE_ESP_K_10);
            MsgObj_ESP_K_10.ESP_10_CRC = Frm_CalcChecksumCRC8(FRM_HANDLE_ESP_K_10, MsgObj_ESP_K_10, 0xAC);
            output(MsgObj_ESP_K_10);
            break;
        case FRM_HANDLE_Einheiten_01:
            output(MsgObj_Einheiten_01);
            break;
        case FRM_HANDLE_Fahrwerk_02:
            MsgObj_Fahrwerk_02.Fahrwerk_02_BZ = Frm_CalcMsgCounter(FRM_HANDLE_Fahrwerk_02);
            MsgObj_Fahrwerk_02.Fahrwerk_02_CHK = Frm_CalcChecksumXORID(FRM_HANDLE_Fahrwerk_02, MsgObj_Fahrwerk_02, 0);
            output(MsgObj_Fahrwerk_02);
            break;
        case FRM_HANDLE_GW_Fwk_01_Ant_PAG:
            output(MsgObj_GW_Fwk_01_Ant_PAG);
            break;
        case FRM_HANDLE_Gateway_05:
            output(MsgObj_Gateway_05);
            break;
        case FRM_HANDLE_Gateway_11:
            output(MsgObj_Gateway_11);
            break;
        case FRM_HANDLE_Getriebe_01:
            MsgObj_Getriebe_01.Getriebe_01_BZ = Frm_CalcMsgCounter(FRM_HANDLE_Getriebe_01);
            MsgObj_Getriebe_01.Getriebe_01_CHK = Frm_CalcChecksumXORID(FRM_HANDLE_Getriebe_01, MsgObj_Getriebe_01, 0);
            output(MsgObj_Getriebe_01);
            break;
        case FRM_HANDLE_Getriebe_02:
            MsgObj_Getriebe_02.Getriebe_02_BZ = Frm_CalcMsgCounter(FRM_HANDLE_Getriebe_02);
            MsgObj_Getriebe_02.Getriebe_02_CHK = Frm_CalcChecksumXORID(FRM_HANDLE_Getriebe_02, MsgObj_Getriebe_02, 0);
            output(MsgObj_Getriebe_02);
            break;
        case FRM_HANDLE_Getriebe_03:
            MsgObj_Getriebe_03.Getriebe_03_BZ = Frm_CalcMsgCounter(FRM_HANDLE_Getriebe_03);
            MsgObj_Getriebe_03.Getriebe_03_CHK = Frm_CalcChecksumXORID(FRM_HANDLE_Getriebe_03, MsgObj_Getriebe_03, 0);
            output(MsgObj_Getriebe_03);
            break;
        case FRM_HANDLE_Getriebe_04:
            output(MsgObj_Getriebe_04);
            break;
        case FRM_HANDLE_Kessy_02:
            output(MsgObj_Kessy_02);
            break;
        case FRM_HANDLE_Klemmen_Status_01:
            MsgObj_Klemmen_Status_01.Klemmen_Status_01_BZ = Frm_CalcMsgCounter(FRM_HANDLE_Klemmen_Status_01);
            MsgObj_Klemmen_Status_01.Klemmen_Status_01_CHK = Frm_CalcChecksumXORID(FRM_HANDLE_Klemmen_Status_01, MsgObj_Klemmen_Status_01, 0);
            output(MsgObj_Klemmen_Status_01);
            break;
        case FRM_HANDLE_Klima_01:
            output(MsgObj_Klima_01);
            break;
        case FRM_HANDLE_Kombi_01:
            output(MsgObj_Kombi_01);
            break;
        case FRM_HANDLE_Kombi_02:
            output(MsgObj_Kombi_02);
            break;
        case FRM_HANDLE_Kombi_03:
            output(MsgObj_Kombi_03);
            break;
        case FRM_HANDLE_LH_EPS_02:
            MsgObj_LH_EPS_02.EPS_02_BZ = Frm_CalcMsgCounter(FRM_HANDLE_LH_EPS_02);
            MsgObj_LH_EPS_02.EPS_02_CRC = Frm_CalcChecksumCRC8Dyn(FRM_HANDLE_LH_EPS_02, MsgObj_LH_EPS_02, MsgObj_LH_EPS_02.EPS_02_BZ);
            output(MsgObj_LH_EPS_02);
            break;
        case FRM_HANDLE_LS_01:
            MsgObj_LS_01.LS_01_BZ = Frm_CalcMsgCounter(FRM_HANDLE_LS_01);
            MsgObj_LS_01.LS_01_CHK = Frm_CalcChecksumXORID(FRM_HANDLE_LS_01, MsgObj_LS_01, 0);
            output(MsgObj_LS_01);
            break;
        case FRM_HANDLE_LWI_01:
            MsgObj_LWI_01.LWI_01_BZ = Frm_CalcMsgCounter(FRM_HANDLE_LWI_01);
            MsgObj_LWI_01.LWI_01_CHK = Frm_CalcChecksumXORID(FRM_HANDLE_LWI_01, MsgObj_LWI_01, 0);
            output(MsgObj_LWI_01);
            break;
        case FRM_HANDLE_Licht_hinten_01:
            MsgObj_Licht_hinten_01.Licht_hinten_01_BZ = Frm_CalcMsgCounter(FRM_HANDLE_Licht_hinten_01);
            output(MsgObj_Licht_hinten_01);
            break;
        case FRM_HANDLE_NMH_Gateway:
            output(MsgObj_NMH_Gateway);
            break;
        case FRM_HANDLE_OBD_Tankgeber_01:
            output(MsgObj_OBD_Tankgeber_01);
            break;
        case FRM_HANDLE_SCR_01:
            MsgObj_SCR_01.SCR_01_BZ = Frm_CalcMsgCounter(FRM_HANDLE_SCR_01);
            output(MsgObj_SCR_01);
            break;
        case FRM_HANDLE_SCR_02:
            MsgObj_SCR_02.SCR_02_BZ = Frm_CalcMsgCounter(FRM_HANDLE_SCR_02);
            output(MsgObj_SCR_02);
            break;
        case FRM_HANDLE_SCR_03:
            MsgObj_SCR_03.SCR_03_BZ = Frm_CalcMsgCounter(FRM_HANDLE_SCR_03);
            output(MsgObj_SCR_03);
            break;
        case FRM_HANDLE_SCR_04:
            MsgObj_SCR_04.SCR_04_BZ = Frm_CalcMsgCounter(FRM_HANDLE_SCR_04);
            output(MsgObj_SCR_04);
            break;
        case FRM_HANDLE_SCR_05:
            MsgObj_SCR_05.SCR_05_BZ = Frm_CalcMsgCounter(FRM_HANDLE_SCR_05);
            output(MsgObj_SCR_05);
            break;
        case FRM_HANDLE_SCR_CAL_ID1:
            output(MsgObj_SCR_CAL_ID1);
            break;
        case FRM_HANDLE_SCR_CAL_ID2:
            output(MsgObj_SCR_CAL_ID2);
            break;
        case FRM_HANDLE_SCU_01:
            MsgObj_SCU_01.SCU_01_BZ = Frm_CalcMsgCounter(FRM_HANDLE_SCU_01);
            MsgObj_SCU_01.SCU_01_CHK = Frm_CalcChecksumXORID(FRM_HANDLE_SCU_01, MsgObj_SCU_01, 0);
            output(MsgObj_SCU_01);
            break;
        case FRM_HANDLE_STH_01:
            output(MsgObj_STH_01);
            break;
        case FRM_HANDLE_STS_01:
            MsgObj_STS_01.STS_01_BZ = Frm_CalcMsgCounter(FRM_HANDLE_STS_01);
            MsgObj_STS_01.STS_01_CHK = Frm_CalcChecksumXORID(FRM_HANDLE_STS_01, MsgObj_STS_01, 0);
            output(MsgObj_STS_01);
            break;
        case FRM_HANDLE_Systeminfo_01:
            output(MsgObj_Systeminfo_01);
            break;
    }
}
/*@@end*/

/*@@caplFunc:Frm_SetDLC(long, long):*/
Frm_SetDLC (long FrmIdx, long FrmDLC)
{
    switch (FrmIdx)
    {
        case FRM_HANDLE_ACC_01:
            MsgObj_ACC_01.DLC = FrmDLC;
            break;
        case FRM_HANDLE_ACC_05:
            MsgObj_ACC_05.DLC = FrmDLC;
            break;
        case FRM_HANDLE_Airbag_01:
            MsgObj_Airbag_01.DLC = FrmDLC;
            break;
        case FRM_HANDLE_Airbag_02:
            MsgObj_Airbag_02.DLC = FrmDLC;
            break;
        case FRM_HANDLE_Allrad_02:
            MsgObj_Allrad_02.DLC = FrmDLC;
            break;
        case FRM_HANDLE_Anhaenger_01:
            MsgObj_Anhaenger_01.DLC = FrmDLC;
            break;
        case FRM_HANDLE_BEM_01:
            MsgObj_BEM_01.DLC = FrmDLC;
            break;
        case FRM_HANDLE_Charisma_01:
            MsgObj_Charisma_01.DLC = FrmDLC;
            break;
        case FRM_HANDLE_Diagnose_01:
            MsgObj_Diagnose_01.DLC = FrmDLC;
            break;
        case FRM_HANDLE_EPB_01:
            MsgObj_EPB_01.DLC = FrmDLC;
            break;
        case FRM_HANDLE_ESP_01:
            MsgObj_ESP_01.DLC = FrmDLC;
            break;
        case FRM_HANDLE_ESP_02:
            MsgObj_ESP_02.DLC = FrmDLC;
            break;
        case FRM_HANDLE_ESP_03:
            MsgObj_ESP_03.DLC = FrmDLC;
            break;
        case FRM_HANDLE_ESP_05:
            MsgObj_ESP_05.DLC = FrmDLC;
            break;
        case FRM_HANDLE_ESP_07_FR:
            MsgObj_ESP_07_FR.DLC = FrmDLC;
            break;
        case FRM_HANDLE_ESP_16:
            MsgObj_ESP_16.DLC = FrmDLC;
            break;
        case FRM_HANDLE_ESP_K_10:
            MsgObj_ESP_K_10.DLC = FrmDLC;
            break;
        case FRM_HANDLE_Einheiten_01:
            MsgObj_Einheiten_01.DLC = FrmDLC;
            break;
        case FRM_HANDLE_Fahrwerk_02:
            MsgObj_Fahrwerk_02.DLC = FrmDLC;
            break;
        case FRM_HANDLE_GW_Fwk_01_Ant_PAG:
            MsgObj_GW_Fwk_01_Ant_PAG.DLC = FrmDLC;
            break;
        case FRM_HANDLE_Gateway_05:
            MsgObj_Gateway_05.DLC = FrmDLC;
            break;
        case FRM_HANDLE_Gateway_11:
            MsgObj_Gateway_11.DLC = FrmDLC;
            break;
        case FRM_HANDLE_Getriebe_01:
            MsgObj_Getriebe_01.DLC = FrmDLC;
            break;
        case FRM_HANDLE_Getriebe_02:
            MsgObj_Getriebe_02.DLC = FrmDLC;
            break;
        case FRM_HANDLE_Getriebe_03:
            MsgObj_Getriebe_03.DLC = FrmDLC;
            break;
        case FRM_HANDLE_Getriebe_04:
            MsgObj_Getriebe_04.DLC = FrmDLC;
            break;
        case FRM_HANDLE_Kessy_02:
            MsgObj_Kessy_02.DLC = FrmDLC;
            break;
        case FRM_HANDLE_Klemmen_Status_01:
            MsgObj_Klemmen_Status_01.DLC = FrmDLC;
            break;
        case FRM_HANDLE_Klima_01:
            MsgObj_Klima_01.DLC = FrmDLC;
            break;
        case FRM_HANDLE_Kombi_01:
            MsgObj_Kombi_01.DLC = FrmDLC;
            break;
        case FRM_HANDLE_Kombi_02:
            MsgObj_Kombi_02.DLC = FrmDLC;
            break;
        case FRM_HANDLE_Kombi_03:
            MsgObj_Kombi_03.DLC = FrmDLC;
            break;
        case FRM_HANDLE_LH_EPS_02:
            MsgObj_LH_EPS_02.DLC = FrmDLC;
            break;
        case FRM_HANDLE_LS_01:
            MsgObj_LS_01.DLC = FrmDLC;
            break;
        case FRM_HANDLE_LWI_01:
            MsgObj_LWI_01.DLC = FrmDLC;
            break;
        case FRM_HANDLE_Licht_hinten_01:
            MsgObj_Licht_hinten_01.DLC = FrmDLC;
            break;
        case FRM_HANDLE_NMH_Gateway:
            MsgObj_NMH_Gateway.DLC = FrmDLC;
            break;
        case FRM_HANDLE_OBD_Tankgeber_01:
            MsgObj_OBD_Tankgeber_01.DLC = FrmDLC;
            break;
        case FRM_HANDLE_SCR_01:
            MsgObj_SCR_01.DLC = FrmDLC;
            break;
        case FRM_HANDLE_SCR_02:
            MsgObj_SCR_02.DLC = FrmDLC;
            break;
        case FRM_HANDLE_SCR_03:
            MsgObj_SCR_03.DLC = FrmDLC;
            break;
        case FRM_HANDLE_SCR_04:
            MsgObj_SCR_04.DLC = FrmDLC;
            break;
        case FRM_HANDLE_SCR_05:
            MsgObj_SCR_05.DLC = FrmDLC;
            break;
        case FRM_HANDLE_SCR_CAL_ID1:
            MsgObj_SCR_CAL_ID1.DLC = FrmDLC;
            break;
        case FRM_HANDLE_SCR_CAL_ID2:
            MsgObj_SCR_CAL_ID2.DLC = FrmDLC;
            break;
        case FRM_HANDLE_SCU_01:
            MsgObj_SCU_01.DLC = FrmDLC;
            break;
        case FRM_HANDLE_STH_01:
            MsgObj_STH_01.DLC = FrmDLC;
            break;
        case FRM_HANDLE_STS_01:
            MsgObj_STS_01.DLC = FrmDLC;
            break;
        case FRM_HANDLE_Systeminfo_01:
            MsgObj_Systeminfo_01.DLC = FrmDLC;
            break;
    }
}
/*@@end*/

/*@@busOff:BusOff:*/
on busOff
{
    resetCan();
}
/*@@end*/

/*@@caplFunc:HelpCommands():*/
HelpCommands ()
{
    write("-------------------------------------------");
    write("Supported commands:");
    write("[a] ... toggle timeout error status");
    write("[b] ... toggle message counter error status");
    write("[c] ... toggle checksumm error status");
    write("[d] ... toggle DLC error status");
    write("[.] ... one level up in command prompt");
    write("-------------------------------------------");
}

/*@@caplFunc:HelpFrameList():*/
HelpFrameList ()
{
    HelpCommands();

    write("[0] ... ACC_01");
    write("[1] ... ACC_05");
    write("[2] ... Airbag_01");
    write("[3] ... Airbag_02");
    write("[4] ... Allrad_02");
    write("[5] ... Anhaenger_01");
    write("[6] ... BEM_01");
    write("[7] ... Charisma_01");
    write("[8] ... Diagnose_01");
    write("[9] ... EPB_01");
    write("[10] ... ESP_01");
    write("[11] ... ESP_02");
    write("[12] ... ESP_03");
    write("[13] ... ESP_05");
    write("[14] ... ESP_07_FR");
    write("[15] ... ESP_16");
    write("[16] ... ESP_K_10");
    write("[17] ... Einheiten_01");
    write("[18] ... Fahrwerk_02");
    write("[19] ... GW_Fwk_01_Ant_PAG");
    write("[20] ... Gateway_05");
    write("[21] ... Gateway_11");
    write("[22] ... Getriebe_01");
    write("[23] ... Getriebe_02");
    write("[24] ... Getriebe_03");
    write("[25] ... Getriebe_04");
    write("[26] ... Kessy_02");
    write("[27] ... Klemmen_Status_01");
    write("[28] ... Klima_01");
    write("[29] ... Kombi_01");
    write("[30] ... Kombi_02");
    write("[31] ... Kombi_03");
    write("[32] ... LH_EPS_02");
    write("[33] ... LS_01");
    write("[34] ... LWI_01");
    write("[35] ... Licht_hinten_01");
    write("[36] ... NMH_Gateway");
    write("[37] ... OBD_Tankgeber_01");
    write("[38] ... SCR_01");
    write("[39] ... SCR_02");
    write("[40] ... SCR_03");
    write("[41] ... SCR_04");
    write("[42] ... SCR_05");
    write("[43] ... SCR_CAL_ID1");
    write("[44] ... SCR_CAL_ID2");
    write("[45] ... SCU_01");
    write("[46] ... STH_01");
    write("[47] ... STS_01");
    write("[48] ... Systeminfo_01");

}

/*@@caplFunc:HelpSignalList():*/
HelpSignalList ()
{
    HelpCommands();

    switch(CaplCtrl_FrameActv)
    {
        case FRM_HANDLE_ACC_01:
        {
            write("[0] ... ACC_01_BZ");
            write("[1] ... ACC_01_CHK");
            write("[2] ... ACC_Anhalten");
            write("[3] ... ACC_Dynamik");
            write("[4] ... ACC_KD_Fehler");
            write("[5] ... ACC_Minimale_Bremsung");
            write("[6] ... ACC_Sollbeschleunigung");
            write("[7] ... ACC_Status_ACC");
            write("[8] ... ACC_neg_Sollbeschl_Grad");
            write("[9] ... ACC_pos_Sollbeschl_Grad");
            write("[10] ... ACC_zul_Regelabw_oben");
            write("[11] ... ACC_zul_Regelabw_unten");
        }
        break;
        case FRM_HANDLE_ACC_05:
        {
            write("[0] ... ACC_05_BZ");
            write("[1] ... ACC_05_CHK");
            write("[2] ... ACC_Anhalten");
            write("[3] ... ACC_Betaetigung_EPB");
            write("[4] ... ACC_Freigabe_Momentenanf");
            write("[5] ... ACC_Momentenanforderung");
            write("[6] ... ACC_StartStopp_Info");
            write("[7] ... ACC_Status_ACC");
            write("[8] ... ACC_limitierte_Anfahrdyn");
        }
        break;
        case FRM_HANDLE_Airbag_01:
        {
            write("[0] ... AB_Anzeige_Fussg");
            write("[1] ... AB_Crash_Int");
            write("[2] ... AB_Deaktiviert");
            write("[3] ... AB_Deaktivierung_HV");
            write("[4] ... AB_Diagnose");
            write("[5] ... AB_Erh_Auf_VB");
            write("[6] ... AB_Front_Crash");
            write("[7] ... AB_Gurtwarn_VB");
            write("[8] ... AB_Gurtwarn_VF");
            write("[9] ... AB_Heck_Crash");
            write("[10] ... AB_KD_Fehler");
            write("[11] ... AB_Lampe");
            write("[12] ... AB_Rollover_Crash");
            write("[13] ... AB_SB_Crash");
            write("[14] ... AB_SF_Crash");
            write("[15] ... AB_Stellgliedtest");
            write("[16] ... AB_Systemfehler");
            write("[17] ... AB_VB_deaktiviert");
            write("[18] ... Airbag_01_BZ");
            write("[19] ... Airbag_01_CHK");
            write("[20] ... void_Byte_02");
            write("[21] ... void_Byte_03");
        }
        break;
        case FRM_HANDLE_Airbag_02:
        {
            write("[0] ... AB_Belegung_VB");
            write("[1] ... AB_Gurtschloss_BF");
            write("[2] ... AB_Gurtschloss_FA");
            write("[3] ... AB_Gurtschloss_Reihe2_BF");
            write("[4] ... AB_Gurtschloss_Reihe2_FA");
            write("[5] ... AB_Gurtschloss_Reihe2_MI");
            write("[6] ... AB_Gurtschloss_Reihe3_BF");
            write("[7] ... AB_Gurtschloss_Reihe3_FA");
            write("[8] ... AB_Gurtschloss_Reihe3_MI");
            write("[9] ... AB_Sitzpos_Sens_BF");
            write("[10] ... AB_Sitzpos_Sens_FA");
        }
        break;
        case FRM_HANDLE_Allrad_02:
        {
            write("[0] ... ALR_Begrenzungsmoment");
            write("[1] ... ALR_Charisma_FahrPr");
            write("[2] ... ALR_Charisma_Status");
            write("[3] ... ALR_Charisma_Umschaltung");
            write("[4] ... ALR_ESP_akt");
            write("[5] ... ALR_Fahrerwunsch");
            write("[6] ... ALR_KD_Fehler");
            write("[7] ... ALR_LED_Auto_Diff");
            write("[8] ... ALR_LED_High");
            write("[9] ... ALR_LED_Low");
            write("[10] ... ALR_LED_Low_Lock");
            write("[11] ... ALR_LED_Rear_Lock");
            write("[12] ... ALR_Limiter");
            write("[13] ... ALR_Offroad");
            write("[14] ... ALR_Schalten");
            write("[15] ... ALR_Sta_Begrenzungsmom");
            write("[16] ... ALR_Sta_Laengssperre");
            write("[17] ... ALR_Sta_PrioAnzeige");
            write("[18] ... ALR_Sta_Quersperre");
            write("[19] ... ALR_Sta_Untersetzung");
            write("[20] ... ALR_Symbol_Lock");
            write("[21] ... ALR_Symbol_Low");
            write("[22] ... ALR_Symbol_RearLock");
            write("[23] ... ALR_Temp_schutz");
            write("[24] ... ALR_Texte");
            write("[25] ... ALR_Vorwarnung");
        }
        break;
        case FRM_HANDLE_Anhaenger_01:
        {
            write("[0] ... AAG_AVS_Fehler");
            write("[1] ... AAG_AVS_Stati");
            write("[2] ... AAG_Anhaenger_abgesteckt");
            write("[3] ... AAG_Anhaenger_erkannt");
            write("[4] ... AAG_BZ");
            write("[5] ... AAG_Blinker_HL_def");
            write("[6] ... AAG_Blinker_HR_def");
            write("[7] ... AAG_Blinker_H_aktiv");
            write("[8] ... AAG_Bremsl_durch_ECD");
            write("[9] ... AAG_Bremslicht_H_def");
            write("[10] ... AAG_KD_Fehler");
            write("[11] ... AAG_NSL_aktiv");
            write("[12] ... AAG_Schlusslicht_HL_def");
            write("[13] ... AAG_Schlusslicht_HR_def");
        }
        break;
        case FRM_HANDLE_BEM_01:
        {
            write("[0] ... BEM_01_Abschaltstufen");
            write("[1] ... BEM_01_BZ");
            write("[2] ... BEM_01_CHK");
            write("[3] ... BEM_Anf_KL");
            write("[4] ... BEM_P_Generator");
            write("[5] ... BEM_Segel_Info");
            write("[6] ... BEM_StartStopp_Info");
            write("[7] ... BEM_n_LLA");
        }
        break;
        case FRM_HANDLE_Charisma_01:
        {
            write("[0] ... CHA_01_BZ");
            write("[1] ... CHA_01_CHK");
            write("[2] ... CHA_Systemstatus");
            write("[3] ... CHA_Ziel_FahrPr_DR");
            write("[4] ... CHA_Ziel_FahrPr_GE");
            write("[5] ... CHA_Ziel_FahrPr_MO");
            write("[6] ... CHA_Ziel_FahrPr_QS");
            write("[7] ... CHA_Ziel_FahrPr_SCU");
            write("[8] ... CHA_Ziel_FahrPr_ST");
            write("[9] ... CHA_Ziel_FahrPr_Sys_7");
            write("[10] ... CHA_Ziel_FahrPr_Sys_8");
        }
        break;
        case FRM_HANDLE_Diagnose_01:
        {
            write("[0] ... DGN_Verlernzaehler");
            write("[1] ... KBI_Kilometerstand");
            write("[2] ... Kombi_02_alt");
            write("[3] ... UH_Jahr");
            write("[4] ... UH_Minute");
            write("[5] ... UH_Monat");
            write("[6] ... UH_Sekunde");
            write("[7] ... UH_Stunde");
            write("[8] ... UH_Tag");
            write("[9] ... Uhrzeit_01_alt");
        }
        break;
        case FRM_HANDLE_EPB_01:
        {
            write("[0] ... EPB_01_BZ");
            write("[1] ... EPB_01_CHK");
            write("[2] ... EPB_BCM2_Motor_Wakeup");
            write("[3] ... EPB_Fehlerstatus");
            write("[4] ... EPB_Freig_Verzoeg_Anf");
            write("[5] ... EPB_KD_Fehler");
            write("[6] ... EPB_Laengsbeschleunigung");
            write("[7] ... EPB_Pedalweg_Kuppl");
            write("[8] ... EPB_QBit_Laengsbeschleunigung");
            write("[9] ... EPB_QBit_Pedalweg_Kuppl");
            write("[10] ... EPB_QBit_Schalterpos");
            write("[11] ... EPB_Schalterposition");
            write("[12] ... EPB_Spannkraft");
            write("[13] ... EPB_Status");
            write("[14] ... EPB_Verzoeg_Anf");
        }
        break;
        case FRM_HANDLE_ESP_01:
        {
            write("[0] ... ABS_Bremsung");
            write("[1] ... ASR_Anf");
            write("[2] ... ASR_MSR_Moment_schnell");
            write("[3] ... ASR_Moment_langsam");
            write("[4] ... ASR_Schalteingriff");
            write("[5] ... ASR_Tastung_passiv");
            write("[6] ... EBV_Eingriff");
            write("[7] ... EDS_Eingriff");
            write("[8] ... ESP_01_BZ");
            write("[9] ... ESP_01_CHK");
            write("[10] ... ESP_ASP");
            write("[11] ... ESP_Eingriff");
            write("[12] ... ESP_KD_Fehler");
            write("[13] ... ESP_QBit_v_Signal");
            write("[14] ... ESP_Systemstatus");
            write("[15] ... ESP_Tastung_passiv");
            write("[16] ... ESP_v_Signal");
            write("[17] ... MSR_Anf");
            write("[18] ... OBD_QBit_Schlechtweg");
            write("[19] ... OBD_Schlechtweg");
        }
        break;
        case FRM_HANDLE_ESP_02:
        {
            write("[0] ... ESP_02_BZ");
            write("[1] ... ESP_02_CHK");
            write("[2] ... ESP_Gierrate");
            write("[3] ... ESP_Laengsbeschl");
            write("[4] ... ESP_Notbremsanzeige");
            write("[5] ... ESP_QBit_Anf_Vert_Wank");
            write("[6] ... ESP_QBit_Gierrate");
            write("[7] ... ESP_QBit_Laengsbeschl");
            write("[8] ... ESP_QBit_Querb");
            write("[9] ... ESP_Querbeschleunigung");
            write("[10] ... ESP_Stillstandsflag");
            write("[11] ... ESP_VZ_Gierrate");
            write("[12] ... ESP_Verteil_Wankmom");
            write("[13] ... void_Byte_11");
        }
        break;
        case FRM_HANDLE_ESP_03:
        {
            write("[0] ... ESP_03_BZ");
            write("[1] ... ESP_03_CHK");
            write("[2] ... ESP_HL_FR");
            write("[3] ... ESP_HL_Radgeschw");
            write("[4] ... ESP_HR_FR");
            write("[5] ... ESP_HR_Radgeschw");
            write("[6] ... ESP_VL_FR");
            write("[7] ... ESP_VL_Radgeschw");
            write("[8] ... ESP_VR_FR");
            write("[9] ... ESP_VR_Radgeschw");
        }
        break;
        case FRM_HANDLE_ESP_05:
        {
            write("[0] ... ECD_Bremslicht");
            write("[1] ... ECD_Fehler");
            write("[2] ... ECD_nicht_verfuegbar");
            write("[3] ... ESP_05_BZ");
            write("[4] ... ESP_05_CHK");
            write("[5] ... ESP_Anforderung_EPB");
            write("[6] ... ESP_Autohold_Standby");
            write("[7] ... ESP_Autohold_aktiv");
            write("[8] ... ESP_BKV_Unterdruck");
            write("[9] ... ESP_Bremsdruck");
            write("[10] ... ESP_Bremsruck_AWV2");
            write("[11] ... ESP_Eingr_HL");
            write("[12] ... ESP_Eingr_HR");
            write("[13] ... ESP_Eingr_VL");
            write("[14] ... ESP_Eingr_VR");
            write("[15] ... ESP_FStatus_Anfahrhilfe");
            write("[16] ... ESP_Fahrer_bremst");
            write("[17] ... ESP_HBA_aktiv");
            write("[18] ... ESP_HDC_Standby");
            write("[19] ... ESP_HDC_aktiv");
            write("[20] ... ESP_Konsistenz_AWV2");
            write("[21] ... ESP_Konsistenz_TSK");
            write("[22] ... ESP_Lenkeingriff_ADS");
            write("[23] ... ESP_Prefill_ausgeloest");
            write("[24] ... ESP_QBit_Bremsdruck");
            write("[25] ... ESP_QBit_Fahrer_bremst");
            write("[26] ... ESP_Rueckwaertsfahrt_erkannt");
            write("[27] ... ESP_Schwelle_Unterdruck");
            write("[28] ... ESP_StartStopp_Info");
            write("[29] ... ESP_Status_Anfahrhilfe");
            write("[30] ... ESP_Status_Bremsdruck");
            write("[31] ... ESP_Status_Bremsentemp");
            write("[32] ... ESP_Verz_EPB_aktiv");
            write("[33] ... ESP_Verz_TSK_aktiv");
            write("[34] ... ESP_Verzoeg_EPB_verf");
        }
        break;
        case FRM_HANDLE_ESP_07_FR:
        {
            write("[0] ... ESP_07_BZ");
            write("[1] ... ESP_07_CHK");
            write("[2] ... ESP_ACC_LDE");
            write("[3] ... ESP_CM_Variante");
            write("[4] ... ESP_Codierung_ADS");
            write("[5] ... ESP_MKB_Status");
            write("[6] ... ESP_MKB_ausloesbar");
            write("[7] ... ESP_OBD_Status");
            write("[8] ... ESP_Offroad_Modus");
            write("[9] ... ESP_Qualifizierung_Antriebsart");
            write("[10] ... ESP_Quattro_Antrieb");
            write("[11] ... ESP_RTA_HL");
            write("[12] ... ESP_RTA_HR");
            write("[13] ... ESP_RTA_VR");
            write("[14] ... ESP_Rollenmodus_Deaktivieren");
            write("[15] ... ESP_nachtr_Stopp_Anf");
            write("[16] ... OBD_Fehler_Radsensor_HL");
            write("[17] ... OBD_Fehler_Radsensor_HR");
            write("[18] ... OBD_Fehler_Radsensor_VL");
            write("[19] ... OBD_Fehler_Radsensor_VR");
        }
        break;
        case FRM_HANDLE_ESP_16:
        {
            write("[0] ... ESP_16_BZ");
            write("[1] ... ESP_16_CRC");
            write("[2] ... ESP_Antrieb_Anf");
            write("[3] ... ESP_Eingriffsmoment");
            write("[4] ... ESP_KD_OBD_Fehler");
            write("[5] ... ESP_KD_OBD_Readiness");
            write("[6] ... ESP_Pedalweg_Bremse");
            write("[7] ... ESP_Reku_Anf");
            write("[8] ... ESP_Reku_Index");
        }
        break;
        case FRM_HANDLE_ESP_K_10:
        {
            write("[0] ... ESP_10_BZ");
            write("[1] ... ESP_10_CRC");
            write("[2] ... ESP_HL_Fahrtrichtung");
            write("[3] ... ESP_HR_Fahrtrichtung");
            write("[4] ... ESP_QBit_Wegimpuls_HL");
            write("[5] ... ESP_QBit_Wegimpuls_HR");
            write("[6] ... ESP_QBit_Wegimpuls_VL");
            write("[7] ... ESP_QBit_Wegimpuls_VR");
            write("[8] ... ESP_VL_Fahrtrichtung");
            write("[9] ... ESP_VR_Fahrtrichtung");
            write("[10] ... ESP_Wegimpuls_HL");
            write("[11] ... ESP_Wegimpuls_HR");
            write("[12] ... ESP_Wegimpuls_VL");
            write("[13] ... ESP_Wegimpuls_VR");
        }
        break;
        case FRM_HANDLE_Einheiten_01:
        {
            write("[0] ... KBI_Einheit_Datum");
            write("[1] ... KBI_Einheit_Druck");
            write("[2] ... KBI_Einheit_Sprache");
            write("[3] ... KBI_Einheit_Streckenanz");
            write("[4] ... KBI_Einheit_Temp");
            write("[5] ... KBI_Einheit_Uhrzeit");
            write("[6] ... KBI_Einheit_Verbrauch");
            write("[7] ... KBI_Einheit_Volumen");
            write("[8] ... KBI_MFA_v_Einheit_02");
        }
        break;
        case FRM_HANDLE_Fahrwerk_02:
        {
            write("[0] ... FA_MSG_Einschraenkung");
            write("[1] ... Fahrwerk_02_BZ");
            write("[2] ... Fahrwerk_02_CHK");
        }
        break;
        case FRM_HANDLE_GW_Fwk_01_Ant_PAG:
        {
            write("[0] ... ESP_Gierrate_Offset");
            write("[1] ... ESP_Rollenmodus");
            write("[2] ... FAS_Status_Anzeige");
            write("[3] ... FSM_Status");
            write("[4] ... F_ESP_11_Ant");
            write("[5] ... F_ESP_13_Ant");
            write("[6] ... F_Getriebe_07_PAG_Fwk");
            write("[7] ... F_Klima_03_Fwk_Ant");
            write("[8] ... F_Klima_08_PAG_Fwk");
            write("[9] ... F_LS_01_Fwk");
            write("[10] ... F_TSK_03_Fwk");
            write("[11] ... F_Wischer_01_Fwk");
            write("[12] ... GE_Getriebestatus");
            write("[13] ... KL_AussenTemp_WK");
            write("[14] ... KL_Magnetventil");
            write("[15] ... KL_Niv_down");
            write("[16] ... KL_Niv_up");
            write("[17] ... KL_T_Abgasklappe");
            write("[18] ... KL_T_HDC");
            write("[19] ... KL_T_PASM_1");
            write("[20] ... KL_T_PASM_2");
            write("[21] ... KL_T_PASM_3");
            write("[22] ... KL_T_PSM_off");
            write("[23] ... LS_Fehler");
            write("[24] ... LS_Tip_Hoch");
            write("[25] ... LS_Tip_Runter");
            write("[26] ... TV_Eingriff");
            write("[27] ... Wischer_vorne_Normal");
            write("[28] ... Wischer_vorne_Schnell");
        }
        break;
        case FRM_HANDLE_Gateway_05:
        {
            write("[0] ... BCM1_01_alt");
            write("[1] ... BCM1_02_alt");
            write("[2] ... BCM1_Adaptive_Lichtvert_Anf");
            write("[3] ... BCM1_Aussen_Temp_ungef");
            write("[4] ... BCM1_Gleitende_Leuchtw_Anf");
            write("[5] ... BCM1_MH_WIV_Schalter");
            write("[6] ... BCM1_OBD_FStatus_ATemp");
            write("[7] ... BCM1_Oeldruck_Schalter");
            write("[8] ... BCM1_Oeldruck_Schalter_2");
            write("[9] ... BCM1_RFahrlicht_Fzg_Anf");
            write("[10] ... BCM1_Rueckfahrlicht_Schalter");
            write("[11] ... BCM1_Schalter_StartStopp");
            write("[12] ... BCM1_Vorwaertsgang_eingelegt");
            write("[13] ... BT_Tuer_geoeffnet");
            write("[14] ... ESP_07_alt");
            write("[15] ... ESP_Codierung_ADS");
            write("[16] ... FA_StartStopp_Info");
            write("[17] ... FT_Sperrklinke");
            write("[18] ... FT_Tuer_geoeffnet");
            write("[19] ... Fahrwerk_02_alt");
            write("[20] ... GW_05_va_27");
            write("[21] ... HL_Tuer_geoeffnet");
            write("[22] ... HR_Tuer_geoeffnet");
            write("[23] ... KL_HSH_ein_Soll");
            write("[24] ... KL_Zuheizer_Freigabe");
            write("[25] ... Klima_02_alt");
            write("[26] ... Klima_Sensor_02_alt");
            write("[27] ... MO_Handshake_STH");
            write("[28] ... MO_Status_Normalbetrieb_01");
            write("[29] ... Motor_02_alt");
            write("[30] ... Motor_05_alt");
            write("[31] ... PH_StartStopp_Info");
            write("[32] ... Parkhilfe_01_alt");
            write("[33] ... QSP_01_alt");
            write("[34] ... QSP_StartStopp_Info");
            write("[35] ... TSG_BT_1_alt");
            write("[36] ... TSG_FT_1_alt");
            write("[37] ... TSG_HL_1_alt");
            write("[38] ... TSG_HR_1_alt");
            write("[39] ... Wischer_01_alt");
            write("[40] ... Wischer_vorne_aktiv");
        }
        break;
        case FRM_HANDLE_Gateway_11:
        {
            write("[0] ... BCM1_01_alt");
            write("[1] ... BCM1_02_alt");
            write("[2] ... BCM1_04_alt");
            write("[3] ... BCM1_Allwetterlicht_Anf");
            write("[4] ... BCM1_LDS_Stellung");
            write("[5] ... BCM1_Licht_Dunkelheit_aktiv");
            write("[6] ... BCM1_Linksverkehr");
            write("[7] ... BCM1_MH_Schalter");
            write("[8] ... BCM1_Touristen_Licht_Anf");
            write("[9] ... BCM2_02_alt");
            write("[10] ... BCM2_P_verriegelt");
            write("[11] ... BCM_Tankwunsch");
            write("[12] ... BH_Blinker_li");
            write("[13] ... BH_Blinker_re");
            write("[14] ... BH_Fernlicht");
            write("[15] ... BH_Lichthupe");
            write("[16] ... BM_Autobahn");
            write("[17] ... ESP_04_alt");
            write("[18] ... ESP_Diagnose");
            write("[19] ... GW_11_va_20");
            write("[20] ... GW_11_va_21");
            write("[21] ... GW_11_va_22");
            write("[22] ... GW_11_va_23");
            write("[23] ... GW_11_va_24");
            write("[24] ... GW_11_va_25");
            write("[25] ... GW_11_va_26");
            write("[26] ... GW_11_va_27");
            write("[27] ... HUD_01_alt");
            write("[28] ... HUD_Anzeigefehler_NV");
            write("[29] ... HUD_NV_in_Anzeige");
            write("[30] ... HYB_Anf_E_Mode");
            write("[31] ... HYB_Anf_E_Mode_alt");
            write("[32] ... LV_AFL_aktiv_Anzeige");
            write("[33] ... LV_Abblendlicht_Anzeige");
            write("[34] ... LV_Abblendlicht_li_def");
            write("[35] ... LV_Abblendlicht_re_def");
            write("[36] ... LV_Nebelschlusslicht_Anzeige");
            write("[37] ... SMLS_01_alt");
            write("[38] ... ZV_Tankklappenstatus");
        }
        break;
        case FRM_HANDLE_Getriebe_01:
        {
            write("[0] ... GE_Freig_MMom_Vorhalt");
            write("[1] ... GE_Freig_Mmom_Soll");
            write("[2] ... GE_Freig_Mom_Eingriff");
            write("[3] ... GE_KD_Fehler");
            write("[4] ... GE_MMom_Soll");
            write("[5] ... GE_MMom_Status");
            write("[6] ... GE_MMom_Vorhalt");
            write("[7] ... GE_Mom_Ident");
            write("[8] ... GE_Mom_MZP");
            write("[9] ... GE_Schaltvorgang");
            write("[10] ... GE_Status_Kupplung");
            write("[11] ... GE_Status_Schaltablauf");
            write("[12] ... GE_Verbot_Ausblendung");
            write("[13] ... GE_Zeit_MZP");
            write("[14] ... Getriebe_01_BZ");
            write("[15] ... Getriebe_01_CHK");
        }
        break;
        case FRM_HANDLE_Getriebe_02:
        {
            write("[0] ... GE_Anf_Zylabsch");
            write("[1] ... GE_Anheb_Solldrehz_Leerlauf");
            write("[2] ... GE_Drehzahlmesser_Daempfung");
            write("[3] ... GE_Freigabe_Synchro");
            write("[4] ... GE_HYB_DZ_Eingriff");
            write("[5] ... GE_Mom_Begr_Gradient");
            write("[6] ... GE_Schubabschalt_Unt");
            write("[7] ... GE_Synchro_Wunschdrehz");
            write("[8] ... GE_Synchro_Zeit");
            write("[9] ... GE_Vorsteuermoment");
            write("[10] ... Getriebe_02_BZ");
            write("[11] ... Getriebe_02_CHK");
        }
        break;
        case FRM_HANDLE_Getriebe_03:
        {
            write("[0] ... GE_Codierung_MSG");
            write("[1] ... GE_Eingangsdrehz");
            write("[2] ... GE_Freig_Langfr_Schutzmom");
            write("[3] ... GE_Langfr_Schutzmom");
            write("[4] ... GE_Notlauf");
            write("[5] ... GE_Performance_Start_LB");
            write("[6] ... GE_StartStopp_Info");
            write("[7] ... GE_Uefkt");
            write("[8] ... GE_Waehlhebel");
            write("[9] ... GE_Zielgang");
            write("[10] ... GE_reserv_Waehlhebel");
            write("[11] ... Getriebe_03_BZ");
            write("[12] ... Getriebe_03_CHK");
        }
        break;
        case FRM_HANDLE_Getriebe_04:
        {
            write("[0] ... GE_Charisma_FahrPr");
            write("[1] ... GE_Charisma_Status");
            write("[2] ... GE_Charisma_Umschaltung");
            write("[3] ... GE_Freigabe_Verfallsinfo_WFS");
            write("[4] ... GE_Grenzkriechmoment");
            write("[5] ... GE_Heizwunsch");
            write("[6] ... GE_Index_Fahrwid");
            write("[7] ... GE_LFR_Adaption");
            write("[8] ... GE_OBD_AbsperrVent");
            write("[9] ... GE_OBD_Status");
            write("[10] ... GE_Sumpftemperatur");
            write("[11] ... GE_Verlustmoment");
            write("[12] ... GE_amax_moeglich");
        }
        break;
        case FRM_HANDLE_Kessy_02:
        {
            write("[0] ... FBS_KD_Fehler");
            write("[1] ... FBS_Prio_Warn_04");
            write("[2] ... FBS_Prio_Warn_05");
            write("[3] ... FBS_Warn_LenkVerriegelung_def");
            write("[4] ... FBS_Warn_Lenkung_def");
            write("[5] ... FBS_Warn_Schluessel_Batt");
            write("[6] ... KYL_Warn_Kessy_defekt");
            write("[7] ... KYL_Warn_kein_Schuessel");
            write("[8] ... KY_ELV_enable_Anforderung");
            write("[9] ... KY_ELV_entr");
            write("[10] ... KY_ELV_verr");
            write("[11] ... KY_FBS_Fahrer_Hinweise");
            write("[12] ... KY_FFB_Frequenz");
            write("[13] ... KY_Funkschl_Nr");
            write("[14] ... KY_HF_Aktiv");
            write("[15] ... KY_ID_Geb_autorisiert");
            write("[16] ... KY_ID_Geb_steckt");
            write("[17] ... KY_KYL_Fahrer_Hinweise");
            write("[18] ... KY_KYL_Prio_Warn_03");
            write("[19] ... KY_KYL_Prio_Warn_04");
            write("[20] ... KY_KYL_Prio_Warn_05");
            write("[21] ... KY_Keyless_Verbau");
            write("[22] ... KY_LF_Aktiv");
            write("[23] ... KY_Schluessel_Ist");
            write("[24] ... KY_Schluessel_Soll");
            write("[25] ... KY_StartStopp_Info");
            write("[26] ... KY_Valet_Parking");
            write("[27] ... KY_WFS_LZ");
            write("[28] ... KY_WFS_Safe");
        }
        break;
        case FRM_HANDLE_Klemmen_Status_01:
        {
            write("[0] ... Klemmen_Status_01_BZ");
            write("[1] ... Klemmen_Status_01_CHK");
            write("[2] ... ZAS_Kl_15");
            write("[3] ... ZAS_Kl_50");
            write("[4] ... ZAS_Kl_S");
            write("[5] ... ZAS_Kl_X");
        }
        break;
        case FRM_HANDLE_Klima_01:
        {
            write("[0] ... KL_4_Zonen");
            write("[1] ... KL_AC_Schalter");
            write("[2] ... KL_Anf_KL");
            write("[3] ... KL_Charisma_FahrPr");
            write("[4] ... KL_Charisma_Status");
            write("[5] ... KL_Charisma_Umschaltung");
            write("[6] ... KL_Comp_enable");
            write("[7] ... KL_Comp_rev_rq");
            write("[8] ... KL_Diag_Absperrvent");
            write("[9] ... KL_Drehz_Anh");
            write("[10] ... KL_Handshake_BEM");
            write("[11] ... KL_KD_Fehler");
            write("[12] ... KL_Komp_Moment_alt");
            write("[13] ... KL_Last_Kompr");
            write("[14] ... KL_Leistung_Hzg_Soll");
            write("[15] ... KL_StartStopp_Info");
            write("[16] ... KL_Thermomanagement");
            write("[17] ... KL_Vorwarn_HFS_ein");
            write("[18] ... KL_Vorwarn_HHS_ein");
            write("[19] ... KL_Vorwarn_Komp_ein");
            write("[20] ... KL_Vorwarn_Zuheizer_ein");
            write("[21] ... KL_Zustand");
            write("[22] ... KL_el_Zuheizer_Stufe");
        }
        break;
        case FRM_HANDLE_Kombi_01:
        {
            write("[0] ... KBI_ABS_Lampe");
            write("[1] ... KBI_Airbag_Lampe");
            write("[2] ... KBI_Anzeigefehler_LDW");
            write("[3] ... KBI_Anzeigefehler_SWA");
            write("[4] ... KBI_BKL_Lampe");
            write("[5] ... KBI_ESP_Lampe");
            write("[6] ... KBI_Einheit_Tacho");
            write("[7] ... KBI_Fehler_Anzeige_ACC");
            write("[8] ... KBI_Handbremse");
            write("[9] ... KBI_KD_Fehler");
            write("[10] ... KBI_Konsistenz_ACC");
            write("[11] ... KBI_Lenkung_Lampe");
            write("[12] ... KBI_MFA_v_Einheit_01");
            write("[13] ... KBI_Oeldruck_Schalter");
            write("[14] ... KBI_Oeldruckwarnung");
            write("[15] ... KBI_SILA_gueltig");
            write("[16] ... KBI_Tankwarnung");
            write("[17] ... KBI_Variante_USA");
            write("[18] ... KBI_Vorglueh_System_Lampe");
            write("[19] ... KBI_angez_Geschw");
            write("[20] ... KBI_im_Stellgliedtest");
        }
        break;
        case FRM_HANDLE_Kombi_02:
        {
            write("[0] ... KBI_Aussen_Temp_gef");
            write("[1] ... KBI_FStatus_Tank");
            write("[2] ... KBI_Inhalt_Tank");
            write("[3] ... KBI_Kilometerstand");
            write("[4] ... KBI_Oelwechsel_durchgefuehrt");
            write("[5] ... KBI_QBit_Aussen_Temp_gef");
            write("[6] ... KBI_Reset_Standzeit");
            write("[7] ... KBI_Standzeit");
        }
        break;
        case FRM_HANDLE_Kombi_03:
        {
            write("[0] ... KBI_Reifenumfang");
        }
        break;
        case FRM_HANDLE_LH_EPS_02:
        {
            write("[0] ... EPS_02_BZ");
            write("[1] ... EPS_02_CRC");
            write("[2] ... EPS_Drehzahlreserve");
            write("[3] ... EPS_Lastinfo");
            write("[4] ... EPS_Leistungsanforderung");
            write("[5] ... EPS_Motorstartverzoegerung");
            write("[6] ... EPS_Notlauf");
            write("[7] ... EPS_StartStopp_Info");
            write("[8] ... EPS_Unterstuetzungsleistung");
            write("[9] ... EPS_VZ_Drehzahlreserve");
        }
        break;
        case FRM_HANDLE_LS_01:
        {
            write("[0] ... LS_01_BZ");
            write("[1] ... LS_01_CHK");
            write("[2] ... LS_Abbrechen");
            write("[3] ... LS_Codierung");
            write("[4] ... LS_Fehler");
            write("[5] ... LS_GRA_ACC_2stufig");
            write("[6] ... LS_Hauptschalter");
            write("[7] ... LS_Limiter");
            write("[8] ... LS_Tip_Hoch");
            write("[9] ... LS_Tip_Runter");
            write("[10] ... LS_Tip_Setzen");
            write("[11] ... LS_Tip_Stufe_2");
            write("[12] ... LS_Tip_Wiederaufnahme");
            write("[13] ... LS_Tiptronic_Fehler");
            write("[14] ... LS_Typ_Hauptschalter");
            write("[15] ... LS_Verstellung_Zeitluecke");
            write("[16] ... MFL_Tip_Down");
            write("[17] ... MFL_Tip_Up");
        }
        break;
        case FRM_HANDLE_LWI_01:
        {
            write("[0] ... LWI_01_BZ");
            write("[1] ... LWI_01_CHK");
            write("[2] ... LWI_01_CRC");
            write("[3] ... LWI_Lenkradw_Geschw");
            write("[4] ... LWI_Lenkradwinkel");
            write("[5] ... LWI_QBit_Lenkradwinkel");
            write("[6] ... LWI_QBit_Sub_Daten");
            write("[7] ... LWI_Sensorstatus");
            write("[8] ... LWI_Sub_Daten");
            write("[9] ... LWI_VZ_Lenkradw_Geschw");
            write("[10] ... LWI_VZ_Lenkradwinkel");
        }
        break;
        case FRM_HANDLE_Licht_hinten_01:
        {
            write("[0] ... BCM2_Bremsl_durch_ECD");
            write("[1] ... LH_3_Bremsl_def");
            write("[2] ... LH_Aussenlicht_def");
            write("[3] ... LH_Blinker_HL_akt");
            write("[4] ... LH_Blinker_HR_akt");
            write("[5] ... LH_Blinker_li_def");
            write("[6] ... LH_Blinker_re_def");
            write("[7] ... LH_Brems_Blk_li_def");
            write("[8] ... LH_Brems_Blk_re_def");
            write("[9] ... LH_Bremsl_li_def");
            write("[10] ... LH_Bremsl_li_ges_def");
            write("[11] ... LH_Bremsl_re_def");
            write("[12] ... LH_Bremsl_re_ges_def");
            write("[13] ... LH_Bremslicht_H_aktiv");
            write("[14] ... LH_Kennzl_def");
            write("[15] ... LH_Nebel_li_def");
            write("[16] ... LH_Nebel_mi_def");
            write("[17] ... LH_Nebel_re_def");
            write("[18] ... LH_Nebelschluss_aktiv");
            write("[19] ... LH_Parklicht_HL_aktiv");
            write("[20] ... LH_Parklicht_HR_aktiv");
            write("[21] ... LH_Rueckf_li_def");
            write("[22] ... LH_Rueckf_mi_def");
            write("[23] ... LH_Rueckf_re_def");
            write("[24] ... LH_Rueckfahrlicht_aktiv");
            write("[25] ... LH_SL_BRL_BLK_li_def");
            write("[26] ... LH_SL_BRL_BLK_re_def");
            write("[27] ... LH_Schluss_Brems_li_def");
            write("[28] ... LH_Schluss_Brems_re_def");
            write("[29] ... LH_Schluss_Nebel_li_def");
            write("[30] ... LH_Schluss_Nebel_re_def");
            write("[31] ... LH_Schlusslicht_li_def");
            write("[32] ... LH_Schlusslicht_re_def");
            write("[33] ... LH_Standlicht_H_aktiv");
            write("[34] ... Licht_hinten_01_BZ");
        }
        break;
        case FRM_HANDLE_NMH_Gateway:
        {
            write("[0] ... NMH_GW_ACAN");
            write("[1] ... NMH_GW_Abschaltstufe_3");
            write("[2] ... NMH_GW_Abschaltstufe_aktiv");
            write("[3] ... NMH_GW_CAN_Diag_deaktiv");
            write("[4] ... NMH_GW_Car_WakeUp");
            write("[5] ... NMH_GW_Eindraht_Fehler");
            write("[6] ... NMH_GW_Fkt_WakeUp");
            write("[7] ... NMH_GW_Infotainment");
            write("[8] ... NMH_GW_KombiCAN");
            write("[9] ... NMH_GW_KomfortCAN");
            write("[10] ... NMH_GW_KompSchutz");
            write("[11] ... NMH_GW_Mute_Mode");
            write("[12] ... NMH_GW_NM_aktiv_BDM");
            write("[13] ... NMH_GW_NM_aktiv_Diagnose");
            write("[14] ... NMH_GW_NM_aktiv_ESP");
            write("[15] ... NMH_GW_NM_aktiv_Klemme_15");
            write("[16] ... NMH_GW_NM_aktiv_Start");
            write("[17] ... NMH_GW_NM_aktiv_Warnblinken");
            write("[18] ... NMH_GW_Normal_Mode_1");
            write("[19] ... NMH_GW_Normal_Mode_2");
            write("[20] ... NMH_GW_Per_WakeUp");
            write("[21] ... NMH_GW_SG_Fehlerdauer");
            write("[22] ... NMH_GW_STH_Wakeup");
            write("[23] ... NMH_GW_Start_1");
            write("[24] ... NMH_GW_Start_2");
            write("[25] ... NMH_GW_TimeOut_Fehler");
            write("[26] ... NMH_GW_Transport_Mode");
            write("[27] ... NMH_GW_WakeUp_CAN_Bus");
        }
        break;
        case FRM_HANDLE_OBD_Tankgeber_01:
        {
            write("[0] ... OBD_TG_F_Status_1");
            write("[1] ... OBD_TG_F_Status_2");
            write("[2] ... OBD_TG_F_Status_3");
            write("[3] ... OBD_TG_F_Status_4");
            write("[4] ... OBD_TG_Sens_Rohwert_1");
            write("[5] ... OBD_TG_Sens_Rohwert_2");
            write("[6] ... OBD_TG_Sens_Rohwert_3");
            write("[7] ... OBD_TG_Sens_Rohwert_4");
        }
        break;
        case FRM_HANDLE_SCR_01:
        {
            write("[0] ... SCR_01_BZ");
            write("[1] ... SCR_Dosierpumpe_Drehzahl");
            write("[2] ... SCR_Druck");
            write("[3] ... SCR_Level_Aktivtank");
            write("[4] ... SCR_Level_Passivtank");
        }
        break;
        case FRM_HANDLE_SCR_02:
        {
            write("[0] ... SCR_02_BZ");
            write("[1] ... SCR_Guetesensor");
            write("[2] ... SCR_Heizkreis_3_Strom");
            write("[3] ... SCR_KD_Fehler");
            write("[4] ... SCR_Leitungsheizung_Strom");
            write("[5] ... SCR_Tankheizung_Strom");
            write("[6] ... SCR_Temp_Aktivtank");
            write("[7] ... SCR_Temp_Passivtank");
            write("[8] ... SCR_Transferpumpe_Strom");
        }
        break;
        case FRM_HANDLE_SCR_03:
        {
            write("[0] ... SCR_03_BZ");
            write("[1] ... SCR_Dosierpumpe_Status_Spule");
            write("[2] ... SCR_Druck_Status");
            write("[3] ... SCR_Guetesensor_Status");
            write("[4] ... SCR_Heizkreis_3_Status");
            write("[5] ... SCR_Leitungsheizung_Status");
            write("[6] ... SCR_Level_Aktivtank_Status");
            write("[7] ... SCR_Level_Passivtank_Status");
            write("[8] ... SCR_Spannungsversorgung_Status");
            write("[9] ... SCR_Tankheizung_Status");
            write("[10] ... SCR_Temp_Aktivtank_Status");
            write("[11] ... SCR_Temp_Passivtank_Status");
            write("[12] ... SCR_Transferpumpe_Status");
            write("[13] ... SCR_VersorgungSensoren_Status");
        }
        break;
        case FRM_HANDLE_SCR_04:
        {
            write("[0] ... SCR_04_BZ");
            write("[1] ... SCR_Ansteuerung_Dosierpumpe");
            write("[2] ... SCR_Ansteuerung_Heizkreis_3");
            write("[3] ... SCR_Ansteuerung_Leitungsheizung");
            write("[4] ... SCR_Ansteuerung_Tankheizung");
            write("[5] ... SCR_Ansteuerung_Transferpumpe");
            write("[6] ... SCR_CAL_CVN_CRC_32");
        }
        break;
        case FRM_HANDLE_SCR_05:
        {
            write("[0] ... SCR_05_BZ");
            write("[1] ... SCR_Steuergeraet_Bus_Status");
            write("[2] ... SCR_Steuergeraet_Codierung_Status");
            write("[3] ... SCR_Steuergeraet_Datensatz_Status");
            write("[4] ... SCR_Steuergeraet_Defekt_Status");
            write("[5] ... SCR_Steuergeraet_Heizung_Status");
            write("[6] ... SCR_Steuergeraet_Pumpe_Status");
            write("[7] ... SCR_Steuergeraet_Relais_Status");
        }
        break;
        case FRM_HANDLE_SCR_CAL_ID1:
        {
            write("[0] ... SCR_CAL_ID_Index_01");
            write("[1] ... SCR_CAL_ID_Index_02");
            write("[2] ... SCR_CAL_ID_Index_03");
            write("[3] ... SCR_CAL_ID_Index_04");
            write("[4] ... SCR_CAL_ID_Index_05");
            write("[5] ... SCR_CAL_ID_Index_06");
            write("[6] ... SCR_CAL_ID_Index_07");
            write("[7] ... SCR_CAL_ID_Index_08");
        }
        break;
        case FRM_HANDLE_SCR_CAL_ID2:
        {
            write("[0] ... SCR_CAL_ID_Index_09");
            write("[1] ... SCR_CAL_ID_Index_10");
            write("[2] ... SCR_CAL_ID_Index_11");
            write("[3] ... SCR_CAL_ID_Index_12");
            write("[4] ... SCR_CAL_ID_Index_13");
            write("[5] ... SCR_CAL_ID_Index_14");
            write("[6] ... SCR_CAL_ID_Index_15");
            write("[7] ... SCR_CAL_ID_Index_16");
        }
        break;
        case FRM_HANDLE_SCU_01:
        {
            write("[0] ... SCU_01_BZ");
            write("[1] ... SCU_01_CHK");
            write("[2] ... SCU_01_CRC");
            write("[3] ... SCU_KD_Fehler");
            write("[4] ... SCU_Soll_Ue_Winkel");
            write("[5] ... SCU_Status");
            write("[6] ... SCU_Ue_Winkel_ADS");
            write("[7] ... SCU_VZ_Soll_Ue_Winkel");
            write("[8] ... SCU_VZ_Ue_Winkel_ADS");
            write("[9] ... SCU_max_Gradient");
        }
        break;
        case FRM_HANDLE_STH_01:
        {
            write("[0] ... STH_EKP_Anst");
            write("[1] ... STH_Fehler_ElWaPu");
            write("[2] ... STH_Fehlerstatus");
            write("[3] ... STH_Funk_aus");
            write("[4] ... STH_Funk_ein");
            write("[5] ... STH_Geblaese");
            write("[6] ... STH_Heizleistung");
            write("[7] ... STH_KD_Fehler");
            write("[8] ... STH_KVS");
            write("[9] ... STH_KVS_Ueberlauf");
            write("[10] ... STH_LED");
            write("[11] ... STH_Motorvorwaermung");
            write("[12] ... STH_Pumpe_ein");
            write("[13] ... STH_Pumpen_Anf_extern");
            write("[14] ... STH_Servicemode");
            write("[15] ... STH_Ventil_Status");
            write("[16] ... STH_Ventiloeffnungszeit");
            write("[17] ... STH_Waermeeintrag");
            write("[18] ... STH_Wassertemp");
            write("[19] ... STH_Zusatzheizung");
            write("[20] ... STH_war_aktiv");
        }
        break;
        case FRM_HANDLE_STS_01:
        {
            write("[0] ... STS_01_BZ");
            write("[1] ... STS_01_CHK");
            write("[2] ... STS_Alarm_Blinker");
            write("[3] ... STS_Anlassersperre");
            write("[4] ... STS_Car_not_under_theft");
            write("[5] ... STS_Car_under_theft");
            write("[6] ... STS_Fahrlicht");
            write("[7] ... STS_KD_Fehler");
            write("[8] ... STS_LIN_aktiv");
            write("[9] ... STS_Laderelais");
            write("[10] ... STS_Leerlaufschaltung");
            write("[11] ... STS_Notstart");
            write("[12] ... STS_Signalhorn");
            write("[13] ... STS_Standlicht");
            write("[14] ... STS_Summer");
            write("[15] ... STS_Typencodierung");
        }
        break;
        case FRM_HANDLE_Systeminfo_01:
        {
            write("[0] ... GW_KD_Fehler");
            write("[1] ... SI_CAN_Antrieb_Sleep");
            write("[2] ... SI_CAN_Dashboard_Sleep");
            write("[3] ... SI_CAN_Extended_Sleep");
            write("[4] ... SI_CAN_Fahrwerk_Sleep");
            write("[5] ... SI_CAN_Komfort_Sleep");
            write("[6] ... SI_Diagnose_Aktiv");
            write("[7] ... SI_Fahrwerk_Sleep");
            write("[8] ... SI_Infotainment_Sleep");
            write("[9] ... SI_Int_CAN_gespiegelt");
            write("[10] ... SI_MOST_Status");
            write("[11] ... SI_MO_WU");
            write("[12] ... SI_NWDF");
            write("[13] ... SI_NWDF_gueltig");
            write("[14] ... SI_QRS_Mode");
            write("[15] ... SI_Sammel_SG_Fehler");
            write("[16] ... SI_Sammelfehler");
            write("[17] ... SI_T_Mode");
        }
        break;

    }
}

/*@@caplFunc:HelpSignal():*/
HelpSignal ()
{
    //REPLACE_HELP_SIGNAL
}
/*@@end*/

/*@@caplFunc:GetFrameName(int):*/
GetFrameName (int FrmIdx)
{
    switch (FrmIdx)
    {
        case FRM_HANDLE_ACC_01:
            strncpy(CaplCtrl_FrameName, "ACC_01", 7);
            break;
        case FRM_HANDLE_ACC_05:
            strncpy(CaplCtrl_FrameName, "ACC_05", 7);
            break;
        case FRM_HANDLE_Airbag_01:
            strncpy(CaplCtrl_FrameName, "Airbag_01", 10);
            break;
        case FRM_HANDLE_Airbag_02:
            strncpy(CaplCtrl_FrameName, "Airbag_02", 10);
            break;
        case FRM_HANDLE_Allrad_02:
            strncpy(CaplCtrl_FrameName, "Allrad_02", 10);
            break;
        case FRM_HANDLE_Anhaenger_01:
            strncpy(CaplCtrl_FrameName, "Anhaenger_01", 13);
            break;
        case FRM_HANDLE_BEM_01:
            strncpy(CaplCtrl_FrameName, "BEM_01", 7);
            break;
        case FRM_HANDLE_Charisma_01:
            strncpy(CaplCtrl_FrameName, "Charisma_01", 12);
            break;
        case FRM_HANDLE_Diagnose_01:
            strncpy(CaplCtrl_FrameName, "Diagnose_01", 12);
            break;
        case FRM_HANDLE_EPB_01:
            strncpy(CaplCtrl_FrameName, "EPB_01", 7);
            break;
        case FRM_HANDLE_ESP_01:
            strncpy(CaplCtrl_FrameName, "ESP_01", 7);
            break;
        case FRM_HANDLE_ESP_02:
            strncpy(CaplCtrl_FrameName, "ESP_02", 7);
            break;
        case FRM_HANDLE_ESP_03:
            strncpy(CaplCtrl_FrameName, "ESP_03", 7);
            break;
        case FRM_HANDLE_ESP_05:
            strncpy(CaplCtrl_FrameName, "ESP_05", 7);
            break;
        case FRM_HANDLE_ESP_07_FR:
            strncpy(CaplCtrl_FrameName, "ESP_07_FR", 10);
            break;
        case FRM_HANDLE_ESP_16:
            strncpy(CaplCtrl_FrameName, "ESP_16", 7);
            break;
        case FRM_HANDLE_ESP_K_10:
            strncpy(CaplCtrl_FrameName, "ESP_K_10", 9);
            break;
        case FRM_HANDLE_Einheiten_01:
            strncpy(CaplCtrl_FrameName, "Einheiten_01", 13);
            break;
        case FRM_HANDLE_Fahrwerk_02:
            strncpy(CaplCtrl_FrameName, "Fahrwerk_02", 12);
            break;
        case FRM_HANDLE_GW_Fwk_01_Ant_PAG:
            strncpy(CaplCtrl_FrameName, "GW_Fwk_01_Ant_PAG", 18);
            break;
        case FRM_HANDLE_Gateway_05:
            strncpy(CaplCtrl_FrameName, "Gateway_05", 11);
            break;
        case FRM_HANDLE_Gateway_11:
            strncpy(CaplCtrl_FrameName, "Gateway_11", 11);
            break;
        case FRM_HANDLE_Getriebe_01:
            strncpy(CaplCtrl_FrameName, "Getriebe_01", 12);
            break;
        case FRM_HANDLE_Getriebe_02:
            strncpy(CaplCtrl_FrameName, "Getriebe_02", 12);
            break;
        case FRM_HANDLE_Getriebe_03:
            strncpy(CaplCtrl_FrameName, "Getriebe_03", 12);
            break;
        case FRM_HANDLE_Getriebe_04:
            strncpy(CaplCtrl_FrameName, "Getriebe_04", 12);
            break;
        case FRM_HANDLE_Kessy_02:
            strncpy(CaplCtrl_FrameName, "Kessy_02", 9);
            break;
        case FRM_HANDLE_Klemmen_Status_01:
            strncpy(CaplCtrl_FrameName, "Klemmen_Status_01", 18);
            break;
        case FRM_HANDLE_Klima_01:
            strncpy(CaplCtrl_FrameName, "Klima_01", 9);
            break;
        case FRM_HANDLE_Kombi_01:
            strncpy(CaplCtrl_FrameName, "Kombi_01", 9);
            break;
        case FRM_HANDLE_Kombi_02:
            strncpy(CaplCtrl_FrameName, "Kombi_02", 9);
            break;
        case FRM_HANDLE_Kombi_03:
            strncpy(CaplCtrl_FrameName, "Kombi_03", 9);
            break;
        case FRM_HANDLE_LH_EPS_02:
            strncpy(CaplCtrl_FrameName, "LH_EPS_02", 10);
            break;
        case FRM_HANDLE_LS_01:
            strncpy(CaplCtrl_FrameName, "LS_01", 6);
            break;
        case FRM_HANDLE_LWI_01:
            strncpy(CaplCtrl_FrameName, "LWI_01", 7);
            break;
        case FRM_HANDLE_Licht_hinten_01:
            strncpy(CaplCtrl_FrameName, "Licht_hinten_01", 16);
            break;
        case FRM_HANDLE_NMH_Gateway:
            strncpy(CaplCtrl_FrameName, "NMH_Gateway", 12);
            break;
        case FRM_HANDLE_OBD_Tankgeber_01:
            strncpy(CaplCtrl_FrameName, "OBD_Tankgeber_01", 17);
            break;
        case FRM_HANDLE_SCR_01:
            strncpy(CaplCtrl_FrameName, "SCR_01", 7);
            break;
        case FRM_HANDLE_SCR_02:
            strncpy(CaplCtrl_FrameName, "SCR_02", 7);
            break;
        case FRM_HANDLE_SCR_03:
            strncpy(CaplCtrl_FrameName, "SCR_03", 7);
            break;
        case FRM_HANDLE_SCR_04:
            strncpy(CaplCtrl_FrameName, "SCR_04", 7);
            break;
        case FRM_HANDLE_SCR_05:
            strncpy(CaplCtrl_FrameName, "SCR_05", 7);
            break;
        case FRM_HANDLE_SCR_CAL_ID1:
            strncpy(CaplCtrl_FrameName, "SCR_CAL_ID1", 12);
            break;
        case FRM_HANDLE_SCR_CAL_ID2:
            strncpy(CaplCtrl_FrameName, "SCR_CAL_ID2", 12);
            break;
        case FRM_HANDLE_SCU_01:
            strncpy(CaplCtrl_FrameName, "SCU_01", 7);
            break;
        case FRM_HANDLE_STH_01:
            strncpy(CaplCtrl_FrameName, "STH_01", 7);
            break;
        case FRM_HANDLE_STS_01:
            strncpy(CaplCtrl_FrameName, "STS_01", 7);
            break;
        case FRM_HANDLE_Systeminfo_01:
            strncpy(CaplCtrl_FrameName, "Systeminfo_01", 14);
            break;
    }
}
/*@@end*/

/*@@caplFunc:GetSignalName(int,int):*/
GetSignalName (int FrmIdx, int SigIdx)
{
    switch (FrmIdx)
    {
        case FRM_HANDLE_ACC_01:
        {
            switch (SigIdx)
            {
                case 0:
                    strncpy(CaplCtrl_SignalName, "ACC_01_BZ", 10);
                    break;
                case 1:
                    strncpy(CaplCtrl_SignalName, "ACC_01_CHK", 11);
                    break;
                case 2:
                    strncpy(CaplCtrl_SignalName, "ACC_Anhalten", 13);
                    break;
                case 3:
                    strncpy(CaplCtrl_SignalName, "ACC_Dynamik", 12);
                    break;
                case 4:
                    strncpy(CaplCtrl_SignalName, "ACC_KD_Fehler", 14);
                    break;
                case 5:
                    strncpy(CaplCtrl_SignalName, "ACC_Minimale_Bremsung", 22);
                    break;
                case 6:
                    strncpy(CaplCtrl_SignalName, "ACC_Sollbeschleunigung", 23);
                    break;
                case 7:
                    strncpy(CaplCtrl_SignalName, "ACC_Status_ACC", 15);
                    break;
                case 8:
                    strncpy(CaplCtrl_SignalName, "ACC_neg_Sollbeschl_Grad", 24);
                    break;
                case 9:
                    strncpy(CaplCtrl_SignalName, "ACC_pos_Sollbeschl_Grad", 24);
                    break;
                case 10:
                    strncpy(CaplCtrl_SignalName, "ACC_zul_Regelabw_oben", 22);
                    break;
                case 11:
                    strncpy(CaplCtrl_SignalName, "ACC_zul_Regelabw_unten", 23);
                    break;
            }
        }
        break;
        case FRM_HANDLE_ACC_05:
        {
            switch (SigIdx)
            {
                case 0:
                    strncpy(CaplCtrl_SignalName, "ACC_05_BZ", 10);
                    break;
                case 1:
                    strncpy(CaplCtrl_SignalName, "ACC_05_CHK", 11);
                    break;
                case 2:
                    strncpy(CaplCtrl_SignalName, "ACC_Anhalten", 13);
                    break;
                case 3:
                    strncpy(CaplCtrl_SignalName, "ACC_Betaetigung_EPB", 20);
                    break;
                case 4:
                    strncpy(CaplCtrl_SignalName, "ACC_Freigabe_Momentenanf", 25);
                    break;
                case 5:
                    strncpy(CaplCtrl_SignalName, "ACC_Momentenanforderung", 24);
                    break;
                case 6:
                    strncpy(CaplCtrl_SignalName, "ACC_StartStopp_Info", 20);
                    break;
                case 7:
                    strncpy(CaplCtrl_SignalName, "ACC_Status_ACC", 15);
                    break;
                case 8:
                    strncpy(CaplCtrl_SignalName, "ACC_limitierte_Anfahrdyn", 25);
                    break;
            }
        }
        break;
        case FRM_HANDLE_Airbag_01:
        {
            switch (SigIdx)
            {
                case 0:
                    strncpy(CaplCtrl_SignalName, "AB_Anzeige_Fussg", 17);
                    break;
                case 1:
                    strncpy(CaplCtrl_SignalName, "AB_Crash_Int", 13);
                    break;
                case 2:
                    strncpy(CaplCtrl_SignalName, "AB_Deaktiviert", 15);
                    break;
                case 3:
                    strncpy(CaplCtrl_SignalName, "AB_Deaktivierung_HV", 20);
                    break;
                case 4:
                    strncpy(CaplCtrl_SignalName, "AB_Diagnose", 12);
                    break;
                case 5:
                    strncpy(CaplCtrl_SignalName, "AB_Erh_Auf_VB", 14);
                    break;
                case 6:
                    strncpy(CaplCtrl_SignalName, "AB_Front_Crash", 15);
                    break;
                case 7:
                    strncpy(CaplCtrl_SignalName, "AB_Gurtwarn_VB", 15);
                    break;
                case 8:
                    strncpy(CaplCtrl_SignalName, "AB_Gurtwarn_VF", 15);
                    break;
                case 9:
                    strncpy(CaplCtrl_SignalName, "AB_Heck_Crash", 14);
                    break;
                case 10:
                    strncpy(CaplCtrl_SignalName, "AB_KD_Fehler", 13);
                    break;
                case 11:
                    strncpy(CaplCtrl_SignalName, "AB_Lampe", 9);
                    break;
                case 12:
                    strncpy(CaplCtrl_SignalName, "AB_Rollover_Crash", 18);
                    break;
                case 13:
                    strncpy(CaplCtrl_SignalName, "AB_SB_Crash", 12);
                    break;
                case 14:
                    strncpy(CaplCtrl_SignalName, "AB_SF_Crash", 12);
                    break;
                case 15:
                    strncpy(CaplCtrl_SignalName, "AB_Stellgliedtest", 18);
                    break;
                case 16:
                    strncpy(CaplCtrl_SignalName, "AB_Systemfehler", 16);
                    break;
                case 17:
                    strncpy(CaplCtrl_SignalName, "AB_VB_deaktiviert", 18);
                    break;
                case 18:
                    strncpy(CaplCtrl_SignalName, "Airbag_01_BZ", 13);
                    break;
                case 19:
                    strncpy(CaplCtrl_SignalName, "Airbag_01_CHK", 14);
                    break;
                case 20:
                    strncpy(CaplCtrl_SignalName, "void_Byte_02", 13);
                    break;
                case 21:
                    strncpy(CaplCtrl_SignalName, "void_Byte_03", 13);
                    break;
            }
        }
        break;
        case FRM_HANDLE_Airbag_02:
        {
            switch (SigIdx)
            {
                case 0:
                    strncpy(CaplCtrl_SignalName, "AB_Belegung_VB", 15);
                    break;
                case 1:
                    strncpy(CaplCtrl_SignalName, "AB_Gurtschloss_BF", 18);
                    break;
                case 2:
                    strncpy(CaplCtrl_SignalName, "AB_Gurtschloss_FA", 18);
                    break;
                case 3:
                    strncpy(CaplCtrl_SignalName, "AB_Gurtschloss_Reihe2_BF", 25);
                    break;
                case 4:
                    strncpy(CaplCtrl_SignalName, "AB_Gurtschloss_Reihe2_FA", 25);
                    break;
                case 5:
                    strncpy(CaplCtrl_SignalName, "AB_Gurtschloss_Reihe2_MI", 25);
                    break;
                case 6:
                    strncpy(CaplCtrl_SignalName, "AB_Gurtschloss_Reihe3_BF", 25);
                    break;
                case 7:
                    strncpy(CaplCtrl_SignalName, "AB_Gurtschloss_Reihe3_FA", 25);
                    break;
                case 8:
                    strncpy(CaplCtrl_SignalName, "AB_Gurtschloss_Reihe3_MI", 25);
                    break;
                case 9:
                    strncpy(CaplCtrl_SignalName, "AB_Sitzpos_Sens_BF", 19);
                    break;
                case 10:
                    strncpy(CaplCtrl_SignalName, "AB_Sitzpos_Sens_FA", 19);
                    break;
            }
        }
        break;
        case FRM_HANDLE_Allrad_02:
        {
            switch (SigIdx)
            {
                case 0:
                    strncpy(CaplCtrl_SignalName, "ALR_Begrenzungsmoment", 22);
                    break;
                case 1:
                    strncpy(CaplCtrl_SignalName, "ALR_Charisma_FahrPr", 20);
                    break;
                case 2:
                    strncpy(CaplCtrl_SignalName, "ALR_Charisma_Status", 20);
                    break;
                case 3:
                    strncpy(CaplCtrl_SignalName, "ALR_Charisma_Umschaltung", 25);
                    break;
                case 4:
                    strncpy(CaplCtrl_SignalName, "ALR_ESP_akt", 12);
                    break;
                case 5:
                    strncpy(CaplCtrl_SignalName, "ALR_Fahrerwunsch", 17);
                    break;
                case 6:
                    strncpy(CaplCtrl_SignalName, "ALR_KD_Fehler", 14);
                    break;
                case 7:
                    strncpy(CaplCtrl_SignalName, "ALR_LED_Auto_Diff", 18);
                    break;
                case 8:
                    strncpy(CaplCtrl_SignalName, "ALR_LED_High", 13);
                    break;
                case 9:
                    strncpy(CaplCtrl_SignalName, "ALR_LED_Low", 12);
                    break;
                case 10:
                    strncpy(CaplCtrl_SignalName, "ALR_LED_Low_Lock", 17);
                    break;
                case 11:
                    strncpy(CaplCtrl_SignalName, "ALR_LED_Rear_Lock", 18);
                    break;
                case 12:
                    strncpy(CaplCtrl_SignalName, "ALR_Limiter", 12);
                    break;
                case 13:
                    strncpy(CaplCtrl_SignalName, "ALR_Offroad", 12);
                    break;
                case 14:
                    strncpy(CaplCtrl_SignalName, "ALR_Schalten", 13);
                    break;
                case 15:
                    strncpy(CaplCtrl_SignalName, "ALR_Sta_Begrenzungsmom", 23);
                    break;
                case 16:
                    strncpy(CaplCtrl_SignalName, "ALR_Sta_Laengssperre", 21);
                    break;
                case 17:
                    strncpy(CaplCtrl_SignalName, "ALR_Sta_PrioAnzeige", 20);
                    break;
                case 18:
                    strncpy(CaplCtrl_SignalName, "ALR_Sta_Quersperre", 19);
                    break;
                case 19:
                    strncpy(CaplCtrl_SignalName, "ALR_Sta_Untersetzung", 21);
                    break;
                case 20:
                    strncpy(CaplCtrl_SignalName, "ALR_Symbol_Lock", 16);
                    break;
                case 21:
                    strncpy(CaplCtrl_SignalName, "ALR_Symbol_Low", 15);
                    break;
                case 22:
                    strncpy(CaplCtrl_SignalName, "ALR_Symbol_RearLock", 20);
                    break;
                case 23:
                    strncpy(CaplCtrl_SignalName, "ALR_Temp_schutz", 16);
                    break;
                case 24:
                    strncpy(CaplCtrl_SignalName, "ALR_Texte", 10);
                    break;
                case 25:
                    strncpy(CaplCtrl_SignalName, "ALR_Vorwarnung", 15);
                    break;
            }
        }
        break;
        case FRM_HANDLE_Anhaenger_01:
        {
            switch (SigIdx)
            {
                case 0:
                    strncpy(CaplCtrl_SignalName, "AAG_AVS_Fehler", 15);
                    break;
                case 1:
                    strncpy(CaplCtrl_SignalName, "AAG_AVS_Stati", 14);
                    break;
                case 2:
                    strncpy(CaplCtrl_SignalName, "AAG_Anhaenger_abgesteckt", 25);
                    break;
                case 3:
                    strncpy(CaplCtrl_SignalName, "AAG_Anhaenger_erkannt", 22);
                    break;
                case 4:
                    strncpy(CaplCtrl_SignalName, "AAG_BZ", 7);
                    break;
                case 5:
                    strncpy(CaplCtrl_SignalName, "AAG_Blinker_HL_def", 19);
                    break;
                case 6:
                    strncpy(CaplCtrl_SignalName, "AAG_Blinker_HR_def", 19);
                    break;
                case 7:
                    strncpy(CaplCtrl_SignalName, "AAG_Blinker_H_aktiv", 20);
                    break;
                case 8:
                    strncpy(CaplCtrl_SignalName, "AAG_Bremsl_durch_ECD", 21);
                    break;
                case 9:
                    strncpy(CaplCtrl_SignalName, "AAG_Bremslicht_H_def", 21);
                    break;
                case 10:
                    strncpy(CaplCtrl_SignalName, "AAG_KD_Fehler", 14);
                    break;
                case 11:
                    strncpy(CaplCtrl_SignalName, "AAG_NSL_aktiv", 14);
                    break;
                case 12:
                    strncpy(CaplCtrl_SignalName, "AAG_Schlusslicht_HL_def", 24);
                    break;
                case 13:
                    strncpy(CaplCtrl_SignalName, "AAG_Schlusslicht_HR_def", 24);
                    break;
            }
        }
        break;
        case FRM_HANDLE_BEM_01:
        {
            switch (SigIdx)
            {
                case 0:
                    strncpy(CaplCtrl_SignalName, "BEM_01_Abschaltstufen", 22);
                    break;
                case 1:
                    strncpy(CaplCtrl_SignalName, "BEM_01_BZ", 10);
                    break;
                case 2:
                    strncpy(CaplCtrl_SignalName, "BEM_01_CHK", 11);
                    break;
                case 3:
                    strncpy(CaplCtrl_SignalName, "BEM_Anf_KL", 11);
                    break;
                case 4:
                    strncpy(CaplCtrl_SignalName, "BEM_P_Generator", 16);
                    break;
                case 5:
                    strncpy(CaplCtrl_SignalName, "BEM_Segel_Info", 15);
                    break;
                case 6:
                    strncpy(CaplCtrl_SignalName, "BEM_StartStopp_Info", 20);
                    break;
                case 7:
                    strncpy(CaplCtrl_SignalName, "BEM_n_LLA", 10);
                    break;
            }
        }
        break;
        case FRM_HANDLE_Charisma_01:
        {
            switch (SigIdx)
            {
                case 0:
                    strncpy(CaplCtrl_SignalName, "CHA_01_BZ", 10);
                    break;
                case 1:
                    strncpy(CaplCtrl_SignalName, "CHA_01_CHK", 11);
                    break;
                case 2:
                    strncpy(CaplCtrl_SignalName, "CHA_Systemstatus", 17);
                    break;
                case 3:
                    strncpy(CaplCtrl_SignalName, "CHA_Ziel_FahrPr_DR", 19);
                    break;
                case 4:
                    strncpy(CaplCtrl_SignalName, "CHA_Ziel_FahrPr_GE", 19);
                    break;
                case 5:
                    strncpy(CaplCtrl_SignalName, "CHA_Ziel_FahrPr_MO", 19);
                    break;
                case 6:
                    strncpy(CaplCtrl_SignalName, "CHA_Ziel_FahrPr_QS", 19);
                    break;
                case 7:
                    strncpy(CaplCtrl_SignalName, "CHA_Ziel_FahrPr_SCU", 20);
                    break;
                case 8:
                    strncpy(CaplCtrl_SignalName, "CHA_Ziel_FahrPr_ST", 19);
                    break;
                case 9:
                    strncpy(CaplCtrl_SignalName, "CHA_Ziel_FahrPr_Sys_7", 22);
                    break;
                case 10:
                    strncpy(CaplCtrl_SignalName, "CHA_Ziel_FahrPr_Sys_8", 22);
                    break;
            }
        }
        break;
        case FRM_HANDLE_Diagnose_01:
        {
            switch (SigIdx)
            {
                case 0:
                    strncpy(CaplCtrl_SignalName, "DGN_Verlernzaehler", 19);
                    break;
                case 1:
                    strncpy(CaplCtrl_SignalName, "KBI_Kilometerstand", 19);
                    break;
                case 2:
                    strncpy(CaplCtrl_SignalName, "Kombi_02_alt", 13);
                    break;
                case 3:
                    strncpy(CaplCtrl_SignalName, "UH_Jahr", 8);
                    break;
                case 4:
                    strncpy(CaplCtrl_SignalName, "UH_Minute", 10);
                    break;
                case 5:
                    strncpy(CaplCtrl_SignalName, "UH_Monat", 9);
                    break;
                case 6:
                    strncpy(CaplCtrl_SignalName, "UH_Sekunde", 11);
                    break;
                case 7:
                    strncpy(CaplCtrl_SignalName, "UH_Stunde", 10);
                    break;
                case 8:
                    strncpy(CaplCtrl_SignalName, "UH_Tag", 7);
                    break;
                case 9:
                    strncpy(CaplCtrl_SignalName, "Uhrzeit_01_alt", 15);
                    break;
            }
        }
        break;
        case FRM_HANDLE_EPB_01:
        {
            switch (SigIdx)
            {
                case 0:
                    strncpy(CaplCtrl_SignalName, "EPB_01_BZ", 10);
                    break;
                case 1:
                    strncpy(CaplCtrl_SignalName, "EPB_01_CHK", 11);
                    break;
                case 2:
                    strncpy(CaplCtrl_SignalName, "EPB_BCM2_Motor_Wakeup", 22);
                    break;
                case 3:
                    strncpy(CaplCtrl_SignalName, "EPB_Fehlerstatus", 17);
                    break;
                case 4:
                    strncpy(CaplCtrl_SignalName, "EPB_Freig_Verzoeg_Anf", 22);
                    break;
                case 5:
                    strncpy(CaplCtrl_SignalName, "EPB_KD_Fehler", 14);
                    break;
                case 6:
                    strncpy(CaplCtrl_SignalName, "EPB_Laengsbeschleunigung", 25);
                    break;
                case 7:
                    strncpy(CaplCtrl_SignalName, "EPB_Pedalweg_Kuppl", 19);
                    break;
                case 8:
                    strncpy(CaplCtrl_SignalName, "EPB_QBit_Laengsbeschleunigung", 30);
                    break;
                case 9:
                    strncpy(CaplCtrl_SignalName, "EPB_QBit_Pedalweg_Kuppl", 24);
                    break;
                case 10:
                    strncpy(CaplCtrl_SignalName, "EPB_QBit_Schalterpos", 21);
                    break;
                case 11:
                    strncpy(CaplCtrl_SignalName, "EPB_Schalterposition", 21);
                    break;
                case 12:
                    strncpy(CaplCtrl_SignalName, "EPB_Spannkraft", 15);
                    break;
                case 13:
                    strncpy(CaplCtrl_SignalName, "EPB_Status", 11);
                    break;
                case 14:
                    strncpy(CaplCtrl_SignalName, "EPB_Verzoeg_Anf", 16);
                    break;
            }
        }
        break;
        case FRM_HANDLE_ESP_01:
        {
            switch (SigIdx)
            {
                case 0:
                    strncpy(CaplCtrl_SignalName, "ABS_Bremsung", 13);
                    break;
                case 1:
                    strncpy(CaplCtrl_SignalName, "ASR_Anf", 8);
                    break;
                case 2:
                    strncpy(CaplCtrl_SignalName, "ASR_MSR_Moment_schnell", 23);
                    break;
                case 3:
                    strncpy(CaplCtrl_SignalName, "ASR_Moment_langsam", 19);
                    break;
                case 4:
                    strncpy(CaplCtrl_SignalName, "ASR_Schalteingriff", 19);
                    break;
                case 5:
                    strncpy(CaplCtrl_SignalName, "ASR_Tastung_passiv", 19);
                    break;
                case 6:
                    strncpy(CaplCtrl_SignalName, "EBV_Eingriff", 13);
                    break;
                case 7:
                    strncpy(CaplCtrl_SignalName, "EDS_Eingriff", 13);
                    break;
                case 8:
                    strncpy(CaplCtrl_SignalName, "ESP_01_BZ", 10);
                    break;
                case 9:
                    strncpy(CaplCtrl_SignalName, "ESP_01_CHK", 11);
                    break;
                case 10:
                    strncpy(CaplCtrl_SignalName, "ESP_ASP", 8);
                    break;
                case 11:
                    strncpy(CaplCtrl_SignalName, "ESP_Eingriff", 13);
                    break;
                case 12:
                    strncpy(CaplCtrl_SignalName, "ESP_KD_Fehler", 14);
                    break;
                case 13:
                    strncpy(CaplCtrl_SignalName, "ESP_QBit_v_Signal", 18);
                    break;
                case 14:
                    strncpy(CaplCtrl_SignalName, "ESP_Systemstatus", 17);
                    break;
                case 15:
                    strncpy(CaplCtrl_SignalName, "ESP_Tastung_passiv", 19);
                    break;
                case 16:
                    strncpy(CaplCtrl_SignalName, "ESP_v_Signal", 13);
                    break;
                case 17:
                    strncpy(CaplCtrl_SignalName, "MSR_Anf", 8);
                    break;
                case 18:
                    strncpy(CaplCtrl_SignalName, "OBD_QBit_Schlechtweg", 21);
                    break;
                case 19:
                    strncpy(CaplCtrl_SignalName, "OBD_Schlechtweg", 16);
                    break;
            }
        }
        break;
        case FRM_HANDLE_ESP_02:
        {
            switch (SigIdx)
            {
                case 0:
                    strncpy(CaplCtrl_SignalName, "ESP_02_BZ", 10);
                    break;
                case 1:
                    strncpy(CaplCtrl_SignalName, "ESP_02_CHK", 11);
                    break;
                case 2:
                    strncpy(CaplCtrl_SignalName, "ESP_Gierrate", 13);
                    break;
                case 3:
                    strncpy(CaplCtrl_SignalName, "ESP_Laengsbeschl", 17);
                    break;
                case 4:
                    strncpy(CaplCtrl_SignalName, "ESP_Notbremsanzeige", 20);
                    break;
                case 5:
                    strncpy(CaplCtrl_SignalName, "ESP_QBit_Anf_Vert_Wank", 23);
                    break;
                case 6:
                    strncpy(CaplCtrl_SignalName, "ESP_QBit_Gierrate", 18);
                    break;
                case 7:
                    strncpy(CaplCtrl_SignalName, "ESP_QBit_Laengsbeschl", 22);
                    break;
                case 8:
                    strncpy(CaplCtrl_SignalName, "ESP_QBit_Querb", 15);
                    break;
                case 9:
                    strncpy(CaplCtrl_SignalName, "ESP_Querbeschleunigung", 23);
                    break;
                case 10:
                    strncpy(CaplCtrl_SignalName, "ESP_Stillstandsflag", 20);
                    break;
                case 11:
                    strncpy(CaplCtrl_SignalName, "ESP_VZ_Gierrate", 16);
                    break;
                case 12:
                    strncpy(CaplCtrl_SignalName, "ESP_Verteil_Wankmom", 20);
                    break;
                case 13:
                    strncpy(CaplCtrl_SignalName, "void_Byte_11", 13);
                    break;
            }
        }
        break;
        case FRM_HANDLE_ESP_03:
        {
            switch (SigIdx)
            {
                case 0:
                    strncpy(CaplCtrl_SignalName, "ESP_03_BZ", 10);
                    break;
                case 1:
                    strncpy(CaplCtrl_SignalName, "ESP_03_CHK", 11);
                    break;
                case 2:
                    strncpy(CaplCtrl_SignalName, "ESP_HL_FR", 10);
                    break;
                case 3:
                    strncpy(CaplCtrl_SignalName, "ESP_HL_Radgeschw", 17);
                    break;
                case 4:
                    strncpy(CaplCtrl_SignalName, "ESP_HR_FR", 10);
                    break;
                case 5:
                    strncpy(CaplCtrl_SignalName, "ESP_HR_Radgeschw", 17);
                    break;
                case 6:
                    strncpy(CaplCtrl_SignalName, "ESP_VL_FR", 10);
                    break;
                case 7:
                    strncpy(CaplCtrl_SignalName, "ESP_VL_Radgeschw", 17);
                    break;
                case 8:
                    strncpy(CaplCtrl_SignalName, "ESP_VR_FR", 10);
                    break;
                case 9:
                    strncpy(CaplCtrl_SignalName, "ESP_VR_Radgeschw", 17);
                    break;
            }
        }
        break;
        case FRM_HANDLE_ESP_05:
        {
            switch (SigIdx)
            {
                case 0:
                    strncpy(CaplCtrl_SignalName, "ECD_Bremslicht", 15);
                    break;
                case 1:
                    strncpy(CaplCtrl_SignalName, "ECD_Fehler", 11);
                    break;
                case 2:
                    strncpy(CaplCtrl_SignalName, "ECD_nicht_verfuegbar", 21);
                    break;
                case 3:
                    strncpy(CaplCtrl_SignalName, "ESP_05_BZ", 10);
                    break;
                case 4:
                    strncpy(CaplCtrl_SignalName, "ESP_05_CHK", 11);
                    break;
                case 5:
                    strncpy(CaplCtrl_SignalName, "ESP_Anforderung_EPB", 20);
                    break;
                case 6:
                    strncpy(CaplCtrl_SignalName, "ESP_Autohold_Standby", 21);
                    break;
                case 7:
                    strncpy(CaplCtrl_SignalName, "ESP_Autohold_aktiv", 19);
                    break;
                case 8:
                    strncpy(CaplCtrl_SignalName, "ESP_BKV_Unterdruck", 19);
                    break;
                case 9:
                    strncpy(CaplCtrl_SignalName, "ESP_Bremsdruck", 15);
                    break;
                case 10:
                    strncpy(CaplCtrl_SignalName, "ESP_Bremsruck_AWV2", 19);
                    break;
                case 11:
                    strncpy(CaplCtrl_SignalName, "ESP_Eingr_HL", 13);
                    break;
                case 12:
                    strncpy(CaplCtrl_SignalName, "ESP_Eingr_HR", 13);
                    break;
                case 13:
                    strncpy(CaplCtrl_SignalName, "ESP_Eingr_VL", 13);
                    break;
                case 14:
                    strncpy(CaplCtrl_SignalName, "ESP_Eingr_VR", 13);
                    break;
                case 15:
                    strncpy(CaplCtrl_SignalName, "ESP_FStatus_Anfahrhilfe", 24);
                    break;
                case 16:
                    strncpy(CaplCtrl_SignalName, "ESP_Fahrer_bremst", 18);
                    break;
                case 17:
                    strncpy(CaplCtrl_SignalName, "ESP_HBA_aktiv", 14);
                    break;
                case 18:
                    strncpy(CaplCtrl_SignalName, "ESP_HDC_Standby", 16);
                    break;
                case 19:
                    strncpy(CaplCtrl_SignalName, "ESP_HDC_aktiv", 14);
                    break;
                case 20:
                    strncpy(CaplCtrl_SignalName, "ESP_Konsistenz_AWV2", 20);
                    break;
                case 21:
                    strncpy(CaplCtrl_SignalName, "ESP_Konsistenz_TSK", 19);
                    break;
                case 22:
                    strncpy(CaplCtrl_SignalName, "ESP_Lenkeingriff_ADS", 21);
                    break;
                case 23:
                    strncpy(CaplCtrl_SignalName, "ESP_Prefill_ausgeloest", 23);
                    break;
                case 24:
                    strncpy(CaplCtrl_SignalName, "ESP_QBit_Bremsdruck", 20);
                    break;
                case 25:
                    strncpy(CaplCtrl_SignalName, "ESP_QBit_Fahrer_bremst", 23);
                    break;
                case 26:
                    strncpy(CaplCtrl_SignalName, "ESP_Rueckwaertsfahrt_erkannt", 29);
                    break;
                case 27:
                    strncpy(CaplCtrl_SignalName, "ESP_Schwelle_Unterdruck", 24);
                    break;
                case 28:
                    strncpy(CaplCtrl_SignalName, "ESP_StartStopp_Info", 20);
                    break;
                case 29:
                    strncpy(CaplCtrl_SignalName, "ESP_Status_Anfahrhilfe", 23);
                    break;
                case 30:
                    strncpy(CaplCtrl_SignalName, "ESP_Status_Bremsdruck", 22);
                    break;
                case 31:
                    strncpy(CaplCtrl_SignalName, "ESP_Status_Bremsentemp", 23);
                    break;
                case 32:
                    strncpy(CaplCtrl_SignalName, "ESP_Verz_EPB_aktiv", 19);
                    break;
                case 33:
                    strncpy(CaplCtrl_SignalName, "ESP_Verz_TSK_aktiv", 19);
                    break;
                case 34:
                    strncpy(CaplCtrl_SignalName, "ESP_Verzoeg_EPB_verf", 21);
                    break;
            }
        }
        break;
        case FRM_HANDLE_ESP_07_FR:
        {
            switch (SigIdx)
            {
                case 0:
                    strncpy(CaplCtrl_SignalName, "ESP_07_BZ", 10);
                    break;
                case 1:
                    strncpy(CaplCtrl_SignalName, "ESP_07_CHK", 11);
                    break;
                case 2:
                    strncpy(CaplCtrl_SignalName, "ESP_ACC_LDE", 12);
                    break;
                case 3:
                    strncpy(CaplCtrl_SignalName, "ESP_CM_Variante", 16);
                    break;
                case 4:
                    strncpy(CaplCtrl_SignalName, "ESP_Codierung_ADS", 18);
                    break;
                case 5:
                    strncpy(CaplCtrl_SignalName, "ESP_MKB_Status", 15);
                    break;
                case 6:
                    strncpy(CaplCtrl_SignalName, "ESP_MKB_ausloesbar", 19);
                    break;
                case 7:
                    strncpy(CaplCtrl_SignalName, "ESP_OBD_Status", 15);
                    break;
                case 8:
                    strncpy(CaplCtrl_SignalName, "ESP_Offroad_Modus", 18);
                    break;
                case 9:
                    strncpy(CaplCtrl_SignalName, "ESP_Qualifizierung_Antriebsart", 31);
                    break;
                case 10:
                    strncpy(CaplCtrl_SignalName, "ESP_Quattro_Antrieb", 20);
                    break;
                case 11:
                    strncpy(CaplCtrl_SignalName, "ESP_RTA_HL", 11);
                    break;
                case 12:
                    strncpy(CaplCtrl_SignalName, "ESP_RTA_HR", 11);
                    break;
                case 13:
                    strncpy(CaplCtrl_SignalName, "ESP_RTA_VR", 11);
                    break;
                case 14:
                    strncpy(CaplCtrl_SignalName, "ESP_Rollenmodus_Deaktivieren", 29);
                    break;
                case 15:
                    strncpy(CaplCtrl_SignalName, "ESP_nachtr_Stopp_Anf", 21);
                    break;
                case 16:
                    strncpy(CaplCtrl_SignalName, "OBD_Fehler_Radsensor_HL", 24);
                    break;
                case 17:
                    strncpy(CaplCtrl_SignalName, "OBD_Fehler_Radsensor_HR", 24);
                    break;
                case 18:
                    strncpy(CaplCtrl_SignalName, "OBD_Fehler_Radsensor_VL", 24);
                    break;
                case 19:
                    strncpy(CaplCtrl_SignalName, "OBD_Fehler_Radsensor_VR", 24);
                    break;
            }
        }
        break;
        case FRM_HANDLE_ESP_16:
        {
            switch (SigIdx)
            {
                case 0:
                    strncpy(CaplCtrl_SignalName, "ESP_16_BZ", 10);
                    break;
                case 1:
                    strncpy(CaplCtrl_SignalName, "ESP_16_CRC", 11);
                    break;
                case 2:
                    strncpy(CaplCtrl_SignalName, "ESP_Antrieb_Anf", 16);
                    break;
                case 3:
                    strncpy(CaplCtrl_SignalName, "ESP_Eingriffsmoment", 20);
                    break;
                case 4:
                    strncpy(CaplCtrl_SignalName, "ESP_KD_OBD_Fehler", 18);
                    break;
                case 5:
                    strncpy(CaplCtrl_SignalName, "ESP_KD_OBD_Readiness", 21);
                    break;
                case 6:
                    strncpy(CaplCtrl_SignalName, "ESP_Pedalweg_Bremse", 20);
                    break;
                case 7:
                    strncpy(CaplCtrl_SignalName, "ESP_Reku_Anf", 13);
                    break;
                case 8:
                    strncpy(CaplCtrl_SignalName, "ESP_Reku_Index", 15);
                    break;
            }
        }
        break;
        case FRM_HANDLE_ESP_K_10:
        {
            switch (SigIdx)
            {
                case 0:
                    strncpy(CaplCtrl_SignalName, "ESP_10_BZ", 10);
                    break;
                case 1:
                    strncpy(CaplCtrl_SignalName, "ESP_10_CRC", 11);
                    break;
                case 2:
                    strncpy(CaplCtrl_SignalName, "ESP_HL_Fahrtrichtung", 21);
                    break;
                case 3:
                    strncpy(CaplCtrl_SignalName, "ESP_HR_Fahrtrichtung", 21);
                    break;
                case 4:
                    strncpy(CaplCtrl_SignalName, "ESP_QBit_Wegimpuls_HL", 22);
                    break;
                case 5:
                    strncpy(CaplCtrl_SignalName, "ESP_QBit_Wegimpuls_HR", 22);
                    break;
                case 6:
                    strncpy(CaplCtrl_SignalName, "ESP_QBit_Wegimpuls_VL", 22);
                    break;
                case 7:
                    strncpy(CaplCtrl_SignalName, "ESP_QBit_Wegimpuls_VR", 22);
                    break;
                case 8:
                    strncpy(CaplCtrl_SignalName, "ESP_VL_Fahrtrichtung", 21);
                    break;
                case 9:
                    strncpy(CaplCtrl_SignalName, "ESP_VR_Fahrtrichtung", 21);
                    break;
                case 10:
                    strncpy(CaplCtrl_SignalName, "ESP_Wegimpuls_HL", 17);
                    break;
                case 11:
                    strncpy(CaplCtrl_SignalName, "ESP_Wegimpuls_HR", 17);
                    break;
                case 12:
                    strncpy(CaplCtrl_SignalName, "ESP_Wegimpuls_VL", 17);
                    break;
                case 13:
                    strncpy(CaplCtrl_SignalName, "ESP_Wegimpuls_VR", 17);
                    break;
            }
        }
        break;
        case FRM_HANDLE_Einheiten_01:
        {
            switch (SigIdx)
            {
                case 0:
                    strncpy(CaplCtrl_SignalName, "KBI_Einheit_Datum", 18);
                    break;
                case 1:
                    strncpy(CaplCtrl_SignalName, "KBI_Einheit_Druck", 18);
                    break;
                case 2:
                    strncpy(CaplCtrl_SignalName, "KBI_Einheit_Sprache", 20);
                    break;
                case 3:
                    strncpy(CaplCtrl_SignalName, "KBI_Einheit_Streckenanz", 24);
                    break;
                case 4:
                    strncpy(CaplCtrl_SignalName, "KBI_Einheit_Temp", 17);
                    break;
                case 5:
                    strncpy(CaplCtrl_SignalName, "KBI_Einheit_Uhrzeit", 20);
                    break;
                case 6:
                    strncpy(CaplCtrl_SignalName, "KBI_Einheit_Verbrauch", 22);
                    break;
                case 7:
                    strncpy(CaplCtrl_SignalName, "KBI_Einheit_Volumen", 20);
                    break;
                case 8:
                    strncpy(CaplCtrl_SignalName, "KBI_MFA_v_Einheit_02", 21);
                    break;
            }
        }
        break;
        case FRM_HANDLE_Fahrwerk_02:
        {
            switch (SigIdx)
            {
                case 0:
                    strncpy(CaplCtrl_SignalName, "FA_MSG_Einschraenkung", 22);
                    break;
                case 1:
                    strncpy(CaplCtrl_SignalName, "Fahrwerk_02_BZ", 15);
                    break;
                case 2:
                    strncpy(CaplCtrl_SignalName, "Fahrwerk_02_CHK", 16);
                    break;
            }
        }
        break;
        case FRM_HANDLE_GW_Fwk_01_Ant_PAG:
        {
            switch (SigIdx)
            {
                case 0:
                    strncpy(CaplCtrl_SignalName, "ESP_Gierrate_Offset", 20);
                    break;
                case 1:
                    strncpy(CaplCtrl_SignalName, "ESP_Rollenmodus", 16);
                    break;
                case 2:
                    strncpy(CaplCtrl_SignalName, "FAS_Status_Anzeige", 19);
                    break;
                case 3:
                    strncpy(CaplCtrl_SignalName, "FSM_Status", 11);
                    break;
                case 4:
                    strncpy(CaplCtrl_SignalName, "F_ESP_11_Ant", 13);
                    break;
                case 5:
                    strncpy(CaplCtrl_SignalName, "F_ESP_13_Ant", 13);
                    break;
                case 6:
                    strncpy(CaplCtrl_SignalName, "F_Getriebe_07_PAG_Fwk", 22);
                    break;
                case 7:
                    strncpy(CaplCtrl_SignalName, "F_Klima_03_Fwk_Ant", 19);
                    break;
                case 8:
                    strncpy(CaplCtrl_SignalName, "F_Klima_08_PAG_Fwk", 19);
                    break;
                case 9:
                    strncpy(CaplCtrl_SignalName, "F_LS_01_Fwk", 12);
                    break;
                case 10:
                    strncpy(CaplCtrl_SignalName, "F_TSK_03_Fwk", 13);
                    break;
                case 11:
                    strncpy(CaplCtrl_SignalName, "F_Wischer_01_Fwk", 17);
                    break;
                case 12:
                    strncpy(CaplCtrl_SignalName, "GE_Getriebestatus", 18);
                    break;
                case 13:
                    strncpy(CaplCtrl_SignalName, "KL_AussenTemp_WK", 17);
                    break;
                case 14:
                    strncpy(CaplCtrl_SignalName, "KL_Magnetventil", 16);
                    break;
                case 15:
                    strncpy(CaplCtrl_SignalName, "KL_Niv_down", 12);
                    break;
                case 16:
                    strncpy(CaplCtrl_SignalName, "KL_Niv_up", 10);
                    break;
                case 17:
                    strncpy(CaplCtrl_SignalName, "KL_T_Abgasklappe", 17);
                    break;
                case 18:
                    strncpy(CaplCtrl_SignalName, "KL_T_HDC", 9);
                    break;
                case 19:
                    strncpy(CaplCtrl_SignalName, "KL_T_PASM_1", 12);
                    break;
                case 20:
                    strncpy(CaplCtrl_SignalName, "KL_T_PASM_2", 12);
                    break;
                case 21:
                    strncpy(CaplCtrl_SignalName, "KL_T_PASM_3", 12);
                    break;
                case 22:
                    strncpy(CaplCtrl_SignalName, "KL_T_PSM_off", 13);
                    break;
                case 23:
                    strncpy(CaplCtrl_SignalName, "LS_Fehler", 10);
                    break;
                case 24:
                    strncpy(CaplCtrl_SignalName, "LS_Tip_Hoch", 12);
                    break;
                case 25:
                    strncpy(CaplCtrl_SignalName, "LS_Tip_Runter", 14);
                    break;
                case 26:
                    strncpy(CaplCtrl_SignalName, "TV_Eingriff", 12);
                    break;
                case 27:
                    strncpy(CaplCtrl_SignalName, "Wischer_vorne_Normal", 21);
                    break;
                case 28:
                    strncpy(CaplCtrl_SignalName, "Wischer_vorne_Schnell", 22);
                    break;
            }
        }
        break;
        case FRM_HANDLE_Gateway_05:
        {
            switch (SigIdx)
            {
                case 0:
                    strncpy(CaplCtrl_SignalName, "BCM1_01_alt", 12);
                    break;
                case 1:
                    strncpy(CaplCtrl_SignalName, "BCM1_02_alt", 12);
                    break;
                case 2:
                    strncpy(CaplCtrl_SignalName, "BCM1_Adaptive_Lichtvert_Anf", 28);
                    break;
                case 3:
                    strncpy(CaplCtrl_SignalName, "BCM1_Aussen_Temp_ungef", 23);
                    break;
                case 4:
                    strncpy(CaplCtrl_SignalName, "BCM1_Gleitende_Leuchtw_Anf", 27);
                    break;
                case 5:
                    strncpy(CaplCtrl_SignalName, "BCM1_MH_WIV_Schalter", 21);
                    break;
                case 6:
                    strncpy(CaplCtrl_SignalName, "BCM1_OBD_FStatus_ATemp", 23);
                    break;
                case 7:
                    strncpy(CaplCtrl_SignalName, "BCM1_Oeldruck_Schalter", 23);
                    break;
                case 8:
                    strncpy(CaplCtrl_SignalName, "BCM1_Oeldruck_Schalter_2", 25);
                    break;
                case 9:
                    strncpy(CaplCtrl_SignalName, "BCM1_RFahrlicht_Fzg_Anf", 24);
                    break;
                case 10:
                    strncpy(CaplCtrl_SignalName, "BCM1_Rueckfahrlicht_Schalter", 29);
                    break;
                case 11:
                    strncpy(CaplCtrl_SignalName, "BCM1_Schalter_StartStopp", 25);
                    break;
                case 12:
                    strncpy(CaplCtrl_SignalName, "BCM1_Vorwaertsgang_eingelegt", 29);
                    break;
                case 13:
                    strncpy(CaplCtrl_SignalName, "BT_Tuer_geoeffnet", 18);
                    break;
                case 14:
                    strncpy(CaplCtrl_SignalName, "ESP_07_alt", 11);
                    break;
                case 15:
                    strncpy(CaplCtrl_SignalName, "ESP_Codierung_ADS", 18);
                    break;
                case 16:
                    strncpy(CaplCtrl_SignalName, "FA_StartStopp_Info", 19);
                    break;
                case 17:
                    strncpy(CaplCtrl_SignalName, "FT_Sperrklinke", 15);
                    break;
                case 18:
                    strncpy(CaplCtrl_SignalName, "FT_Tuer_geoeffnet", 18);
                    break;
                case 19:
                    strncpy(CaplCtrl_SignalName, "Fahrwerk_02_alt", 16);
                    break;
                case 20:
                    strncpy(CaplCtrl_SignalName, "GW_05_va_27", 12);
                    break;
                case 21:
                    strncpy(CaplCtrl_SignalName, "HL_Tuer_geoeffnet", 18);
                    break;
                case 22:
                    strncpy(CaplCtrl_SignalName, "HR_Tuer_geoeffnet", 18);
                    break;
                case 23:
                    strncpy(CaplCtrl_SignalName, "KL_HSH_ein_Soll", 16);
                    break;
                case 24:
                    strncpy(CaplCtrl_SignalName, "KL_Zuheizer_Freigabe", 21);
                    break;
                case 25:
                    strncpy(CaplCtrl_SignalName, "Klima_02_alt", 13);
                    break;
                case 26:
                    strncpy(CaplCtrl_SignalName, "Klima_Sensor_02_alt", 20);
                    break;
                case 27:
                    strncpy(CaplCtrl_SignalName, "MO_Handshake_STH", 17);
                    break;
                case 28:
                    strncpy(CaplCtrl_SignalName, "MO_Status_Normalbetrieb_01", 27);
                    break;
                case 29:
                    strncpy(CaplCtrl_SignalName, "Motor_02_alt", 13);
                    break;
                case 30:
                    strncpy(CaplCtrl_SignalName, "Motor_05_alt", 13);
                    break;
                case 31:
                    strncpy(CaplCtrl_SignalName, "PH_StartStopp_Info", 19);
                    break;
                case 32:
                    strncpy(CaplCtrl_SignalName, "Parkhilfe_01_alt", 17);
                    break;
                case 33:
                    strncpy(CaplCtrl_SignalName, "QSP_01_alt", 11);
                    break;
                case 34:
                    strncpy(CaplCtrl_SignalName, "QSP_StartStopp_Info", 20);
                    break;
                case 35:
                    strncpy(CaplCtrl_SignalName, "TSG_BT_1_alt", 13);
                    break;
                case 36:
                    strncpy(CaplCtrl_SignalName, "TSG_FT_1_alt", 13);
                    break;
                case 37:
                    strncpy(CaplCtrl_SignalName, "TSG_HL_1_alt", 13);
                    break;
                case 38:
                    strncpy(CaplCtrl_SignalName, "TSG_HR_1_alt", 13);
                    break;
                case 39:
                    strncpy(CaplCtrl_SignalName, "Wischer_01_alt", 15);
                    break;
                case 40:
                    strncpy(CaplCtrl_SignalName, "Wischer_vorne_aktiv", 20);
                    break;
            }
        }
        break;
        case FRM_HANDLE_Gateway_11:
        {
            switch (SigIdx)
            {
                case 0:
                    strncpy(CaplCtrl_SignalName, "BCM1_01_alt", 12);
                    break;
                case 1:
                    strncpy(CaplCtrl_SignalName, "BCM1_02_alt", 12);
                    break;
                case 2:
                    strncpy(CaplCtrl_SignalName, "BCM1_04_alt", 12);
                    break;
                case 3:
                    strncpy(CaplCtrl_SignalName, "BCM1_Allwetterlicht_Anf", 24);
                    break;
                case 4:
                    strncpy(CaplCtrl_SignalName, "BCM1_LDS_Stellung", 18);
                    break;
                case 5:
                    strncpy(CaplCtrl_SignalName, "BCM1_Licht_Dunkelheit_aktiv", 28);
                    break;
                case 6:
                    strncpy(CaplCtrl_SignalName, "BCM1_Linksverkehr", 18);
                    break;
                case 7:
                    strncpy(CaplCtrl_SignalName, "BCM1_MH_Schalter", 17);
                    break;
                case 8:
                    strncpy(CaplCtrl_SignalName, "BCM1_Touristen_Licht_Anf", 25);
                    break;
                case 9:
                    strncpy(CaplCtrl_SignalName, "BCM2_02_alt", 12);
                    break;
                case 10:
                    strncpy(CaplCtrl_SignalName, "BCM2_P_verriegelt", 18);
                    break;
                case 11:
                    strncpy(CaplCtrl_SignalName, "BCM_Tankwunsch", 15);
                    break;
                case 12:
                    strncpy(CaplCtrl_SignalName, "BH_Blinker_li", 14);
                    break;
                case 13:
                    strncpy(CaplCtrl_SignalName, "BH_Blinker_re", 14);
                    break;
                case 14:
                    strncpy(CaplCtrl_SignalName, "BH_Fernlicht", 13);
                    break;
                case 15:
                    strncpy(CaplCtrl_SignalName, "BH_Lichthupe", 13);
                    break;
                case 16:
                    strncpy(CaplCtrl_SignalName, "BM_Autobahn", 12);
                    break;
                case 17:
                    strncpy(CaplCtrl_SignalName, "ESP_04_alt", 11);
                    break;
                case 18:
                    strncpy(CaplCtrl_SignalName, "ESP_Diagnose", 13);
                    break;
                case 19:
                    strncpy(CaplCtrl_SignalName, "GW_11_va_20", 12);
                    break;
                case 20:
                    strncpy(CaplCtrl_SignalName, "GW_11_va_21", 12);
                    break;
                case 21:
                    strncpy(CaplCtrl_SignalName, "GW_11_va_22", 12);
                    break;
                case 22:
                    strncpy(CaplCtrl_SignalName, "GW_11_va_23", 12);
                    break;
                case 23:
                    strncpy(CaplCtrl_SignalName, "GW_11_va_24", 12);
                    break;
                case 24:
                    strncpy(CaplCtrl_SignalName, "GW_11_va_25", 12);
                    break;
                case 25:
                    strncpy(CaplCtrl_SignalName, "GW_11_va_26", 12);
                    break;
                case 26:
                    strncpy(CaplCtrl_SignalName, "GW_11_va_27", 12);
                    break;
                case 27:
                    strncpy(CaplCtrl_SignalName, "HUD_01_alt", 11);
                    break;
                case 28:
                    strncpy(CaplCtrl_SignalName, "HUD_Anzeigefehler_NV", 21);
                    break;
                case 29:
                    strncpy(CaplCtrl_SignalName, "HUD_NV_in_Anzeige", 18);
                    break;
                case 30:
                    strncpy(CaplCtrl_SignalName, "HYB_Anf_E_Mode", 15);
                    break;
                case 31:
                    strncpy(CaplCtrl_SignalName, "HYB_Anf_E_Mode_alt", 19);
                    break;
                case 32:
                    strncpy(CaplCtrl_SignalName, "LV_AFL_aktiv_Anzeige", 21);
                    break;
                case 33:
                    strncpy(CaplCtrl_SignalName, "LV_Abblendlicht_Anzeige", 24);
                    break;
                case 34:
                    strncpy(CaplCtrl_SignalName, "LV_Abblendlicht_li_def", 23);
                    break;
                case 35:
                    strncpy(CaplCtrl_SignalName, "LV_Abblendlicht_re_def", 23);
                    break;
                case 36:
                    strncpy(CaplCtrl_SignalName, "LV_Nebelschlusslicht_Anzeige", 29);
                    break;
                case 37:
                    strncpy(CaplCtrl_SignalName, "SMLS_01_alt", 12);
                    break;
                case 38:
                    strncpy(CaplCtrl_SignalName, "ZV_Tankklappenstatus", 21);
                    break;
            }
        }
        break;
        case FRM_HANDLE_Getriebe_01:
        {
            switch (SigIdx)
            {
                case 0:
                    strncpy(CaplCtrl_SignalName, "GE_Freig_MMom_Vorhalt", 22);
                    break;
                case 1:
                    strncpy(CaplCtrl_SignalName, "GE_Freig_Mmom_Soll", 19);
                    break;
                case 2:
                    strncpy(CaplCtrl_SignalName, "GE_Freig_Mom_Eingriff", 22);
                    break;
                case 3:
                    strncpy(CaplCtrl_SignalName, "GE_KD_Fehler", 13);
                    break;
                case 4:
                    strncpy(CaplCtrl_SignalName, "GE_MMom_Soll", 13);
                    break;
                case 5:
                    strncpy(CaplCtrl_SignalName, "GE_MMom_Status", 15);
                    break;
                case 6:
                    strncpy(CaplCtrl_SignalName, "GE_MMom_Vorhalt", 16);
                    break;
                case 7:
                    strncpy(CaplCtrl_SignalName, "GE_Mom_Ident", 13);
                    break;
                case 8:
                    strncpy(CaplCtrl_SignalName, "GE_Mom_MZP", 11);
                    break;
                case 9:
                    strncpy(CaplCtrl_SignalName, "GE_Schaltvorgang", 17);
                    break;
                case 10:
                    strncpy(CaplCtrl_SignalName, "GE_Status_Kupplung", 19);
                    break;
                case 11:
                    strncpy(CaplCtrl_SignalName, "GE_Status_Schaltablauf", 23);
                    break;
                case 12:
                    strncpy(CaplCtrl_SignalName, "GE_Verbot_Ausblendung", 22);
                    break;
                case 13:
                    strncpy(CaplCtrl_SignalName, "GE_Zeit_MZP", 12);
                    break;
                case 14:
                    strncpy(CaplCtrl_SignalName, "Getriebe_01_BZ", 15);
                    break;
                case 15:
                    strncpy(CaplCtrl_SignalName, "Getriebe_01_CHK", 16);
                    break;
            }
        }
        break;
        case FRM_HANDLE_Getriebe_02:
        {
            switch (SigIdx)
            {
                case 0:
                    strncpy(CaplCtrl_SignalName, "GE_Anf_Zylabsch", 16);
                    break;
                case 1:
                    strncpy(CaplCtrl_SignalName, "GE_Anheb_Solldrehz_Leerlauf", 28);
                    break;
                case 2:
                    strncpy(CaplCtrl_SignalName, "GE_Drehzahlmesser_Daempfung", 28);
                    break;
                case 3:
                    strncpy(CaplCtrl_SignalName, "GE_Freigabe_Synchro", 20);
                    break;
                case 4:
                    strncpy(CaplCtrl_SignalName, "GE_HYB_DZ_Eingriff", 19);
                    break;
                case 5:
                    strncpy(CaplCtrl_SignalName, "GE_Mom_Begr_Gradient", 21);
                    break;
                case 6:
                    strncpy(CaplCtrl_SignalName, "GE_Schubabschalt_Unt", 21);
                    break;
                case 7:
                    strncpy(CaplCtrl_SignalName, "GE_Synchro_Wunschdrehz", 23);
                    break;
                case 8:
                    strncpy(CaplCtrl_SignalName, "GE_Synchro_Zeit", 16);
                    break;
                case 9:
                    strncpy(CaplCtrl_SignalName, "GE_Vorsteuermoment", 19);
                    break;
                case 10:
                    strncpy(CaplCtrl_SignalName, "Getriebe_02_BZ", 15);
                    break;
                case 11:
                    strncpy(CaplCtrl_SignalName, "Getriebe_02_CHK", 16);
                    break;
            }
        }
        break;
        case FRM_HANDLE_Getriebe_03:
        {
            switch (SigIdx)
            {
                case 0:
                    strncpy(CaplCtrl_SignalName, "GE_Codierung_MSG", 17);
                    break;
                case 1:
                    strncpy(CaplCtrl_SignalName, "GE_Eingangsdrehz", 17);
                    break;
                case 2:
                    strncpy(CaplCtrl_SignalName, "GE_Freig_Langfr_Schutzmom", 26);
                    break;
                case 3:
                    strncpy(CaplCtrl_SignalName, "GE_Langfr_Schutzmom", 20);
                    break;
                case 4:
                    strncpy(CaplCtrl_SignalName, "GE_Notlauf", 11);
                    break;
                case 5:
                    strncpy(CaplCtrl_SignalName, "GE_Performance_Start_LB", 24);
                    break;
                case 6:
                    strncpy(CaplCtrl_SignalName, "GE_StartStopp_Info", 19);
                    break;
                case 7:
                    strncpy(CaplCtrl_SignalName, "GE_Uefkt", 9);
                    break;
                case 8:
                    strncpy(CaplCtrl_SignalName, "GE_Waehlhebel", 14);
                    break;
                case 9:
                    strncpy(CaplCtrl_SignalName, "GE_Zielgang", 12);
                    break;
                case 10:
                    strncpy(CaplCtrl_SignalName, "GE_reserv_Waehlhebel", 21);
                    break;
                case 11:
                    strncpy(CaplCtrl_SignalName, "Getriebe_03_BZ", 15);
                    break;
                case 12:
                    strncpy(CaplCtrl_SignalName, "Getriebe_03_CHK", 16);
                    break;
            }
        }
        break;
        case FRM_HANDLE_Getriebe_04:
        {
            switch (SigIdx)
            {
                case 0:
                    strncpy(CaplCtrl_SignalName, "GE_Charisma_FahrPr", 19);
                    break;
                case 1:
                    strncpy(CaplCtrl_SignalName, "GE_Charisma_Status", 19);
                    break;
                case 2:
                    strncpy(CaplCtrl_SignalName, "GE_Charisma_Umschaltung", 24);
                    break;
                case 3:
                    strncpy(CaplCtrl_SignalName, "GE_Freigabe_Verfallsinfo_WFS", 29);
                    break;
                case 4:
                    strncpy(CaplCtrl_SignalName, "GE_Grenzkriechmoment", 21);
                    break;
                case 5:
                    strncpy(CaplCtrl_SignalName, "GE_Heizwunsch", 14);
                    break;
                case 6:
                    strncpy(CaplCtrl_SignalName, "GE_Index_Fahrwid", 17);
                    break;
                case 7:
                    strncpy(CaplCtrl_SignalName, "GE_LFR_Adaption", 16);
                    break;
                case 8:
                    strncpy(CaplCtrl_SignalName, "GE_OBD_AbsperrVent", 19);
                    break;
                case 9:
                    strncpy(CaplCtrl_SignalName, "GE_OBD_Status", 14);
                    break;
                case 10:
                    strncpy(CaplCtrl_SignalName, "GE_Sumpftemperatur", 19);
                    break;
                case 11:
                    strncpy(CaplCtrl_SignalName, "GE_Verlustmoment", 17);
                    break;
                case 12:
                    strncpy(CaplCtrl_SignalName, "GE_amax_moeglich", 17);
                    break;
            }
        }
        break;
        case FRM_HANDLE_Kessy_02:
        {
            switch (SigIdx)
            {
                case 0:
                    strncpy(CaplCtrl_SignalName, "FBS_KD_Fehler", 14);
                    break;
                case 1:
                    strncpy(CaplCtrl_SignalName, "FBS_Prio_Warn_04", 17);
                    break;
                case 2:
                    strncpy(CaplCtrl_SignalName, "FBS_Prio_Warn_05", 17);
                    break;
                case 3:
                    strncpy(CaplCtrl_SignalName, "FBS_Warn_LenkVerriegelung_def", 30);
                    break;
                case 4:
                    strncpy(CaplCtrl_SignalName, "FBS_Warn_Lenkung_def", 21);
                    break;
                case 5:
                    strncpy(CaplCtrl_SignalName, "FBS_Warn_Schluessel_Batt", 25);
                    break;
                case 6:
                    strncpy(CaplCtrl_SignalName, "KYL_Warn_Kessy_defekt", 22);
                    break;
                case 7:
                    strncpy(CaplCtrl_SignalName, "KYL_Warn_kein_Schuessel", 24);
                    break;
                case 8:
                    strncpy(CaplCtrl_SignalName, "KY_ELV_enable_Anforderung", 26);
                    break;
                case 9:
                    strncpy(CaplCtrl_SignalName, "KY_ELV_entr", 12);
                    break;
                case 10:
                    strncpy(CaplCtrl_SignalName, "KY_ELV_verr", 12);
                    break;
                case 11:
                    strncpy(CaplCtrl_SignalName, "KY_FBS_Fahrer_Hinweise", 23);
                    break;
                case 12:
                    strncpy(CaplCtrl_SignalName, "KY_FFB_Frequenz", 16);
                    break;
                case 13:
                    strncpy(CaplCtrl_SignalName, "KY_Funkschl_Nr", 15);
                    break;
                case 14:
                    strncpy(CaplCtrl_SignalName, "KY_HF_Aktiv", 12);
                    break;
                case 15:
                    strncpy(CaplCtrl_SignalName, "KY_ID_Geb_autorisiert", 22);
                    break;
                case 16:
                    strncpy(CaplCtrl_SignalName, "KY_ID_Geb_steckt", 17);
                    break;
                case 17:
                    strncpy(CaplCtrl_SignalName, "KY_KYL_Fahrer_Hinweise", 23);
                    break;
                case 18:
                    strncpy(CaplCtrl_SignalName, "KY_KYL_Prio_Warn_03", 20);
                    break;
                case 19:
                    strncpy(CaplCtrl_SignalName, "KY_KYL_Prio_Warn_04", 20);
                    break;
                case 20:
                    strncpy(CaplCtrl_SignalName, "KY_KYL_Prio_Warn_05", 20);
                    break;
                case 21:
                    strncpy(CaplCtrl_SignalName, "KY_Keyless_Verbau", 18);
                    break;
                case 22:
                    strncpy(CaplCtrl_SignalName, "KY_LF_Aktiv", 12);
                    break;
                case 23:
                    strncpy(CaplCtrl_SignalName, "KY_Schluessel_Ist", 18);
                    break;
                case 24:
                    strncpy(CaplCtrl_SignalName, "KY_Schluessel_Soll", 19);
                    break;
                case 25:
                    strncpy(CaplCtrl_SignalName, "KY_StartStopp_Info", 19);
                    break;
                case 26:
                    strncpy(CaplCtrl_SignalName, "KY_Valet_Parking", 17);
                    break;
                case 27:
                    strncpy(CaplCtrl_SignalName, "KY_WFS_LZ", 10);
                    break;
                case 28:
                    strncpy(CaplCtrl_SignalName, "KY_WFS_Safe", 12);
                    break;
            }
        }
        break;
        case FRM_HANDLE_Klemmen_Status_01:
        {
            switch (SigIdx)
            {
                case 0:
                    strncpy(CaplCtrl_SignalName, "Klemmen_Status_01_BZ", 21);
                    break;
                case 1:
                    strncpy(CaplCtrl_SignalName, "Klemmen_Status_01_CHK", 22);
                    break;
                case 2:
                    strncpy(CaplCtrl_SignalName, "ZAS_Kl_15", 10);
                    break;
                case 3:
                    strncpy(CaplCtrl_SignalName, "ZAS_Kl_50", 10);
                    break;
                case 4:
                    strncpy(CaplCtrl_SignalName, "ZAS_Kl_S", 9);
                    break;
                case 5:
                    strncpy(CaplCtrl_SignalName, "ZAS_Kl_X", 9);
                    break;
            }
        }
        break;
        case FRM_HANDLE_Klima_01:
        {
            switch (SigIdx)
            {
                case 0:
                    strncpy(CaplCtrl_SignalName, "KL_4_Zonen", 11);
                    break;
                case 1:
                    strncpy(CaplCtrl_SignalName, "KL_AC_Schalter", 15);
                    break;
                case 2:
                    strncpy(CaplCtrl_SignalName, "KL_Anf_KL", 10);
                    break;
                case 3:
                    strncpy(CaplCtrl_SignalName, "KL_Charisma_FahrPr", 19);
                    break;
                case 4:
                    strncpy(CaplCtrl_SignalName, "KL_Charisma_Status", 19);
                    break;
                case 5:
                    strncpy(CaplCtrl_SignalName, "KL_Charisma_Umschaltung", 24);
                    break;
                case 6:
                    strncpy(CaplCtrl_SignalName, "KL_Comp_enable", 15);
                    break;
                case 7:
                    strncpy(CaplCtrl_SignalName, "KL_Comp_rev_rq", 15);
                    break;
                case 8:
                    strncpy(CaplCtrl_SignalName, "KL_Diag_Absperrvent", 20);
                    break;
                case 9:
                    strncpy(CaplCtrl_SignalName, "KL_Drehz_Anh", 13);
                    break;
                case 10:
                    strncpy(CaplCtrl_SignalName, "KL_Handshake_BEM", 17);
                    break;
                case 11:
                    strncpy(CaplCtrl_SignalName, "KL_KD_Fehler", 13);
                    break;
                case 12:
                    strncpy(CaplCtrl_SignalName, "KL_Komp_Moment_alt", 19);
                    break;
                case 13:
                    strncpy(CaplCtrl_SignalName, "KL_Last_Kompr", 14);
                    break;
                case 14:
                    strncpy(CaplCtrl_SignalName, "KL_Leistung_Hzg_Soll", 21);
                    break;
                case 15:
                    strncpy(CaplCtrl_SignalName, "KL_StartStopp_Info", 19);
                    break;
                case 16:
                    strncpy(CaplCtrl_SignalName, "KL_Thermomanagement", 20);
                    break;
                case 17:
                    strncpy(CaplCtrl_SignalName, "KL_Vorwarn_HFS_ein", 19);
                    break;
                case 18:
                    strncpy(CaplCtrl_SignalName, "KL_Vorwarn_HHS_ein", 19);
                    break;
                case 19:
                    strncpy(CaplCtrl_SignalName, "KL_Vorwarn_Komp_ein", 20);
                    break;
                case 20:
                    strncpy(CaplCtrl_SignalName, "KL_Vorwarn_Zuheizer_ein", 24);
                    break;
                case 21:
                    strncpy(CaplCtrl_SignalName, "KL_Zustand", 11);
                    break;
                case 22:
                    strncpy(CaplCtrl_SignalName, "KL_el_Zuheizer_Stufe", 21);
                    break;
            }
        }
        break;
        case FRM_HANDLE_Kombi_01:
        {
            switch (SigIdx)
            {
                case 0:
                    strncpy(CaplCtrl_SignalName, "KBI_ABS_Lampe", 14);
                    break;
                case 1:
                    strncpy(CaplCtrl_SignalName, "KBI_Airbag_Lampe", 17);
                    break;
                case 2:
                    strncpy(CaplCtrl_SignalName, "KBI_Anzeigefehler_LDW", 22);
                    break;
                case 3:
                    strncpy(CaplCtrl_SignalName, "KBI_Anzeigefehler_SWA", 22);
                    break;
                case 4:
                    strncpy(CaplCtrl_SignalName, "KBI_BKL_Lampe", 14);
                    break;
                case 5:
                    strncpy(CaplCtrl_SignalName, "KBI_ESP_Lampe", 14);
                    break;
                case 6:
                    strncpy(CaplCtrl_SignalName, "KBI_Einheit_Tacho", 18);
                    break;
                case 7:
                    strncpy(CaplCtrl_SignalName, "KBI_Fehler_Anzeige_ACC", 23);
                    break;
                case 8:
                    strncpy(CaplCtrl_SignalName, "KBI_Handbremse", 15);
                    break;
                case 9:
                    strncpy(CaplCtrl_SignalName, "KBI_KD_Fehler", 14);
                    break;
                case 10:
                    strncpy(CaplCtrl_SignalName, "KBI_Konsistenz_ACC", 19);
                    break;
                case 11:
                    strncpy(CaplCtrl_SignalName, "KBI_Lenkung_Lampe", 18);
                    break;
                case 12:
                    strncpy(CaplCtrl_SignalName, "KBI_MFA_v_Einheit_01", 21);
                    break;
                case 13:
                    strncpy(CaplCtrl_SignalName, "KBI_Oeldruck_Schalter", 22);
                    break;
                case 14:
                    strncpy(CaplCtrl_SignalName, "KBI_Oeldruckwarnung", 20);
                    break;
                case 15:
                    strncpy(CaplCtrl_SignalName, "KBI_SILA_gueltig", 17);
                    break;
                case 16:
                    strncpy(CaplCtrl_SignalName, "KBI_Tankwarnung", 16);
                    break;
                case 17:
                    strncpy(CaplCtrl_SignalName, "KBI_Variante_USA", 17);
                    break;
                case 18:
                    strncpy(CaplCtrl_SignalName, "KBI_Vorglueh_System_Lampe", 26);
                    break;
                case 19:
                    strncpy(CaplCtrl_SignalName, "KBI_angez_Geschw", 17);
                    break;
                case 20:
                    strncpy(CaplCtrl_SignalName, "KBI_im_Stellgliedtest", 22);
                    break;
            }
        }
        break;
        case FRM_HANDLE_Kombi_02:
        {
            switch (SigIdx)
            {
                case 0:
                    strncpy(CaplCtrl_SignalName, "KBI_Aussen_Temp_gef", 20);
                    break;
                case 1:
                    strncpy(CaplCtrl_SignalName, "KBI_FStatus_Tank", 17);
                    break;
                case 2:
                    strncpy(CaplCtrl_SignalName, "KBI_Inhalt_Tank", 16);
                    break;
                case 3:
                    strncpy(CaplCtrl_SignalName, "KBI_Kilometerstand", 19);
                    break;
                case 4:
                    strncpy(CaplCtrl_SignalName, "KBI_Oelwechsel_durchgefuehrt", 29);
                    break;
                case 5:
                    strncpy(CaplCtrl_SignalName, "KBI_QBit_Aussen_Temp_gef", 25);
                    break;
                case 6:
                    strncpy(CaplCtrl_SignalName, "KBI_Reset_Standzeit", 20);
                    break;
                case 7:
                    strncpy(CaplCtrl_SignalName, "KBI_Standzeit", 14);
                    break;
            }
        }
        break;
        case FRM_HANDLE_Kombi_03:
        {
            switch (SigIdx)
            {
                case 0:
                    strncpy(CaplCtrl_SignalName, "KBI_Reifenumfang", 17);
                    break;
            }
        }
        break;
        case FRM_HANDLE_LH_EPS_02:
        {
            switch (SigIdx)
            {
                case 0:
                    strncpy(CaplCtrl_SignalName, "EPS_02_BZ", 10);
                    break;
                case 1:
                    strncpy(CaplCtrl_SignalName, "EPS_02_CRC", 11);
                    break;
                case 2:
                    strncpy(CaplCtrl_SignalName, "EPS_Drehzahlreserve", 20);
                    break;
                case 3:
                    strncpy(CaplCtrl_SignalName, "EPS_Lastinfo", 13);
                    break;
                case 4:
                    strncpy(CaplCtrl_SignalName, "EPS_Leistungsanforderung", 25);
                    break;
                case 5:
                    strncpy(CaplCtrl_SignalName, "EPS_Motorstartverzoegerung", 27);
                    break;
                case 6:
                    strncpy(CaplCtrl_SignalName, "EPS_Notlauf", 12);
                    break;
                case 7:
                    strncpy(CaplCtrl_SignalName, "EPS_StartStopp_Info", 20);
                    break;
                case 8:
                    strncpy(CaplCtrl_SignalName, "EPS_Unterstuetzungsleistung", 28);
                    break;
                case 9:
                    strncpy(CaplCtrl_SignalName, "EPS_VZ_Drehzahlreserve", 23);
                    break;
            }
        }
        break;
        case FRM_HANDLE_LS_01:
        {
            switch (SigIdx)
            {
                case 0:
                    strncpy(CaplCtrl_SignalName, "LS_01_BZ", 9);
                    break;
                case 1:
                    strncpy(CaplCtrl_SignalName, "LS_01_CHK", 10);
                    break;
                case 2:
                    strncpy(CaplCtrl_SignalName, "LS_Abbrechen", 13);
                    break;
                case 3:
                    strncpy(CaplCtrl_SignalName, "LS_Codierung", 13);
                    break;
                case 4:
                    strncpy(CaplCtrl_SignalName, "LS_Fehler", 10);
                    break;
                case 5:
                    strncpy(CaplCtrl_SignalName, "LS_GRA_ACC_2stufig", 19);
                    break;
                case 6:
                    strncpy(CaplCtrl_SignalName, "LS_Hauptschalter", 17);
                    break;
                case 7:
                    strncpy(CaplCtrl_SignalName, "LS_Limiter", 11);
                    break;
                case 8:
                    strncpy(CaplCtrl_SignalName, "LS_Tip_Hoch", 12);
                    break;
                case 9:
                    strncpy(CaplCtrl_SignalName, "LS_Tip_Runter", 14);
                    break;
                case 10:
                    strncpy(CaplCtrl_SignalName, "LS_Tip_Setzen", 14);
                    break;
                case 11:
                    strncpy(CaplCtrl_SignalName, "LS_Tip_Stufe_2", 15);
                    break;
                case 12:
                    strncpy(CaplCtrl_SignalName, "LS_Tip_Wiederaufnahme", 22);
                    break;
                case 13:
                    strncpy(CaplCtrl_SignalName, "LS_Tiptronic_Fehler", 20);
                    break;
                case 14:
                    strncpy(CaplCtrl_SignalName, "LS_Typ_Hauptschalter", 21);
                    break;
                case 15:
                    strncpy(CaplCtrl_SignalName, "LS_Verstellung_Zeitluecke", 26);
                    break;
                case 16:
                    strncpy(CaplCtrl_SignalName, "MFL_Tip_Down", 13);
                    break;
                case 17:
                    strncpy(CaplCtrl_SignalName, "MFL_Tip_Up", 11);
                    break;
            }
        }
        break;
        case FRM_HANDLE_LWI_01:
        {
            switch (SigIdx)
            {
                case 0:
                    strncpy(CaplCtrl_SignalName, "LWI_01_BZ", 10);
                    break;
                case 1:
                    strncpy(CaplCtrl_SignalName, "LWI_01_CHK", 11);
                    break;
                case 2:
                    strncpy(CaplCtrl_SignalName, "LWI_01_CRC", 11);
                    break;
                case 3:
                    strncpy(CaplCtrl_SignalName, "LWI_Lenkradw_Geschw", 20);
                    break;
                case 4:
                    strncpy(CaplCtrl_SignalName, "LWI_Lenkradwinkel", 18);
                    break;
                case 5:
                    strncpy(CaplCtrl_SignalName, "LWI_QBit_Lenkradwinkel", 23);
                    break;
                case 6:
                    strncpy(CaplCtrl_SignalName, "LWI_QBit_Sub_Daten", 19);
                    break;
                case 7:
                    strncpy(CaplCtrl_SignalName, "LWI_Sensorstatus", 17);
                    break;
                case 8:
                    strncpy(CaplCtrl_SignalName, "LWI_Sub_Daten", 14);
                    break;
                case 9:
                    strncpy(CaplCtrl_SignalName, "LWI_VZ_Lenkradw_Geschw", 23);
                    break;
                case 10:
                    strncpy(CaplCtrl_SignalName, "LWI_VZ_Lenkradwinkel", 21);
                    break;
            }
        }
        break;
        case FRM_HANDLE_Licht_hinten_01:
        {
            switch (SigIdx)
            {
                case 0:
                    strncpy(CaplCtrl_SignalName, "BCM2_Bremsl_durch_ECD", 22);
                    break;
                case 1:
                    strncpy(CaplCtrl_SignalName, "LH_3_Bremsl_def", 16);
                    break;
                case 2:
                    strncpy(CaplCtrl_SignalName, "LH_Aussenlicht_def", 19);
                    break;
                case 3:
                    strncpy(CaplCtrl_SignalName, "LH_Blinker_HL_akt", 18);
                    break;
                case 4:
                    strncpy(CaplCtrl_SignalName, "LH_Blinker_HR_akt", 18);
                    break;
                case 5:
                    strncpy(CaplCtrl_SignalName, "LH_Blinker_li_def", 18);
                    break;
                case 6:
                    strncpy(CaplCtrl_SignalName, "LH_Blinker_re_def", 18);
                    break;
                case 7:
                    strncpy(CaplCtrl_SignalName, "LH_Brems_Blk_li_def", 20);
                    break;
                case 8:
                    strncpy(CaplCtrl_SignalName, "LH_Brems_Blk_re_def", 20);
                    break;
                case 9:
                    strncpy(CaplCtrl_SignalName, "LH_Bremsl_li_def", 17);
                    break;
                case 10:
                    strncpy(CaplCtrl_SignalName, "LH_Bremsl_li_ges_def", 21);
                    break;
                case 11:
                    strncpy(CaplCtrl_SignalName, "LH_Bremsl_re_def", 17);
                    break;
                case 12:
                    strncpy(CaplCtrl_SignalName, "LH_Bremsl_re_ges_def", 21);
                    break;
                case 13:
                    strncpy(CaplCtrl_SignalName, "LH_Bremslicht_H_aktiv", 22);
                    break;
                case 14:
                    strncpy(CaplCtrl_SignalName, "LH_Kennzl_def", 14);
                    break;
                case 15:
                    strncpy(CaplCtrl_SignalName, "LH_Nebel_li_def", 16);
                    break;
                case 16:
                    strncpy(CaplCtrl_SignalName, "LH_Nebel_mi_def", 16);
                    break;
                case 17:
                    strncpy(CaplCtrl_SignalName, "LH_Nebel_re_def", 16);
                    break;
                case 18:
                    strncpy(CaplCtrl_SignalName, "LH_Nebelschluss_aktiv", 22);
                    break;
                case 19:
                    strncpy(CaplCtrl_SignalName, "LH_Parklicht_HL_aktiv", 22);
                    break;
                case 20:
                    strncpy(CaplCtrl_SignalName, "LH_Parklicht_HR_aktiv", 22);
                    break;
                case 21:
                    strncpy(CaplCtrl_SignalName, "LH_Rueckf_li_def", 17);
                    break;
                case 22:
                    strncpy(CaplCtrl_SignalName, "LH_Rueckf_mi_def", 17);
                    break;
                case 23:
                    strncpy(CaplCtrl_SignalName, "LH_Rueckf_re_def", 17);
                    break;
                case 24:
                    strncpy(CaplCtrl_SignalName, "LH_Rueckfahrlicht_aktiv", 24);
                    break;
                case 25:
                    strncpy(CaplCtrl_SignalName, "LH_SL_BRL_BLK_li_def", 21);
                    break;
                case 26:
                    strncpy(CaplCtrl_SignalName, "LH_SL_BRL_BLK_re_def", 21);
                    break;
                case 27:
                    strncpy(CaplCtrl_SignalName, "LH_Schluss_Brems_li_def", 24);
                    break;
                case 28:
                    strncpy(CaplCtrl_SignalName, "LH_Schluss_Brems_re_def", 24);
                    break;
                case 29:
                    strncpy(CaplCtrl_SignalName, "LH_Schluss_Nebel_li_def", 24);
                    break;
                case 30:
                    strncpy(CaplCtrl_SignalName, "LH_Schluss_Nebel_re_def", 24);
                    break;
                case 31:
                    strncpy(CaplCtrl_SignalName, "LH_Schlusslicht_li_def", 23);
                    break;
                case 32:
                    strncpy(CaplCtrl_SignalName, "LH_Schlusslicht_re_def", 23);
                    break;
                case 33:
                    strncpy(CaplCtrl_SignalName, "LH_Standlicht_H_aktiv", 22);
                    break;
                case 34:
                    strncpy(CaplCtrl_SignalName, "Licht_hinten_01_BZ", 19);
                    break;
            }
        }
        break;
        case FRM_HANDLE_NMH_Gateway:
        {
            switch (SigIdx)
            {
                case 0:
                    strncpy(CaplCtrl_SignalName, "NMH_GW_ACAN", 12);
                    break;
                case 1:
                    strncpy(CaplCtrl_SignalName, "NMH_GW_Abschaltstufe_3", 23);
                    break;
                case 2:
                    strncpy(CaplCtrl_SignalName, "NMH_GW_Abschaltstufe_aktiv", 27);
                    break;
                case 3:
                    strncpy(CaplCtrl_SignalName, "NMH_GW_CAN_Diag_deaktiv", 24);
                    break;
                case 4:
                    strncpy(CaplCtrl_SignalName, "NMH_GW_Car_WakeUp", 18);
                    break;
                case 5:
                    strncpy(CaplCtrl_SignalName, "NMH_GW_Eindraht_Fehler", 23);
                    break;
                case 6:
                    strncpy(CaplCtrl_SignalName, "NMH_GW_Fkt_WakeUp", 18);
                    break;
                case 7:
                    strncpy(CaplCtrl_SignalName, "NMH_GW_Infotainment", 20);
                    break;
                case 8:
                    strncpy(CaplCtrl_SignalName, "NMH_GW_KombiCAN", 16);
                    break;
                case 9:
                    strncpy(CaplCtrl_SignalName, "NMH_GW_KomfortCAN", 18);
                    break;
                case 10:
                    strncpy(CaplCtrl_SignalName, "NMH_GW_KompSchutz", 18);
                    break;
                case 11:
                    strncpy(CaplCtrl_SignalName, "NMH_GW_Mute_Mode", 17);
                    break;
                case 12:
                    strncpy(CaplCtrl_SignalName, "NMH_GW_NM_aktiv_BDM", 20);
                    break;
                case 13:
                    strncpy(CaplCtrl_SignalName, "NMH_GW_NM_aktiv_Diagnose", 25);
                    break;
                case 14:
                    strncpy(CaplCtrl_SignalName, "NMH_GW_NM_aktiv_ESP", 20);
                    break;
                case 15:
                    strncpy(CaplCtrl_SignalName, "NMH_GW_NM_aktiv_Klemme_15", 26);
                    break;
                case 16:
                    strncpy(CaplCtrl_SignalName, "NMH_GW_NM_aktiv_Start", 22);
                    break;
                case 17:
                    strncpy(CaplCtrl_SignalName, "NMH_GW_NM_aktiv_Warnblinken", 28);
                    break;
                case 18:
                    strncpy(CaplCtrl_SignalName, "NMH_GW_Normal_Mode_1", 21);
                    break;
                case 19:
                    strncpy(CaplCtrl_SignalName, "NMH_GW_Normal_Mode_2", 21);
                    break;
                case 20:
                    strncpy(CaplCtrl_SignalName, "NMH_GW_Per_WakeUp", 18);
                    break;
                case 21:
                    strncpy(CaplCtrl_SignalName, "NMH_GW_SG_Fehlerdauer", 22);
                    break;
                case 22:
                    strncpy(CaplCtrl_SignalName, "NMH_GW_STH_Wakeup", 18);
                    break;
                case 23:
                    strncpy(CaplCtrl_SignalName, "NMH_GW_Start_1", 15);
                    break;
                case 24:
                    strncpy(CaplCtrl_SignalName, "NMH_GW_Start_2", 15);
                    break;
                case 25:
                    strncpy(CaplCtrl_SignalName, "NMH_GW_TimeOut_Fehler", 22);
                    break;
                case 26:
                    strncpy(CaplCtrl_SignalName, "NMH_GW_Transport_Mode", 22);
                    break;
                case 27:
                    strncpy(CaplCtrl_SignalName, "NMH_GW_WakeUp_CAN_Bus", 22);
                    break;
            }
        }
        break;
        case FRM_HANDLE_OBD_Tankgeber_01:
        {
            switch (SigIdx)
            {
                case 0:
                    strncpy(CaplCtrl_SignalName, "OBD_TG_F_Status_1", 18);
                    break;
                case 1:
                    strncpy(CaplCtrl_SignalName, "OBD_TG_F_Status_2", 18);
                    break;
                case 2:
                    strncpy(CaplCtrl_SignalName, "OBD_TG_F_Status_3", 18);
                    break;
                case 3:
                    strncpy(CaplCtrl_SignalName, "OBD_TG_F_Status_4", 18);
                    break;
                case 4:
                    strncpy(CaplCtrl_SignalName, "OBD_TG_Sens_Rohwert_1", 22);
                    break;
                case 5:
                    strncpy(CaplCtrl_SignalName, "OBD_TG_Sens_Rohwert_2", 22);
                    break;
                case 6:
                    strncpy(CaplCtrl_SignalName, "OBD_TG_Sens_Rohwert_3", 22);
                    break;
                case 7:
                    strncpy(CaplCtrl_SignalName, "OBD_TG_Sens_Rohwert_4", 22);
                    break;
            }
        }
        break;
        case FRM_HANDLE_SCR_01:
        {
            switch (SigIdx)
            {
                case 0:
                    strncpy(CaplCtrl_SignalName, "SCR_01_BZ", 10);
                    break;
                case 1:
                    strncpy(CaplCtrl_SignalName, "SCR_Dosierpumpe_Drehzahl", 25);
                    break;
                case 2:
                    strncpy(CaplCtrl_SignalName, "SCR_Druck", 10);
                    break;
                case 3:
                    strncpy(CaplCtrl_SignalName, "SCR_Level_Aktivtank", 20);
                    break;
                case 4:
                    strncpy(CaplCtrl_SignalName, "SCR_Level_Passivtank", 21);
                    break;
            }
        }
        break;
        case FRM_HANDLE_SCR_02:
        {
            switch (SigIdx)
            {
                case 0:
                    strncpy(CaplCtrl_SignalName, "SCR_02_BZ", 10);
                    break;
                case 1:
                    strncpy(CaplCtrl_SignalName, "SCR_Guetesensor", 16);
                    break;
                case 2:
                    strncpy(CaplCtrl_SignalName, "SCR_Heizkreis_3_Strom", 22);
                    break;
                case 3:
                    strncpy(CaplCtrl_SignalName, "SCR_KD_Fehler", 14);
                    break;
                case 4:
                    strncpy(CaplCtrl_SignalName, "SCR_Leitungsheizung_Strom", 26);
                    break;
                case 5:
                    strncpy(CaplCtrl_SignalName, "SCR_Tankheizung_Strom", 22);
                    break;
                case 6:
                    strncpy(CaplCtrl_SignalName, "SCR_Temp_Aktivtank", 19);
                    break;
                case 7:
                    strncpy(CaplCtrl_SignalName, "SCR_Temp_Passivtank", 20);
                    break;
                case 8:
                    strncpy(CaplCtrl_SignalName, "SCR_Transferpumpe_Strom", 24);
                    break;
            }
        }
        break;
        case FRM_HANDLE_SCR_03:
        {
            switch (SigIdx)
            {
                case 0:
                    strncpy(CaplCtrl_SignalName, "SCR_03_BZ", 10);
                    break;
                case 1:
                    strncpy(CaplCtrl_SignalName, "SCR_Dosierpumpe_Status_Spule", 29);
                    break;
                case 2:
                    strncpy(CaplCtrl_SignalName, "SCR_Druck_Status", 17);
                    break;
                case 3:
                    strncpy(CaplCtrl_SignalName, "SCR_Guetesensor_Status", 23);
                    break;
                case 4:
                    strncpy(CaplCtrl_SignalName, "SCR_Heizkreis_3_Status", 23);
                    break;
                case 5:
                    strncpy(CaplCtrl_SignalName, "SCR_Leitungsheizung_Status", 27);
                    break;
                case 6:
                    strncpy(CaplCtrl_SignalName, "SCR_Level_Aktivtank_Status", 27);
                    break;
                case 7:
                    strncpy(CaplCtrl_SignalName, "SCR_Level_Passivtank_Status", 28);
                    break;
                case 8:
                    strncpy(CaplCtrl_SignalName, "SCR_Spannungsversorgung_Status", 31);
                    break;
                case 9:
                    strncpy(CaplCtrl_SignalName, "SCR_Tankheizung_Status", 23);
                    break;
                case 10:
                    strncpy(CaplCtrl_SignalName, "SCR_Temp_Aktivtank_Status", 26);
                    break;
                case 11:
                    strncpy(CaplCtrl_SignalName, "SCR_Temp_Passivtank_Status", 27);
                    break;
                case 12:
                    strncpy(CaplCtrl_SignalName, "SCR_Transferpumpe_Status", 25);
                    break;
                case 13:
                    strncpy(CaplCtrl_SignalName, "SCR_VersorgungSensoren_Status", 30);
                    break;
            }
        }
        break;
        case FRM_HANDLE_SCR_04:
        {
            switch (SigIdx)
            {
                case 0:
                    strncpy(CaplCtrl_SignalName, "SCR_04_BZ", 10);
                    break;
                case 1:
                    strncpy(CaplCtrl_SignalName, "SCR_Ansteuerung_Dosierpumpe", 28);
                    break;
                case 2:
                    strncpy(CaplCtrl_SignalName, "SCR_Ansteuerung_Heizkreis_3", 28);
                    break;
                case 3:
                    strncpy(CaplCtrl_SignalName, "SCR_Ansteuerung_Leitungsheizung", 32);
                    break;
                case 4:
                    strncpy(CaplCtrl_SignalName, "SCR_Ansteuerung_Tankheizung", 28);
                    break;
                case 5:
                    strncpy(CaplCtrl_SignalName, "SCR_Ansteuerung_Transferpumpe", 30);
                    break;
                case 6:
                    strncpy(CaplCtrl_SignalName, "SCR_CAL_CVN_CRC_32", 19);
                    break;
            }
        }
        break;
        case FRM_HANDLE_SCR_05:
        {
            switch (SigIdx)
            {
                case 0:
                    strncpy(CaplCtrl_SignalName, "SCR_05_BZ", 10);
                    break;
                case 1:
                    strncpy(CaplCtrl_SignalName, "SCR_Steuergeraet_Bus_Status", 28);
                    break;
                case 2:
                    strncpy(CaplCtrl_SignalName, "SCR_Steuergeraet_Codierung_Status", 34);
                    break;
                case 3:
                    strncpy(CaplCtrl_SignalName, "SCR_Steuergeraet_Datensatz_Status", 34);
                    break;
                case 4:
                    strncpy(CaplCtrl_SignalName, "SCR_Steuergeraet_Defekt_Status", 31);
                    break;
                case 5:
                    strncpy(CaplCtrl_SignalName, "SCR_Steuergeraet_Heizung_Status", 32);
                    break;
                case 6:
                    strncpy(CaplCtrl_SignalName, "SCR_Steuergeraet_Pumpe_Status", 30);
                    break;
                case 7:
                    strncpy(CaplCtrl_SignalName, "SCR_Steuergeraet_Relais_Status", 31);
                    break;
            }
        }
        break;
        case FRM_HANDLE_SCR_CAL_ID1:
        {
            switch (SigIdx)
            {
                case 0:
                    strncpy(CaplCtrl_SignalName, "SCR_CAL_ID_Index_01", 20);
                    break;
                case 1:
                    strncpy(CaplCtrl_SignalName, "SCR_CAL_ID_Index_02", 20);
                    break;
                case 2:
                    strncpy(CaplCtrl_SignalName, "SCR_CAL_ID_Index_03", 20);
                    break;
                case 3:
                    strncpy(CaplCtrl_SignalName, "SCR_CAL_ID_Index_04", 20);
                    break;
                case 4:
                    strncpy(CaplCtrl_SignalName, "SCR_CAL_ID_Index_05", 20);
                    break;
                case 5:
                    strncpy(CaplCtrl_SignalName, "SCR_CAL_ID_Index_06", 20);
                    break;
                case 6:
                    strncpy(CaplCtrl_SignalName, "SCR_CAL_ID_Index_07", 20);
                    break;
                case 7:
                    strncpy(CaplCtrl_SignalName, "SCR_CAL_ID_Index_08", 20);
                    break;
            }
        }
        break;
        case FRM_HANDLE_SCR_CAL_ID2:
        {
            switch (SigIdx)
            {
                case 0:
                    strncpy(CaplCtrl_SignalName, "SCR_CAL_ID_Index_09", 20);
                    break;
                case 1:
                    strncpy(CaplCtrl_SignalName, "SCR_CAL_ID_Index_10", 20);
                    break;
                case 2:
                    strncpy(CaplCtrl_SignalName, "SCR_CAL_ID_Index_11", 20);
                    break;
                case 3:
                    strncpy(CaplCtrl_SignalName, "SCR_CAL_ID_Index_12", 20);
                    break;
                case 4:
                    strncpy(CaplCtrl_SignalName, "SCR_CAL_ID_Index_13", 20);
                    break;
                case 5:
                    strncpy(CaplCtrl_SignalName, "SCR_CAL_ID_Index_14", 20);
                    break;
                case 6:
                    strncpy(CaplCtrl_SignalName, "SCR_CAL_ID_Index_15", 20);
                    break;
                case 7:
                    strncpy(CaplCtrl_SignalName, "SCR_CAL_ID_Index_16", 20);
                    break;
            }
        }
        break;
        case FRM_HANDLE_SCU_01:
        {
            switch (SigIdx)
            {
                case 0:
                    strncpy(CaplCtrl_SignalName, "SCU_01_BZ", 10);
                    break;
                case 1:
                    strncpy(CaplCtrl_SignalName, "SCU_01_CHK", 11);
                    break;
                case 2:
                    strncpy(CaplCtrl_SignalName, "SCU_01_CRC", 11);
                    break;
                case 3:
                    strncpy(CaplCtrl_SignalName, "SCU_KD_Fehler", 14);
                    break;
                case 4:
                    strncpy(CaplCtrl_SignalName, "SCU_Soll_Ue_Winkel", 19);
                    break;
                case 5:
                    strncpy(CaplCtrl_SignalName, "SCU_Status", 11);
                    break;
                case 6:
                    strncpy(CaplCtrl_SignalName, "SCU_Ue_Winkel_ADS", 18);
                    break;
                case 7:
                    strncpy(CaplCtrl_SignalName, "SCU_VZ_Soll_Ue_Winkel", 22);
                    break;
                case 8:
                    strncpy(CaplCtrl_SignalName, "SCU_VZ_Ue_Winkel_ADS", 21);
                    break;
                case 9:
                    strncpy(CaplCtrl_SignalName, "SCU_max_Gradient", 17);
                    break;
            }
        }
        break;
        case FRM_HANDLE_STH_01:
        {
            switch (SigIdx)
            {
                case 0:
                    strncpy(CaplCtrl_SignalName, "STH_EKP_Anst", 13);
                    break;
                case 1:
                    strncpy(CaplCtrl_SignalName, "STH_Fehler_ElWaPu", 18);
                    break;
                case 2:
                    strncpy(CaplCtrl_SignalName, "STH_Fehlerstatus", 17);
                    break;
                case 3:
                    strncpy(CaplCtrl_SignalName, "STH_Funk_aus", 13);
                    break;
                case 4:
                    strncpy(CaplCtrl_SignalName, "STH_Funk_ein", 13);
                    break;
                case 5:
                    strncpy(CaplCtrl_SignalName, "STH_Geblaese", 13);
                    break;
                case 6:
                    strncpy(CaplCtrl_SignalName, "STH_Heizleistung", 17);
                    break;
                case 7:
                    strncpy(CaplCtrl_SignalName, "STH_KD_Fehler", 14);
                    break;
                case 8:
                    strncpy(CaplCtrl_SignalName, "STH_KVS", 8);
                    break;
                case 9:
                    strncpy(CaplCtrl_SignalName, "STH_KVS_Ueberlauf", 18);
                    break;
                case 10:
                    strncpy(CaplCtrl_SignalName, "STH_LED", 8);
                    break;
                case 11:
                    strncpy(CaplCtrl_SignalName, "STH_Motorvorwaermung", 21);
                    break;
                case 12:
                    strncpy(CaplCtrl_SignalName, "STH_Pumpe_ein", 14);
                    break;
                case 13:
                    strncpy(CaplCtrl_SignalName, "STH_Pumpen_Anf_extern", 22);
                    break;
                case 14:
                    strncpy(CaplCtrl_SignalName, "STH_Servicemode", 16);
                    break;
                case 15:
                    strncpy(CaplCtrl_SignalName, "STH_Ventil_Status", 18);
                    break;
                case 16:
                    strncpy(CaplCtrl_SignalName, "STH_Ventiloeffnungszeit", 24);
                    break;
                case 17:
                    strncpy(CaplCtrl_SignalName, "STH_Waermeeintrag", 18);
                    break;
                case 18:
                    strncpy(CaplCtrl_SignalName, "STH_Wassertemp", 15);
                    break;
                case 19:
                    strncpy(CaplCtrl_SignalName, "STH_Zusatzheizung", 18);
                    break;
                case 20:
                    strncpy(CaplCtrl_SignalName, "STH_war_aktiv", 14);
                    break;
            }
        }
        break;
        case FRM_HANDLE_STS_01:
        {
            switch (SigIdx)
            {
                case 0:
                    strncpy(CaplCtrl_SignalName, "STS_01_BZ", 10);
                    break;
                case 1:
                    strncpy(CaplCtrl_SignalName, "STS_01_CHK", 11);
                    break;
                case 2:
                    strncpy(CaplCtrl_SignalName, "STS_Alarm_Blinker", 18);
                    break;
                case 3:
                    strncpy(CaplCtrl_SignalName, "STS_Anlassersperre", 19);
                    break;
                case 4:
                    strncpy(CaplCtrl_SignalName, "STS_Car_not_under_theft", 24);
                    break;
                case 5:
                    strncpy(CaplCtrl_SignalName, "STS_Car_under_theft", 20);
                    break;
                case 6:
                    strncpy(CaplCtrl_SignalName, "STS_Fahrlicht", 14);
                    break;
                case 7:
                    strncpy(CaplCtrl_SignalName, "STS_KD_Fehler", 14);
                    break;
                case 8:
                    strncpy(CaplCtrl_SignalName, "STS_LIN_aktiv", 14);
                    break;
                case 9:
                    strncpy(CaplCtrl_SignalName, "STS_Laderelais", 15);
                    break;
                case 10:
                    strncpy(CaplCtrl_SignalName, "STS_Leerlaufschaltung", 22);
                    break;
                case 11:
                    strncpy(CaplCtrl_SignalName, "STS_Notstart", 13);
                    break;
                case 12:
                    strncpy(CaplCtrl_SignalName, "STS_Signalhorn", 15);
                    break;
                case 13:
                    strncpy(CaplCtrl_SignalName, "STS_Standlicht", 15);
                    break;
                case 14:
                    strncpy(CaplCtrl_SignalName, "STS_Summer", 11);
                    break;
                case 15:
                    strncpy(CaplCtrl_SignalName, "STS_Typencodierung", 19);
                    break;
            }
        }
        break;
        case FRM_HANDLE_Systeminfo_01:
        {
            switch (SigIdx)
            {
                case 0:
                    strncpy(CaplCtrl_SignalName, "GW_KD_Fehler", 13);
                    break;
                case 1:
                    strncpy(CaplCtrl_SignalName, "SI_CAN_Antrieb_Sleep", 21);
                    break;
                case 2:
                    strncpy(CaplCtrl_SignalName, "SI_CAN_Dashboard_Sleep", 23);
                    break;
                case 3:
                    strncpy(CaplCtrl_SignalName, "SI_CAN_Extended_Sleep", 22);
                    break;
                case 4:
                    strncpy(CaplCtrl_SignalName, "SI_CAN_Fahrwerk_Sleep", 22);
                    break;
                case 5:
                    strncpy(CaplCtrl_SignalName, "SI_CAN_Komfort_Sleep", 21);
                    break;
                case 6:
                    strncpy(CaplCtrl_SignalName, "SI_Diagnose_Aktiv", 18);
                    break;
                case 7:
                    strncpy(CaplCtrl_SignalName, "SI_Fahrwerk_Sleep", 18);
                    break;
                case 8:
                    strncpy(CaplCtrl_SignalName, "SI_Infotainment_Sleep", 22);
                    break;
                case 9:
                    strncpy(CaplCtrl_SignalName, "SI_Int_CAN_gespiegelt", 22);
                    break;
                case 10:
                    strncpy(CaplCtrl_SignalName, "SI_MOST_Status", 15);
                    break;
                case 11:
                    strncpy(CaplCtrl_SignalName, "SI_MO_WU", 9);
                    break;
                case 12:
                    strncpy(CaplCtrl_SignalName, "SI_NWDF", 8);
                    break;
                case 13:
                    strncpy(CaplCtrl_SignalName, "SI_NWDF_gueltig", 16);
                    break;
                case 14:
                    strncpy(CaplCtrl_SignalName, "SI_QRS_Mode", 12);
                    break;
                case 15:
                    strncpy(CaplCtrl_SignalName, "SI_Sammel_SG_Fehler", 20);
                    break;
                case 16:
                    strncpy(CaplCtrl_SignalName, "SI_Sammelfehler", 16);
                    break;
                case 17:
                    strncpy(CaplCtrl_SignalName, "SI_T_Mode", 10);
                    break;
            }
        }
        break;
    }
}
/*@@end*/

/*@@caplFunc:Frm_SetSignal(long,long,long):*/
Frm_SetSignal (long FrmIdx, long SigIdx, long SigVal)
{
    switch (FrmIdx)
    {
        case FRM_HANDLE_ACC_01:
        {
            switch (SigIdx)
            {
                case 0:
                    MsgObj_ACC_01.ACC_01_BZ = SigVal;
                    break;
                case 1:
                    MsgObj_ACC_01.ACC_01_CHK = SigVal;
                    break;
                case 2:
                    MsgObj_ACC_01.ACC_Anhalten = SigVal;
                    break;
                case 3:
                    MsgObj_ACC_01.ACC_Dynamik = SigVal;
                    break;
                case 4:
                    MsgObj_ACC_01.ACC_KD_Fehler = SigVal;
                    break;
                case 5:
                    MsgObj_ACC_01.ACC_Minimale_Bremsung = SigVal;
                    break;
                case 6:
                    MsgObj_ACC_01.ACC_Sollbeschleunigung = SigVal;
                    break;
                case 7:
                    MsgObj_ACC_01.ACC_Status_ACC = SigVal;
                    break;
                case 8:
                    MsgObj_ACC_01.ACC_neg_Sollbeschl_Grad = SigVal;
                    break;
                case 9:
                    MsgObj_ACC_01.ACC_pos_Sollbeschl_Grad = SigVal;
                    break;
                case 10:
                    MsgObj_ACC_01.ACC_zul_Regelabw_oben = SigVal;
                    break;
                case 11:
                    MsgObj_ACC_01.ACC_zul_Regelabw_unten = SigVal;
                    break;
            }
        }
        break;
        case FRM_HANDLE_ACC_05:
        {
            switch (SigIdx)
            {
                case 0:
                    MsgObj_ACC_05.ACC_05_BZ = SigVal;
                    break;
                case 1:
                    MsgObj_ACC_05.ACC_05_CHK = SigVal;
                    break;
                case 2:
                    MsgObj_ACC_05.ACC_Anhalten = SigVal;
                    break;
                case 3:
                    MsgObj_ACC_05.ACC_Betaetigung_EPB = SigVal;
                    break;
                case 4:
                    MsgObj_ACC_05.ACC_Freigabe_Momentenanf = SigVal;
                    break;
                case 5:
                    MsgObj_ACC_05.ACC_Momentenanforderung = SigVal;
                    break;
                case 6:
                    MsgObj_ACC_05.ACC_StartStopp_Info = SigVal;
                    break;
                case 7:
                    MsgObj_ACC_05.ACC_Status_ACC = SigVal;
                    break;
                case 8:
                    MsgObj_ACC_05.ACC_limitierte_Anfahrdyn = SigVal;
                    break;
            }
        }
        break;
        case FRM_HANDLE_Airbag_01:
        {
            switch (SigIdx)
            {
                case 0:
                    MsgObj_Airbag_01.AB_Anzeige_Fussg = SigVal;
                    break;
                case 1:
                    MsgObj_Airbag_01.AB_Crash_Int = SigVal;
                    break;
                case 2:
                    MsgObj_Airbag_01.AB_Deaktiviert = SigVal;
                    break;
                case 3:
                    MsgObj_Airbag_01.AB_Deaktivierung_HV = SigVal;
                    break;
                case 4:
                    MsgObj_Airbag_01.AB_Diagnose = SigVal;
                    break;
                case 5:
                    MsgObj_Airbag_01.AB_Erh_Auf_VB = SigVal;
                    break;
                case 6:
                    MsgObj_Airbag_01.AB_Front_Crash = SigVal;
                    break;
                case 7:
                    MsgObj_Airbag_01.AB_Gurtwarn_VB = SigVal;
                    break;
                case 8:
                    MsgObj_Airbag_01.AB_Gurtwarn_VF = SigVal;
                    break;
                case 9:
                    MsgObj_Airbag_01.AB_Heck_Crash = SigVal;
                    break;
                case 10:
                    MsgObj_Airbag_01.AB_KD_Fehler = SigVal;
                    break;
                case 11:
                    MsgObj_Airbag_01.AB_Lampe = SigVal;
                    break;
                case 12:
                    MsgObj_Airbag_01.AB_Rollover_Crash = SigVal;
                    break;
                case 13:
                    MsgObj_Airbag_01.AB_SB_Crash = SigVal;
                    break;
                case 14:
                    MsgObj_Airbag_01.AB_SF_Crash = SigVal;
                    break;
                case 15:
                    MsgObj_Airbag_01.AB_Stellgliedtest = SigVal;
                    break;
                case 16:
                    MsgObj_Airbag_01.AB_Systemfehler = SigVal;
                    break;
                case 17:
                    MsgObj_Airbag_01.AB_VB_deaktiviert = SigVal;
                    break;
                case 18:
                    MsgObj_Airbag_01.Airbag_01_BZ = SigVal;
                    break;
                case 19:
                    MsgObj_Airbag_01.Airbag_01_CHK = SigVal;
                    break;
                case 20:
                    MsgObj_Airbag_01.void_Byte_02 = SigVal;
                    break;
                case 21:
                    MsgObj_Airbag_01.void_Byte_03 = SigVal;
                    break;
            }
        }
        break;
        case FRM_HANDLE_Airbag_02:
        {
            switch (SigIdx)
            {
                case 0:
                    MsgObj_Airbag_02.AB_Belegung_VB = SigVal;
                    break;
                case 1:
                    MsgObj_Airbag_02.AB_Gurtschloss_BF = SigVal;
                    break;
                case 2:
                    MsgObj_Airbag_02.AB_Gurtschloss_FA = SigVal;
                    break;
                case 3:
                    MsgObj_Airbag_02.AB_Gurtschloss_Reihe2_BF = SigVal;
                    break;
                case 4:
                    MsgObj_Airbag_02.AB_Gurtschloss_Reihe2_FA = SigVal;
                    break;
                case 5:
                    MsgObj_Airbag_02.AB_Gurtschloss_Reihe2_MI = SigVal;
                    break;
                case 6:
                    MsgObj_Airbag_02.AB_Gurtschloss_Reihe3_BF = SigVal;
                    break;
                case 7:
                    MsgObj_Airbag_02.AB_Gurtschloss_Reihe3_FA = SigVal;
                    break;
                case 8:
                    MsgObj_Airbag_02.AB_Gurtschloss_Reihe3_MI = SigVal;
                    break;
                case 9:
                    MsgObj_Airbag_02.AB_Sitzpos_Sens_BF = SigVal;
                    break;
                case 10:
                    MsgObj_Airbag_02.AB_Sitzpos_Sens_FA = SigVal;
                    break;
            }
        }
        break;
        case FRM_HANDLE_Allrad_02:
        {
            switch (SigIdx)
            {
                case 0:
                    MsgObj_Allrad_02.ALR_Begrenzungsmoment = SigVal;
                    break;
                case 1:
                    MsgObj_Allrad_02.ALR_Charisma_FahrPr = SigVal;
                    break;
                case 2:
                    MsgObj_Allrad_02.ALR_Charisma_Status = SigVal;
                    break;
                case 3:
                    MsgObj_Allrad_02.ALR_Charisma_Umschaltung = SigVal;
                    break;
                case 4:
                    MsgObj_Allrad_02.ALR_ESP_akt = SigVal;
                    break;
                case 5:
                    MsgObj_Allrad_02.ALR_Fahrerwunsch = SigVal;
                    break;
                case 6:
                    MsgObj_Allrad_02.ALR_KD_Fehler = SigVal;
                    break;
                case 7:
                    MsgObj_Allrad_02.ALR_LED_Auto_Diff = SigVal;
                    break;
                case 8:
                    MsgObj_Allrad_02.ALR_LED_High = SigVal;
                    break;
                case 9:
                    MsgObj_Allrad_02.ALR_LED_Low = SigVal;
                    break;
                case 10:
                    MsgObj_Allrad_02.ALR_LED_Low_Lock = SigVal;
                    break;
                case 11:
                    MsgObj_Allrad_02.ALR_LED_Rear_Lock = SigVal;
                    break;
                case 12:
                    MsgObj_Allrad_02.ALR_Limiter = SigVal;
                    break;
                case 13:
                    MsgObj_Allrad_02.ALR_Offroad = SigVal;
                    break;
                case 14:
                    MsgObj_Allrad_02.ALR_Schalten = SigVal;
                    break;
                case 15:
                    MsgObj_Allrad_02.ALR_Sta_Begrenzungsmom = SigVal;
                    break;
                case 16:
                    MsgObj_Allrad_02.ALR_Sta_Laengssperre = SigVal;
                    break;
                case 17:
                    MsgObj_Allrad_02.ALR_Sta_PrioAnzeige = SigVal;
                    break;
                case 18:
                    MsgObj_Allrad_02.ALR_Sta_Quersperre = SigVal;
                    break;
                case 19:
                    MsgObj_Allrad_02.ALR_Sta_Untersetzung = SigVal;
                    break;
                case 20:
                    MsgObj_Allrad_02.ALR_Symbol_Lock = SigVal;
                    break;
                case 21:
                    MsgObj_Allrad_02.ALR_Symbol_Low = SigVal;
                    break;
                case 22:
                    MsgObj_Allrad_02.ALR_Symbol_RearLock = SigVal;
                    break;
                case 23:
                    MsgObj_Allrad_02.ALR_Temp_schutz = SigVal;
                    break;
                case 24:
                    MsgObj_Allrad_02.ALR_Texte = SigVal;
                    break;
                case 25:
                    MsgObj_Allrad_02.ALR_Vorwarnung = SigVal;
                    break;
            }
        }
        break;
        case FRM_HANDLE_Anhaenger_01:
        {
            switch (SigIdx)
            {
                case 0:
                    MsgObj_Anhaenger_01.AAG_AVS_Fehler = SigVal;
                    break;
                case 1:
                    MsgObj_Anhaenger_01.AAG_AVS_Stati = SigVal;
                    break;
                case 2:
                    MsgObj_Anhaenger_01.AAG_Anhaenger_abgesteckt = SigVal;
                    break;
                case 3:
                    MsgObj_Anhaenger_01.AAG_Anhaenger_erkannt = SigVal;
                    break;
                case 4:
                    MsgObj_Anhaenger_01.AAG_BZ = SigVal;
                    break;
                case 5:
                    MsgObj_Anhaenger_01.AAG_Blinker_HL_def = SigVal;
                    break;
                case 6:
                    MsgObj_Anhaenger_01.AAG_Blinker_HR_def = SigVal;
                    break;
                case 7:
                    MsgObj_Anhaenger_01.AAG_Blinker_H_aktiv = SigVal;
                    break;
                case 8:
                    MsgObj_Anhaenger_01.AAG_Bremsl_durch_ECD = SigVal;
                    break;
                case 9:
                    MsgObj_Anhaenger_01.AAG_Bremslicht_H_def = SigVal;
                    break;
                case 10:
                    MsgObj_Anhaenger_01.AAG_KD_Fehler = SigVal;
                    break;
                case 11:
                    MsgObj_Anhaenger_01.AAG_NSL_aktiv = SigVal;
                    break;
                case 12:
                    MsgObj_Anhaenger_01.AAG_Schlusslicht_HL_def = SigVal;
                    break;
                case 13:
                    MsgObj_Anhaenger_01.AAG_Schlusslicht_HR_def = SigVal;
                    break;
            }
        }
        break;
        case FRM_HANDLE_BEM_01:
        {
            switch (SigIdx)
            {
                case 0:
                    MsgObj_BEM_01.BEM_01_Abschaltstufen = SigVal;
                    break;
                case 1:
                    MsgObj_BEM_01.BEM_01_BZ = SigVal;
                    break;
                case 2:
                    MsgObj_BEM_01.BEM_01_CHK = SigVal;
                    break;
                case 3:
                    MsgObj_BEM_01.BEM_Anf_KL = SigVal;
                    break;
                case 4:
                    MsgObj_BEM_01.BEM_P_Generator = SigVal;
                    break;
                case 5:
                    MsgObj_BEM_01.BEM_Segel_Info = SigVal;
                    break;
                case 6:
                    MsgObj_BEM_01.BEM_StartStopp_Info = SigVal;
                    break;
                case 7:
                    MsgObj_BEM_01.BEM_n_LLA = SigVal;
                    break;
            }
        }
        break;
        case FRM_HANDLE_Charisma_01:
        {
            switch (SigIdx)
            {
                case 0:
                    MsgObj_Charisma_01.CHA_01_BZ = SigVal;
                    break;
                case 1:
                    MsgObj_Charisma_01.CHA_01_CHK = SigVal;
                    break;
                case 2:
                    MsgObj_Charisma_01.CHA_Systemstatus = SigVal;
                    break;
                case 3:
                    MsgObj_Charisma_01.CHA_Ziel_FahrPr_DR = SigVal;
                    break;
                case 4:
                    MsgObj_Charisma_01.CHA_Ziel_FahrPr_GE = SigVal;
                    break;
                case 5:
                    MsgObj_Charisma_01.CHA_Ziel_FahrPr_MO = SigVal;
                    break;
                case 6:
                    MsgObj_Charisma_01.CHA_Ziel_FahrPr_QS = SigVal;
                    break;
                case 7:
                    MsgObj_Charisma_01.CHA_Ziel_FahrPr_SCU = SigVal;
                    break;
                case 8:
                    MsgObj_Charisma_01.CHA_Ziel_FahrPr_ST = SigVal;
                    break;
                case 9:
                    MsgObj_Charisma_01.CHA_Ziel_FahrPr_Sys_7 = SigVal;
                    break;
                case 10:
                    MsgObj_Charisma_01.CHA_Ziel_FahrPr_Sys_8 = SigVal;
                    break;
            }
        }
        break;
        case FRM_HANDLE_Diagnose_01:
        {
            switch (SigIdx)
            {
                case 0:
                    MsgObj_Diagnose_01.DGN_Verlernzaehler = SigVal;
                    break;
                case 1:
                    MsgObj_Diagnose_01.KBI_Kilometerstand = SigVal;
                    break;
                case 2:
                    MsgObj_Diagnose_01.Kombi_02_alt = SigVal;
                    break;
                case 3:
                    MsgObj_Diagnose_01.UH_Jahr = SigVal;
                    break;
                case 4:
                    MsgObj_Diagnose_01.UH_Minute = SigVal;
                    break;
                case 5:
                    MsgObj_Diagnose_01.UH_Monat = SigVal;
                    break;
                case 6:
                    MsgObj_Diagnose_01.UH_Sekunde = SigVal;
                    break;
                case 7:
                    MsgObj_Diagnose_01.UH_Stunde = SigVal;
                    break;
                case 8:
                    MsgObj_Diagnose_01.UH_Tag = SigVal;
                    break;
                case 9:
                    MsgObj_Diagnose_01.Uhrzeit_01_alt = SigVal;
                    break;
            }
        }
        break;
        case FRM_HANDLE_EPB_01:
        {
            switch (SigIdx)
            {
                case 0:
                    MsgObj_EPB_01.EPB_01_BZ = SigVal;
                    break;
                case 1:
                    MsgObj_EPB_01.EPB_01_CHK = SigVal;
                    break;
                case 2:
                    MsgObj_EPB_01.EPB_BCM2_Motor_Wakeup = SigVal;
                    break;
                case 3:
                    MsgObj_EPB_01.EPB_Fehlerstatus = SigVal;
                    break;
                case 4:
                    MsgObj_EPB_01.EPB_Freig_Verzoeg_Anf = SigVal;
                    break;
                case 5:
                    MsgObj_EPB_01.EPB_KD_Fehler = SigVal;
                    break;
                case 6:
                    MsgObj_EPB_01.EPB_Laengsbeschleunigung = SigVal;
                    break;
                case 7:
                    MsgObj_EPB_01.EPB_Pedalweg_Kuppl = SigVal;
                    break;
                case 8:
                    MsgObj_EPB_01.EPB_QBit_Laengsbeschleunigung = SigVal;
                    break;
                case 9:
                    MsgObj_EPB_01.EPB_QBit_Pedalweg_Kuppl = SigVal;
                    break;
                case 10:
                    MsgObj_EPB_01.EPB_QBit_Schalterpos = SigVal;
                    break;
                case 11:
                    MsgObj_EPB_01.EPB_Schalterposition = SigVal;
                    break;
                case 12:
                    MsgObj_EPB_01.EPB_Spannkraft = SigVal;
                    break;
                case 13:
                    MsgObj_EPB_01.EPB_Status = SigVal;
                    break;
                case 14:
                    MsgObj_EPB_01.EPB_Verzoeg_Anf = SigVal;
                    break;
            }
        }
        break;
        case FRM_HANDLE_ESP_01:
        {
            switch (SigIdx)
            {
                case 0:
                    MsgObj_ESP_01.ABS_Bremsung = SigVal;
                    break;
                case 1:
                    MsgObj_ESP_01.ASR_Anf = SigVal;
                    break;
                case 2:
                    MsgObj_ESP_01.ASR_MSR_Moment_schnell = SigVal;
                    break;
                case 3:
                    MsgObj_ESP_01.ASR_Moment_langsam = SigVal;
                    break;
                case 4:
                    MsgObj_ESP_01.ASR_Schalteingriff = SigVal;
                    break;
                case 5:
                    MsgObj_ESP_01.ASR_Tastung_passiv = SigVal;
                    break;
                case 6:
                    MsgObj_ESP_01.EBV_Eingriff = SigVal;
                    break;
                case 7:
                    MsgObj_ESP_01.EDS_Eingriff = SigVal;
                    break;
                case 8:
                    MsgObj_ESP_01.ESP_01_BZ = SigVal;
                    break;
                case 9:
                    MsgObj_ESP_01.ESP_01_CHK = SigVal;
                    break;
                case 10:
                    MsgObj_ESP_01.ESP_ASP = SigVal;
                    break;
                case 11:
                    MsgObj_ESP_01.ESP_Eingriff = SigVal;
                    break;
                case 12:
                    MsgObj_ESP_01.ESP_KD_Fehler = SigVal;
                    break;
                case 13:
                    MsgObj_ESP_01.ESP_QBit_v_Signal = SigVal;
                    break;
                case 14:
                    MsgObj_ESP_01.ESP_Systemstatus = SigVal;
                    break;
                case 15:
                    MsgObj_ESP_01.ESP_Tastung_passiv = SigVal;
                    break;
                case 16:
                    MsgObj_ESP_01.ESP_v_Signal = SigVal;
                    break;
                case 17:
                    MsgObj_ESP_01.MSR_Anf = SigVal;
                    break;
                case 18:
                    MsgObj_ESP_01.OBD_QBit_Schlechtweg = SigVal;
                    break;
                case 19:
                    MsgObj_ESP_01.OBD_Schlechtweg = SigVal;
                    break;
            }
        }
        break;
        case FRM_HANDLE_ESP_02:
        {
            switch (SigIdx)
            {
                case 0:
                    MsgObj_ESP_02.ESP_02_BZ = SigVal;
                    break;
                case 1:
                    MsgObj_ESP_02.ESP_02_CHK = SigVal;
                    break;
                case 2:
                    MsgObj_ESP_02.ESP_Gierrate = SigVal;
                    break;
                case 3:
                    MsgObj_ESP_02.ESP_Laengsbeschl = SigVal;
                    break;
                case 4:
                    MsgObj_ESP_02.ESP_Notbremsanzeige = SigVal;
                    break;
                case 5:
                    MsgObj_ESP_02.ESP_QBit_Anf_Vert_Wank = SigVal;
                    break;
                case 6:
                    MsgObj_ESP_02.ESP_QBit_Gierrate = SigVal;
                    break;
                case 7:
                    MsgObj_ESP_02.ESP_QBit_Laengsbeschl = SigVal;
                    break;
                case 8:
                    MsgObj_ESP_02.ESP_QBit_Querb = SigVal;
                    break;
                case 9:
                    MsgObj_ESP_02.ESP_Querbeschleunigung = SigVal;
                    break;
                case 10:
                    MsgObj_ESP_02.ESP_Stillstandsflag = SigVal;
                    break;
                case 11:
                    MsgObj_ESP_02.ESP_VZ_Gierrate = SigVal;
                    break;
                case 12:
                    MsgObj_ESP_02.ESP_Verteil_Wankmom = SigVal;
                    break;
                case 13:
                    MsgObj_ESP_02.void_Byte_11 = SigVal;
                    break;
            }
        }
        break;
        case FRM_HANDLE_ESP_03:
        {
            switch (SigIdx)
            {
                case 0:
                    MsgObj_ESP_03.ESP_03_BZ = SigVal;
                    break;
                case 1:
                    MsgObj_ESP_03.ESP_03_CHK = SigVal;
                    break;
                case 2:
                    MsgObj_ESP_03.ESP_HL_FR = SigVal;
                    break;
                case 3:
                    MsgObj_ESP_03.ESP_HL_Radgeschw = SigVal;
                    break;
                case 4:
                    MsgObj_ESP_03.ESP_HR_FR = SigVal;
                    break;
                case 5:
                    MsgObj_ESP_03.ESP_HR_Radgeschw = SigVal;
                    break;
                case 6:
                    MsgObj_ESP_03.ESP_VL_FR = SigVal;
                    break;
                case 7:
                    MsgObj_ESP_03.ESP_VL_Radgeschw = SigVal;
                    break;
                case 8:
                    MsgObj_ESP_03.ESP_VR_FR = SigVal;
                    break;
                case 9:
                    MsgObj_ESP_03.ESP_VR_Radgeschw = SigVal;
                    break;
            }
        }
        break;
        case FRM_HANDLE_ESP_05:
        {
            switch (SigIdx)
            {
                case 0:
                    MsgObj_ESP_05.ECD_Bremslicht = SigVal;
                    break;
                case 1:
                    MsgObj_ESP_05.ECD_Fehler = SigVal;
                    break;
                case 2:
                    MsgObj_ESP_05.ECD_nicht_verfuegbar = SigVal;
                    break;
                case 3:
                    MsgObj_ESP_05.ESP_05_BZ = SigVal;
                    break;
                case 4:
                    MsgObj_ESP_05.ESP_05_CHK = SigVal;
                    break;
                case 5:
                    MsgObj_ESP_05.ESP_Anforderung_EPB = SigVal;
                    break;
                case 6:
                    MsgObj_ESP_05.ESP_Autohold_Standby = SigVal;
                    break;
                case 7:
                    MsgObj_ESP_05.ESP_Autohold_aktiv = SigVal;
                    break;
                case 8:
                    MsgObj_ESP_05.ESP_BKV_Unterdruck = SigVal;
                    break;
                case 9:
                    MsgObj_ESP_05.ESP_Bremsdruck = SigVal;
                    break;
                case 10:
                    MsgObj_ESP_05.ESP_Bremsruck_AWV2 = SigVal;
                    break;
                case 11:
                    MsgObj_ESP_05.ESP_Eingr_HL = SigVal;
                    break;
                case 12:
                    MsgObj_ESP_05.ESP_Eingr_HR = SigVal;
                    break;
                case 13:
                    MsgObj_ESP_05.ESP_Eingr_VL = SigVal;
                    break;
                case 14:
                    MsgObj_ESP_05.ESP_Eingr_VR = SigVal;
                    break;
                case 15:
                    MsgObj_ESP_05.ESP_FStatus_Anfahrhilfe = SigVal;
                    break;
                case 16:
                    MsgObj_ESP_05.ESP_Fahrer_bremst = SigVal;
                    break;
                case 17:
                    MsgObj_ESP_05.ESP_HBA_aktiv = SigVal;
                    break;
                case 18:
                    MsgObj_ESP_05.ESP_HDC_Standby = SigVal;
                    break;
                case 19:
                    MsgObj_ESP_05.ESP_HDC_aktiv = SigVal;
                    break;
                case 20:
                    MsgObj_ESP_05.ESP_Konsistenz_AWV2 = SigVal;
                    break;
                case 21:
                    MsgObj_ESP_05.ESP_Konsistenz_TSK = SigVal;
                    break;
                case 22:
                    MsgObj_ESP_05.ESP_Lenkeingriff_ADS = SigVal;
                    break;
                case 23:
                    MsgObj_ESP_05.ESP_Prefill_ausgeloest = SigVal;
                    break;
                case 24:
                    MsgObj_ESP_05.ESP_QBit_Bremsdruck = SigVal;
                    break;
                case 25:
                    MsgObj_ESP_05.ESP_QBit_Fahrer_bremst = SigVal;
                    break;
                case 26:
                    MsgObj_ESP_05.ESP_Rueckwaertsfahrt_erkannt = SigVal;
                    break;
                case 27:
                    MsgObj_ESP_05.ESP_Schwelle_Unterdruck = SigVal;
                    break;
                case 28:
                    MsgObj_ESP_05.ESP_StartStopp_Info = SigVal;
                    break;
                case 29:
                    MsgObj_ESP_05.ESP_Status_Anfahrhilfe = SigVal;
                    break;
                case 30:
                    MsgObj_ESP_05.ESP_Status_Bremsdruck = SigVal;
                    break;
                case 31:
                    MsgObj_ESP_05.ESP_Status_Bremsentemp = SigVal;
                    break;
                case 32:
                    MsgObj_ESP_05.ESP_Verz_EPB_aktiv = SigVal;
                    break;
                case 33:
                    MsgObj_ESP_05.ESP_Verz_TSK_aktiv = SigVal;
                    break;
                case 34:
                    MsgObj_ESP_05.ESP_Verzoeg_EPB_verf = SigVal;
                    break;
            }
        }
        break;
        case FRM_HANDLE_ESP_07_FR:
        {
            switch (SigIdx)
            {
                case 0:
                    MsgObj_ESP_07_FR.ESP_07_BZ = SigVal;
                    break;
                case 1:
                    MsgObj_ESP_07_FR.ESP_07_CHK = SigVal;
                    break;
                case 2:
                    MsgObj_ESP_07_FR.ESP_ACC_LDE = SigVal;
                    break;
                case 3:
                    MsgObj_ESP_07_FR.ESP_CM_Variante = SigVal;
                    break;
                case 4:
                    MsgObj_ESP_07_FR.ESP_Codierung_ADS = SigVal;
                    break;
                case 5:
                    MsgObj_ESP_07_FR.ESP_MKB_Status = SigVal;
                    break;
                case 6:
                    MsgObj_ESP_07_FR.ESP_MKB_ausloesbar = SigVal;
                    break;
                case 7:
                    MsgObj_ESP_07_FR.ESP_OBD_Status = SigVal;
                    break;
                case 8:
                    MsgObj_ESP_07_FR.ESP_Offroad_Modus = SigVal;
                    break;
                case 9:
                    MsgObj_ESP_07_FR.ESP_Qualifizierung_Antriebsart = SigVal;
                    break;
                case 10:
                    MsgObj_ESP_07_FR.ESP_Quattro_Antrieb = SigVal;
                    break;
                case 11:
                    MsgObj_ESP_07_FR.ESP_RTA_HL = SigVal;
                    break;
                case 12:
                    MsgObj_ESP_07_FR.ESP_RTA_HR = SigVal;
                    break;
                case 13:
                    MsgObj_ESP_07_FR.ESP_RTA_VR = SigVal;
                    break;
                case 14:
                    MsgObj_ESP_07_FR.ESP_Rollenmodus_Deaktivieren = SigVal;
                    break;
                case 15:
                    MsgObj_ESP_07_FR.ESP_nachtr_Stopp_Anf = SigVal;
                    break;
                case 16:
                    MsgObj_ESP_07_FR.OBD_Fehler_Radsensor_HL = SigVal;
                    break;
                case 17:
                    MsgObj_ESP_07_FR.OBD_Fehler_Radsensor_HR = SigVal;
                    break;
                case 18:
                    MsgObj_ESP_07_FR.OBD_Fehler_Radsensor_VL = SigVal;
                    break;
                case 19:
                    MsgObj_ESP_07_FR.OBD_Fehler_Radsensor_VR = SigVal;
                    break;
            }
        }
        break;
        case FRM_HANDLE_ESP_16:
        {
            switch (SigIdx)
            {
                case 0:
                    MsgObj_ESP_16.ESP_16_BZ = SigVal;
                    break;
                case 1:
                    MsgObj_ESP_16.ESP_16_CRC = SigVal;
                    break;
                case 2:
                    MsgObj_ESP_16.ESP_Antrieb_Anf = SigVal;
                    break;
                case 3:
                    MsgObj_ESP_16.ESP_Eingriffsmoment = SigVal;
                    break;
                case 4:
                    MsgObj_ESP_16.ESP_KD_OBD_Fehler = SigVal;
                    break;
                case 5:
                    MsgObj_ESP_16.ESP_KD_OBD_Readiness = SigVal;
                    break;
                case 6:
                    MsgObj_ESP_16.ESP_Pedalweg_Bremse = SigVal;
                    break;
                case 7:
                    MsgObj_ESP_16.ESP_Reku_Anf = SigVal;
                    break;
                case 8:
                    MsgObj_ESP_16.ESP_Reku_Index = SigVal;
                    break;
            }
        }
        break;
        case FRM_HANDLE_ESP_K_10:
        {
            switch (SigIdx)
            {
                case 0:
                    MsgObj_ESP_K_10.ESP_10_BZ = SigVal;
                    break;
                case 1:
                    MsgObj_ESP_K_10.ESP_10_CRC = SigVal;
                    break;
                case 2:
                    MsgObj_ESP_K_10.ESP_HL_Fahrtrichtung = SigVal;
                    break;
                case 3:
                    MsgObj_ESP_K_10.ESP_HR_Fahrtrichtung = SigVal;
                    break;
                case 4:
                    MsgObj_ESP_K_10.ESP_QBit_Wegimpuls_HL = SigVal;
                    break;
                case 5:
                    MsgObj_ESP_K_10.ESP_QBit_Wegimpuls_HR = SigVal;
                    break;
                case 6:
                    MsgObj_ESP_K_10.ESP_QBit_Wegimpuls_VL = SigVal;
                    break;
                case 7:
                    MsgObj_ESP_K_10.ESP_QBit_Wegimpuls_VR = SigVal;
                    break;
                case 8:
                    MsgObj_ESP_K_10.ESP_VL_Fahrtrichtung = SigVal;
                    break;
                case 9:
                    MsgObj_ESP_K_10.ESP_VR_Fahrtrichtung = SigVal;
                    break;
                case 10:
                    MsgObj_ESP_K_10.ESP_Wegimpuls_HL = SigVal;
                    break;
                case 11:
                    MsgObj_ESP_K_10.ESP_Wegimpuls_HR = SigVal;
                    break;
                case 12:
                    MsgObj_ESP_K_10.ESP_Wegimpuls_VL = SigVal;
                    break;
                case 13:
                    MsgObj_ESP_K_10.ESP_Wegimpuls_VR = SigVal;
                    break;
            }
        }
        break;
        case FRM_HANDLE_Einheiten_01:
        {
            switch (SigIdx)
            {
                case 0:
                    MsgObj_Einheiten_01.KBI_Einheit_Datum = SigVal;
                    break;
                case 1:
                    MsgObj_Einheiten_01.KBI_Einheit_Druck = SigVal;
                    break;
                case 2:
                    MsgObj_Einheiten_01.KBI_Einheit_Sprache = SigVal;
                    break;
                case 3:
                    MsgObj_Einheiten_01.KBI_Einheit_Streckenanz = SigVal;
                    break;
                case 4:
                    MsgObj_Einheiten_01.KBI_Einheit_Temp = SigVal;
                    break;
                case 5:
                    MsgObj_Einheiten_01.KBI_Einheit_Uhrzeit = SigVal;
                    break;
                case 6:
                    MsgObj_Einheiten_01.KBI_Einheit_Verbrauch = SigVal;
                    break;
                case 7:
                    MsgObj_Einheiten_01.KBI_Einheit_Volumen = SigVal;
                    break;
                case 8:
                    MsgObj_Einheiten_01.KBI_MFA_v_Einheit_02 = SigVal;
                    break;
            }
        }
        break;
        case FRM_HANDLE_Fahrwerk_02:
        {
            switch (SigIdx)
            {
                case 0:
                    MsgObj_Fahrwerk_02.FA_MSG_Einschraenkung = SigVal;
                    break;
                case 1:
                    MsgObj_Fahrwerk_02.Fahrwerk_02_BZ = SigVal;
                    break;
                case 2:
                    MsgObj_Fahrwerk_02.Fahrwerk_02_CHK = SigVal;
                    break;
            }
        }
        break;
        case FRM_HANDLE_GW_Fwk_01_Ant_PAG:
        {
            switch (SigIdx)
            {
                case 0:
                    MsgObj_GW_Fwk_01_Ant_PAG.ESP_Gierrate_Offset = SigVal;
                    break;
                case 1:
                    MsgObj_GW_Fwk_01_Ant_PAG.ESP_Rollenmodus = SigVal;
                    break;
                case 2:
                    MsgObj_GW_Fwk_01_Ant_PAG.FAS_Status_Anzeige = SigVal;
                    break;
                case 3:
                    MsgObj_GW_Fwk_01_Ant_PAG.FSM_Status = SigVal;
                    break;
                case 4:
                    MsgObj_GW_Fwk_01_Ant_PAG.F_ESP_11_Ant = SigVal;
                    break;
                case 5:
                    MsgObj_GW_Fwk_01_Ant_PAG.F_ESP_13_Ant = SigVal;
                    break;
                case 6:
                    MsgObj_GW_Fwk_01_Ant_PAG.F_Getriebe_07_PAG_Fwk = SigVal;
                    break;
                case 7:
                    MsgObj_GW_Fwk_01_Ant_PAG.F_Klima_03_Fwk_Ant = SigVal;
                    break;
                case 8:
                    MsgObj_GW_Fwk_01_Ant_PAG.F_Klima_08_PAG_Fwk = SigVal;
                    break;
                case 9:
                    MsgObj_GW_Fwk_01_Ant_PAG.F_LS_01_Fwk = SigVal;
                    break;
                case 10:
                    MsgObj_GW_Fwk_01_Ant_PAG.F_TSK_03_Fwk = SigVal;
                    break;
                case 11:
                    MsgObj_GW_Fwk_01_Ant_PAG.F_Wischer_01_Fwk = SigVal;
                    break;
                case 12:
                    MsgObj_GW_Fwk_01_Ant_PAG.GE_Getriebestatus = SigVal;
                    break;
                case 13:
                    MsgObj_GW_Fwk_01_Ant_PAG.KL_AussenTemp_WK = SigVal;
                    break;
                case 14:
                    MsgObj_GW_Fwk_01_Ant_PAG.KL_Magnetventil = SigVal;
                    break;
                case 15:
                    MsgObj_GW_Fwk_01_Ant_PAG.KL_Niv_down = SigVal;
                    break;
                case 16:
                    MsgObj_GW_Fwk_01_Ant_PAG.KL_Niv_up = SigVal;
                    break;
                case 17:
                    MsgObj_GW_Fwk_01_Ant_PAG.KL_T_Abgasklappe = SigVal;
                    break;
                case 18:
                    MsgObj_GW_Fwk_01_Ant_PAG.KL_T_HDC = SigVal;
                    break;
                case 19:
                    MsgObj_GW_Fwk_01_Ant_PAG.KL_T_PASM_1 = SigVal;
                    break;
                case 20:
                    MsgObj_GW_Fwk_01_Ant_PAG.KL_T_PASM_2 = SigVal;
                    break;
                case 21:
                    MsgObj_GW_Fwk_01_Ant_PAG.KL_T_PASM_3 = SigVal;
                    break;
                case 22:
                    MsgObj_GW_Fwk_01_Ant_PAG.KL_T_PSM_off = SigVal;
                    break;
                case 23:
                    MsgObj_GW_Fwk_01_Ant_PAG.LS_Fehler = SigVal;
                    break;
                case 24:
                    MsgObj_GW_Fwk_01_Ant_PAG.LS_Tip_Hoch = SigVal;
                    break;
                case 25:
                    MsgObj_GW_Fwk_01_Ant_PAG.LS_Tip_Runter = SigVal;
                    break;
                case 26:
                    MsgObj_GW_Fwk_01_Ant_PAG.TV_Eingriff = SigVal;
                    break;
                case 27:
                    MsgObj_GW_Fwk_01_Ant_PAG.Wischer_vorne_Normal = SigVal;
                    break;
                case 28:
                    MsgObj_GW_Fwk_01_Ant_PAG.Wischer_vorne_Schnell = SigVal;
                    break;
            }
        }
        break;
        case FRM_HANDLE_Gateway_05:
        {
            switch (SigIdx)
            {
                case 0:
                    MsgObj_Gateway_05.BCM1_01_alt = SigVal;
                    break;
                case 1:
                    MsgObj_Gateway_05.BCM1_02_alt = SigVal;
                    break;
                case 2:
                    MsgObj_Gateway_05.BCM1_Adaptive_Lichtvert_Anf = SigVal;
                    break;
                case 3:
                    MsgObj_Gateway_05.BCM1_Aussen_Temp_ungef = SigVal;
                    break;
                case 4:
                    MsgObj_Gateway_05.BCM1_Gleitende_Leuchtw_Anf = SigVal;
                    break;
                case 5:
                    MsgObj_Gateway_05.BCM1_MH_WIV_Schalter = SigVal;
                    break;
                case 6:
                    MsgObj_Gateway_05.BCM1_OBD_FStatus_ATemp = SigVal;
                    break;
                case 7:
                    MsgObj_Gateway_05.BCM1_Oeldruck_Schalter = SigVal;
                    break;
                case 8:
                    MsgObj_Gateway_05.BCM1_Oeldruck_Schalter_2 = SigVal;
                    break;
                case 9:
                    MsgObj_Gateway_05.BCM1_RFahrlicht_Fzg_Anf = SigVal;
                    break;
                case 10:
                    MsgObj_Gateway_05.BCM1_Rueckfahrlicht_Schalter = SigVal;
                    break;
                case 11:
                    MsgObj_Gateway_05.BCM1_Schalter_StartStopp = SigVal;
                    break;
                case 12:
                    MsgObj_Gateway_05.BCM1_Vorwaertsgang_eingelegt = SigVal;
                    break;
                case 13:
                    MsgObj_Gateway_05.BT_Tuer_geoeffnet = SigVal;
                    break;
                case 14:
                    MsgObj_Gateway_05.ESP_07_alt = SigVal;
                    break;
                case 15:
                    MsgObj_Gateway_05.ESP_Codierung_ADS = SigVal;
                    break;
                case 16:
                    MsgObj_Gateway_05.FA_StartStopp_Info = SigVal;
                    break;
                case 17:
                    MsgObj_Gateway_05.FT_Sperrklinke = SigVal;
                    break;
                case 18:
                    MsgObj_Gateway_05.FT_Tuer_geoeffnet = SigVal;
                    break;
                case 19:
                    MsgObj_Gateway_05.Fahrwerk_02_alt = SigVal;
                    break;
                case 20:
                    MsgObj_Gateway_05.GW_05_va_27 = SigVal;
                    break;
                case 21:
                    MsgObj_Gateway_05.HL_Tuer_geoeffnet = SigVal;
                    break;
                case 22:
                    MsgObj_Gateway_05.HR_Tuer_geoeffnet = SigVal;
                    break;
                case 23:
                    MsgObj_Gateway_05.KL_HSH_ein_Soll = SigVal;
                    break;
                case 24:
                    MsgObj_Gateway_05.KL_Zuheizer_Freigabe = SigVal;
                    break;
                case 25:
                    MsgObj_Gateway_05.Klima_02_alt = SigVal;
                    break;
                case 26:
                    MsgObj_Gateway_05.Klima_Sensor_02_alt = SigVal;
                    break;
                case 27:
                    MsgObj_Gateway_05.MO_Handshake_STH = SigVal;
                    break;
                case 28:
                    MsgObj_Gateway_05.MO_Status_Normalbetrieb_01 = SigVal;
                    break;
                case 29:
                    MsgObj_Gateway_05.Motor_02_alt = SigVal;
                    break;
                case 30:
                    MsgObj_Gateway_05.Motor_05_alt = SigVal;
                    break;
                case 31:
                    MsgObj_Gateway_05.PH_StartStopp_Info = SigVal;
                    break;
                case 32:
                    MsgObj_Gateway_05.Parkhilfe_01_alt = SigVal;
                    break;
                case 33:
                    MsgObj_Gateway_05.QSP_01_alt = SigVal;
                    break;
                case 34:
                    MsgObj_Gateway_05.QSP_StartStopp_Info = SigVal;
                    break;
                case 35:
                    MsgObj_Gateway_05.TSG_BT_1_alt = SigVal;
                    break;
                case 36:
                    MsgObj_Gateway_05.TSG_FT_1_alt = SigVal;
                    break;
                case 37:
                    MsgObj_Gateway_05.TSG_HL_1_alt = SigVal;
                    break;
                case 38:
                    MsgObj_Gateway_05.TSG_HR_1_alt = SigVal;
                    break;
                case 39:
                    MsgObj_Gateway_05.Wischer_01_alt = SigVal;
                    break;
                case 40:
                    MsgObj_Gateway_05.Wischer_vorne_aktiv = SigVal;
                    break;
            }
        }
        break;
        case FRM_HANDLE_Gateway_11:
        {
            switch (SigIdx)
            {
                case 0:
                    MsgObj_Gateway_11.BCM1_01_alt = SigVal;
                    break;
                case 1:
                    MsgObj_Gateway_11.BCM1_02_alt = SigVal;
                    break;
                case 2:
                    MsgObj_Gateway_11.BCM1_04_alt = SigVal;
                    break;
                case 3:
                    MsgObj_Gateway_11.BCM1_Allwetterlicht_Anf = SigVal;
                    break;
                case 4:
                    MsgObj_Gateway_11.BCM1_LDS_Stellung = SigVal;
                    break;
                case 5:
                    MsgObj_Gateway_11.BCM1_Licht_Dunkelheit_aktiv = SigVal;
                    break;
                case 6:
                    MsgObj_Gateway_11.BCM1_Linksverkehr = SigVal;
                    break;
                case 7:
                    MsgObj_Gateway_11.BCM1_MH_Schalter = SigVal;
                    break;
                case 8:
                    MsgObj_Gateway_11.BCM1_Touristen_Licht_Anf = SigVal;
                    break;
                case 9:
                    MsgObj_Gateway_11.BCM2_02_alt = SigVal;
                    break;
                case 10:
                    MsgObj_Gateway_11.BCM2_P_verriegelt = SigVal;
                    break;
                case 11:
                    MsgObj_Gateway_11.BCM_Tankwunsch = SigVal;
                    break;
                case 12:
                    MsgObj_Gateway_11.BH_Blinker_li = SigVal;
                    break;
                case 13:
                    MsgObj_Gateway_11.BH_Blinker_re = SigVal;
                    break;
                case 14:
                    MsgObj_Gateway_11.BH_Fernlicht = SigVal;
                    break;
                case 15:
                    MsgObj_Gateway_11.BH_Lichthupe = SigVal;
                    break;
                case 16:
                    MsgObj_Gateway_11.BM_Autobahn = SigVal;
                    break;
                case 17:
                    MsgObj_Gateway_11.ESP_04_alt = SigVal;
                    break;
                case 18:
                    MsgObj_Gateway_11.ESP_Diagnose = SigVal;
                    break;
                case 19:
                    MsgObj_Gateway_11.GW_11_va_20 = SigVal;
                    break;
                case 20:
                    MsgObj_Gateway_11.GW_11_va_21 = SigVal;
                    break;
                case 21:
                    MsgObj_Gateway_11.GW_11_va_22 = SigVal;
                    break;
                case 22:
                    MsgObj_Gateway_11.GW_11_va_23 = SigVal;
                    break;
                case 23:
                    MsgObj_Gateway_11.GW_11_va_24 = SigVal;
                    break;
                case 24:
                    MsgObj_Gateway_11.GW_11_va_25 = SigVal;
                    break;
                case 25:
                    MsgObj_Gateway_11.GW_11_va_26 = SigVal;
                    break;
                case 26:
                    MsgObj_Gateway_11.GW_11_va_27 = SigVal;
                    break;
                case 27:
                    MsgObj_Gateway_11.HUD_01_alt = SigVal;
                    break;
                case 28:
                    MsgObj_Gateway_11.HUD_Anzeigefehler_NV = SigVal;
                    break;
                case 29:
                    MsgObj_Gateway_11.HUD_NV_in_Anzeige = SigVal;
                    break;
                case 30:
                    MsgObj_Gateway_11.HYB_Anf_E_Mode = SigVal;
                    break;
                case 31:
                    MsgObj_Gateway_11.HYB_Anf_E_Mode_alt = SigVal;
                    break;
                case 32:
                    MsgObj_Gateway_11.LV_AFL_aktiv_Anzeige = SigVal;
                    break;
                case 33:
                    MsgObj_Gateway_11.LV_Abblendlicht_Anzeige = SigVal;
                    break;
                case 34:
                    MsgObj_Gateway_11.LV_Abblendlicht_li_def = SigVal;
                    break;
                case 35:
                    MsgObj_Gateway_11.LV_Abblendlicht_re_def = SigVal;
                    break;
                case 36:
                    MsgObj_Gateway_11.LV_Nebelschlusslicht_Anzeige = SigVal;
                    break;
                case 37:
                    MsgObj_Gateway_11.SMLS_01_alt = SigVal;
                    break;
                case 38:
                    MsgObj_Gateway_11.ZV_Tankklappenstatus = SigVal;
                    break;
            }
        }
        break;
        case FRM_HANDLE_Getriebe_01:
        {
            switch (SigIdx)
            {
                case 0:
                    MsgObj_Getriebe_01.GE_Freig_MMom_Vorhalt = SigVal;
                    break;
                case 1:
                    MsgObj_Getriebe_01.GE_Freig_Mmom_Soll = SigVal;
                    break;
                case 2:
                    MsgObj_Getriebe_01.GE_Freig_Mom_Eingriff = SigVal;
                    break;
                case 3:
                    MsgObj_Getriebe_01.GE_KD_Fehler = SigVal;
                    break;
                case 4:
                    MsgObj_Getriebe_01.GE_MMom_Soll = SigVal;
                    break;
                case 5:
                    MsgObj_Getriebe_01.GE_MMom_Status = SigVal;
                    break;
                case 6:
                    MsgObj_Getriebe_01.GE_MMom_Vorhalt = SigVal;
                    break;
                case 7:
                    MsgObj_Getriebe_01.GE_Mom_Ident = SigVal;
                    break;
                case 8:
                    MsgObj_Getriebe_01.GE_Mom_MZP = SigVal;
                    break;
                case 9:
                    MsgObj_Getriebe_01.GE_Schaltvorgang = SigVal;
                    break;
                case 10:
                    MsgObj_Getriebe_01.GE_Status_Kupplung = SigVal;
                    break;
                case 11:
                    MsgObj_Getriebe_01.GE_Status_Schaltablauf = SigVal;
                    break;
                case 12:
                    MsgObj_Getriebe_01.GE_Verbot_Ausblendung = SigVal;
                    break;
                case 13:
                    MsgObj_Getriebe_01.GE_Zeit_MZP = SigVal;
                    break;
                case 14:
                    MsgObj_Getriebe_01.Getriebe_01_BZ = SigVal;
                    break;
                case 15:
                    MsgObj_Getriebe_01.Getriebe_01_CHK = SigVal;
                    break;
            }
        }
        break;
        case FRM_HANDLE_Getriebe_02:
        {
            switch (SigIdx)
            {
                case 0:
                    MsgObj_Getriebe_02.GE_Anf_Zylabsch = SigVal;
                    break;
                case 1:
                    MsgObj_Getriebe_02.GE_Anheb_Solldrehz_Leerlauf = SigVal;
                    break;
                case 2:
                    MsgObj_Getriebe_02.GE_Drehzahlmesser_Daempfung = SigVal;
                    break;
                case 3:
                    MsgObj_Getriebe_02.GE_Freigabe_Synchro = SigVal;
                    break;
                case 4:
                    MsgObj_Getriebe_02.GE_HYB_DZ_Eingriff = SigVal;
                    break;
                case 5:
                    MsgObj_Getriebe_02.GE_Mom_Begr_Gradient = SigVal;
                    break;
                case 6:
                    MsgObj_Getriebe_02.GE_Schubabschalt_Unt = SigVal;
                    break;
                case 7:
                    MsgObj_Getriebe_02.GE_Synchro_Wunschdrehz = SigVal;
                    break;
                case 8:
                    MsgObj_Getriebe_02.GE_Synchro_Zeit = SigVal;
                    break;
                case 9:
                    MsgObj_Getriebe_02.GE_Vorsteuermoment = SigVal;
                    break;
                case 10:
                    MsgObj_Getriebe_02.Getriebe_02_BZ = SigVal;
                    break;
                case 11:
                    MsgObj_Getriebe_02.Getriebe_02_CHK = SigVal;
                    break;
            }
        }
        break;
        case FRM_HANDLE_Getriebe_03:
        {
            switch (SigIdx)
            {
                case 0:
                    MsgObj_Getriebe_03.GE_Codierung_MSG = SigVal;
                    break;
                case 1:
                    MsgObj_Getriebe_03.GE_Eingangsdrehz = SigVal;
                    break;
                case 2:
                    MsgObj_Getriebe_03.GE_Freig_Langfr_Schutzmom = SigVal;
                    break;
                case 3:
                    MsgObj_Getriebe_03.GE_Langfr_Schutzmom = SigVal;
                    break;
                case 4:
                    MsgObj_Getriebe_03.GE_Notlauf = SigVal;
                    break;
                case 5:
                    MsgObj_Getriebe_03.GE_Performance_Start_LB = SigVal;
                    break;
                case 6:
                    MsgObj_Getriebe_03.GE_StartStopp_Info = SigVal;
                    break;
                case 7:
                    MsgObj_Getriebe_03.GE_Uefkt = SigVal;
                    break;
                case 8:
                    MsgObj_Getriebe_03.GE_Waehlhebel = SigVal;
                    break;
                case 9:
                    MsgObj_Getriebe_03.GE_Zielgang = SigVal;
                    break;
                case 10:
                    MsgObj_Getriebe_03.GE_reserv_Waehlhebel = SigVal;
                    break;
                case 11:
                    MsgObj_Getriebe_03.Getriebe_03_BZ = SigVal;
                    break;
                case 12:
                    MsgObj_Getriebe_03.Getriebe_03_CHK = SigVal;
                    break;
            }
        }
        break;
        case FRM_HANDLE_Getriebe_04:
        {
            switch (SigIdx)
            {
                case 0:
                    MsgObj_Getriebe_04.GE_Charisma_FahrPr = SigVal;
                    break;
                case 1:
                    MsgObj_Getriebe_04.GE_Charisma_Status = SigVal;
                    break;
                case 2:
                    MsgObj_Getriebe_04.GE_Charisma_Umschaltung = SigVal;
                    break;
                case 3:
                    MsgObj_Getriebe_04.GE_Freigabe_Verfallsinfo_WFS = SigVal;
                    break;
                case 4:
                    MsgObj_Getriebe_04.GE_Grenzkriechmoment = SigVal;
                    break;
                case 5:
                    MsgObj_Getriebe_04.GE_Heizwunsch = SigVal;
                    break;
                case 6:
                    MsgObj_Getriebe_04.GE_Index_Fahrwid = SigVal;
                    break;
                case 7:
                    MsgObj_Getriebe_04.GE_LFR_Adaption = SigVal;
                    break;
                case 8:
                    MsgObj_Getriebe_04.GE_OBD_AbsperrVent = SigVal;
                    break;
                case 9:
                    MsgObj_Getriebe_04.GE_OBD_Status = SigVal;
                    break;
                case 10:
                    MsgObj_Getriebe_04.GE_Sumpftemperatur = SigVal;
                    break;
                case 11:
                    MsgObj_Getriebe_04.GE_Verlustmoment = SigVal;
                    break;
                case 12:
                    MsgObj_Getriebe_04.GE_amax_moeglich = SigVal;
                    break;
            }
        }
        break;
        case FRM_HANDLE_Kessy_02:
        {
            switch (SigIdx)
            {
                case 0:
                    MsgObj_Kessy_02.FBS_KD_Fehler = SigVal;
                    break;
                case 1:
                    MsgObj_Kessy_02.FBS_Prio_Warn_04 = SigVal;
                    break;
                case 2:
                    MsgObj_Kessy_02.FBS_Prio_Warn_05 = SigVal;
                    break;
                case 3:
                    MsgObj_Kessy_02.FBS_Warn_LenkVerriegelung_def = SigVal;
                    break;
                case 4:
                    MsgObj_Kessy_02.FBS_Warn_Lenkung_def = SigVal;
                    break;
                case 5:
                    MsgObj_Kessy_02.FBS_Warn_Schluessel_Batt = SigVal;
                    break;
                case 6:
                    MsgObj_Kessy_02.KYL_Warn_Kessy_defekt = SigVal;
                    break;
                case 7:
                    MsgObj_Kessy_02.KYL_Warn_kein_Schuessel = SigVal;
                    break;
                case 8:
                    MsgObj_Kessy_02.KY_ELV_enable_Anforderung = SigVal;
                    break;
                case 9:
                    MsgObj_Kessy_02.KY_ELV_entr = SigVal;
                    break;
                case 10:
                    MsgObj_Kessy_02.KY_ELV_verr = SigVal;
                    break;
                case 11:
                    MsgObj_Kessy_02.KY_FBS_Fahrer_Hinweise = SigVal;
                    break;
                case 12:
                    MsgObj_Kessy_02.KY_FFB_Frequenz = SigVal;
                    break;
                case 13:
                    MsgObj_Kessy_02.KY_Funkschl_Nr = SigVal;
                    break;
                case 14:
                    MsgObj_Kessy_02.KY_HF_Aktiv = SigVal;
                    break;
                case 15:
                    MsgObj_Kessy_02.KY_ID_Geb_autorisiert = SigVal;
                    break;
                case 16:
                    MsgObj_Kessy_02.KY_ID_Geb_steckt = SigVal;
                    break;
                case 17:
                    MsgObj_Kessy_02.KY_KYL_Fahrer_Hinweise = SigVal;
                    break;
                case 18:
                    MsgObj_Kessy_02.KY_KYL_Prio_Warn_03 = SigVal;
                    break;
                case 19:
                    MsgObj_Kessy_02.KY_KYL_Prio_Warn_04 = SigVal;
                    break;
                case 20:
                    MsgObj_Kessy_02.KY_KYL_Prio_Warn_05 = SigVal;
                    break;
                case 21:
                    MsgObj_Kessy_02.KY_Keyless_Verbau = SigVal;
                    break;
                case 22:
                    MsgObj_Kessy_02.KY_LF_Aktiv = SigVal;
                    break;
                case 23:
                    MsgObj_Kessy_02.KY_Schluessel_Ist = SigVal;
                    break;
                case 24:
                    MsgObj_Kessy_02.KY_Schluessel_Soll = SigVal;
                    break;
                case 25:
                    MsgObj_Kessy_02.KY_StartStopp_Info = SigVal;
                    break;
                case 26:
                    MsgObj_Kessy_02.KY_Valet_Parking = SigVal;
                    break;
                case 27:
                    MsgObj_Kessy_02.KY_WFS_LZ = SigVal;
                    break;
                case 28:
                    MsgObj_Kessy_02.KY_WFS_Safe = SigVal;
                    break;
            }
        }
        break;
        case FRM_HANDLE_Klemmen_Status_01:
        {
            switch (SigIdx)
            {
                case 0:
                    MsgObj_Klemmen_Status_01.Klemmen_Status_01_BZ = SigVal;
                    break;
                case 1:
                    MsgObj_Klemmen_Status_01.Klemmen_Status_01_CHK = SigVal;
                    break;
                case 2:
                    MsgObj_Klemmen_Status_01.ZAS_Kl_15 = SigVal;
                    break;
                case 3:
                    MsgObj_Klemmen_Status_01.ZAS_Kl_50 = SigVal;
                    break;
                case 4:
                    MsgObj_Klemmen_Status_01.ZAS_Kl_S = SigVal;
                    break;
                case 5:
                    MsgObj_Klemmen_Status_01.ZAS_Kl_X = SigVal;
                    break;
            }
        }
        break;
        case FRM_HANDLE_Klima_01:
        {
            switch (SigIdx)
            {
                case 0:
                    MsgObj_Klima_01.KL_4_Zonen = SigVal;
                    break;
                case 1:
                    MsgObj_Klima_01.KL_AC_Schalter = SigVal;
                    break;
                case 2:
                    MsgObj_Klima_01.KL_Anf_KL = SigVal;
                    break;
                case 3:
                    MsgObj_Klima_01.KL_Charisma_FahrPr = SigVal;
                    break;
                case 4:
                    MsgObj_Klima_01.KL_Charisma_Status = SigVal;
                    break;
                case 5:
                    MsgObj_Klima_01.KL_Charisma_Umschaltung = SigVal;
                    break;
                case 6:
                    MsgObj_Klima_01.KL_Comp_enable = SigVal;
                    break;
                case 7:
                    MsgObj_Klima_01.KL_Comp_rev_rq = SigVal;
                    break;
                case 8:
                    MsgObj_Klima_01.KL_Diag_Absperrvent = SigVal;
                    break;
                case 9:
                    MsgObj_Klima_01.KL_Drehz_Anh = SigVal;
                    break;
                case 10:
                    MsgObj_Klima_01.KL_Handshake_BEM = SigVal;
                    break;
                case 11:
                    MsgObj_Klima_01.KL_KD_Fehler = SigVal;
                    break;
                case 12:
                    MsgObj_Klima_01.KL_Komp_Moment_alt = SigVal;
                    break;
                case 13:
                    MsgObj_Klima_01.KL_Last_Kompr = SigVal;
                    break;
                case 14:
                    MsgObj_Klima_01.KL_Leistung_Hzg_Soll = SigVal;
                    break;
                case 15:
                    MsgObj_Klima_01.KL_StartStopp_Info = SigVal;
                    break;
                case 16:
                    MsgObj_Klima_01.KL_Thermomanagement = SigVal;
                    break;
                case 17:
                    MsgObj_Klima_01.KL_Vorwarn_HFS_ein = SigVal;
                    break;
                case 18:
                    MsgObj_Klima_01.KL_Vorwarn_HHS_ein = SigVal;
                    break;
                case 19:
                    MsgObj_Klima_01.KL_Vorwarn_Komp_ein = SigVal;
                    break;
                case 20:
                    MsgObj_Klima_01.KL_Vorwarn_Zuheizer_ein = SigVal;
                    break;
                case 21:
                    MsgObj_Klima_01.KL_Zustand = SigVal;
                    break;
                case 22:
                    MsgObj_Klima_01.KL_el_Zuheizer_Stufe = SigVal;
                    break;
            }
        }
        break;
        case FRM_HANDLE_Kombi_01:
        {
            switch (SigIdx)
            {
                case 0:
                    MsgObj_Kombi_01.KBI_ABS_Lampe = SigVal;
                    break;
                case 1:
                    MsgObj_Kombi_01.KBI_Airbag_Lampe = SigVal;
                    break;
                case 2:
                    MsgObj_Kombi_01.KBI_Anzeigefehler_LDW = SigVal;
                    break;
                case 3:
                    MsgObj_Kombi_01.KBI_Anzeigefehler_SWA = SigVal;
                    break;
                case 4:
                    MsgObj_Kombi_01.KBI_BKL_Lampe = SigVal;
                    break;
                case 5:
                    MsgObj_Kombi_01.KBI_ESP_Lampe = SigVal;
                    break;
                case 6:
                    MsgObj_Kombi_01.KBI_Einheit_Tacho = SigVal;
                    break;
                case 7:
                    MsgObj_Kombi_01.KBI_Fehler_Anzeige_ACC = SigVal;
                    break;
                case 8:
                    MsgObj_Kombi_01.KBI_Handbremse = SigVal;
                    break;
                case 9:
                    MsgObj_Kombi_01.KBI_KD_Fehler = SigVal;
                    break;
                case 10:
                    MsgObj_Kombi_01.KBI_Konsistenz_ACC = SigVal;
                    break;
                case 11:
                    MsgObj_Kombi_01.KBI_Lenkung_Lampe = SigVal;
                    break;
                case 12:
                    MsgObj_Kombi_01.KBI_MFA_v_Einheit_01 = SigVal;
                    break;
                case 13:
                    MsgObj_Kombi_01.KBI_Oeldruck_Schalter = SigVal;
                    break;
                case 14:
                    MsgObj_Kombi_01.KBI_Oeldruckwarnung = SigVal;
                    break;
                case 15:
                    MsgObj_Kombi_01.KBI_SILA_gueltig = SigVal;
                    break;
                case 16:
                    MsgObj_Kombi_01.KBI_Tankwarnung = SigVal;
                    break;
                case 17:
                    MsgObj_Kombi_01.KBI_Variante_USA = SigVal;
                    break;
                case 18:
                    MsgObj_Kombi_01.KBI_Vorglueh_System_Lampe = SigVal;
                    break;
                case 19:
                    MsgObj_Kombi_01.KBI_angez_Geschw = SigVal;
                    break;
                case 20:
                    MsgObj_Kombi_01.KBI_im_Stellgliedtest = SigVal;
                    break;
            }
        }
        break;
        case FRM_HANDLE_Kombi_02:
        {
            switch (SigIdx)
            {
                case 0:
                    MsgObj_Kombi_02.KBI_Aussen_Temp_gef = SigVal;
                    break;
                case 1:
                    MsgObj_Kombi_02.KBI_FStatus_Tank = SigVal;
                    break;
                case 2:
                    MsgObj_Kombi_02.KBI_Inhalt_Tank = SigVal;
                    break;
                case 3:
                    MsgObj_Kombi_02.KBI_Kilometerstand = SigVal;
                    break;
                case 4:
                    MsgObj_Kombi_02.KBI_Oelwechsel_durchgefuehrt = SigVal;
                    break;
                case 5:
                    MsgObj_Kombi_02.KBI_QBit_Aussen_Temp_gef = SigVal;
                    break;
                case 6:
                    MsgObj_Kombi_02.KBI_Reset_Standzeit = SigVal;
                    break;
                case 7:
                    MsgObj_Kombi_02.KBI_Standzeit = SigVal;
                    break;
            }
        }
        break;
        case FRM_HANDLE_Kombi_03:
        {
            switch (SigIdx)
            {
                case 0:
                    MsgObj_Kombi_03.KBI_Reifenumfang = SigVal;
                    break;
            }
        }
        break;
        case FRM_HANDLE_LH_EPS_02:
        {
            switch (SigIdx)
            {
                case 0:
                    MsgObj_LH_EPS_02.EPS_02_BZ = SigVal;
                    break;
                case 1:
                    MsgObj_LH_EPS_02.EPS_02_CRC = SigVal;
                    break;
                case 2:
                    MsgObj_LH_EPS_02.EPS_Drehzahlreserve = SigVal;
                    break;
                case 3:
                    MsgObj_LH_EPS_02.EPS_Lastinfo = SigVal;
                    break;
                case 4:
                    MsgObj_LH_EPS_02.EPS_Leistungsanforderung = SigVal;
                    break;
                case 5:
                    MsgObj_LH_EPS_02.EPS_Motorstartverzoegerung = SigVal;
                    break;
                case 6:
                    MsgObj_LH_EPS_02.EPS_Notlauf = SigVal;
                    break;
                case 7:
                    MsgObj_LH_EPS_02.EPS_StartStopp_Info = SigVal;
                    break;
                case 8:
                    MsgObj_LH_EPS_02.EPS_Unterstuetzungsleistung = SigVal;
                    break;
                case 9:
                    MsgObj_LH_EPS_02.EPS_VZ_Drehzahlreserve = SigVal;
                    break;
            }
        }
        break;
        case FRM_HANDLE_LS_01:
        {
            switch (SigIdx)
            {
                case 0:
                    MsgObj_LS_01.LS_01_BZ = SigVal;
                    break;
                case 1:
                    MsgObj_LS_01.LS_01_CHK = SigVal;
                    break;
                case 2:
                    MsgObj_LS_01.LS_Abbrechen = SigVal;
                    break;
                case 3:
                    MsgObj_LS_01.LS_Codierung = SigVal;
                    break;
                case 4:
                    MsgObj_LS_01.LS_Fehler = SigVal;
                    break;
                case 5:
                    MsgObj_LS_01.LS_GRA_ACC_2stufig = SigVal;
                    break;
                case 6:
                    MsgObj_LS_01.LS_Hauptschalter = SigVal;
                    break;
                case 7:
                    MsgObj_LS_01.LS_Limiter = SigVal;
                    break;
                case 8:
                    MsgObj_LS_01.LS_Tip_Hoch = SigVal;
                    break;
                case 9:
                    MsgObj_LS_01.LS_Tip_Runter = SigVal;
                    break;
                case 10:
                    MsgObj_LS_01.LS_Tip_Setzen = SigVal;
                    break;
                case 11:
                    MsgObj_LS_01.LS_Tip_Stufe_2 = SigVal;
                    break;
                case 12:
                    MsgObj_LS_01.LS_Tip_Wiederaufnahme = SigVal;
                    break;
                case 13:
                    MsgObj_LS_01.LS_Tiptronic_Fehler = SigVal;
                    break;
                case 14:
                    MsgObj_LS_01.LS_Typ_Hauptschalter = SigVal;
                    break;
                case 15:
                    MsgObj_LS_01.LS_Verstellung_Zeitluecke = SigVal;
                    break;
                case 16:
                    MsgObj_LS_01.MFL_Tip_Down = SigVal;
                    break;
                case 17:
                    MsgObj_LS_01.MFL_Tip_Up = SigVal;
                    break;
            }
        }
        break;
        case FRM_HANDLE_LWI_01:
        {
            switch (SigIdx)
            {
                case 0:
                    MsgObj_LWI_01.LWI_01_BZ = SigVal;
                    break;
                case 1:
                    MsgObj_LWI_01.LWI_01_CHK = SigVal;
                    break;
                case 2:
                    MsgObj_LWI_01.LWI_01_CRC = SigVal;
                    break;
                case 3:
                    MsgObj_LWI_01.LWI_Lenkradw_Geschw = SigVal;
                    break;
                case 4:
                    MsgObj_LWI_01.LWI_Lenkradwinkel = SigVal;
                    break;
                case 5:
                    MsgObj_LWI_01.LWI_QBit_Lenkradwinkel = SigVal;
                    break;
                case 6:
                    MsgObj_LWI_01.LWI_QBit_Sub_Daten = SigVal;
                    break;
                case 7:
                    MsgObj_LWI_01.LWI_Sensorstatus = SigVal;
                    break;
                case 8:
                    MsgObj_LWI_01.LWI_Sub_Daten = SigVal;
                    break;
                case 9:
                    MsgObj_LWI_01.LWI_VZ_Lenkradw_Geschw = SigVal;
                    break;
                case 10:
                    MsgObj_LWI_01.LWI_VZ_Lenkradwinkel = SigVal;
                    break;
            }
        }
        break;
        case FRM_HANDLE_Licht_hinten_01:
        {
            switch (SigIdx)
            {
                case 0:
                    MsgObj_Licht_hinten_01.BCM2_Bremsl_durch_ECD = SigVal;
                    break;
                case 1:
                    MsgObj_Licht_hinten_01.LH_3_Bremsl_def = SigVal;
                    break;
                case 2:
                    MsgObj_Licht_hinten_01.LH_Aussenlicht_def = SigVal;
                    break;
                case 3:
                    MsgObj_Licht_hinten_01.LH_Blinker_HL_akt = SigVal;
                    break;
                case 4:
                    MsgObj_Licht_hinten_01.LH_Blinker_HR_akt = SigVal;
                    break;
                case 5:
                    MsgObj_Licht_hinten_01.LH_Blinker_li_def = SigVal;
                    break;
                case 6:
                    MsgObj_Licht_hinten_01.LH_Blinker_re_def = SigVal;
                    break;
                case 7:
                    MsgObj_Licht_hinten_01.LH_Brems_Blk_li_def = SigVal;
                    break;
                case 8:
                    MsgObj_Licht_hinten_01.LH_Brems_Blk_re_def = SigVal;
                    break;
                case 9:
                    MsgObj_Licht_hinten_01.LH_Bremsl_li_def = SigVal;
                    break;
                case 10:
                    MsgObj_Licht_hinten_01.LH_Bremsl_li_ges_def = SigVal;
                    break;
                case 11:
                    MsgObj_Licht_hinten_01.LH_Bremsl_re_def = SigVal;
                    break;
                case 12:
                    MsgObj_Licht_hinten_01.LH_Bremsl_re_ges_def = SigVal;
                    break;
                case 13:
                    MsgObj_Licht_hinten_01.LH_Bremslicht_H_aktiv = SigVal;
                    break;
                case 14:
                    MsgObj_Licht_hinten_01.LH_Kennzl_def = SigVal;
                    break;
                case 15:
                    MsgObj_Licht_hinten_01.LH_Nebel_li_def = SigVal;
                    break;
                case 16:
                    MsgObj_Licht_hinten_01.LH_Nebel_mi_def = SigVal;
                    break;
                case 17:
                    MsgObj_Licht_hinten_01.LH_Nebel_re_def = SigVal;
                    break;
                case 18:
                    MsgObj_Licht_hinten_01.LH_Nebelschluss_aktiv = SigVal;
                    break;
                case 19:
                    MsgObj_Licht_hinten_01.LH_Parklicht_HL_aktiv = SigVal;
                    break;
                case 20:
                    MsgObj_Licht_hinten_01.LH_Parklicht_HR_aktiv = SigVal;
                    break;
                case 21:
                    MsgObj_Licht_hinten_01.LH_Rueckf_li_def = SigVal;
                    break;
                case 22:
                    MsgObj_Licht_hinten_01.LH_Rueckf_mi_def = SigVal;
                    break;
                case 23:
                    MsgObj_Licht_hinten_01.LH_Rueckf_re_def = SigVal;
                    break;
                case 24:
                    MsgObj_Licht_hinten_01.LH_Rueckfahrlicht_aktiv = SigVal;
                    break;
                case 25:
                    MsgObj_Licht_hinten_01.LH_SL_BRL_BLK_li_def = SigVal;
                    break;
                case 26:
                    MsgObj_Licht_hinten_01.LH_SL_BRL_BLK_re_def = SigVal;
                    break;
                case 27:
                    MsgObj_Licht_hinten_01.LH_Schluss_Brems_li_def = SigVal;
                    break;
                case 28:
                    MsgObj_Licht_hinten_01.LH_Schluss_Brems_re_def = SigVal;
                    break;
                case 29:
                    MsgObj_Licht_hinten_01.LH_Schluss_Nebel_li_def = SigVal;
                    break;
                case 30:
                    MsgObj_Licht_hinten_01.LH_Schluss_Nebel_re_def = SigVal;
                    break;
                case 31:
                    MsgObj_Licht_hinten_01.LH_Schlusslicht_li_def = SigVal;
                    break;
                case 32:
                    MsgObj_Licht_hinten_01.LH_Schlusslicht_re_def = SigVal;
                    break;
                case 33:
                    MsgObj_Licht_hinten_01.LH_Standlicht_H_aktiv = SigVal;
                    break;
                case 34:
                    MsgObj_Licht_hinten_01.Licht_hinten_01_BZ = SigVal;
                    break;
            }
        }
        break;
        case FRM_HANDLE_NMH_Gateway:
        {
            switch (SigIdx)
            {
                case 0:
                    MsgObj_NMH_Gateway.NMH_GW_ACAN = SigVal;
                    break;
                case 1:
                    MsgObj_NMH_Gateway.NMH_GW_Abschaltstufe_3 = SigVal;
                    break;
                case 2:
                    MsgObj_NMH_Gateway.NMH_GW_Abschaltstufe_aktiv = SigVal;
                    break;
                case 3:
                    MsgObj_NMH_Gateway.NMH_GW_CAN_Diag_deaktiv = SigVal;
                    break;
                case 4:
                    MsgObj_NMH_Gateway.NMH_GW_Car_WakeUp = SigVal;
                    break;
                case 5:
                    MsgObj_NMH_Gateway.NMH_GW_Eindraht_Fehler = SigVal;
                    break;
                case 6:
                    MsgObj_NMH_Gateway.NMH_GW_Fkt_WakeUp = SigVal;
                    break;
                case 7:
                    MsgObj_NMH_Gateway.NMH_GW_Infotainment = SigVal;
                    break;
                case 8:
                    MsgObj_NMH_Gateway.NMH_GW_KombiCAN = SigVal;
                    break;
                case 9:
                    MsgObj_NMH_Gateway.NMH_GW_KomfortCAN = SigVal;
                    break;
                case 10:
                    MsgObj_NMH_Gateway.NMH_GW_KompSchutz = SigVal;
                    break;
                case 11:
                    MsgObj_NMH_Gateway.NMH_GW_Mute_Mode = SigVal;
                    break;
                case 12:
                    MsgObj_NMH_Gateway.NMH_GW_NM_aktiv_BDM = SigVal;
                    break;
                case 13:
                    MsgObj_NMH_Gateway.NMH_GW_NM_aktiv_Diagnose = SigVal;
                    break;
                case 14:
                    MsgObj_NMH_Gateway.NMH_GW_NM_aktiv_ESP = SigVal;
                    break;
                case 15:
                    MsgObj_NMH_Gateway.NMH_GW_NM_aktiv_Klemme_15 = SigVal;
                    break;
                case 16:
                    MsgObj_NMH_Gateway.NMH_GW_NM_aktiv_Start = SigVal;
                    break;
                case 17:
                    MsgObj_NMH_Gateway.NMH_GW_NM_aktiv_Warnblinken = SigVal;
                    break;
                case 18:
                    MsgObj_NMH_Gateway.NMH_GW_Normal_Mode_1 = SigVal;
                    break;
                case 19:
                    MsgObj_NMH_Gateway.NMH_GW_Normal_Mode_2 = SigVal;
                    break;
                case 20:
                    MsgObj_NMH_Gateway.NMH_GW_Per_WakeUp = SigVal;
                    break;
                case 21:
                    MsgObj_NMH_Gateway.NMH_GW_SG_Fehlerdauer = SigVal;
                    break;
                case 22:
                    MsgObj_NMH_Gateway.NMH_GW_STH_Wakeup = SigVal;
                    break;
                case 23:
                    MsgObj_NMH_Gateway.NMH_GW_Start_1 = SigVal;
                    break;
                case 24:
                    MsgObj_NMH_Gateway.NMH_GW_Start_2 = SigVal;
                    break;
                case 25:
                    MsgObj_NMH_Gateway.NMH_GW_TimeOut_Fehler = SigVal;
                    break;
                case 26:
                    MsgObj_NMH_Gateway.NMH_GW_Transport_Mode = SigVal;
                    break;
                case 27:
                    MsgObj_NMH_Gateway.NMH_GW_WakeUp_CAN_Bus = SigVal;
                    break;
            }
        }
        break;
        case FRM_HANDLE_OBD_Tankgeber_01:
        {
            switch (SigIdx)
            {
                case 0:
                    MsgObj_OBD_Tankgeber_01.OBD_TG_F_Status_1 = SigVal;
                    break;
                case 1:
                    MsgObj_OBD_Tankgeber_01.OBD_TG_F_Status_2 = SigVal;
                    break;
                case 2:
                    MsgObj_OBD_Tankgeber_01.OBD_TG_F_Status_3 = SigVal;
                    break;
                case 3:
                    MsgObj_OBD_Tankgeber_01.OBD_TG_F_Status_4 = SigVal;
                    break;
                case 4:
                    MsgObj_OBD_Tankgeber_01.OBD_TG_Sens_Rohwert_1 = SigVal;
                    break;
                case 5:
                    MsgObj_OBD_Tankgeber_01.OBD_TG_Sens_Rohwert_2 = SigVal;
                    break;
                case 6:
                    MsgObj_OBD_Tankgeber_01.OBD_TG_Sens_Rohwert_3 = SigVal;
                    break;
                case 7:
                    MsgObj_OBD_Tankgeber_01.OBD_TG_Sens_Rohwert_4 = SigVal;
                    break;
            }
        }
        break;
        case FRM_HANDLE_SCR_01:
        {
            switch (SigIdx)
            {
                case 0:
                    MsgObj_SCR_01.SCR_01_BZ = SigVal;
                    break;
                case 1:
                    MsgObj_SCR_01.SCR_Dosierpumpe_Drehzahl = SigVal;
                    break;
                case 2:
                    MsgObj_SCR_01.SCR_Druck = SigVal;
                    break;
                case 3:
                    MsgObj_SCR_01.SCR_Level_Aktivtank = SigVal;
                    break;
                case 4:
                    MsgObj_SCR_01.SCR_Level_Passivtank = SigVal;
                    break;
            }
        }
        break;
        case FRM_HANDLE_SCR_02:
        {
            switch (SigIdx)
            {
                case 0:
                    MsgObj_SCR_02.SCR_02_BZ = SigVal;
                    break;
                case 1:
                    MsgObj_SCR_02.SCR_Guetesensor = SigVal;
                    break;
                case 2:
                    MsgObj_SCR_02.SCR_Heizkreis_3_Strom = SigVal;
                    break;
                case 3:
                    MsgObj_SCR_02.SCR_KD_Fehler = SigVal;
                    break;
                case 4:
                    MsgObj_SCR_02.SCR_Leitungsheizung_Strom = SigVal;
                    break;
                case 5:
                    MsgObj_SCR_02.SCR_Tankheizung_Strom = SigVal;
                    break;
                case 6:
                    MsgObj_SCR_02.SCR_Temp_Aktivtank = SigVal;
                    break;
                case 7:
                    MsgObj_SCR_02.SCR_Temp_Passivtank = SigVal;
                    break;
                case 8:
                    MsgObj_SCR_02.SCR_Transferpumpe_Strom = SigVal;
                    break;
            }
        }
        break;
        case FRM_HANDLE_SCR_03:
        {
            switch (SigIdx)
            {
                case 0:
                    MsgObj_SCR_03.SCR_03_BZ = SigVal;
                    break;
                case 1:
                    MsgObj_SCR_03.SCR_Dosierpumpe_Status_Spule = SigVal;
                    break;
                case 2:
                    MsgObj_SCR_03.SCR_Druck_Status = SigVal;
                    break;
                case 3:
                    MsgObj_SCR_03.SCR_Guetesensor_Status = SigVal;
                    break;
                case 4:
                    MsgObj_SCR_03.SCR_Heizkreis_3_Status = SigVal;
                    break;
                case 5:
                    MsgObj_SCR_03.SCR_Leitungsheizung_Status = SigVal;
                    break;
                case 6:
                    MsgObj_SCR_03.SCR_Level_Aktivtank_Status = SigVal;
                    break;
                case 7:
                    MsgObj_SCR_03.SCR_Level_Passivtank_Status = SigVal;
                    break;
                case 8:
                    MsgObj_SCR_03.SCR_Spannungsversorgung_Status = SigVal;
                    break;
                case 9:
                    MsgObj_SCR_03.SCR_Tankheizung_Status = SigVal;
                    break;
                case 10:
                    MsgObj_SCR_03.SCR_Temp_Aktivtank_Status = SigVal;
                    break;
                case 11:
                    MsgObj_SCR_03.SCR_Temp_Passivtank_Status = SigVal;
                    break;
                case 12:
                    MsgObj_SCR_03.SCR_Transferpumpe_Status = SigVal;
                    break;
                case 13:
                    MsgObj_SCR_03.SCR_VersorgungSensoren_Status = SigVal;
                    break;
            }
        }
        break;
        case FRM_HANDLE_SCR_04:
        {
            switch (SigIdx)
            {
                case 0:
                    MsgObj_SCR_04.SCR_04_BZ = SigVal;
                    break;
                case 1:
                    MsgObj_SCR_04.SCR_Ansteuerung_Dosierpumpe = SigVal;
                    break;
                case 2:
                    MsgObj_SCR_04.SCR_Ansteuerung_Heizkreis_3 = SigVal;
                    break;
                case 3:
                    MsgObj_SCR_04.SCR_Ansteuerung_Leitungsheizung = SigVal;
                    break;
                case 4:
                    MsgObj_SCR_04.SCR_Ansteuerung_Tankheizung = SigVal;
                    break;
                case 5:
                    MsgObj_SCR_04.SCR_Ansteuerung_Transferpumpe = SigVal;
                    break;
                case 6:
                    MsgObj_SCR_04.SCR_CAL_CVN_CRC_32 = SigVal;
                    break;
            }
        }
        break;
        case FRM_HANDLE_SCR_05:
        {
            switch (SigIdx)
            {
                case 0:
                    MsgObj_SCR_05.SCR_05_BZ = SigVal;
                    break;
                case 1:
                    MsgObj_SCR_05.SCR_Steuergeraet_Bus_Status = SigVal;
                    break;
                case 2:
                    MsgObj_SCR_05.SCR_Steuergeraet_Codierung_Status = SigVal;
                    break;
                case 3:
                    MsgObj_SCR_05.SCR_Steuergeraet_Datensatz_Status = SigVal;
                    break;
                case 4:
                    MsgObj_SCR_05.SCR_Steuergeraet_Defekt_Status = SigVal;
                    break;
                case 5:
                    MsgObj_SCR_05.SCR_Steuergeraet_Heizung_Status = SigVal;
                    break;
                case 6:
                    MsgObj_SCR_05.SCR_Steuergeraet_Pumpe_Status = SigVal;
                    break;
                case 7:
                    MsgObj_SCR_05.SCR_Steuergeraet_Relais_Status = SigVal;
                    break;
            }
        }
        break;
        case FRM_HANDLE_SCR_CAL_ID1:
        {
            switch (SigIdx)
            {
                case 0:
                    MsgObj_SCR_CAL_ID1.SCR_CAL_ID_Index_01 = SigVal;
                    break;
                case 1:
                    MsgObj_SCR_CAL_ID1.SCR_CAL_ID_Index_02 = SigVal;
                    break;
                case 2:
                    MsgObj_SCR_CAL_ID1.SCR_CAL_ID_Index_03 = SigVal;
                    break;
                case 3:
                    MsgObj_SCR_CAL_ID1.SCR_CAL_ID_Index_04 = SigVal;
                    break;
                case 4:
                    MsgObj_SCR_CAL_ID1.SCR_CAL_ID_Index_05 = SigVal;
                    break;
                case 5:
                    MsgObj_SCR_CAL_ID1.SCR_CAL_ID_Index_06 = SigVal;
                    break;
                case 6:
                    MsgObj_SCR_CAL_ID1.SCR_CAL_ID_Index_07 = SigVal;
                    break;
                case 7:
                    MsgObj_SCR_CAL_ID1.SCR_CAL_ID_Index_08 = SigVal;
                    break;
            }
        }
        break;
        case FRM_HANDLE_SCR_CAL_ID2:
        {
            switch (SigIdx)
            {
                case 0:
                    MsgObj_SCR_CAL_ID2.SCR_CAL_ID_Index_09 = SigVal;
                    break;
                case 1:
                    MsgObj_SCR_CAL_ID2.SCR_CAL_ID_Index_10 = SigVal;
                    break;
                case 2:
                    MsgObj_SCR_CAL_ID2.SCR_CAL_ID_Index_11 = SigVal;
                    break;
                case 3:
                    MsgObj_SCR_CAL_ID2.SCR_CAL_ID_Index_12 = SigVal;
                    break;
                case 4:
                    MsgObj_SCR_CAL_ID2.SCR_CAL_ID_Index_13 = SigVal;
                    break;
                case 5:
                    MsgObj_SCR_CAL_ID2.SCR_CAL_ID_Index_14 = SigVal;
                    break;
                case 6:
                    MsgObj_SCR_CAL_ID2.SCR_CAL_ID_Index_15 = SigVal;
                    break;
                case 7:
                    MsgObj_SCR_CAL_ID2.SCR_CAL_ID_Index_16 = SigVal;
                    break;
            }
        }
        break;
        case FRM_HANDLE_SCU_01:
        {
            switch (SigIdx)
            {
                case 0:
                    MsgObj_SCU_01.SCU_01_BZ = SigVal;
                    break;
                case 1:
                    MsgObj_SCU_01.SCU_01_CHK = SigVal;
                    break;
                case 2:
                    MsgObj_SCU_01.SCU_01_CRC = SigVal;
                    break;
                case 3:
                    MsgObj_SCU_01.SCU_KD_Fehler = SigVal;
                    break;
                case 4:
                    MsgObj_SCU_01.SCU_Soll_Ue_Winkel = SigVal;
                    break;
                case 5:
                    MsgObj_SCU_01.SCU_Status = SigVal;
                    break;
                case 6:
                    MsgObj_SCU_01.SCU_Ue_Winkel_ADS = SigVal;
                    break;
                case 7:
                    MsgObj_SCU_01.SCU_VZ_Soll_Ue_Winkel = SigVal;
                    break;
                case 8:
                    MsgObj_SCU_01.SCU_VZ_Ue_Winkel_ADS = SigVal;
                    break;
                case 9:
                    MsgObj_SCU_01.SCU_max_Gradient = SigVal;
                    break;
            }
        }
        break;
        case FRM_HANDLE_STH_01:
        {
            switch (SigIdx)
            {
                case 0:
                    MsgObj_STH_01.STH_EKP_Anst = SigVal;
                    break;
                case 1:
                    MsgObj_STH_01.STH_Fehler_ElWaPu = SigVal;
                    break;
                case 2:
                    MsgObj_STH_01.STH_Fehlerstatus = SigVal;
                    break;
                case 3:
                    MsgObj_STH_01.STH_Funk_aus = SigVal;
                    break;
                case 4:
                    MsgObj_STH_01.STH_Funk_ein = SigVal;
                    break;
                case 5:
                    MsgObj_STH_01.STH_Geblaese = SigVal;
                    break;
                case 6:
                    MsgObj_STH_01.STH_Heizleistung = SigVal;
                    break;
                case 7:
                    MsgObj_STH_01.STH_KD_Fehler = SigVal;
                    break;
                case 8:
                    MsgObj_STH_01.STH_KVS = SigVal;
                    break;
                case 9:
                    MsgObj_STH_01.STH_KVS_Ueberlauf = SigVal;
                    break;
                case 10:
                    MsgObj_STH_01.STH_LED = SigVal;
                    break;
                case 11:
                    MsgObj_STH_01.STH_Motorvorwaermung = SigVal;
                    break;
                case 12:
                    MsgObj_STH_01.STH_Pumpe_ein = SigVal;
                    break;
                case 13:
                    MsgObj_STH_01.STH_Pumpen_Anf_extern = SigVal;
                    break;
                case 14:
                    MsgObj_STH_01.STH_Servicemode = SigVal;
                    break;
                case 15:
                    MsgObj_STH_01.STH_Ventil_Status = SigVal;
                    break;
                case 16:
                    MsgObj_STH_01.STH_Ventiloeffnungszeit = SigVal;
                    break;
                case 17:
                    MsgObj_STH_01.STH_Waermeeintrag = SigVal;
                    break;
                case 18:
                    MsgObj_STH_01.STH_Wassertemp = SigVal;
                    break;
                case 19:
                    MsgObj_STH_01.STH_Zusatzheizung = SigVal;
                    break;
                case 20:
                    MsgObj_STH_01.STH_war_aktiv = SigVal;
                    break;
            }
        }
        break;
        case FRM_HANDLE_STS_01:
        {
            switch (SigIdx)
            {
                case 0:
                    MsgObj_STS_01.STS_01_BZ = SigVal;
                    break;
                case 1:
                    MsgObj_STS_01.STS_01_CHK = SigVal;
                    break;
                case 2:
                    MsgObj_STS_01.STS_Alarm_Blinker = SigVal;
                    break;
                case 3:
                    MsgObj_STS_01.STS_Anlassersperre = SigVal;
                    break;
                case 4:
                    MsgObj_STS_01.STS_Car_not_under_theft = SigVal;
                    break;
                case 5:
                    MsgObj_STS_01.STS_Car_under_theft = SigVal;
                    break;
                case 6:
                    MsgObj_STS_01.STS_Fahrlicht = SigVal;
                    break;
                case 7:
                    MsgObj_STS_01.STS_KD_Fehler = SigVal;
                    break;
                case 8:
                    MsgObj_STS_01.STS_LIN_aktiv = SigVal;
                    break;
                case 9:
                    MsgObj_STS_01.STS_Laderelais = SigVal;
                    break;
                case 10:
                    MsgObj_STS_01.STS_Leerlaufschaltung = SigVal;
                    break;
                case 11:
                    MsgObj_STS_01.STS_Notstart = SigVal;
                    break;
                case 12:
                    MsgObj_STS_01.STS_Signalhorn = SigVal;
                    break;
                case 13:
                    MsgObj_STS_01.STS_Standlicht = SigVal;
                    break;
                case 14:
                    MsgObj_STS_01.STS_Summer = SigVal;
                    break;
                case 15:
                    MsgObj_STS_01.STS_Typencodierung = SigVal;
                    break;
            }
        }
        break;
        case FRM_HANDLE_Systeminfo_01:
        {
            switch (SigIdx)
            {
                case 0:
                    MsgObj_Systeminfo_01.GW_KD_Fehler = SigVal;
                    break;
                case 1:
                    MsgObj_Systeminfo_01.SI_CAN_Antrieb_Sleep = SigVal;
                    break;
                case 2:
                    MsgObj_Systeminfo_01.SI_CAN_Dashboard_Sleep = SigVal;
                    break;
                case 3:
                    MsgObj_Systeminfo_01.SI_CAN_Extended_Sleep = SigVal;
                    break;
                case 4:
                    MsgObj_Systeminfo_01.SI_CAN_Fahrwerk_Sleep = SigVal;
                    break;
                case 5:
                    MsgObj_Systeminfo_01.SI_CAN_Komfort_Sleep = SigVal;
                    break;
                case 6:
                    MsgObj_Systeminfo_01.SI_Diagnose_Aktiv = SigVal;
                    break;
                case 7:
                    MsgObj_Systeminfo_01.SI_Fahrwerk_Sleep = SigVal;
                    break;
                case 8:
                    MsgObj_Systeminfo_01.SI_Infotainment_Sleep = SigVal;
                    break;
                case 9:
                    MsgObj_Systeminfo_01.SI_Int_CAN_gespiegelt = SigVal;
                    break;
                case 10:
                    MsgObj_Systeminfo_01.SI_MOST_Status = SigVal;
                    break;
                case 11:
                    MsgObj_Systeminfo_01.SI_MO_WU = SigVal;
                    break;
                case 12:
                    MsgObj_Systeminfo_01.SI_NWDF = SigVal;
                    break;
                case 13:
                    MsgObj_Systeminfo_01.SI_NWDF_gueltig = SigVal;
                    break;
                case 14:
                    MsgObj_Systeminfo_01.SI_QRS_Mode = SigVal;
                    break;
                case 15:
                    MsgObj_Systeminfo_01.SI_Sammel_SG_Fehler = SigVal;
                    break;
                case 16:
                    MsgObj_Systeminfo_01.SI_Sammelfehler = SigVal;
                    break;
                case 17:
                    MsgObj_Systeminfo_01.SI_T_Mode = SigVal;
                    break;
            }
        }
        break;
    }
}
/*@@end*/

/*@@caplFunc:GetSignalVal(int,int):*/
int GetSignalVal (int FrmIdx, int SigIdx)
{
    int SigVal;

    switch (FrmIdx)
    {
        case FRM_HANDLE_ACC_01:
        {
            switch (SigIdx)
            {
                case 0:
                    SigVal = MsgObj_ACC_01.ACC_01_BZ;
                    break;
                case 1:
                    SigVal = MsgObj_ACC_01.ACC_01_CHK;
                    break;
                case 2:
                    SigVal = MsgObj_ACC_01.ACC_Anhalten;
                    break;
                case 3:
                    SigVal = MsgObj_ACC_01.ACC_Dynamik;
                    break;
                case 4:
                    SigVal = MsgObj_ACC_01.ACC_KD_Fehler;
                    break;
                case 5:
                    SigVal = MsgObj_ACC_01.ACC_Minimale_Bremsung;
                    break;
                case 6:
                    SigVal = MsgObj_ACC_01.ACC_Sollbeschleunigung;
                    break;
                case 7:
                    SigVal = MsgObj_ACC_01.ACC_Status_ACC;
                    break;
                case 8:
                    SigVal = MsgObj_ACC_01.ACC_neg_Sollbeschl_Grad;
                    break;
                case 9:
                    SigVal = MsgObj_ACC_01.ACC_pos_Sollbeschl_Grad;
                    break;
                case 10:
                    SigVal = MsgObj_ACC_01.ACC_zul_Regelabw_oben;
                    break;
                case 11:
                    SigVal = MsgObj_ACC_01.ACC_zul_Regelabw_unten;
                    break;
            }
        }
        break;
        case FRM_HANDLE_ACC_05:
        {
            switch (SigIdx)
            {
                case 0:
                    SigVal = MsgObj_ACC_05.ACC_05_BZ;
                    break;
                case 1:
                    SigVal = MsgObj_ACC_05.ACC_05_CHK;
                    break;
                case 2:
                    SigVal = MsgObj_ACC_05.ACC_Anhalten;
                    break;
                case 3:
                    SigVal = MsgObj_ACC_05.ACC_Betaetigung_EPB;
                    break;
                case 4:
                    SigVal = MsgObj_ACC_05.ACC_Freigabe_Momentenanf;
                    break;
                case 5:
                    SigVal = MsgObj_ACC_05.ACC_Momentenanforderung;
                    break;
                case 6:
                    SigVal = MsgObj_ACC_05.ACC_StartStopp_Info;
                    break;
                case 7:
                    SigVal = MsgObj_ACC_05.ACC_Status_ACC;
                    break;
                case 8:
                    SigVal = MsgObj_ACC_05.ACC_limitierte_Anfahrdyn;
                    break;
            }
        }
        break;
        case FRM_HANDLE_Airbag_01:
        {
            switch (SigIdx)
            {
                case 0:
                    SigVal = MsgObj_Airbag_01.AB_Anzeige_Fussg;
                    break;
                case 1:
                    SigVal = MsgObj_Airbag_01.AB_Crash_Int;
                    break;
                case 2:
                    SigVal = MsgObj_Airbag_01.AB_Deaktiviert;
                    break;
                case 3:
                    SigVal = MsgObj_Airbag_01.AB_Deaktivierung_HV;
                    break;
                case 4:
                    SigVal = MsgObj_Airbag_01.AB_Diagnose;
                    break;
                case 5:
                    SigVal = MsgObj_Airbag_01.AB_Erh_Auf_VB;
                    break;
                case 6:
                    SigVal = MsgObj_Airbag_01.AB_Front_Crash;
                    break;
                case 7:
                    SigVal = MsgObj_Airbag_01.AB_Gurtwarn_VB;
                    break;
                case 8:
                    SigVal = MsgObj_Airbag_01.AB_Gurtwarn_VF;
                    break;
                case 9:
                    SigVal = MsgObj_Airbag_01.AB_Heck_Crash;
                    break;
                case 10:
                    SigVal = MsgObj_Airbag_01.AB_KD_Fehler;
                    break;
                case 11:
                    SigVal = MsgObj_Airbag_01.AB_Lampe;
                    break;
                case 12:
                    SigVal = MsgObj_Airbag_01.AB_Rollover_Crash;
                    break;
                case 13:
                    SigVal = MsgObj_Airbag_01.AB_SB_Crash;
                    break;
                case 14:
                    SigVal = MsgObj_Airbag_01.AB_SF_Crash;
                    break;
                case 15:
                    SigVal = MsgObj_Airbag_01.AB_Stellgliedtest;
                    break;
                case 16:
                    SigVal = MsgObj_Airbag_01.AB_Systemfehler;
                    break;
                case 17:
                    SigVal = MsgObj_Airbag_01.AB_VB_deaktiviert;
                    break;
                case 18:
                    SigVal = MsgObj_Airbag_01.Airbag_01_BZ;
                    break;
                case 19:
                    SigVal = MsgObj_Airbag_01.Airbag_01_CHK;
                    break;
                case 20:
                    SigVal = MsgObj_Airbag_01.void_Byte_02;
                    break;
                case 21:
                    SigVal = MsgObj_Airbag_01.void_Byte_03;
                    break;
            }
        }
        break;
        case FRM_HANDLE_Airbag_02:
        {
            switch (SigIdx)
            {
                case 0:
                    SigVal = MsgObj_Airbag_02.AB_Belegung_VB;
                    break;
                case 1:
                    SigVal = MsgObj_Airbag_02.AB_Gurtschloss_BF;
                    break;
                case 2:
                    SigVal = MsgObj_Airbag_02.AB_Gurtschloss_FA;
                    break;
                case 3:
                    SigVal = MsgObj_Airbag_02.AB_Gurtschloss_Reihe2_BF;
                    break;
                case 4:
                    SigVal = MsgObj_Airbag_02.AB_Gurtschloss_Reihe2_FA;
                    break;
                case 5:
                    SigVal = MsgObj_Airbag_02.AB_Gurtschloss_Reihe2_MI;
                    break;
                case 6:
                    SigVal = MsgObj_Airbag_02.AB_Gurtschloss_Reihe3_BF;
                    break;
                case 7:
                    SigVal = MsgObj_Airbag_02.AB_Gurtschloss_Reihe3_FA;
                    break;
                case 8:
                    SigVal = MsgObj_Airbag_02.AB_Gurtschloss_Reihe3_MI;
                    break;
                case 9:
                    SigVal = MsgObj_Airbag_02.AB_Sitzpos_Sens_BF;
                    break;
                case 10:
                    SigVal = MsgObj_Airbag_02.AB_Sitzpos_Sens_FA;
                    break;
            }
        }
        break;
        case FRM_HANDLE_Allrad_02:
        {
            switch (SigIdx)
            {
                case 0:
                    SigVal = MsgObj_Allrad_02.ALR_Begrenzungsmoment;
                    break;
                case 1:
                    SigVal = MsgObj_Allrad_02.ALR_Charisma_FahrPr;
                    break;
                case 2:
                    SigVal = MsgObj_Allrad_02.ALR_Charisma_Status;
                    break;
                case 3:
                    SigVal = MsgObj_Allrad_02.ALR_Charisma_Umschaltung;
                    break;
                case 4:
                    SigVal = MsgObj_Allrad_02.ALR_ESP_akt;
                    break;
                case 5:
                    SigVal = MsgObj_Allrad_02.ALR_Fahrerwunsch;
                    break;
                case 6:
                    SigVal = MsgObj_Allrad_02.ALR_KD_Fehler;
                    break;
                case 7:
                    SigVal = MsgObj_Allrad_02.ALR_LED_Auto_Diff;
                    break;
                case 8:
                    SigVal = MsgObj_Allrad_02.ALR_LED_High;
                    break;
                case 9:
                    SigVal = MsgObj_Allrad_02.ALR_LED_Low;
                    break;
                case 10:
                    SigVal = MsgObj_Allrad_02.ALR_LED_Low_Lock;
                    break;
                case 11:
                    SigVal = MsgObj_Allrad_02.ALR_LED_Rear_Lock;
                    break;
                case 12:
                    SigVal = MsgObj_Allrad_02.ALR_Limiter;
                    break;
                case 13:
                    SigVal = MsgObj_Allrad_02.ALR_Offroad;
                    break;
                case 14:
                    SigVal = MsgObj_Allrad_02.ALR_Schalten;
                    break;
                case 15:
                    SigVal = MsgObj_Allrad_02.ALR_Sta_Begrenzungsmom;
                    break;
                case 16:
                    SigVal = MsgObj_Allrad_02.ALR_Sta_Laengssperre;
                    break;
                case 17:
                    SigVal = MsgObj_Allrad_02.ALR_Sta_PrioAnzeige;
                    break;
                case 18:
                    SigVal = MsgObj_Allrad_02.ALR_Sta_Quersperre;
                    break;
                case 19:
                    SigVal = MsgObj_Allrad_02.ALR_Sta_Untersetzung;
                    break;
                case 20:
                    SigVal = MsgObj_Allrad_02.ALR_Symbol_Lock;
                    break;
                case 21:
                    SigVal = MsgObj_Allrad_02.ALR_Symbol_Low;
                    break;
                case 22:
                    SigVal = MsgObj_Allrad_02.ALR_Symbol_RearLock;
                    break;
                case 23:
                    SigVal = MsgObj_Allrad_02.ALR_Temp_schutz;
                    break;
                case 24:
                    SigVal = MsgObj_Allrad_02.ALR_Texte;
                    break;
                case 25:
                    SigVal = MsgObj_Allrad_02.ALR_Vorwarnung;
                    break;
            }
        }
        break;
        case FRM_HANDLE_Anhaenger_01:
        {
            switch (SigIdx)
            {
                case 0:
                    SigVal = MsgObj_Anhaenger_01.AAG_AVS_Fehler;
                    break;
                case 1:
                    SigVal = MsgObj_Anhaenger_01.AAG_AVS_Stati;
                    break;
                case 2:
                    SigVal = MsgObj_Anhaenger_01.AAG_Anhaenger_abgesteckt;
                    break;
                case 3:
                    SigVal = MsgObj_Anhaenger_01.AAG_Anhaenger_erkannt;
                    break;
                case 4:
                    SigVal = MsgObj_Anhaenger_01.AAG_BZ;
                    break;
                case 5:
                    SigVal = MsgObj_Anhaenger_01.AAG_Blinker_HL_def;
                    break;
                case 6:
                    SigVal = MsgObj_Anhaenger_01.AAG_Blinker_HR_def;
                    break;
                case 7:
                    SigVal = MsgObj_Anhaenger_01.AAG_Blinker_H_aktiv;
                    break;
                case 8:
                    SigVal = MsgObj_Anhaenger_01.AAG_Bremsl_durch_ECD;
                    break;
                case 9:
                    SigVal = MsgObj_Anhaenger_01.AAG_Bremslicht_H_def;
                    break;
                case 10:
                    SigVal = MsgObj_Anhaenger_01.AAG_KD_Fehler;
                    break;
                case 11:
                    SigVal = MsgObj_Anhaenger_01.AAG_NSL_aktiv;
                    break;
                case 12:
                    SigVal = MsgObj_Anhaenger_01.AAG_Schlusslicht_HL_def;
                    break;
                case 13:
                    SigVal = MsgObj_Anhaenger_01.AAG_Schlusslicht_HR_def;
                    break;
            }
        }
        break;
        case FRM_HANDLE_BEM_01:
        {
            switch (SigIdx)
            {
                case 0:
                    SigVal = MsgObj_BEM_01.BEM_01_Abschaltstufen;
                    break;
                case 1:
                    SigVal = MsgObj_BEM_01.BEM_01_BZ;
                    break;
                case 2:
                    SigVal = MsgObj_BEM_01.BEM_01_CHK;
                    break;
                case 3:
                    SigVal = MsgObj_BEM_01.BEM_Anf_KL;
                    break;
                case 4:
                    SigVal = MsgObj_BEM_01.BEM_P_Generator;
                    break;
                case 5:
                    SigVal = MsgObj_BEM_01.BEM_Segel_Info;
                    break;
                case 6:
                    SigVal = MsgObj_BEM_01.BEM_StartStopp_Info;
                    break;
                case 7:
                    SigVal = MsgObj_BEM_01.BEM_n_LLA;
                    break;
            }
        }
        break;
        case FRM_HANDLE_Charisma_01:
        {
            switch (SigIdx)
            {
                case 0:
                    SigVal = MsgObj_Charisma_01.CHA_01_BZ;
                    break;
                case 1:
                    SigVal = MsgObj_Charisma_01.CHA_01_CHK;
                    break;
                case 2:
                    SigVal = MsgObj_Charisma_01.CHA_Systemstatus;
                    break;
                case 3:
                    SigVal = MsgObj_Charisma_01.CHA_Ziel_FahrPr_DR;
                    break;
                case 4:
                    SigVal = MsgObj_Charisma_01.CHA_Ziel_FahrPr_GE;
                    break;
                case 5:
                    SigVal = MsgObj_Charisma_01.CHA_Ziel_FahrPr_MO;
                    break;
                case 6:
                    SigVal = MsgObj_Charisma_01.CHA_Ziel_FahrPr_QS;
                    break;
                case 7:
                    SigVal = MsgObj_Charisma_01.CHA_Ziel_FahrPr_SCU;
                    break;
                case 8:
                    SigVal = MsgObj_Charisma_01.CHA_Ziel_FahrPr_ST;
                    break;
                case 9:
                    SigVal = MsgObj_Charisma_01.CHA_Ziel_FahrPr_Sys_7;
                    break;
                case 10:
                    SigVal = MsgObj_Charisma_01.CHA_Ziel_FahrPr_Sys_8;
                    break;
            }
        }
        break;
        case FRM_HANDLE_Diagnose_01:
        {
            switch (SigIdx)
            {
                case 0:
                    SigVal = MsgObj_Diagnose_01.DGN_Verlernzaehler;
                    break;
                case 1:
                    SigVal = MsgObj_Diagnose_01.KBI_Kilometerstand;
                    break;
                case 2:
                    SigVal = MsgObj_Diagnose_01.Kombi_02_alt;
                    break;
                case 3:
                    SigVal = MsgObj_Diagnose_01.UH_Jahr;
                    break;
                case 4:
                    SigVal = MsgObj_Diagnose_01.UH_Minute;
                    break;
                case 5:
                    SigVal = MsgObj_Diagnose_01.UH_Monat;
                    break;
                case 6:
                    SigVal = MsgObj_Diagnose_01.UH_Sekunde;
                    break;
                case 7:
                    SigVal = MsgObj_Diagnose_01.UH_Stunde;
                    break;
                case 8:
                    SigVal = MsgObj_Diagnose_01.UH_Tag;
                    break;
                case 9:
                    SigVal = MsgObj_Diagnose_01.Uhrzeit_01_alt;
                    break;
            }
        }
        break;
        case FRM_HANDLE_EPB_01:
        {
            switch (SigIdx)
            {
                case 0:
                    SigVal = MsgObj_EPB_01.EPB_01_BZ;
                    break;
                case 1:
                    SigVal = MsgObj_EPB_01.EPB_01_CHK;
                    break;
                case 2:
                    SigVal = MsgObj_EPB_01.EPB_BCM2_Motor_Wakeup;
                    break;
                case 3:
                    SigVal = MsgObj_EPB_01.EPB_Fehlerstatus;
                    break;
                case 4:
                    SigVal = MsgObj_EPB_01.EPB_Freig_Verzoeg_Anf;
                    break;
                case 5:
                    SigVal = MsgObj_EPB_01.EPB_KD_Fehler;
                    break;
                case 6:
                    SigVal = MsgObj_EPB_01.EPB_Laengsbeschleunigung;
                    break;
                case 7:
                    SigVal = MsgObj_EPB_01.EPB_Pedalweg_Kuppl;
                    break;
                case 8:
                    SigVal = MsgObj_EPB_01.EPB_QBit_Laengsbeschleunigung;
                    break;
                case 9:
                    SigVal = MsgObj_EPB_01.EPB_QBit_Pedalweg_Kuppl;
                    break;
                case 10:
                    SigVal = MsgObj_EPB_01.EPB_QBit_Schalterpos;
                    break;
                case 11:
                    SigVal = MsgObj_EPB_01.EPB_Schalterposition;
                    break;
                case 12:
                    SigVal = MsgObj_EPB_01.EPB_Spannkraft;
                    break;
                case 13:
                    SigVal = MsgObj_EPB_01.EPB_Status;
                    break;
                case 14:
                    SigVal = MsgObj_EPB_01.EPB_Verzoeg_Anf;
                    break;
            }
        }
        break;
        case FRM_HANDLE_ESP_01:
        {
            switch (SigIdx)
            {
                case 0:
                    SigVal = MsgObj_ESP_01.ABS_Bremsung;
                    break;
                case 1:
                    SigVal = MsgObj_ESP_01.ASR_Anf;
                    break;
                case 2:
                    SigVal = MsgObj_ESP_01.ASR_MSR_Moment_schnell;
                    break;
                case 3:
                    SigVal = MsgObj_ESP_01.ASR_Moment_langsam;
                    break;
                case 4:
                    SigVal = MsgObj_ESP_01.ASR_Schalteingriff;
                    break;
                case 5:
                    SigVal = MsgObj_ESP_01.ASR_Tastung_passiv;
                    break;
                case 6:
                    SigVal = MsgObj_ESP_01.EBV_Eingriff;
                    break;
                case 7:
                    SigVal = MsgObj_ESP_01.EDS_Eingriff;
                    break;
                case 8:
                    SigVal = MsgObj_ESP_01.ESP_01_BZ;
                    break;
                case 9:
                    SigVal = MsgObj_ESP_01.ESP_01_CHK;
                    break;
                case 10:
                    SigVal = MsgObj_ESP_01.ESP_ASP;
                    break;
                case 11:
                    SigVal = MsgObj_ESP_01.ESP_Eingriff;
                    break;
                case 12:
                    SigVal = MsgObj_ESP_01.ESP_KD_Fehler;
                    break;
                case 13:
                    SigVal = MsgObj_ESP_01.ESP_QBit_v_Signal;
                    break;
                case 14:
                    SigVal = MsgObj_ESP_01.ESP_Systemstatus;
                    break;
                case 15:
                    SigVal = MsgObj_ESP_01.ESP_Tastung_passiv;
                    break;
                case 16:
                    SigVal = MsgObj_ESP_01.ESP_v_Signal;
                    break;
                case 17:
                    SigVal = MsgObj_ESP_01.MSR_Anf;
                    break;
                case 18:
                    SigVal = MsgObj_ESP_01.OBD_QBit_Schlechtweg;
                    break;
                case 19:
                    SigVal = MsgObj_ESP_01.OBD_Schlechtweg;
                    break;
            }
        }
        break;
        case FRM_HANDLE_ESP_02:
        {
            switch (SigIdx)
            {
                case 0:
                    SigVal = MsgObj_ESP_02.ESP_02_BZ;
                    break;
                case 1:
                    SigVal = MsgObj_ESP_02.ESP_02_CHK;
                    break;
                case 2:
                    SigVal = MsgObj_ESP_02.ESP_Gierrate;
                    break;
                case 3:
                    SigVal = MsgObj_ESP_02.ESP_Laengsbeschl;
                    break;
                case 4:
                    SigVal = MsgObj_ESP_02.ESP_Notbremsanzeige;
                    break;
                case 5:
                    SigVal = MsgObj_ESP_02.ESP_QBit_Anf_Vert_Wank;
                    break;
                case 6:
                    SigVal = MsgObj_ESP_02.ESP_QBit_Gierrate;
                    break;
                case 7:
                    SigVal = MsgObj_ESP_02.ESP_QBit_Laengsbeschl;
                    break;
                case 8:
                    SigVal = MsgObj_ESP_02.ESP_QBit_Querb;
                    break;
                case 9:
                    SigVal = MsgObj_ESP_02.ESP_Querbeschleunigung;
                    break;
                case 10:
                    SigVal = MsgObj_ESP_02.ESP_Stillstandsflag;
                    break;
                case 11:
                    SigVal = MsgObj_ESP_02.ESP_VZ_Gierrate;
                    break;
                case 12:
                    SigVal = MsgObj_ESP_02.ESP_Verteil_Wankmom;
                    break;
                case 13:
                    SigVal = MsgObj_ESP_02.void_Byte_11;
                    break;
            }
        }
        break;
        case FRM_HANDLE_ESP_03:
        {
            switch (SigIdx)
            {
                case 0:
                    SigVal = MsgObj_ESP_03.ESP_03_BZ;
                    break;
                case 1:
                    SigVal = MsgObj_ESP_03.ESP_03_CHK;
                    break;
                case 2:
                    SigVal = MsgObj_ESP_03.ESP_HL_FR;
                    break;
                case 3:
                    SigVal = MsgObj_ESP_03.ESP_HL_Radgeschw;
                    break;
                case 4:
                    SigVal = MsgObj_ESP_03.ESP_HR_FR;
                    break;
                case 5:
                    SigVal = MsgObj_ESP_03.ESP_HR_Radgeschw;
                    break;
                case 6:
                    SigVal = MsgObj_ESP_03.ESP_VL_FR;
                    break;
                case 7:
                    SigVal = MsgObj_ESP_03.ESP_VL_Radgeschw;
                    break;
                case 8:
                    SigVal = MsgObj_ESP_03.ESP_VR_FR;
                    break;
                case 9:
                    SigVal = MsgObj_ESP_03.ESP_VR_Radgeschw;
                    break;
            }
        }
        break;
        case FRM_HANDLE_ESP_05:
        {
            switch (SigIdx)
            {
                case 0:
                    SigVal = MsgObj_ESP_05.ECD_Bremslicht;
                    break;
                case 1:
                    SigVal = MsgObj_ESP_05.ECD_Fehler;
                    break;
                case 2:
                    SigVal = MsgObj_ESP_05.ECD_nicht_verfuegbar;
                    break;
                case 3:
                    SigVal = MsgObj_ESP_05.ESP_05_BZ;
                    break;
                case 4:
                    SigVal = MsgObj_ESP_05.ESP_05_CHK;
                    break;
                case 5:
                    SigVal = MsgObj_ESP_05.ESP_Anforderung_EPB;
                    break;
                case 6:
                    SigVal = MsgObj_ESP_05.ESP_Autohold_Standby;
                    break;
                case 7:
                    SigVal = MsgObj_ESP_05.ESP_Autohold_aktiv;
                    break;
                case 8:
                    SigVal = MsgObj_ESP_05.ESP_BKV_Unterdruck;
                    break;
                case 9:
                    SigVal = MsgObj_ESP_05.ESP_Bremsdruck;
                    break;
                case 10:
                    SigVal = MsgObj_ESP_05.ESP_Bremsruck_AWV2;
                    break;
                case 11:
                    SigVal = MsgObj_ESP_05.ESP_Eingr_HL;
                    break;
                case 12:
                    SigVal = MsgObj_ESP_05.ESP_Eingr_HR;
                    break;
                case 13:
                    SigVal = MsgObj_ESP_05.ESP_Eingr_VL;
                    break;
                case 14:
                    SigVal = MsgObj_ESP_05.ESP_Eingr_VR;
                    break;
                case 15:
                    SigVal = MsgObj_ESP_05.ESP_FStatus_Anfahrhilfe;
                    break;
                case 16:
                    SigVal = MsgObj_ESP_05.ESP_Fahrer_bremst;
                    break;
                case 17:
                    SigVal = MsgObj_ESP_05.ESP_HBA_aktiv;
                    break;
                case 18:
                    SigVal = MsgObj_ESP_05.ESP_HDC_Standby;
                    break;
                case 19:
                    SigVal = MsgObj_ESP_05.ESP_HDC_aktiv;
                    break;
                case 20:
                    SigVal = MsgObj_ESP_05.ESP_Konsistenz_AWV2;
                    break;
                case 21:
                    SigVal = MsgObj_ESP_05.ESP_Konsistenz_TSK;
                    break;
                case 22:
                    SigVal = MsgObj_ESP_05.ESP_Lenkeingriff_ADS;
                    break;
                case 23:
                    SigVal = MsgObj_ESP_05.ESP_Prefill_ausgeloest;
                    break;
                case 24:
                    SigVal = MsgObj_ESP_05.ESP_QBit_Bremsdruck;
                    break;
                case 25:
                    SigVal = MsgObj_ESP_05.ESP_QBit_Fahrer_bremst;
                    break;
                case 26:
                    SigVal = MsgObj_ESP_05.ESP_Rueckwaertsfahrt_erkannt;
                    break;
                case 27:
                    SigVal = MsgObj_ESP_05.ESP_Schwelle_Unterdruck;
                    break;
                case 28:
                    SigVal = MsgObj_ESP_05.ESP_StartStopp_Info;
                    break;
                case 29:
                    SigVal = MsgObj_ESP_05.ESP_Status_Anfahrhilfe;
                    break;
                case 30:
                    SigVal = MsgObj_ESP_05.ESP_Status_Bremsdruck;
                    break;
                case 31:
                    SigVal = MsgObj_ESP_05.ESP_Status_Bremsentemp;
                    break;
                case 32:
                    SigVal = MsgObj_ESP_05.ESP_Verz_EPB_aktiv;
                    break;
                case 33:
                    SigVal = MsgObj_ESP_05.ESP_Verz_TSK_aktiv;
                    break;
                case 34:
                    SigVal = MsgObj_ESP_05.ESP_Verzoeg_EPB_verf;
                    break;
            }
        }
        break;
        case FRM_HANDLE_ESP_07_FR:
        {
            switch (SigIdx)
            {
                case 0:
                    SigVal = MsgObj_ESP_07_FR.ESP_07_BZ;
                    break;
                case 1:
                    SigVal = MsgObj_ESP_07_FR.ESP_07_CHK;
                    break;
                case 2:
                    SigVal = MsgObj_ESP_07_FR.ESP_ACC_LDE;
                    break;
                case 3:
                    SigVal = MsgObj_ESP_07_FR.ESP_CM_Variante;
                    break;
                case 4:
                    SigVal = MsgObj_ESP_07_FR.ESP_Codierung_ADS;
                    break;
                case 5:
                    SigVal = MsgObj_ESP_07_FR.ESP_MKB_Status;
                    break;
                case 6:
                    SigVal = MsgObj_ESP_07_FR.ESP_MKB_ausloesbar;
                    break;
                case 7:
                    SigVal = MsgObj_ESP_07_FR.ESP_OBD_Status;
                    break;
                case 8:
                    SigVal = MsgObj_ESP_07_FR.ESP_Offroad_Modus;
                    break;
                case 9:
                    SigVal = MsgObj_ESP_07_FR.ESP_Qualifizierung_Antriebsart;
                    break;
                case 10:
                    SigVal = MsgObj_ESP_07_FR.ESP_Quattro_Antrieb;
                    break;
                case 11:
                    SigVal = MsgObj_ESP_07_FR.ESP_RTA_HL;
                    break;
                case 12:
                    SigVal = MsgObj_ESP_07_FR.ESP_RTA_HR;
                    break;
                case 13:
                    SigVal = MsgObj_ESP_07_FR.ESP_RTA_VR;
                    break;
                case 14:
                    SigVal = MsgObj_ESP_07_FR.ESP_Rollenmodus_Deaktivieren;
                    break;
                case 15:
                    SigVal = MsgObj_ESP_07_FR.ESP_nachtr_Stopp_Anf;
                    break;
                case 16:
                    SigVal = MsgObj_ESP_07_FR.OBD_Fehler_Radsensor_HL;
                    break;
                case 17:
                    SigVal = MsgObj_ESP_07_FR.OBD_Fehler_Radsensor_HR;
                    break;
                case 18:
                    SigVal = MsgObj_ESP_07_FR.OBD_Fehler_Radsensor_VL;
                    break;
                case 19:
                    SigVal = MsgObj_ESP_07_FR.OBD_Fehler_Radsensor_VR;
                    break;
            }
        }
        break;
        case FRM_HANDLE_ESP_16:
        {
            switch (SigIdx)
            {
                case 0:
                    SigVal = MsgObj_ESP_16.ESP_16_BZ;
                    break;
                case 1:
                    SigVal = MsgObj_ESP_16.ESP_16_CRC;
                    break;
                case 2:
                    SigVal = MsgObj_ESP_16.ESP_Antrieb_Anf;
                    break;
                case 3:
                    SigVal = MsgObj_ESP_16.ESP_Eingriffsmoment;
                    break;
                case 4:
                    SigVal = MsgObj_ESP_16.ESP_KD_OBD_Fehler;
                    break;
                case 5:
                    SigVal = MsgObj_ESP_16.ESP_KD_OBD_Readiness;
                    break;
                case 6:
                    SigVal = MsgObj_ESP_16.ESP_Pedalweg_Bremse;
                    break;
                case 7:
                    SigVal = MsgObj_ESP_16.ESP_Reku_Anf;
                    break;
                case 8:
                    SigVal = MsgObj_ESP_16.ESP_Reku_Index;
                    break;
            }
        }
        break;
        case FRM_HANDLE_ESP_K_10:
        {
            switch (SigIdx)
            {
                case 0:
                    SigVal = MsgObj_ESP_K_10.ESP_10_BZ;
                    break;
                case 1:
                    SigVal = MsgObj_ESP_K_10.ESP_10_CRC;
                    break;
                case 2:
                    SigVal = MsgObj_ESP_K_10.ESP_HL_Fahrtrichtung;
                    break;
                case 3:
                    SigVal = MsgObj_ESP_K_10.ESP_HR_Fahrtrichtung;
                    break;
                case 4:
                    SigVal = MsgObj_ESP_K_10.ESP_QBit_Wegimpuls_HL;
                    break;
                case 5:
                    SigVal = MsgObj_ESP_K_10.ESP_QBit_Wegimpuls_HR;
                    break;
                case 6:
                    SigVal = MsgObj_ESP_K_10.ESP_QBit_Wegimpuls_VL;
                    break;
                case 7:
                    SigVal = MsgObj_ESP_K_10.ESP_QBit_Wegimpuls_VR;
                    break;
                case 8:
                    SigVal = MsgObj_ESP_K_10.ESP_VL_Fahrtrichtung;
                    break;
                case 9:
                    SigVal = MsgObj_ESP_K_10.ESP_VR_Fahrtrichtung;
                    break;
                case 10:
                    SigVal = MsgObj_ESP_K_10.ESP_Wegimpuls_HL;
                    break;
                case 11:
                    SigVal = MsgObj_ESP_K_10.ESP_Wegimpuls_HR;
                    break;
                case 12:
                    SigVal = MsgObj_ESP_K_10.ESP_Wegimpuls_VL;
                    break;
                case 13:
                    SigVal = MsgObj_ESP_K_10.ESP_Wegimpuls_VR;
                    break;
            }
        }
        break;
        case FRM_HANDLE_Einheiten_01:
        {
            switch (SigIdx)
            {
                case 0:
                    SigVal = MsgObj_Einheiten_01.KBI_Einheit_Datum;
                    break;
                case 1:
                    SigVal = MsgObj_Einheiten_01.KBI_Einheit_Druck;
                    break;
                case 2:
                    SigVal = MsgObj_Einheiten_01.KBI_Einheit_Sprache;
                    break;
                case 3:
                    SigVal = MsgObj_Einheiten_01.KBI_Einheit_Streckenanz;
                    break;
                case 4:
                    SigVal = MsgObj_Einheiten_01.KBI_Einheit_Temp;
                    break;
                case 5:
                    SigVal = MsgObj_Einheiten_01.KBI_Einheit_Uhrzeit;
                    break;
                case 6:
                    SigVal = MsgObj_Einheiten_01.KBI_Einheit_Verbrauch;
                    break;
                case 7:
                    SigVal = MsgObj_Einheiten_01.KBI_Einheit_Volumen;
                    break;
                case 8:
                    SigVal = MsgObj_Einheiten_01.KBI_MFA_v_Einheit_02;
                    break;
            }
        }
        break;
        case FRM_HANDLE_Fahrwerk_02:
        {
            switch (SigIdx)
            {
                case 0:
                    SigVal = MsgObj_Fahrwerk_02.FA_MSG_Einschraenkung;
                    break;
                case 1:
                    SigVal = MsgObj_Fahrwerk_02.Fahrwerk_02_BZ;
                    break;
                case 2:
                    SigVal = MsgObj_Fahrwerk_02.Fahrwerk_02_CHK;
                    break;
            }
        }
        break;
        case FRM_HANDLE_GW_Fwk_01_Ant_PAG:
        {
            switch (SigIdx)
            {
                case 0:
                    SigVal = MsgObj_GW_Fwk_01_Ant_PAG.ESP_Gierrate_Offset;
                    break;
                case 1:
                    SigVal = MsgObj_GW_Fwk_01_Ant_PAG.ESP_Rollenmodus;
                    break;
                case 2:
                    SigVal = MsgObj_GW_Fwk_01_Ant_PAG.FAS_Status_Anzeige;
                    break;
                case 3:
                    SigVal = MsgObj_GW_Fwk_01_Ant_PAG.FSM_Status;
                    break;
                case 4:
                    SigVal = MsgObj_GW_Fwk_01_Ant_PAG.F_ESP_11_Ant;
                    break;
                case 5:
                    SigVal = MsgObj_GW_Fwk_01_Ant_PAG.F_ESP_13_Ant;
                    break;
                case 6:
                    SigVal = MsgObj_GW_Fwk_01_Ant_PAG.F_Getriebe_07_PAG_Fwk;
                    break;
                case 7:
                    SigVal = MsgObj_GW_Fwk_01_Ant_PAG.F_Klima_03_Fwk_Ant;
                    break;
                case 8:
                    SigVal = MsgObj_GW_Fwk_01_Ant_PAG.F_Klima_08_PAG_Fwk;
                    break;
                case 9:
                    SigVal = MsgObj_GW_Fwk_01_Ant_PAG.F_LS_01_Fwk;
                    break;
                case 10:
                    SigVal = MsgObj_GW_Fwk_01_Ant_PAG.F_TSK_03_Fwk;
                    break;
                case 11:
                    SigVal = MsgObj_GW_Fwk_01_Ant_PAG.F_Wischer_01_Fwk;
                    break;
                case 12:
                    SigVal = MsgObj_GW_Fwk_01_Ant_PAG.GE_Getriebestatus;
                    break;
                case 13:
                    SigVal = MsgObj_GW_Fwk_01_Ant_PAG.KL_AussenTemp_WK;
                    break;
                case 14:
                    SigVal = MsgObj_GW_Fwk_01_Ant_PAG.KL_Magnetventil;
                    break;
                case 15:
                    SigVal = MsgObj_GW_Fwk_01_Ant_PAG.KL_Niv_down;
                    break;
                case 16:
                    SigVal = MsgObj_GW_Fwk_01_Ant_PAG.KL_Niv_up;
                    break;
                case 17:
                    SigVal = MsgObj_GW_Fwk_01_Ant_PAG.KL_T_Abgasklappe;
                    break;
                case 18:
                    SigVal = MsgObj_GW_Fwk_01_Ant_PAG.KL_T_HDC;
                    break;
                case 19:
                    SigVal = MsgObj_GW_Fwk_01_Ant_PAG.KL_T_PASM_1;
                    break;
                case 20:
                    SigVal = MsgObj_GW_Fwk_01_Ant_PAG.KL_T_PASM_2;
                    break;
                case 21:
                    SigVal = MsgObj_GW_Fwk_01_Ant_PAG.KL_T_PASM_3;
                    break;
                case 22:
                    SigVal = MsgObj_GW_Fwk_01_Ant_PAG.KL_T_PSM_off;
                    break;
                case 23:
                    SigVal = MsgObj_GW_Fwk_01_Ant_PAG.LS_Fehler;
                    break;
                case 24:
                    SigVal = MsgObj_GW_Fwk_01_Ant_PAG.LS_Tip_Hoch;
                    break;
                case 25:
                    SigVal = MsgObj_GW_Fwk_01_Ant_PAG.LS_Tip_Runter;
                    break;
                case 26:
                    SigVal = MsgObj_GW_Fwk_01_Ant_PAG.TV_Eingriff;
                    break;
                case 27:
                    SigVal = MsgObj_GW_Fwk_01_Ant_PAG.Wischer_vorne_Normal;
                    break;
                case 28:
                    SigVal = MsgObj_GW_Fwk_01_Ant_PAG.Wischer_vorne_Schnell;
                    break;
            }
        }
        break;
        case FRM_HANDLE_Gateway_05:
        {
            switch (SigIdx)
            {
                case 0:
                    SigVal = MsgObj_Gateway_05.BCM1_01_alt;
                    break;
                case 1:
                    SigVal = MsgObj_Gateway_05.BCM1_02_alt;
                    break;
                case 2:
                    SigVal = MsgObj_Gateway_05.BCM1_Adaptive_Lichtvert_Anf;
                    break;
                case 3:
                    SigVal = MsgObj_Gateway_05.BCM1_Aussen_Temp_ungef;
                    break;
                case 4:
                    SigVal = MsgObj_Gateway_05.BCM1_Gleitende_Leuchtw_Anf;
                    break;
                case 5:
                    SigVal = MsgObj_Gateway_05.BCM1_MH_WIV_Schalter;
                    break;
                case 6:
                    SigVal = MsgObj_Gateway_05.BCM1_OBD_FStatus_ATemp;
                    break;
                case 7:
                    SigVal = MsgObj_Gateway_05.BCM1_Oeldruck_Schalter;
                    break;
                case 8:
                    SigVal = MsgObj_Gateway_05.BCM1_Oeldruck_Schalter_2;
                    break;
                case 9:
                    SigVal = MsgObj_Gateway_05.BCM1_RFahrlicht_Fzg_Anf;
                    break;
                case 10:
                    SigVal = MsgObj_Gateway_05.BCM1_Rueckfahrlicht_Schalter;
                    break;
                case 11:
                    SigVal = MsgObj_Gateway_05.BCM1_Schalter_StartStopp;
                    break;
                case 12:
                    SigVal = MsgObj_Gateway_05.BCM1_Vorwaertsgang_eingelegt;
                    break;
                case 13:
                    SigVal = MsgObj_Gateway_05.BT_Tuer_geoeffnet;
                    break;
                case 14:
                    SigVal = MsgObj_Gateway_05.ESP_07_alt;
                    break;
                case 15:
                    SigVal = MsgObj_Gateway_05.ESP_Codierung_ADS;
                    break;
                case 16:
                    SigVal = MsgObj_Gateway_05.FA_StartStopp_Info;
                    break;
                case 17:
                    SigVal = MsgObj_Gateway_05.FT_Sperrklinke;
                    break;
                case 18:
                    SigVal = MsgObj_Gateway_05.FT_Tuer_geoeffnet;
                    break;
                case 19:
                    SigVal = MsgObj_Gateway_05.Fahrwerk_02_alt;
                    break;
                case 20:
                    SigVal = MsgObj_Gateway_05.GW_05_va_27;
                    break;
                case 21:
                    SigVal = MsgObj_Gateway_05.HL_Tuer_geoeffnet;
                    break;
                case 22:
                    SigVal = MsgObj_Gateway_05.HR_Tuer_geoeffnet;
                    break;
                case 23:
                    SigVal = MsgObj_Gateway_05.KL_HSH_ein_Soll;
                    break;
                case 24:
                    SigVal = MsgObj_Gateway_05.KL_Zuheizer_Freigabe;
                    break;
                case 25:
                    SigVal = MsgObj_Gateway_05.Klima_02_alt;
                    break;
                case 26:
                    SigVal = MsgObj_Gateway_05.Klima_Sensor_02_alt;
                    break;
                case 27:
                    SigVal = MsgObj_Gateway_05.MO_Handshake_STH;
                    break;
                case 28:
                    SigVal = MsgObj_Gateway_05.MO_Status_Normalbetrieb_01;
                    break;
                case 29:
                    SigVal = MsgObj_Gateway_05.Motor_02_alt;
                    break;
                case 30:
                    SigVal = MsgObj_Gateway_05.Motor_05_alt;
                    break;
                case 31:
                    SigVal = MsgObj_Gateway_05.PH_StartStopp_Info;
                    break;
                case 32:
                    SigVal = MsgObj_Gateway_05.Parkhilfe_01_alt;
                    break;
                case 33:
                    SigVal = MsgObj_Gateway_05.QSP_01_alt;
                    break;
                case 34:
                    SigVal = MsgObj_Gateway_05.QSP_StartStopp_Info;
                    break;
                case 35:
                    SigVal = MsgObj_Gateway_05.TSG_BT_1_alt;
                    break;
                case 36:
                    SigVal = MsgObj_Gateway_05.TSG_FT_1_alt;
                    break;
                case 37:
                    SigVal = MsgObj_Gateway_05.TSG_HL_1_alt;
                    break;
                case 38:
                    SigVal = MsgObj_Gateway_05.TSG_HR_1_alt;
                    break;
                case 39:
                    SigVal = MsgObj_Gateway_05.Wischer_01_alt;
                    break;
                case 40:
                    SigVal = MsgObj_Gateway_05.Wischer_vorne_aktiv;
                    break;
            }
        }
        break;
        case FRM_HANDLE_Gateway_11:
        {
            switch (SigIdx)
            {
                case 0:
                    SigVal = MsgObj_Gateway_11.BCM1_01_alt;
                    break;
                case 1:
                    SigVal = MsgObj_Gateway_11.BCM1_02_alt;
                    break;
                case 2:
                    SigVal = MsgObj_Gateway_11.BCM1_04_alt;
                    break;
                case 3:
                    SigVal = MsgObj_Gateway_11.BCM1_Allwetterlicht_Anf;
                    break;
                case 4:
                    SigVal = MsgObj_Gateway_11.BCM1_LDS_Stellung;
                    break;
                case 5:
                    SigVal = MsgObj_Gateway_11.BCM1_Licht_Dunkelheit_aktiv;
                    break;
                case 6:
                    SigVal = MsgObj_Gateway_11.BCM1_Linksverkehr;
                    break;
                case 7:
                    SigVal = MsgObj_Gateway_11.BCM1_MH_Schalter;
                    break;
                case 8:
                    SigVal = MsgObj_Gateway_11.BCM1_Touristen_Licht_Anf;
                    break;
                case 9:
                    SigVal = MsgObj_Gateway_11.BCM2_02_alt;
                    break;
                case 10:
                    SigVal = MsgObj_Gateway_11.BCM2_P_verriegelt;
                    break;
                case 11:
                    SigVal = MsgObj_Gateway_11.BCM_Tankwunsch;
                    break;
                case 12:
                    SigVal = MsgObj_Gateway_11.BH_Blinker_li;
                    break;
                case 13:
                    SigVal = MsgObj_Gateway_11.BH_Blinker_re;
                    break;
                case 14:
                    SigVal = MsgObj_Gateway_11.BH_Fernlicht;
                    break;
                case 15:
                    SigVal = MsgObj_Gateway_11.BH_Lichthupe;
                    break;
                case 16:
                    SigVal = MsgObj_Gateway_11.BM_Autobahn;
                    break;
                case 17:
                    SigVal = MsgObj_Gateway_11.ESP_04_alt;
                    break;
                case 18:
                    SigVal = MsgObj_Gateway_11.ESP_Diagnose;
                    break;
                case 19:
                    SigVal = MsgObj_Gateway_11.GW_11_va_20;
                    break;
                case 20:
                    SigVal = MsgObj_Gateway_11.GW_11_va_21;
                    break;
                case 21:
                    SigVal = MsgObj_Gateway_11.GW_11_va_22;
                    break;
                case 22:
                    SigVal = MsgObj_Gateway_11.GW_11_va_23;
                    break;
                case 23:
                    SigVal = MsgObj_Gateway_11.GW_11_va_24;
                    break;
                case 24:
                    SigVal = MsgObj_Gateway_11.GW_11_va_25;
                    break;
                case 25:
                    SigVal = MsgObj_Gateway_11.GW_11_va_26;
                    break;
                case 26:
                    SigVal = MsgObj_Gateway_11.GW_11_va_27;
                    break;
                case 27:
                    SigVal = MsgObj_Gateway_11.HUD_01_alt;
                    break;
                case 28:
                    SigVal = MsgObj_Gateway_11.HUD_Anzeigefehler_NV;
                    break;
                case 29:
                    SigVal = MsgObj_Gateway_11.HUD_NV_in_Anzeige;
                    break;
                case 30:
                    SigVal = MsgObj_Gateway_11.HYB_Anf_E_Mode;
                    break;
                case 31:
                    SigVal = MsgObj_Gateway_11.HYB_Anf_E_Mode_alt;
                    break;
                case 32:
                    SigVal = MsgObj_Gateway_11.LV_AFL_aktiv_Anzeige;
                    break;
                case 33:
                    SigVal = MsgObj_Gateway_11.LV_Abblendlicht_Anzeige;
                    break;
                case 34:
                    SigVal = MsgObj_Gateway_11.LV_Abblendlicht_li_def;
                    break;
                case 35:
                    SigVal = MsgObj_Gateway_11.LV_Abblendlicht_re_def;
                    break;
                case 36:
                    SigVal = MsgObj_Gateway_11.LV_Nebelschlusslicht_Anzeige;
                    break;
                case 37:
                    SigVal = MsgObj_Gateway_11.SMLS_01_alt;
                    break;
                case 38:
                    SigVal = MsgObj_Gateway_11.ZV_Tankklappenstatus;
                    break;
            }
        }
        break;
        case FRM_HANDLE_Getriebe_01:
        {
            switch (SigIdx)
            {
                case 0:
                    SigVal = MsgObj_Getriebe_01.GE_Freig_MMom_Vorhalt;
                    break;
                case 1:
                    SigVal = MsgObj_Getriebe_01.GE_Freig_Mmom_Soll;
                    break;
                case 2:
                    SigVal = MsgObj_Getriebe_01.GE_Freig_Mom_Eingriff;
                    break;
                case 3:
                    SigVal = MsgObj_Getriebe_01.GE_KD_Fehler;
                    break;
                case 4:
                    SigVal = MsgObj_Getriebe_01.GE_MMom_Soll;
                    break;
                case 5:
                    SigVal = MsgObj_Getriebe_01.GE_MMom_Status;
                    break;
                case 6:
                    SigVal = MsgObj_Getriebe_01.GE_MMom_Vorhalt;
                    break;
                case 7:
                    SigVal = MsgObj_Getriebe_01.GE_Mom_Ident;
                    break;
                case 8:
                    SigVal = MsgObj_Getriebe_01.GE_Mom_MZP;
                    break;
                case 9:
                    SigVal = MsgObj_Getriebe_01.GE_Schaltvorgang;
                    break;
                case 10:
                    SigVal = MsgObj_Getriebe_01.GE_Status_Kupplung;
                    break;
                case 11:
                    SigVal = MsgObj_Getriebe_01.GE_Status_Schaltablauf;
                    break;
                case 12:
                    SigVal = MsgObj_Getriebe_01.GE_Verbot_Ausblendung;
                    break;
                case 13:
                    SigVal = MsgObj_Getriebe_01.GE_Zeit_MZP;
                    break;
                case 14:
                    SigVal = MsgObj_Getriebe_01.Getriebe_01_BZ;
                    break;
                case 15:
                    SigVal = MsgObj_Getriebe_01.Getriebe_01_CHK;
                    break;
            }
        }
        break;
        case FRM_HANDLE_Getriebe_02:
        {
            switch (SigIdx)
            {
                case 0:
                    SigVal = MsgObj_Getriebe_02.GE_Anf_Zylabsch;
                    break;
                case 1:
                    SigVal = MsgObj_Getriebe_02.GE_Anheb_Solldrehz_Leerlauf;
                    break;
                case 2:
                    SigVal = MsgObj_Getriebe_02.GE_Drehzahlmesser_Daempfung;
                    break;
                case 3:
                    SigVal = MsgObj_Getriebe_02.GE_Freigabe_Synchro;
                    break;
                case 4:
                    SigVal = MsgObj_Getriebe_02.GE_HYB_DZ_Eingriff;
                    break;
                case 5:
                    SigVal = MsgObj_Getriebe_02.GE_Mom_Begr_Gradient;
                    break;
                case 6:
                    SigVal = MsgObj_Getriebe_02.GE_Schubabschalt_Unt;
                    break;
                case 7:
                    SigVal = MsgObj_Getriebe_02.GE_Synchro_Wunschdrehz;
                    break;
                case 8:
                    SigVal = MsgObj_Getriebe_02.GE_Synchro_Zeit;
                    break;
                case 9:
                    SigVal = MsgObj_Getriebe_02.GE_Vorsteuermoment;
                    break;
                case 10:
                    SigVal = MsgObj_Getriebe_02.Getriebe_02_BZ;
                    break;
                case 11:
                    SigVal = MsgObj_Getriebe_02.Getriebe_02_CHK;
                    break;
            }
        }
        break;
        case FRM_HANDLE_Getriebe_03:
        {
            switch (SigIdx)
            {
                case 0:
                    SigVal = MsgObj_Getriebe_03.GE_Codierung_MSG;
                    break;
                case 1:
                    SigVal = MsgObj_Getriebe_03.GE_Eingangsdrehz;
                    break;
                case 2:
                    SigVal = MsgObj_Getriebe_03.GE_Freig_Langfr_Schutzmom;
                    break;
                case 3:
                    SigVal = MsgObj_Getriebe_03.GE_Langfr_Schutzmom;
                    break;
                case 4:
                    SigVal = MsgObj_Getriebe_03.GE_Notlauf;
                    break;
                case 5:
                    SigVal = MsgObj_Getriebe_03.GE_Performance_Start_LB;
                    break;
                case 6:
                    SigVal = MsgObj_Getriebe_03.GE_StartStopp_Info;
                    break;
                case 7:
                    SigVal = MsgObj_Getriebe_03.GE_Uefkt;
                    break;
                case 8:
                    SigVal = MsgObj_Getriebe_03.GE_Waehlhebel;
                    break;
                case 9:
                    SigVal = MsgObj_Getriebe_03.GE_Zielgang;
                    break;
                case 10:
                    SigVal = MsgObj_Getriebe_03.GE_reserv_Waehlhebel;
                    break;
                case 11:
                    SigVal = MsgObj_Getriebe_03.Getriebe_03_BZ;
                    break;
                case 12:
                    SigVal = MsgObj_Getriebe_03.Getriebe_03_CHK;
                    break;
            }
        }
        break;
        case FRM_HANDLE_Getriebe_04:
        {
            switch (SigIdx)
            {
                case 0:
                    SigVal = MsgObj_Getriebe_04.GE_Charisma_FahrPr;
                    break;
                case 1:
                    SigVal = MsgObj_Getriebe_04.GE_Charisma_Status;
                    break;
                case 2:
                    SigVal = MsgObj_Getriebe_04.GE_Charisma_Umschaltung;
                    break;
                case 3:
                    SigVal = MsgObj_Getriebe_04.GE_Freigabe_Verfallsinfo_WFS;
                    break;
                case 4:
                    SigVal = MsgObj_Getriebe_04.GE_Grenzkriechmoment;
                    break;
                case 5:
                    SigVal = MsgObj_Getriebe_04.GE_Heizwunsch;
                    break;
                case 6:
                    SigVal = MsgObj_Getriebe_04.GE_Index_Fahrwid;
                    break;
                case 7:
                    SigVal = MsgObj_Getriebe_04.GE_LFR_Adaption;
                    break;
                case 8:
                    SigVal = MsgObj_Getriebe_04.GE_OBD_AbsperrVent;
                    break;
                case 9:
                    SigVal = MsgObj_Getriebe_04.GE_OBD_Status;
                    break;
                case 10:
                    SigVal = MsgObj_Getriebe_04.GE_Sumpftemperatur;
                    break;
                case 11:
                    SigVal = MsgObj_Getriebe_04.GE_Verlustmoment;
                    break;
                case 12:
                    SigVal = MsgObj_Getriebe_04.GE_amax_moeglich;
                    break;
            }
        }
        break;
        case FRM_HANDLE_Kessy_02:
        {
            switch (SigIdx)
            {
                case 0:
                    SigVal = MsgObj_Kessy_02.FBS_KD_Fehler;
                    break;
                case 1:
                    SigVal = MsgObj_Kessy_02.FBS_Prio_Warn_04;
                    break;
                case 2:
                    SigVal = MsgObj_Kessy_02.FBS_Prio_Warn_05;
                    break;
                case 3:
                    SigVal = MsgObj_Kessy_02.FBS_Warn_LenkVerriegelung_def;
                    break;
                case 4:
                    SigVal = MsgObj_Kessy_02.FBS_Warn_Lenkung_def;
                    break;
                case 5:
                    SigVal = MsgObj_Kessy_02.FBS_Warn_Schluessel_Batt;
                    break;
                case 6:
                    SigVal = MsgObj_Kessy_02.KYL_Warn_Kessy_defekt;
                    break;
                case 7:
                    SigVal = MsgObj_Kessy_02.KYL_Warn_kein_Schuessel;
                    break;
                case 8:
                    SigVal = MsgObj_Kessy_02.KY_ELV_enable_Anforderung;
                    break;
                case 9:
                    SigVal = MsgObj_Kessy_02.KY_ELV_entr;
                    break;
                case 10:
                    SigVal = MsgObj_Kessy_02.KY_ELV_verr;
                    break;
                case 11:
                    SigVal = MsgObj_Kessy_02.KY_FBS_Fahrer_Hinweise;
                    break;
                case 12:
                    SigVal = MsgObj_Kessy_02.KY_FFB_Frequenz;
                    break;
                case 13:
                    SigVal = MsgObj_Kessy_02.KY_Funkschl_Nr;
                    break;
                case 14:
                    SigVal = MsgObj_Kessy_02.KY_HF_Aktiv;
                    break;
                case 15:
                    SigVal = MsgObj_Kessy_02.KY_ID_Geb_autorisiert;
                    break;
                case 16:
                    SigVal = MsgObj_Kessy_02.KY_ID_Geb_steckt;
                    break;
                case 17:
                    SigVal = MsgObj_Kessy_02.KY_KYL_Fahrer_Hinweise;
                    break;
                case 18:
                    SigVal = MsgObj_Kessy_02.KY_KYL_Prio_Warn_03;
                    break;
                case 19:
                    SigVal = MsgObj_Kessy_02.KY_KYL_Prio_Warn_04;
                    break;
                case 20:
                    SigVal = MsgObj_Kessy_02.KY_KYL_Prio_Warn_05;
                    break;
                case 21:
                    SigVal = MsgObj_Kessy_02.KY_Keyless_Verbau;
                    break;
                case 22:
                    SigVal = MsgObj_Kessy_02.KY_LF_Aktiv;
                    break;
                case 23:
                    SigVal = MsgObj_Kessy_02.KY_Schluessel_Ist;
                    break;
                case 24:
                    SigVal = MsgObj_Kessy_02.KY_Schluessel_Soll;
                    break;
                case 25:
                    SigVal = MsgObj_Kessy_02.KY_StartStopp_Info;
                    break;
                case 26:
                    SigVal = MsgObj_Kessy_02.KY_Valet_Parking;
                    break;
                case 27:
                    SigVal = MsgObj_Kessy_02.KY_WFS_LZ;
                    break;
                case 28:
                    SigVal = MsgObj_Kessy_02.KY_WFS_Safe;
                    break;
            }
        }
        break;
        case FRM_HANDLE_Klemmen_Status_01:
        {
            switch (SigIdx)
            {
                case 0:
                    SigVal = MsgObj_Klemmen_Status_01.Klemmen_Status_01_BZ;
                    break;
                case 1:
                    SigVal = MsgObj_Klemmen_Status_01.Klemmen_Status_01_CHK;
                    break;
                case 2:
                    SigVal = MsgObj_Klemmen_Status_01.ZAS_Kl_15;
                    break;
                case 3:
                    SigVal = MsgObj_Klemmen_Status_01.ZAS_Kl_50;
                    break;
                case 4:
                    SigVal = MsgObj_Klemmen_Status_01.ZAS_Kl_S;
                    break;
                case 5:
                    SigVal = MsgObj_Klemmen_Status_01.ZAS_Kl_X;
                    break;
            }
        }
        break;
        case FRM_HANDLE_Klima_01:
        {
            switch (SigIdx)
            {
                case 0:
                    SigVal = MsgObj_Klima_01.KL_4_Zonen;
                    break;
                case 1:
                    SigVal = MsgObj_Klima_01.KL_AC_Schalter;
                    break;
                case 2:
                    SigVal = MsgObj_Klima_01.KL_Anf_KL;
                    break;
                case 3:
                    SigVal = MsgObj_Klima_01.KL_Charisma_FahrPr;
                    break;
                case 4:
                    SigVal = MsgObj_Klima_01.KL_Charisma_Status;
                    break;
                case 5:
                    SigVal = MsgObj_Klima_01.KL_Charisma_Umschaltung;
                    break;
                case 6:
                    SigVal = MsgObj_Klima_01.KL_Comp_enable;
                    break;
                case 7:
                    SigVal = MsgObj_Klima_01.KL_Comp_rev_rq;
                    break;
                case 8:
                    SigVal = MsgObj_Klima_01.KL_Diag_Absperrvent;
                    break;
                case 9:
                    SigVal = MsgObj_Klima_01.KL_Drehz_Anh;
                    break;
                case 10:
                    SigVal = MsgObj_Klima_01.KL_Handshake_BEM;
                    break;
                case 11:
                    SigVal = MsgObj_Klima_01.KL_KD_Fehler;
                    break;
                case 12:
                    SigVal = MsgObj_Klima_01.KL_Komp_Moment_alt;
                    break;
                case 13:
                    SigVal = MsgObj_Klima_01.KL_Last_Kompr;
                    break;
                case 14:
                    SigVal = MsgObj_Klima_01.KL_Leistung_Hzg_Soll;
                    break;
                case 15:
                    SigVal = MsgObj_Klima_01.KL_StartStopp_Info;
                    break;
                case 16:
                    SigVal = MsgObj_Klima_01.KL_Thermomanagement;
                    break;
                case 17:
                    SigVal = MsgObj_Klima_01.KL_Vorwarn_HFS_ein;
                    break;
                case 18:
                    SigVal = MsgObj_Klima_01.KL_Vorwarn_HHS_ein;
                    break;
                case 19:
                    SigVal = MsgObj_Klima_01.KL_Vorwarn_Komp_ein;
                    break;
                case 20:
                    SigVal = MsgObj_Klima_01.KL_Vorwarn_Zuheizer_ein;
                    break;
                case 21:
                    SigVal = MsgObj_Klima_01.KL_Zustand;
                    break;
                case 22:
                    SigVal = MsgObj_Klima_01.KL_el_Zuheizer_Stufe;
                    break;
            }
        }
        break;
        case FRM_HANDLE_Kombi_01:
        {
            switch (SigIdx)
            {
                case 0:
                    SigVal = MsgObj_Kombi_01.KBI_ABS_Lampe;
                    break;
                case 1:
                    SigVal = MsgObj_Kombi_01.KBI_Airbag_Lampe;
                    break;
                case 2:
                    SigVal = MsgObj_Kombi_01.KBI_Anzeigefehler_LDW;
                    break;
                case 3:
                    SigVal = MsgObj_Kombi_01.KBI_Anzeigefehler_SWA;
                    break;
                case 4:
                    SigVal = MsgObj_Kombi_01.KBI_BKL_Lampe;
                    break;
                case 5:
                    SigVal = MsgObj_Kombi_01.KBI_ESP_Lampe;
                    break;
                case 6:
                    SigVal = MsgObj_Kombi_01.KBI_Einheit_Tacho;
                    break;
                case 7:
                    SigVal = MsgObj_Kombi_01.KBI_Fehler_Anzeige_ACC;
                    break;
                case 8:
                    SigVal = MsgObj_Kombi_01.KBI_Handbremse;
                    break;
                case 9:
                    SigVal = MsgObj_Kombi_01.KBI_KD_Fehler;
                    break;
                case 10:
                    SigVal = MsgObj_Kombi_01.KBI_Konsistenz_ACC;
                    break;
                case 11:
                    SigVal = MsgObj_Kombi_01.KBI_Lenkung_Lampe;
                    break;
                case 12:
                    SigVal = MsgObj_Kombi_01.KBI_MFA_v_Einheit_01;
                    break;
                case 13:
                    SigVal = MsgObj_Kombi_01.KBI_Oeldruck_Schalter;
                    break;
                case 14:
                    SigVal = MsgObj_Kombi_01.KBI_Oeldruckwarnung;
                    break;
                case 15:
                    SigVal = MsgObj_Kombi_01.KBI_SILA_gueltig;
                    break;
                case 16:
                    SigVal = MsgObj_Kombi_01.KBI_Tankwarnung;
                    break;
                case 17:
                    SigVal = MsgObj_Kombi_01.KBI_Variante_USA;
                    break;
                case 18:
                    SigVal = MsgObj_Kombi_01.KBI_Vorglueh_System_Lampe;
                    break;
                case 19:
                    SigVal = MsgObj_Kombi_01.KBI_angez_Geschw;
                    break;
                case 20:
                    SigVal = MsgObj_Kombi_01.KBI_im_Stellgliedtest;
                    break;
            }
        }
        break;
        case FRM_HANDLE_Kombi_02:
        {
            switch (SigIdx)
            {
                case 0:
                    SigVal = MsgObj_Kombi_02.KBI_Aussen_Temp_gef;
                    break;
                case 1:
                    SigVal = MsgObj_Kombi_02.KBI_FStatus_Tank;
                    break;
                case 2:
                    SigVal = MsgObj_Kombi_02.KBI_Inhalt_Tank;
                    break;
                case 3:
                    SigVal = MsgObj_Kombi_02.KBI_Kilometerstand;
                    break;
                case 4:
                    SigVal = MsgObj_Kombi_02.KBI_Oelwechsel_durchgefuehrt;
                    break;
                case 5:
                    SigVal = MsgObj_Kombi_02.KBI_QBit_Aussen_Temp_gef;
                    break;
                case 6:
                    SigVal = MsgObj_Kombi_02.KBI_Reset_Standzeit;
                    break;
                case 7:
                    SigVal = MsgObj_Kombi_02.KBI_Standzeit;
                    break;
            }
        }
        break;
        case FRM_HANDLE_Kombi_03:
        {
            switch (SigIdx)
            {
                case 0:
                    SigVal = MsgObj_Kombi_03.KBI_Reifenumfang;
                    break;
            }
        }
        break;
        case FRM_HANDLE_LH_EPS_02:
        {
            switch (SigIdx)
            {
                case 0:
                    SigVal = MsgObj_LH_EPS_02.EPS_02_BZ;
                    break;
                case 1:
                    SigVal = MsgObj_LH_EPS_02.EPS_02_CRC;
                    break;
                case 2:
                    SigVal = MsgObj_LH_EPS_02.EPS_Drehzahlreserve;
                    break;
                case 3:
                    SigVal = MsgObj_LH_EPS_02.EPS_Lastinfo;
                    break;
                case 4:
                    SigVal = MsgObj_LH_EPS_02.EPS_Leistungsanforderung;
                    break;
                case 5:
                    SigVal = MsgObj_LH_EPS_02.EPS_Motorstartverzoegerung;
                    break;
                case 6:
                    SigVal = MsgObj_LH_EPS_02.EPS_Notlauf;
                    break;
                case 7:
                    SigVal = MsgObj_LH_EPS_02.EPS_StartStopp_Info;
                    break;
                case 8:
                    SigVal = MsgObj_LH_EPS_02.EPS_Unterstuetzungsleistung;
                    break;
                case 9:
                    SigVal = MsgObj_LH_EPS_02.EPS_VZ_Drehzahlreserve;
                    break;
            }
        }
        break;
        case FRM_HANDLE_LS_01:
        {
            switch (SigIdx)
            {
                case 0:
                    SigVal = MsgObj_LS_01.LS_01_BZ;
                    break;
                case 1:
                    SigVal = MsgObj_LS_01.LS_01_CHK;
                    break;
                case 2:
                    SigVal = MsgObj_LS_01.LS_Abbrechen;
                    break;
                case 3:
                    SigVal = MsgObj_LS_01.LS_Codierung;
                    break;
                case 4:
                    SigVal = MsgObj_LS_01.LS_Fehler;
                    break;
                case 5:
                    SigVal = MsgObj_LS_01.LS_GRA_ACC_2stufig;
                    break;
                case 6:
                    SigVal = MsgObj_LS_01.LS_Hauptschalter;
                    break;
                case 7:
                    SigVal = MsgObj_LS_01.LS_Limiter;
                    break;
                case 8:
                    SigVal = MsgObj_LS_01.LS_Tip_Hoch;
                    break;
                case 9:
                    SigVal = MsgObj_LS_01.LS_Tip_Runter;
                    break;
                case 10:
                    SigVal = MsgObj_LS_01.LS_Tip_Setzen;
                    break;
                case 11:
                    SigVal = MsgObj_LS_01.LS_Tip_Stufe_2;
                    break;
                case 12:
                    SigVal = MsgObj_LS_01.LS_Tip_Wiederaufnahme;
                    break;
                case 13:
                    SigVal = MsgObj_LS_01.LS_Tiptronic_Fehler;
                    break;
                case 14:
                    SigVal = MsgObj_LS_01.LS_Typ_Hauptschalter;
                    break;
                case 15:
                    SigVal = MsgObj_LS_01.LS_Verstellung_Zeitluecke;
                    break;
                case 16:
                    SigVal = MsgObj_LS_01.MFL_Tip_Down;
                    break;
                case 17:
                    SigVal = MsgObj_LS_01.MFL_Tip_Up;
                    break;
            }
        }
        break;
        case FRM_HANDLE_LWI_01:
        {
            switch (SigIdx)
            {
                case 0:
                    SigVal = MsgObj_LWI_01.LWI_01_BZ;
                    break;
                case 1:
                    SigVal = MsgObj_LWI_01.LWI_01_CHK;
                    break;
                case 2:
                    SigVal = MsgObj_LWI_01.LWI_01_CRC;
                    break;
                case 3:
                    SigVal = MsgObj_LWI_01.LWI_Lenkradw_Geschw;
                    break;
                case 4:
                    SigVal = MsgObj_LWI_01.LWI_Lenkradwinkel;
                    break;
                case 5:
                    SigVal = MsgObj_LWI_01.LWI_QBit_Lenkradwinkel;
                    break;
                case 6:
                    SigVal = MsgObj_LWI_01.LWI_QBit_Sub_Daten;
                    break;
                case 7:
                    SigVal = MsgObj_LWI_01.LWI_Sensorstatus;
                    break;
                case 8:
                    SigVal = MsgObj_LWI_01.LWI_Sub_Daten;
                    break;
                case 9:
                    SigVal = MsgObj_LWI_01.LWI_VZ_Lenkradw_Geschw;
                    break;
                case 10:
                    SigVal = MsgObj_LWI_01.LWI_VZ_Lenkradwinkel;
                    break;
            }
        }
        break;
        case FRM_HANDLE_Licht_hinten_01:
        {
            switch (SigIdx)
            {
                case 0:
                    SigVal = MsgObj_Licht_hinten_01.BCM2_Bremsl_durch_ECD;
                    break;
                case 1:
                    SigVal = MsgObj_Licht_hinten_01.LH_3_Bremsl_def;
                    break;
                case 2:
                    SigVal = MsgObj_Licht_hinten_01.LH_Aussenlicht_def;
                    break;
                case 3:
                    SigVal = MsgObj_Licht_hinten_01.LH_Blinker_HL_akt;
                    break;
                case 4:
                    SigVal = MsgObj_Licht_hinten_01.LH_Blinker_HR_akt;
                    break;
                case 5:
                    SigVal = MsgObj_Licht_hinten_01.LH_Blinker_li_def;
                    break;
                case 6:
                    SigVal = MsgObj_Licht_hinten_01.LH_Blinker_re_def;
                    break;
                case 7:
                    SigVal = MsgObj_Licht_hinten_01.LH_Brems_Blk_li_def;
                    break;
                case 8:
                    SigVal = MsgObj_Licht_hinten_01.LH_Brems_Blk_re_def;
                    break;
                case 9:
                    SigVal = MsgObj_Licht_hinten_01.LH_Bremsl_li_def;
                    break;
                case 10:
                    SigVal = MsgObj_Licht_hinten_01.LH_Bremsl_li_ges_def;
                    break;
                case 11:
                    SigVal = MsgObj_Licht_hinten_01.LH_Bremsl_re_def;
                    break;
                case 12:
                    SigVal = MsgObj_Licht_hinten_01.LH_Bremsl_re_ges_def;
                    break;
                case 13:
                    SigVal = MsgObj_Licht_hinten_01.LH_Bremslicht_H_aktiv;
                    break;
                case 14:
                    SigVal = MsgObj_Licht_hinten_01.LH_Kennzl_def;
                    break;
                case 15:
                    SigVal = MsgObj_Licht_hinten_01.LH_Nebel_li_def;
                    break;
                case 16:
                    SigVal = MsgObj_Licht_hinten_01.LH_Nebel_mi_def;
                    break;
                case 17:
                    SigVal = MsgObj_Licht_hinten_01.LH_Nebel_re_def;
                    break;
                case 18:
                    SigVal = MsgObj_Licht_hinten_01.LH_Nebelschluss_aktiv;
                    break;
                case 19:
                    SigVal = MsgObj_Licht_hinten_01.LH_Parklicht_HL_aktiv;
                    break;
                case 20:
                    SigVal = MsgObj_Licht_hinten_01.LH_Parklicht_HR_aktiv;
                    break;
                case 21:
                    SigVal = MsgObj_Licht_hinten_01.LH_Rueckf_li_def;
                    break;
                case 22:
                    SigVal = MsgObj_Licht_hinten_01.LH_Rueckf_mi_def;
                    break;
                case 23:
                    SigVal = MsgObj_Licht_hinten_01.LH_Rueckf_re_def;
                    break;
                case 24:
                    SigVal = MsgObj_Licht_hinten_01.LH_Rueckfahrlicht_aktiv;
                    break;
                case 25:
                    SigVal = MsgObj_Licht_hinten_01.LH_SL_BRL_BLK_li_def;
                    break;
                case 26:
                    SigVal = MsgObj_Licht_hinten_01.LH_SL_BRL_BLK_re_def;
                    break;
                case 27:
                    SigVal = MsgObj_Licht_hinten_01.LH_Schluss_Brems_li_def;
                    break;
                case 28:
                    SigVal = MsgObj_Licht_hinten_01.LH_Schluss_Brems_re_def;
                    break;
                case 29:
                    SigVal = MsgObj_Licht_hinten_01.LH_Schluss_Nebel_li_def;
                    break;
                case 30:
                    SigVal = MsgObj_Licht_hinten_01.LH_Schluss_Nebel_re_def;
                    break;
                case 31:
                    SigVal = MsgObj_Licht_hinten_01.LH_Schlusslicht_li_def;
                    break;
                case 32:
                    SigVal = MsgObj_Licht_hinten_01.LH_Schlusslicht_re_def;
                    break;
                case 33:
                    SigVal = MsgObj_Licht_hinten_01.LH_Standlicht_H_aktiv;
                    break;
                case 34:
                    SigVal = MsgObj_Licht_hinten_01.Licht_hinten_01_BZ;
                    break;
            }
        }
        break;
        case FRM_HANDLE_NMH_Gateway:
        {
            switch (SigIdx)
            {
                case 0:
                    SigVal = MsgObj_NMH_Gateway.NMH_GW_ACAN;
                    break;
                case 1:
                    SigVal = MsgObj_NMH_Gateway.NMH_GW_Abschaltstufe_3;
                    break;
                case 2:
                    SigVal = MsgObj_NMH_Gateway.NMH_GW_Abschaltstufe_aktiv;
                    break;
                case 3:
                    SigVal = MsgObj_NMH_Gateway.NMH_GW_CAN_Diag_deaktiv;
                    break;
                case 4:
                    SigVal = MsgObj_NMH_Gateway.NMH_GW_Car_WakeUp;
                    break;
                case 5:
                    SigVal = MsgObj_NMH_Gateway.NMH_GW_Eindraht_Fehler;
                    break;
                case 6:
                    SigVal = MsgObj_NMH_Gateway.NMH_GW_Fkt_WakeUp;
                    break;
                case 7:
                    SigVal = MsgObj_NMH_Gateway.NMH_GW_Infotainment;
                    break;
                case 8:
                    SigVal = MsgObj_NMH_Gateway.NMH_GW_KombiCAN;
                    break;
                case 9:
                    SigVal = MsgObj_NMH_Gateway.NMH_GW_KomfortCAN;
                    break;
                case 10:
                    SigVal = MsgObj_NMH_Gateway.NMH_GW_KompSchutz;
                    break;
                case 11:
                    SigVal = MsgObj_NMH_Gateway.NMH_GW_Mute_Mode;
                    break;
                case 12:
                    SigVal = MsgObj_NMH_Gateway.NMH_GW_NM_aktiv_BDM;
                    break;
                case 13:
                    SigVal = MsgObj_NMH_Gateway.NMH_GW_NM_aktiv_Diagnose;
                    break;
                case 14:
                    SigVal = MsgObj_NMH_Gateway.NMH_GW_NM_aktiv_ESP;
                    break;
                case 15:
                    SigVal = MsgObj_NMH_Gateway.NMH_GW_NM_aktiv_Klemme_15;
                    break;
                case 16:
                    SigVal = MsgObj_NMH_Gateway.NMH_GW_NM_aktiv_Start;
                    break;
                case 17:
                    SigVal = MsgObj_NMH_Gateway.NMH_GW_NM_aktiv_Warnblinken;
                    break;
                case 18:
                    SigVal = MsgObj_NMH_Gateway.NMH_GW_Normal_Mode_1;
                    break;
                case 19:
                    SigVal = MsgObj_NMH_Gateway.NMH_GW_Normal_Mode_2;
                    break;
                case 20:
                    SigVal = MsgObj_NMH_Gateway.NMH_GW_Per_WakeUp;
                    break;
                case 21:
                    SigVal = MsgObj_NMH_Gateway.NMH_GW_SG_Fehlerdauer;
                    break;
                case 22:
                    SigVal = MsgObj_NMH_Gateway.NMH_GW_STH_Wakeup;
                    break;
                case 23:
                    SigVal = MsgObj_NMH_Gateway.NMH_GW_Start_1;
                    break;
                case 24:
                    SigVal = MsgObj_NMH_Gateway.NMH_GW_Start_2;
                    break;
                case 25:
                    SigVal = MsgObj_NMH_Gateway.NMH_GW_TimeOut_Fehler;
                    break;
                case 26:
                    SigVal = MsgObj_NMH_Gateway.NMH_GW_Transport_Mode;
                    break;
                case 27:
                    SigVal = MsgObj_NMH_Gateway.NMH_GW_WakeUp_CAN_Bus;
                    break;
            }
        }
        break;
        case FRM_HANDLE_OBD_Tankgeber_01:
        {
            switch (SigIdx)
            {
                case 0:
                    SigVal = MsgObj_OBD_Tankgeber_01.OBD_TG_F_Status_1;
                    break;
                case 1:
                    SigVal = MsgObj_OBD_Tankgeber_01.OBD_TG_F_Status_2;
                    break;
                case 2:
                    SigVal = MsgObj_OBD_Tankgeber_01.OBD_TG_F_Status_3;
                    break;
                case 3:
                    SigVal = MsgObj_OBD_Tankgeber_01.OBD_TG_F_Status_4;
                    break;
                case 4:
                    SigVal = MsgObj_OBD_Tankgeber_01.OBD_TG_Sens_Rohwert_1;
                    break;
                case 5:
                    SigVal = MsgObj_OBD_Tankgeber_01.OBD_TG_Sens_Rohwert_2;
                    break;
                case 6:
                    SigVal = MsgObj_OBD_Tankgeber_01.OBD_TG_Sens_Rohwert_3;
                    break;
                case 7:
                    SigVal = MsgObj_OBD_Tankgeber_01.OBD_TG_Sens_Rohwert_4;
                    break;
            }
        }
        break;
        case FRM_HANDLE_SCR_01:
        {
            switch (SigIdx)
            {
                case 0:
                    SigVal = MsgObj_SCR_01.SCR_01_BZ;
                    break;
                case 1:
                    SigVal = MsgObj_SCR_01.SCR_Dosierpumpe_Drehzahl;
                    break;
                case 2:
                    SigVal = MsgObj_SCR_01.SCR_Druck;
                    break;
                case 3:
                    SigVal = MsgObj_SCR_01.SCR_Level_Aktivtank;
                    break;
                case 4:
                    SigVal = MsgObj_SCR_01.SCR_Level_Passivtank;
                    break;
            }
        }
        break;
        case FRM_HANDLE_SCR_02:
        {
            switch (SigIdx)
            {
                case 0:
                    SigVal = MsgObj_SCR_02.SCR_02_BZ;
                    break;
                case 1:
                    SigVal = MsgObj_SCR_02.SCR_Guetesensor;
                    break;
                case 2:
                    SigVal = MsgObj_SCR_02.SCR_Heizkreis_3_Strom;
                    break;
                case 3:
                    SigVal = MsgObj_SCR_02.SCR_KD_Fehler;
                    break;
                case 4:
                    SigVal = MsgObj_SCR_02.SCR_Leitungsheizung_Strom;
                    break;
                case 5:
                    SigVal = MsgObj_SCR_02.SCR_Tankheizung_Strom;
                    break;
                case 6:
                    SigVal = MsgObj_SCR_02.SCR_Temp_Aktivtank;
                    break;
                case 7:
                    SigVal = MsgObj_SCR_02.SCR_Temp_Passivtank;
                    break;
                case 8:
                    SigVal = MsgObj_SCR_02.SCR_Transferpumpe_Strom;
                    break;
            }
        }
        break;
        case FRM_HANDLE_SCR_03:
        {
            switch (SigIdx)
            {
                case 0:
                    SigVal = MsgObj_SCR_03.SCR_03_BZ;
                    break;
                case 1:
                    SigVal = MsgObj_SCR_03.SCR_Dosierpumpe_Status_Spule;
                    break;
                case 2:
                    SigVal = MsgObj_SCR_03.SCR_Druck_Status;
                    break;
                case 3:
                    SigVal = MsgObj_SCR_03.SCR_Guetesensor_Status;
                    break;
                case 4:
                    SigVal = MsgObj_SCR_03.SCR_Heizkreis_3_Status;
                    break;
                case 5:
                    SigVal = MsgObj_SCR_03.SCR_Leitungsheizung_Status;
                    break;
                case 6:
                    SigVal = MsgObj_SCR_03.SCR_Level_Aktivtank_Status;
                    break;
                case 7:
                    SigVal = MsgObj_SCR_03.SCR_Level_Passivtank_Status;
                    break;
                case 8:
                    SigVal = MsgObj_SCR_03.SCR_Spannungsversorgung_Status;
                    break;
                case 9:
                    SigVal = MsgObj_SCR_03.SCR_Tankheizung_Status;
                    break;
                case 10:
                    SigVal = MsgObj_SCR_03.SCR_Temp_Aktivtank_Status;
                    break;
                case 11:
                    SigVal = MsgObj_SCR_03.SCR_Temp_Passivtank_Status;
                    break;
                case 12:
                    SigVal = MsgObj_SCR_03.SCR_Transferpumpe_Status;
                    break;
                case 13:
                    SigVal = MsgObj_SCR_03.SCR_VersorgungSensoren_Status;
                    break;
            }
        }
        break;
        case FRM_HANDLE_SCR_04:
        {
            switch (SigIdx)
            {
                case 0:
                    SigVal = MsgObj_SCR_04.SCR_04_BZ;
                    break;
                case 1:
                    SigVal = MsgObj_SCR_04.SCR_Ansteuerung_Dosierpumpe;
                    break;
                case 2:
                    SigVal = MsgObj_SCR_04.SCR_Ansteuerung_Heizkreis_3;
                    break;
                case 3:
                    SigVal = MsgObj_SCR_04.SCR_Ansteuerung_Leitungsheizung;
                    break;
                case 4:
                    SigVal = MsgObj_SCR_04.SCR_Ansteuerung_Tankheizung;
                    break;
                case 5:
                    SigVal = MsgObj_SCR_04.SCR_Ansteuerung_Transferpumpe;
                    break;
                case 6:
                    SigVal = MsgObj_SCR_04.SCR_CAL_CVN_CRC_32;
                    break;
            }
        }
        break;
        case FRM_HANDLE_SCR_05:
        {
            switch (SigIdx)
            {
                case 0:
                    SigVal = MsgObj_SCR_05.SCR_05_BZ;
                    break;
                case 1:
                    SigVal = MsgObj_SCR_05.SCR_Steuergeraet_Bus_Status;
                    break;
                case 2:
                    SigVal = MsgObj_SCR_05.SCR_Steuergeraet_Codierung_Status;
                    break;
                case 3:
                    SigVal = MsgObj_SCR_05.SCR_Steuergeraet_Datensatz_Status;
                    break;
                case 4:
                    SigVal = MsgObj_SCR_05.SCR_Steuergeraet_Defekt_Status;
                    break;
                case 5:
                    SigVal = MsgObj_SCR_05.SCR_Steuergeraet_Heizung_Status;
                    break;
                case 6:
                    SigVal = MsgObj_SCR_05.SCR_Steuergeraet_Pumpe_Status;
                    break;
                case 7:
                    SigVal = MsgObj_SCR_05.SCR_Steuergeraet_Relais_Status;
                    break;
            }
        }
        break;
        case FRM_HANDLE_SCR_CAL_ID1:
        {
            switch (SigIdx)
            {
                case 0:
                    SigVal = MsgObj_SCR_CAL_ID1.SCR_CAL_ID_Index_01;
                    break;
                case 1:
                    SigVal = MsgObj_SCR_CAL_ID1.SCR_CAL_ID_Index_02;
                    break;
                case 2:
                    SigVal = MsgObj_SCR_CAL_ID1.SCR_CAL_ID_Index_03;
                    break;
                case 3:
                    SigVal = MsgObj_SCR_CAL_ID1.SCR_CAL_ID_Index_04;
                    break;
                case 4:
                    SigVal = MsgObj_SCR_CAL_ID1.SCR_CAL_ID_Index_05;
                    break;
                case 5:
                    SigVal = MsgObj_SCR_CAL_ID1.SCR_CAL_ID_Index_06;
                    break;
                case 6:
                    SigVal = MsgObj_SCR_CAL_ID1.SCR_CAL_ID_Index_07;
                    break;
                case 7:
                    SigVal = MsgObj_SCR_CAL_ID1.SCR_CAL_ID_Index_08;
                    break;
            }
        }
        break;
        case FRM_HANDLE_SCR_CAL_ID2:
        {
            switch (SigIdx)
            {
                case 0:
                    SigVal = MsgObj_SCR_CAL_ID2.SCR_CAL_ID_Index_09;
                    break;
                case 1:
                    SigVal = MsgObj_SCR_CAL_ID2.SCR_CAL_ID_Index_10;
                    break;
                case 2:
                    SigVal = MsgObj_SCR_CAL_ID2.SCR_CAL_ID_Index_11;
                    break;
                case 3:
                    SigVal = MsgObj_SCR_CAL_ID2.SCR_CAL_ID_Index_12;
                    break;
                case 4:
                    SigVal = MsgObj_SCR_CAL_ID2.SCR_CAL_ID_Index_13;
                    break;
                case 5:
                    SigVal = MsgObj_SCR_CAL_ID2.SCR_CAL_ID_Index_14;
                    break;
                case 6:
                    SigVal = MsgObj_SCR_CAL_ID2.SCR_CAL_ID_Index_15;
                    break;
                case 7:
                    SigVal = MsgObj_SCR_CAL_ID2.SCR_CAL_ID_Index_16;
                    break;
            }
        }
        break;
        case FRM_HANDLE_SCU_01:
        {
            switch (SigIdx)
            {
                case 0:
                    SigVal = MsgObj_SCU_01.SCU_01_BZ;
                    break;
                case 1:
                    SigVal = MsgObj_SCU_01.SCU_01_CHK;
                    break;
                case 2:
                    SigVal = MsgObj_SCU_01.SCU_01_CRC;
                    break;
                case 3:
                    SigVal = MsgObj_SCU_01.SCU_KD_Fehler;
                    break;
                case 4:
                    SigVal = MsgObj_SCU_01.SCU_Soll_Ue_Winkel;
                    break;
                case 5:
                    SigVal = MsgObj_SCU_01.SCU_Status;
                    break;
                case 6:
                    SigVal = MsgObj_SCU_01.SCU_Ue_Winkel_ADS;
                    break;
                case 7:
                    SigVal = MsgObj_SCU_01.SCU_VZ_Soll_Ue_Winkel;
                    break;
                case 8:
                    SigVal = MsgObj_SCU_01.SCU_VZ_Ue_Winkel_ADS;
                    break;
                case 9:
                    SigVal = MsgObj_SCU_01.SCU_max_Gradient;
                    break;
            }
        }
        break;
        case FRM_HANDLE_STH_01:
        {
            switch (SigIdx)
            {
                case 0:
                    SigVal = MsgObj_STH_01.STH_EKP_Anst;
                    break;
                case 1:
                    SigVal = MsgObj_STH_01.STH_Fehler_ElWaPu;
                    break;
                case 2:
                    SigVal = MsgObj_STH_01.STH_Fehlerstatus;
                    break;
                case 3:
                    SigVal = MsgObj_STH_01.STH_Funk_aus;
                    break;
                case 4:
                    SigVal = MsgObj_STH_01.STH_Funk_ein;
                    break;
                case 5:
                    SigVal = MsgObj_STH_01.STH_Geblaese;
                    break;
                case 6:
                    SigVal = MsgObj_STH_01.STH_Heizleistung;
                    break;
                case 7:
                    SigVal = MsgObj_STH_01.STH_KD_Fehler;
                    break;
                case 8:
                    SigVal = MsgObj_STH_01.STH_KVS;
                    break;
                case 9:
                    SigVal = MsgObj_STH_01.STH_KVS_Ueberlauf;
                    break;
                case 10:
                    SigVal = MsgObj_STH_01.STH_LED;
                    break;
                case 11:
                    SigVal = MsgObj_STH_01.STH_Motorvorwaermung;
                    break;
                case 12:
                    SigVal = MsgObj_STH_01.STH_Pumpe_ein;
                    break;
                case 13:
                    SigVal = MsgObj_STH_01.STH_Pumpen_Anf_extern;
                    break;
                case 14:
                    SigVal = MsgObj_STH_01.STH_Servicemode;
                    break;
                case 15:
                    SigVal = MsgObj_STH_01.STH_Ventil_Status;
                    break;
                case 16:
                    SigVal = MsgObj_STH_01.STH_Ventiloeffnungszeit;
                    break;
                case 17:
                    SigVal = MsgObj_STH_01.STH_Waermeeintrag;
                    break;
                case 18:
                    SigVal = MsgObj_STH_01.STH_Wassertemp;
                    break;
                case 19:
                    SigVal = MsgObj_STH_01.STH_Zusatzheizung;
                    break;
                case 20:
                    SigVal = MsgObj_STH_01.STH_war_aktiv;
                    break;
            }
        }
        break;
        case FRM_HANDLE_STS_01:
        {
            switch (SigIdx)
            {
                case 0:
                    SigVal = MsgObj_STS_01.STS_01_BZ;
                    break;
                case 1:
                    SigVal = MsgObj_STS_01.STS_01_CHK;
                    break;
                case 2:
                    SigVal = MsgObj_STS_01.STS_Alarm_Blinker;
                    break;
                case 3:
                    SigVal = MsgObj_STS_01.STS_Anlassersperre;
                    break;
                case 4:
                    SigVal = MsgObj_STS_01.STS_Car_not_under_theft;
                    break;
                case 5:
                    SigVal = MsgObj_STS_01.STS_Car_under_theft;
                    break;
                case 6:
                    SigVal = MsgObj_STS_01.STS_Fahrlicht;
                    break;
                case 7:
                    SigVal = MsgObj_STS_01.STS_KD_Fehler;
                    break;
                case 8:
                    SigVal = MsgObj_STS_01.STS_LIN_aktiv;
                    break;
                case 9:
                    SigVal = MsgObj_STS_01.STS_Laderelais;
                    break;
                case 10:
                    SigVal = MsgObj_STS_01.STS_Leerlaufschaltung;
                    break;
                case 11:
                    SigVal = MsgObj_STS_01.STS_Notstart;
                    break;
                case 12:
                    SigVal = MsgObj_STS_01.STS_Signalhorn;
                    break;
                case 13:
                    SigVal = MsgObj_STS_01.STS_Standlicht;
                    break;
                case 14:
                    SigVal = MsgObj_STS_01.STS_Summer;
                    break;
                case 15:
                    SigVal = MsgObj_STS_01.STS_Typencodierung;
                    break;
            }
        }
        break;
        case FRM_HANDLE_Systeminfo_01:
        {
            switch (SigIdx)
            {
                case 0:
                    SigVal = MsgObj_Systeminfo_01.GW_KD_Fehler;
                    break;
                case 1:
                    SigVal = MsgObj_Systeminfo_01.SI_CAN_Antrieb_Sleep;
                    break;
                case 2:
                    SigVal = MsgObj_Systeminfo_01.SI_CAN_Dashboard_Sleep;
                    break;
                case 3:
                    SigVal = MsgObj_Systeminfo_01.SI_CAN_Extended_Sleep;
                    break;
                case 4:
                    SigVal = MsgObj_Systeminfo_01.SI_CAN_Fahrwerk_Sleep;
                    break;
                case 5:
                    SigVal = MsgObj_Systeminfo_01.SI_CAN_Komfort_Sleep;
                    break;
                case 6:
                    SigVal = MsgObj_Systeminfo_01.SI_Diagnose_Aktiv;
                    break;
                case 7:
                    SigVal = MsgObj_Systeminfo_01.SI_Fahrwerk_Sleep;
                    break;
                case 8:
                    SigVal = MsgObj_Systeminfo_01.SI_Infotainment_Sleep;
                    break;
                case 9:
                    SigVal = MsgObj_Systeminfo_01.SI_Int_CAN_gespiegelt;
                    break;
                case 10:
                    SigVal = MsgObj_Systeminfo_01.SI_MOST_Status;
                    break;
                case 11:
                    SigVal = MsgObj_Systeminfo_01.SI_MO_WU;
                    break;
                case 12:
                    SigVal = MsgObj_Systeminfo_01.SI_NWDF;
                    break;
                case 13:
                    SigVal = MsgObj_Systeminfo_01.SI_NWDF_gueltig;
                    break;
                case 14:
                    SigVal = MsgObj_Systeminfo_01.SI_QRS_Mode;
                    break;
                case 15:
                    SigVal = MsgObj_Systeminfo_01.SI_Sammel_SG_Fehler;
                    break;
                case 16:
                    SigVal = MsgObj_Systeminfo_01.SI_Sammelfehler;
                    break;
                case 17:
                    SigVal = MsgObj_Systeminfo_01.SI_T_Mode;
                    break;
            }
        }
        break;
    }

    return (SigVal);
}
/*@@end*/

/*@@caplFunc:ShowPrompt():*/
ShowPrompt ()
{
    int SigVal = 0;

    switch (CaplCtrl_LevelActv)
    {
        /* currently no level selected */
        case CAPLCTRL_LEVEL_NOSEL:
        {
            if (CaplCtrl_PromptMode == CAPLCTRL_PROMPTMODE_NUM)
            {
                write("# > %s", CaplCtrl_InputBuf);
            }
            else
            {
                write("# > %s", CaplCtrl_CharBuf);
            }
        }
        break;

        case CAPLCTRL_LEVEL_FRAME:
        {
            GetFrameName(CaplCtrl_FrameActv);

            if (CaplCtrl_PromptMode == CAPLCTRL_PROMPTMODE_NUM)
            {
                write("# %s> %s", CaplCtrl_FrameName, CaplCtrl_InputBuf);
            }
            else
            {
                write("# %s> %s", CaplCtrl_FrameName, CaplCtrl_CharBuf);
            }
        }
        break;

        case CAPLCTRL_LEVEL_SIGNAL:
        {
            GetFrameName(CaplCtrl_FrameActv);
            GetSignalName(CaplCtrl_FrameActv, CaplCtrl_SignalActv);

            SigVal = GetSignalVal(CaplCtrl_FrameActv, CaplCtrl_SignalActv);

            if (CaplCtrl_PromptMode == CAPLCTRL_PROMPTMODE_NUM)
            {
                write("# %s.%s = %d> %s", CaplCtrl_FrameName, CaplCtrl_SignalName, SigVal, CaplCtrl_InputBuf);
            }
            else
            {
                write("# %s.%s = %d> %s", CaplCtrl_FrameName, CaplCtrl_SignalName, SigVal, CaplCtrl_CharBuf);
            }
        }
        break;
    }
}
/*@@end*/

/*@@caplFunc:Frm_CalcChecksumCRC8(int, message*, byte):*/
byte Frm_CalcChecksumCRC8(int FrmIdx, message *MsgObj, byte endval)
{
    int idx;
    byte crc;

    /* calculate CRC8 checksum */
    crc = 0xFF;
    /* IMPORTANT NOTE: assumes CRC8 is in byte 0 */
    for (idx = 1; idx < MsgObj.DLC; idx++)
    {
        crc = CRC8_tab_256[(MsgObj.BYTE(idx) ^ crc)];
    }
    crc = CRC8_tab_256[(endval ^ crc)];
    crc = ~crc;

    /* checksum calculation disabled, make sure checksum is wrong */
    if (Frm_MsgChksmEna[FrmIdx] == 0)
    {
        crc = ~crc;
    }

   	return (crc);
}
/*@@end*/

/*@@caplFunc:Frm_CalcChecksumCRC8Id(int, message*):*/
byte Frm_CalcChecksumCRC8Id(int FrmIdx, message *MsgObj)
{
    byte crcid;

    /* XOR high byte and low byte of CAN ID - used as checksum end value */
	crcid = MsgObj.ID;
    crcid = crcid ^ ((MsgObj.ID >> 8) & 0xFF);

    return Frm_CalcChecksumCRC8(FrmIdx, MsgObj, crcid);
}
/*@@end*/

/*@@caplFunc:Frm_CalcChecksumCRC8Dyn(int, message*, int):*/
byte Frm_CalcChecksumCRC8Dyn(int FrmIdx, message *MsgObj, int MsgCnt)
{
    byte crcid;
    byte ChksmEndVal[FRM_NUM_MAX][16] =
    {
        { 0x00,0x00,0x00,0x00,0x00,0x00,0x00,0x00,0x00,0x00,0x00,0x00,0x00,0x00,0x00,0x00 },
        { 0x00,0x00,0x00,0x00,0x00,0x00,0x00,0x00,0x00,0x00,0x00,0x00,0x00,0x00,0x00,0x00 },
        { 0x00,0x00,0x00,0x00,0x00,0x00,0x00,0x00,0x00,0x00,0x00,0x00,0x00,0x00,0x00,0x00 },
        { 0x00,0x00,0x00,0x00,0x00,0x00,0x00,0x00,0x00,0x00,0x00,0x00,0x00,0x00,0x00,0x00 },
        { 0x00,0x00,0x00,0x00,0x00,0x00,0x00,0x00,0x00,0x00,0x00,0x00,0x00,0x00,0x00,0x00 },
        { 0x00,0x00,0x00,0x00,0x00,0x00,0x00,0x00,0x00,0x00,0x00,0x00,0x00,0x00,0x00,0x00 },
        { 0x00,0x00,0x00,0x00,0x00,0x00,0x00,0x00,0x00,0x00,0x00,0x00,0x00,0x00,0x00,0x00 },
        { 0x00,0x00,0x00,0x00,0x00,0x00,0x00,0x00,0x00,0x00,0x00,0x00,0x00,0x00,0x00,0x00 },
        { 0x00,0x00,0x00,0x00,0x00,0x00,0x00,0x00,0x00,0x00,0x00,0x00,0x00,0x00,0x00,0x00 },
        { 0x00,0x00,0x00,0x00,0x00,0x00,0x00,0x00,0x00,0x00,0x00,0x00,0x00,0x00,0x00,0x00 },
        { 0x00,0x00,0x00,0x00,0x00,0x00,0x00,0x00,0x00,0x00,0x00,0x00,0x00,0x00,0x00,0x00 },
        { 0x00,0x00,0x00,0x00,0x00,0x00,0x00,0x00,0x00,0x00,0x00,0x00,0x00,0x00,0x00,0x00 },
        { 0x00,0x00,0x00,0x00,0x00,0x00,0x00,0x00,0x00,0x00,0x00,0x00,0x00,0x00,0x00,0x00 },
        { 0x00,0x00,0x00,0x00,0x00,0x00,0x00,0x00,0x00,0x00,0x00,0x00,0x00,0x00,0x00,0x00 },
        { 0x00,0x00,0x00,0x00,0x00,0x00,0x00,0x00,0x00,0x00,0x00,0x00,0x00,0x00,0x00,0x00 },
        { 0x00,0x00,0x00,0x00,0x00,0x00,0x00,0x00,0x00,0x00,0x00,0x00,0x00,0x00,0x00,0x00 },
        { 0x00,0x00,0x00,0x00,0x00,0x00,0x00,0x00,0x00,0x00,0x00,0x00,0x00,0x00,0x00,0x00 },
        { 0x00,0x00,0x00,0x00,0x00,0x00,0x00,0x00,0x00,0x00,0x00,0x00,0x00,0x00,0x00,0x00 },
        { 0x00,0x00,0x00,0x00,0x00,0x00,0x00,0x00,0x00,0x00,0x00,0x00,0x00,0x00,0x00,0x00 },
        { 0x00,0x00,0x00,0x00,0x00,0x00,0x00,0x00,0x00,0x00,0x00,0x00,0x00,0x00,0x00,0x00 },
        { 0x00,0x00,0x00,0x00,0x00,0x00,0x00,0x00,0x00,0x00,0x00,0x00,0x00,0x00,0x00,0x00 },
        { 0x00,0x00,0x00,0x00,0x00,0x00,0x00,0x00,0x00,0x00,0x00,0x00,0x00,0x00,0x00,0x00 },
        { 0x00,0x00,0x00,0x00,0x00,0x00,0x00,0x00,0x00,0x00,0x00,0x00,0x00,0x00,0x00,0x00 },
        { 0x00,0x00,0x00,0x00,0x00,0x00,0x00,0x00,0x00,0x00,0x00,0x00,0x00,0x00,0x00,0x00 },
        { 0x00,0x00,0x00,0x00,0x00,0x00,0x00,0x00,0x00,0x00,0x00,0x00,0x00,0x00,0x00,0x00 },
        { 0x00,0x00,0x00,0x00,0x00,0x00,0x00,0x00,0x00,0x00,0x00,0x00,0x00,0x00,0x00,0x00 },
        { 0x00,0x00,0x00,0x00,0x00,0x00,0x00,0x00,0x00,0x00,0x00,0x00,0x00,0x00,0x00,0x00 },
        { 0x00,0x00,0x00,0x00,0x00,0x00,0x00,0x00,0x00,0x00,0x00,0x00,0x00,0x00,0x00,0x00 },
        { 0x00,0x00,0x00,0x00,0x00,0x00,0x00,0x00,0x00,0x00,0x00,0x00,0x00,0x00,0x00,0x00 },
        { 0x00,0x00,0x00,0x00,0x00,0x00,0x00,0x00,0x00,0x00,0x00,0x00,0x00,0x00,0x00,0x00 },
        { 0x00,0x00,0x00,0x00,0x00,0x00,0x00,0x00,0x00,0x00,0x00,0x00,0x00,0x00,0x00,0x00 },
        { 0x00,0x00,0x00,0x00,0x00,0x00,0x00,0x00,0x00,0x00,0x00,0x00,0x00,0x00,0x00,0x00 },
        { 0x1c,0x1c,0x1c,0x1c,0x1c,0x1c,0x1c,0x1c,0x1c,0x1c,0x1c,0x1c,0x1c,0x1c,0x1c,0x1c },
        { 0x00,0x00,0x00,0x00,0x00,0x00,0x00,0x00,0x00,0x00,0x00,0x00,0x00,0x00,0x00,0x00 },
        { 0x00,0x00,0x00,0x00,0x00,0x00,0x00,0x00,0x00,0x00,0x00,0x00,0x00,0x00,0x00,0x00 },
        { 0x00,0x00,0x00,0x00,0x00,0x00,0x00,0x00,0x00,0x00,0x00,0x00,0x00,0x00,0x00,0x00 },
        { 0x00,0x00,0x00,0x00,0x00,0x00,0x00,0x00,0x00,0x00,0x00,0x00,0x00,0x00,0x00,0x00 },
        { 0x00,0x00,0x00,0x00,0x00,0x00,0x00,0x00,0x00,0x00,0x00,0x00,0x00,0x00,0x00,0x00 },
        { 0x00,0x00,0x00,0x00,0x00,0x00,0x00,0x00,0x00,0x00,0x00,0x00,0x00,0x00,0x00,0x00 },
        { 0x00,0x00,0x00,0x00,0x00,0x00,0x00,0x00,0x00,0x00,0x00,0x00,0x00,0x00,0x00,0x00 },
        { 0x00,0x00,0x00,0x00,0x00,0x00,0x00,0x00,0x00,0x00,0x00,0x00,0x00,0x00,0x00,0x00 },
        { 0x00,0x00,0x00,0x00,0x00,0x00,0x00,0x00,0x00,0x00,0x00,0x00,0x00,0x00,0x00,0x00 },
        { 0x00,0x00,0x00,0x00,0x00,0x00,0x00,0x00,0x00,0x00,0x00,0x00,0x00,0x00,0x00,0x00 },
        { 0x00,0x00,0x00,0x00,0x00,0x00,0x00,0x00,0x00,0x00,0x00,0x00,0x00,0x00,0x00,0x00 },
        { 0x00,0x00,0x00,0x00,0x00,0x00,0x00,0x00,0x00,0x00,0x00,0x00,0x00,0x00,0x00,0x00 },
        { 0x00,0x00,0x00,0x00,0x00,0x00,0x00,0x00,0x00,0x00,0x00,0x00,0x00,0x00,0x00,0x00 },
        { 0x00,0x00,0x00,0x00,0x00,0x00,0x00,0x00,0x00,0x00,0x00,0x00,0x00,0x00,0x00,0x00 },
        { 0x00,0x00,0x00,0x00,0x00,0x00,0x00,0x00,0x00,0x00,0x00,0x00,0x00,0x00,0x00,0x00 },
        { 0x00,0x00,0x00,0x00,0x00,0x00,0x00,0x00,0x00,0x00,0x00,0x00,0x00,0x00,0x00,0x00 }
    };

    /* checksum end value is based on message counter value */
    crcid = ChksmEndVal[FrmIdx][MsgCnt];

    return Frm_CalcChecksumCRC8(FrmIdx, MsgObj, crcid);
}
/*@@end*/

/*@@caplFunc:Frm_CalcChecksumXOR(int, message*, int):*/
byte Frm_CalcChecksumXOR(int FrmIdx, message *MsgObj, int dChksmIdx)
{
    int idx;
    byte chksm;

    /* reset checksum byte */
    MsgObj.BYTE(dChksmIdx) = 0;

    /* init checksum value */
    chksm = 0;

    /* calculate checksum */
    for (idx = 0; idx < MsgObj.DLC; idx++)
    {
        if (idx != dChksmIdx)
        {
            /* XOR all bytes */
            chksm = chksm ^ MsgObj.BYTE(idx);
        }
    }

    /* checksum calculation disabled, make sure checksum is wrong */
    if (Frm_MsgChksmEna[FrmIdx] == 0)
    {
        chksm = ~chksm;
    }

	return (chksm);
}
/*@@end*/

/*@@caplFunc:Frm_CalcChecksumXORID(int, message*, int):*/
byte Frm_CalcChecksumXORID(int FrmIdx, message *MsgObj, int dChksmIdx)
{
    int idx;
    byte chksm;

    /* reset checksum byte */
    MsgObj.BYTE(dChksmIdx) = 0;

    /* init checksum value */
    chksm = 0;

    /* calculate checksum */
    for (idx = 0; idx < MsgObj.DLC; idx++)
    {
        if (idx != dChksmIdx)
        {
            /* XOR all bytes */
            chksm = chksm ^ MsgObj.BYTE(idx);
        }
    }

    /* add high and low byte of CAN ID */
    chksm = chksm ^ (MsgObj.ID & 0xFF);
    chksm = chksm ^ ((MsgObj.ID >> 8) & 0xFF);

    /* checksum calculation disabled, make sure checksum is wrong */
    if (Frm_MsgChksmEna[FrmIdx] == 0)
    {
        chksm = ~chksm;
    }

	return (chksm);
}
/*@@end*/

/*@@caplFunc:Frm_CalcChecksumLW1(int, message*, int):*/
byte Frm_CalcChecksumLW1(int FrmIdx, message *MsgObj, int dChksmIdx)
{
    int idx;
    byte chksm;

    /* reset checksum byte */
    MsgObj.BYTE(dChksmIdx) = 0;

    /* init checksum value */
    chksm = 0;

    /* calculate checksum */
    chksm = ((MsgObj.BYTE(0) + MsgObj.BYTE(1) + MsgObj.BYTE(2) + MsgObj.BYTE(3) + MsgObj.BYTE(5)) & 0xFF);
    chksm = ~chksm;

    /* checksum calculation disabled, make sure checksum is wrong */
    if (Frm_MsgChksmEna[FrmIdx] == 0)
    {
        chksm = ~chksm;
    }

	return (chksm);
}
/*@@end*/

/*@@caplFunc:Frm_CalcMsgCounter(int):*/
int Frm_CalcMsgCounter(int FrmIdx)
{
    /* IMPORTANT NOTE: currently it is assumed that message counter is 4 bit long */
    if (Frm_MsgCounterEna[FrmIdx] != 0)
    {
        Frm_MsgCounter[FrmIdx] ++;
        Frm_MsgCounter[FrmIdx] &= 0x0F;
    }

    return (Frm_MsgCounter[FrmIdx]);
}
/*@@end*/

/*@@caplFunc:FrmSch_EnableFrame(long):*/
FrmSch_EnableFrame(long FrmIdx)
{
    /* enable TX of CAN frame */
    FrmSched_FrmEna[FrmIdx] = 1;
}
/*@@end*/

/*@@caplFunc:FrmSch_DisableFrame(long):*/
FrmSch_DisableFrame(long FrmIdx)
{
    /* enable TX of CAN frame */
    FrmSched_FrmEna[FrmIdx] = 0;
}
/*@@end*/

/*@@caplFunc:FrmSch_EnableAllFrames():*/
FrmSch_EnableAllFrames()
{
    int FrmIdx;

    for (FrmIdx = 0; FrmIdx < FRM_NUM_MAX; FrmIdx++)
    {
        /* enable scheduler for all frames */
        FrmSched_FrmEna[FrmIdx] = 1;
    }
}
/*@@end*/

/*@@caplFunc:FrmSch_DisableAllFrames():*/
FrmSch_DisableAllFrames()
{
    int FrmIdx;

    for (FrmIdx = 0; FrmIdx < FRM_NUM_MAX; FrmIdx++)
    {
        /* disable scheduler for all frames */
        FrmSched_FrmEna[FrmIdx] = 0;
    }
}
/*@@end*/

/*@@caplFunc:Frm_EnableMsgCounter(long):*/
Frm_EnableMsgCounter(long FrmIdx)
{
    /* enable message counter calculation */
    Frm_MsgCounterEna[FrmIdx] = 1;
}
/*@@end*/

/*@@caplFunc:Frm_DisableMsgCounter(long):*/
Frm_DisableMsgCounter(long FrmIdx)
{
    /* disable message counter calculation */
    Frm_MsgCounterEna[FrmIdx] = 0;
}
/*@@end*/

/*@@caplFunc:Frm_EnableChksm(long):*/
Frm_EnableChksm(long FrmIdx)
{
    /* enable checksum calculation */
    Frm_MsgChksmEna[FrmIdx] = 1;
}
/*@@end*/

/*@@caplFunc:Frm_DisableChksm(long):*/
Frm_DisableChksm(long FrmIdx)
{
    /* disable checksum calculation */
    Frm_MsgChksmEna[FrmIdx] = 0;
}
/*@@end*/
