/*@@var:*/
/* TemplateVersion: 1.0.2 */
variables 
{
    /**********************************************************************************************/
    /* BEGIN AUTO                                                                                 */
    /**********************************************************************************************/
    //message ACC_06 ACC_06;
    message ACC_06 MsgObj_ACC_06;
    message Airbag_01 MsgObj_Airbag_01;
    message Airbag_02 MsgObj_Airbag_02;
    message Anhaenger_01 MsgObj_Anhaenger_01;
    message BCM_01 MsgObj_BCM_01;
    message BEM_05 MsgObj_BEM_05;
    message Bremse_EV_01 MsgObj_Bremse_EV_01;
    message Bremse_EV_02 MsgObj_Bremse_EV_02;
    message CAN_Umsetzer_Resp_01 MsgObj_CAN_Umsetzer_Resp_01;
    message Charisma_01 MsgObj_Charisma_01;
    message Diagnose_01 MsgObj_Diagnose_01;
    message EPB_01 MsgObj_EPB_01;
    message ESP_02 MsgObj_ESP_02;
    message ESP_05 MsgObj_ESP_05;
    message ESP_07 MsgObj_ESP_07;
    message ESP_10 MsgObj_ESP_10;
    message ESP_19 MsgObj_ESP_19;
    message ESP_20 MsgObj_ESP_20;
    message ESP_21 MsgObj_ESP_21;
    message Einheiten_01 MsgObj_Einheiten_01;
    message GRA_ACC_01 MsgObj_GRA_ACC_01;
    message Gateway_72 MsgObj_Gateway_72;
    message Gateway_74 MsgObj_Gateway_74;
    message Getriebe_11 MsgObj_Getriebe_11;
    message Getriebe_12 MsgObj_Getriebe_12;
    message Getriebe_13 MsgObj_Getriebe_13;
    message Getriebe_14 MsgObj_Getriebe_14;
    message Getriebe_Hybrid_01 MsgObj_Getriebe_Hybrid_01;
    message HVEM_02 MsgObj_HVEM_02;
    message HVEM_04 MsgObj_HVEM_04;
    message Klemmen_Status_01 MsgObj_Klemmen_Status_01;
    message Klima_11 MsgObj_Klima_11;
    message Kombi_01 MsgObj_Kombi_01;
    message Kombi_02 MsgObj_Kombi_02;
    message LWI_01 MsgObj_LWI_01;
    message Licht_hinten_01 MsgObj_Licht_hinten_01;
    message NMH_Gateway MsgObj_NMH_Gateway;
    message OBD_Tankgeber_01 MsgObj_OBD_Tankgeber_01;
    message Remotestart_FFB MsgObj_Remotestart_FFB;
    message STH_01 MsgObj_STH_01;
    message STS_01 MsgObj_STS_01;
    message Systeminfo_01 MsgObj_Systeminfo_01;
    message WBA_03 MsgObj_WBA_03;

    const FRM_HANDLE_ACC_06 = 0;
    const FRM_HANDLE_Airbag_01 = 1;
    const FRM_HANDLE_Airbag_02 = 2;
    const FRM_HANDLE_Anhaenger_01 = 3;
    const FRM_HANDLE_BCM_01 = 4;
    const FRM_HANDLE_BEM_05 = 5;
    const FRM_HANDLE_Bremse_EV_01 = 6;
    const FRM_HANDLE_Bremse_EV_02 = 7;
    const FRM_HANDLE_CAN_Umsetzer_Resp_01 = 8;
    const FRM_HANDLE_Charisma_01 = 9;
    const FRM_HANDLE_Diagnose_01 = 10;
    const FRM_HANDLE_EPB_01 = 11;
    const FRM_HANDLE_ESP_02 = 12;
    const FRM_HANDLE_ESP_05 = 13;
    const FRM_HANDLE_ESP_07 = 14;
    const FRM_HANDLE_ESP_10 = 15;
    const FRM_HANDLE_ESP_19 = 16;
    const FRM_HANDLE_ESP_20 = 17;
    const FRM_HANDLE_ESP_21 = 18;
    const FRM_HANDLE_Einheiten_01 = 19;
    const FRM_HANDLE_GRA_ACC_01 = 20;
    const FRM_HANDLE_Gateway_72 = 21;
    const FRM_HANDLE_Gateway_74 = 22;
    const FRM_HANDLE_Getriebe_11 = 23;
    const FRM_HANDLE_Getriebe_12 = 24;
    const FRM_HANDLE_Getriebe_13 = 25;
    const FRM_HANDLE_Getriebe_14 = 26;
    const FRM_HANDLE_Getriebe_Hybrid_01 = 27;
    const FRM_HANDLE_HVEM_02 = 28;
    const FRM_HANDLE_HVEM_04 = 29;
    const FRM_HANDLE_Klemmen_Status_01 = 30;
    const FRM_HANDLE_Klima_11 = 31;
    const FRM_HANDLE_Kombi_01 = 32;
    const FRM_HANDLE_Kombi_02 = 33;
    const FRM_HANDLE_LWI_01 = 34;
    const FRM_HANDLE_Licht_hinten_01 = 35;
    const FRM_HANDLE_NMH_Gateway = 36;
    const FRM_HANDLE_OBD_Tankgeber_01 = 37;
    const FRM_HANDLE_Remotestart_FFB = 38;
    const FRM_HANDLE_STH_01 = 39;
    const FRM_HANDLE_STS_01 = 40;
    const FRM_HANDLE_Systeminfo_01 = 41;
    const FRM_HANDLE_WBA_03 = 42;

    const FRM_NUM_MAX = 43;


    /**********************************************************************************************/
    /* END AUTO                                                                                   */
    /**********************************************************************************************/


    /* ------------------------------------------------------------------------------------------ */
    /*  timer                                                                                     */
    /* ------------------------------------------------------------------------------------------ */
    msTimer Timer_10ms;                   /* 10ms base timer */
    const TIMER_DURATION_10MS = 10;       /* timer duration for 10ms timer */
    

    /* ------------------------------------------------------------------------------------------ */
    /*  frame scheduler                                                                           */
    /* ------------------------------------------------------------------------------------------ */
    int FrmSched_SchedTmr[FRM_NUM_MAX];   /* schedule timer, incremented every 10ms, resolution [1ms] */
    int FrmSched_CycleTime[FRM_NUM_MAX];  /* cycle time of the CAN frame, resolution [1ms] */
    int FrmSched_FrmEna[FRM_NUM_MAX];     /* frame enable status */


    /* ------------------------------------------------------------------------------------------ */
    /*  frame manager                                                                             */
    /* ------------------------------------------------------------------------------------------ */
    int Frm_MsgCounter[FRM_NUM_MAX];      /* current message counter value */
    int Frm_MsgCounterEna[FRM_NUM_MAX];   /* message counter enable status */
    int Frm_MsgChksmEna[FRM_NUM_MAX];     /* checksum enable status */
    int Frm_DLC[FRM_NUM_MAX];             /* DLC */
    int Frm_DLCOk[FRM_NUM_MAX];           /* DLC status (0=DLC wrong, 1=DLC ok) */

    
    /* ------------------------------------------------------------------------------------------ */
    /*  CAPL control                                                                              */
    /* ------------------------------------------------------------------------------------------ */
    const CAPLCTRL_LEVEL_NOSEL = 0;
    const CAPLCTRL_LEVEL_FRAME = 1;
    const CAPLCTRL_LEVEL_SIGNAL = 2;

    const CAPLCTRL_NOVAL = -1;

    const CAPLCTRL_INPUTBUF_LEN = 32;
    const CAPLCTRL_CHARBUF_LEN = 64;

    const CAPLCTRL_PROMPTMODE_NUM = 0;
    const CAPLCTRL_PROMPTMODE_CHAR = 1;

    int  CaplCtrl_LevelActv = CAPLCTRL_LEVEL_NOSEL;  /* current active level */
    int  CaplCtrl_FrameActv = 0;                     /* current selected frame */
    int  CaplCtrl_SignalActv = 0;                    /* current selected signal */
    long CaplCtrl_InputValue = 0;                    /* current input value */
    char CaplCtrl_InputBuf[CAPLCTRL_INPUTBUF_LEN];   /* user input buffer */
    int  CaplCtrl_InputIdx = 0;                      /* index into input buffer */
    char CaplCtrl_FrameName[32];                     /* buffer to store frame name */
    char CaplCtrl_SignalName[64];                    /* buffer to store signal name */
    int  CaplCtrl_PromptMode;                        /* prompt mode */
    char CaplCtrl_CharBuf[CAPLCTRL_CHARBUF_LEN];     /* buffer for char output in prompt */


    /* ------------------------------------------------------------------------------------------ */
    /*  key codes                                                                                 */
    /* ------------------------------------------------------------------------------------------ */
    const KEY_ENTER = 0x0D;
    const KEY_BACKSPACE = 0x08;
    const KEY_UP = 0x4800;
    const KEY_DOWN = 0x5000;
    const KEY_TAB = 0x09;
    const KEY_LEVEL_DOWN = '.';
    const KEY_TIMEOUT = 'a';
    const KEY_MSGCNT = 'b';
    const KEY_CHKSM = 'c';
    const KEY_DLC = 'd';
    const KEY_HELP = '?';


    /* ------------------------------------------------------------------------------------------ */
    /*  checksum related variables                                                                */
    /* ------------------------------------------------------------------------------------------ */
    byte CRC8_tab_256[256] =
    {
        0x00, 0x2f, 0x5e, 0x71, 0xbc, 0x93, 0xe2, 0xcd,
        0x57, 0x78, 0x09, 0x26, 0xeb, 0xc4, 0xb5, 0x9a,
        0xae, 0x81, 0xf0, 0xdf, 0x12, 0x3d, 0x4c, 0x63,
        0xf9, 0xd6, 0xa7, 0x88, 0x45, 0x6a, 0x1b, 0x34,
        0x73, 0x5c, 0x2d, 0x02, 0xcf, 0xe0, 0x91, 0xbe,
        0x24, 0x0b, 0x7a, 0x55, 0x98, 0xb7, 0xc6, 0xe9,
        0xdd, 0xf2, 0x83, 0xac, 0x61, 0x4e, 0x3f, 0x10,
        0x8a, 0xa5, 0xd4, 0xfb, 0x36, 0x19, 0x68, 0x47,
        0xe6, 0xc9, 0xb8, 0x97, 0x5a, 0x75, 0x04, 0x2b,
        0xb1, 0x9e, 0xef, 0xc0, 0x0d, 0x22, 0x53, 0x7c,
        0x48, 0x67, 0x16, 0x39, 0xf4, 0xdb, 0xaa, 0x85,
        0x1f, 0x30, 0x41, 0x6e, 0xa3, 0x8c, 0xfd, 0xd2,
        0x95, 0xba, 0xcb, 0xe4, 0x29, 0x06, 0x77, 0x58,
        0xc2, 0xed, 0x9c, 0xb3, 0x7e, 0x51, 0x20, 0x0f,
        0x3b, 0x14, 0x65, 0x4a, 0x87, 0xa8, 0xd9, 0xf6,
        0x6c, 0x43, 0x32, 0x1d, 0xd0, 0xff, 0x8e, 0xa1,
        0xe3, 0xcc, 0xbd, 0x92, 0x5f, 0x70, 0x01, 0x2e,
        0xb4, 0x9b, 0xea, 0xc5, 0x08, 0x27, 0x56, 0x79,
        0x4d, 0x62, 0x13, 0x3c, 0xf1, 0xde, 0xaf, 0x80,
        0x1a, 0x35, 0x44, 0x6b, 0xa6, 0x89, 0xf8, 0xd7,
        0x90, 0xbf, 0xce, 0xe1, 0x2c, 0x03, 0x72, 0x5d,
        0xc7, 0xe8, 0x99, 0xb6, 0x7b, 0x54, 0x25, 0x0a,
        0x3e, 0x11, 0x60, 0x4f, 0x82, 0xad, 0xdc, 0xf3,
        0x69, 0x46, 0x37, 0x18, 0xd5, 0xfa, 0x8b, 0xa4,
        0x05, 0x2a, 0x5b, 0x74, 0xb9, 0x96, 0xe7, 0xc8,
        0x52, 0x7d, 0x0c, 0x23, 0xee, 0xc1, 0xb0, 0x9f,
        0xab, 0x84, 0xf5, 0xda, 0x17, 0x38, 0x49, 0x66,
        0xfc, 0xd3, 0xa2, 0x8d, 0x40, 0x6f, 0x1e, 0x31,
        0x76, 0x59, 0x28, 0x07, 0xca, 0xe5, 0x94, 0xbb,
        0x21, 0x0e, 0x7f, 0x50, 0x9d, 0xb2, 0xc3, 0xec,
        0xd8, 0xf7, 0x86, 0xa9, 0x64, 0x4b, 0x3a, 0x15,
        0x8f, 0xa0, 0xd1, 0xfe, 0x33, 0x1c, 0x6d, 0x42
    };
}
/*@@end*/

/*@@timer:Timer_10ms:*/
on timer Timer_10ms
{
    int FrmIdx;

    /* restart the 10ms timer */
    setTimer(Timer_10ms,TIMER_DURATION_10MS);


    /* ------------------------------------------------------------------------------------------ */
    /*  BEGIN Frame Scheduler                                                                     */
    /* ------------------------------------------------------------------------------------------ */

    for (FrmIdx = 0; FrmIdx < FRM_NUM_MAX; FrmIdx++)
    {
        /* check if frame is enabled */
        if (FrmSched_FrmEna[FrmIdx] != 0)
        {
            /* increment schedule timer */
            FrmSched_SchedTmr[FrmIdx] += 10;
        }
        else
        {
            /* frame disabled, stop schedule timer */
            FrmSched_SchedTmr[FrmIdx] = 0;
        }

        /* if schedule timer reaches cycle time, trigger transfer of CAN frame */
        if (FrmSched_SchedTmr[FrmIdx] >= FrmSched_CycleTime[FrmIdx])
        {
            /* reset schedule timer */
            FrmSched_SchedTmr[FrmIdx] = 0;

            /* trigger transmission of frame */
            FrmSched_SendFrame(FrmIdx);
        }
    }

    /* ------------------------------------------------------------------------------------------ */
    /*  END Frame Scheduler                                                                       */
    /* ------------------------------------------------------------------------------------------ */
}
/*@@end*/

/*@@preStart:PreStart:*/
on preStart
{
    dword fhdlIn;
    dword fhdlOut;
    
    /* ------------------------------------------------------------------------------------------ */
    /*  BEGIN frame and signal handle export for remote control of CAPL by Perl script            */
    /* ------------------------------------------------------------------------------------------ */

    /* check if CAPL is remote controlled by CaplCtrl Perl script */
    /* NOTE: Communication between CAPL program and Perl scritp is done via file, since with */
    /*       CANalyzer Version v4 it is not possible to use environment variables, so this is */
    /*       just a workaround. */
    fhdlIn = openFileRead ("caplctrl_req.txt", 0);
    if (fhdlIn != 0)
    {
        /* close input file */
        fileClose(fhdlIn);

        /* export frame and signal handles to file for remote control scripts */
        fhdlOut = openFileWrite ("caplctrl.txt", 0);
        if (fhdlOut != 0)
        {
            /* NOTE:   handles are 2 bytes long. */
            /* LAYOUT: frame handle: lower byte = 0xFF, upper byte = frame handle for CAPL program */
            /*         signal handle: lower byte = signal index, upper byte = frame index */
            filePutString ("ACC_06;255\n", 11, fhdlOut);
            filePutString ("ACC_06;ACC06;AliasName\n", 23, fhdlOut);    /* alias frame handle for ACC_06 */
            filePutString ("Airbag_01;511\n", 14, fhdlOut);
            filePutString ("Airbag_01;AIRBG01;AliasName\n", 28, fhdlOut);    /* alias frame handle for Airbag_01 */
            filePutString ("Airbag_02;767\n", 14, fhdlOut);
            filePutString ("Airbag_02;AIRBG02;AliasName\n", 28, fhdlOut);    /* alias frame handle for Airbag_02 */
            filePutString ("Anhaenger_01;1023\n", 18, fhdlOut);
            filePutString ("Anhaenger_01;TRLR01;AliasName\n", 30, fhdlOut);    /* alias frame handle for Anhaenger_01 */
            filePutString ("BCM_01;1279\n", 12, fhdlOut);
            filePutString ("BCM_01;BCM01;AliasName\n", 23, fhdlOut);    /* alias frame handle for BCM_01 */
            filePutString ("BEM_05;1535\n", 12, fhdlOut);
            filePutString ("BEM_05;BEM05;AliasName\n", 23, fhdlOut);    /* alias frame handle for BEM_05 */
            filePutString ("Bremse_EV_01;1791\n", 18, fhdlOut);
            filePutString ("Bremse_EV_01;BRKEV01;AliasName\n", 31, fhdlOut);    /* alias frame handle for Bremse_EV_01 */
            filePutString ("Bremse_EV_02;2047\n", 18, fhdlOut);
            filePutString ("Bremse_EV_02;BRKEV02;AliasName\n", 31, fhdlOut);    /* alias frame handle for Bremse_EV_02 */
            filePutString ("CAN_Umsetzer_Resp_01;2303\n", 26, fhdlOut);
            filePutString ("CAN_Umsetzer_Resp_01;CU1RSP;AliasName\n", 38, fhdlOut);    /* alias frame handle for CAN_Umsetzer_Resp_01 */
            filePutString ("Charisma_01;2559\n", 17, fhdlOut);
            filePutString ("Charisma_01;CHRSM01;AliasName\n", 30, fhdlOut);    /* alias frame handle for Charisma_01 */
            filePutString ("Diagnose_01;2815\n", 17, fhdlOut);
            filePutString ("Diagnose_01;DIA01;AliasName\n", 28, fhdlOut);    /* alias frame handle for Diagnose_01 */
            filePutString ("EPB_01;3071\n", 12, fhdlOut);
            filePutString ("EPB_01;EPB01;AliasName\n", 23, fhdlOut);    /* alias frame handle for EPB_01 */
            filePutString ("ESP_02;3327\n", 12, fhdlOut);
            filePutString ("ESP_02;ESP02;AliasName\n", 23, fhdlOut);    /* alias frame handle for ESP_02 */
            filePutString ("ESP_05;3583\n", 12, fhdlOut);
            filePutString ("ESP_05;ESP05;AliasName\n", 23, fhdlOut);    /* alias frame handle for ESP_05 */
            filePutString ("ESP_07;3839\n", 12, fhdlOut);
            filePutString ("ESP_07;ESP07;AliasName\n", 23, fhdlOut);    /* alias frame handle for ESP_07 */
            filePutString ("ESP_10;4095\n", 12, fhdlOut);
            filePutString ("ESP_10;ESPK10;AliasName\n", 24, fhdlOut);    /* alias frame handle for ESP_10 */
            filePutString ("ESP_19;4351\n", 12, fhdlOut);
            filePutString ("ESP_19;ESP19;AliasName\n", 23, fhdlOut);    /* alias frame handle for ESP_19 */
            filePutString ("ESP_20;4607\n", 12, fhdlOut);
            filePutString ("ESP_20;ESP20;AliasName\n", 23, fhdlOut);    /* alias frame handle for ESP_20 */
            filePutString ("ESP_21;4863\n", 12, fhdlOut);
            filePutString ("ESP_21;ESP21;AliasName\n", 23, fhdlOut);    /* alias frame handle for ESP_21 */
            filePutString ("Einheiten_01;5119\n", 18, fhdlOut);
            filePutString ("Einheiten_01;EINH01;AliasName\n", 30, fhdlOut);    /* alias frame handle for Einheiten_01 */
            filePutString ("GRA_ACC_01;5375\n", 16, fhdlOut);
            filePutString ("GRA_ACC_01;GRAACC01;AliasName\n", 30, fhdlOut);    /* alias frame handle for GRA_ACC_01 */
            filePutString ("Gateway_72;5631\n", 16, fhdlOut);
            filePutString ("Gateway_72;GW72;AliasName\n", 26, fhdlOut);    /* alias frame handle for Gateway_72 */
            filePutString ("Gateway_74;5887\n", 16, fhdlOut);
            filePutString ("Gateway_74;GW74;AliasName\n", 26, fhdlOut);    /* alias frame handle for Gateway_74 */
            filePutString ("Getriebe_11;6143\n", 17, fhdlOut);
            filePutString ("Getriebe_11;GBX11;AliasName\n", 28, fhdlOut);    /* alias frame handle for Getriebe_11 */
            filePutString ("Getriebe_12;6399\n", 17, fhdlOut);
            filePutString ("Getriebe_12;GBX12;AliasName\n", 28, fhdlOut);    /* alias frame handle for Getriebe_12 */
            filePutString ("Getriebe_13;6655\n", 17, fhdlOut);
            filePutString ("Getriebe_13;GBX13;AliasName\n", 28, fhdlOut);    /* alias frame handle for Getriebe_13 */
            filePutString ("Getriebe_14;6911\n", 17, fhdlOut);
            filePutString ("Getriebe_14;GBX14;AliasName\n", 28, fhdlOut);    /* alias frame handle for Getriebe_14 */
            filePutString ("Getriebe_Hybrid_01;7167\n", 24, fhdlOut);
            filePutString ("Getriebe_Hybrid_01;GBXHYB01;AliasName\n", 38, fhdlOut);    /* alias frame handle for Getriebe_Hybrid_01 */
            filePutString ("HVEM_02;7423\n", 13, fhdlOut);
            filePutString ("HVEM_02;HVEM02;AliasName\n", 25, fhdlOut);    /* alias frame handle for HVEM_02 */
            filePutString ("HVEM_04;7679\n", 13, fhdlOut);
            filePutString ("HVEM_04;HVEM04;AliasName\n", 25, fhdlOut);    /* alias frame handle for HVEM_04 */
            filePutString ("Klemmen_Status_01;7935\n", 23, fhdlOut);
            filePutString ("Klemmen_Status_01;STIGN01;AliasName\n", 36, fhdlOut);    /* alias frame handle for Klemmen_Status_01 */
            filePutString ("Klima_11;8191\n", 14, fhdlOut);
            filePutString ("Klima_11;AC11;AliasName\n", 24, fhdlOut);    /* alias frame handle for Klima_11 */
            filePutString ("Kombi_01;8447\n", 14, fhdlOut);
            filePutString ("Kombi_01;DSP01;AliasName\n", 25, fhdlOut);    /* alias frame handle for Kombi_01 */
            filePutString ("Kombi_02;8703\n", 14, fhdlOut);
            filePutString ("Kombi_02;DSP02;AliasName\n", 25, fhdlOut);    /* alias frame handle for Kombi_02 */
            filePutString ("LWI_01;8959\n", 12, fhdlOut);
            filePutString ("LWI_01;LWI01;AliasName\n", 23, fhdlOut);    /* alias frame handle for LWI_01 */
            filePutString ("Licht_hinten_01;9215\n", 21, fhdlOut);
            filePutString ("Licht_hinten_01;LH01;AliasName\n", 31, fhdlOut);    /* alias frame handle for Licht_hinten_01 */
            filePutString ("NMH_Gateway;9471\n", 17, fhdlOut);
            filePutString ("NMH_Gateway;NMH_Gateway;AliasName\n", 34, fhdlOut);    /* alias frame handle for NMH_Gateway */
            filePutString ("OBD_Tankgeber_01;9727\n", 22, fhdlOut);
            filePutString ("OBD_Tankgeber_01;FLS01;AliasName\n", 33, fhdlOut);    /* alias frame handle for OBD_Tankgeber_01 */
            filePutString ("Remotestart_FFB;9983\n", 21, fhdlOut);
            filePutString ("Remotestart_FFB;RCS1;AliasName\n", 31, fhdlOut);    /* alias frame handle for Remotestart_FFB */
            filePutString ("STH_01;10239\n", 13, fhdlOut);
            filePutString ("STH_01;STH01;AliasName\n", 23, fhdlOut);    /* alias frame handle for STH_01 */
            filePutString ("STS_01;10495\n", 13, fhdlOut);
            filePutString ("STS_01;STS01;AliasName\n", 23, fhdlOut);    /* alias frame handle for STS_01 */
            filePutString ("Systeminfo_01;10751\n", 20, fhdlOut);
            filePutString ("Systeminfo_01;SYS01;AliasName\n", 30, fhdlOut);    /* alias frame handle for Systeminfo_01 */
            filePutString ("WBA_03;11007\n", 13, fhdlOut);
            filePutString ("WBA_03;WBA03;AliasName\n", 23, fhdlOut);    /* alias frame handle for WBA_03 */

            filePutString ("ACC_06_BZ;0\n", 12, fhdlOut);
            filePutString ("ACC_06_BZ/ACC_06;0\n", 19, fhdlOut);
            filePutString ("ACC_06_BZ/ACC06;0\n", 18, fhdlOut);
            filePutString ("ACC_06_CRC;1\n", 13, fhdlOut);
            filePutString ("ACC_06_CRC/ACC_06;1\n", 20, fhdlOut);
            filePutString ("ACC_06_CRC/ACC06;1\n", 19, fhdlOut);
            filePutString ("ACC_Anfahren;2\n", 15, fhdlOut);
            filePutString ("ACC_Anfahren/ACC_06;2\n", 22, fhdlOut);
            filePutString ("ACC_Anfahren/ACC06;2\n", 21, fhdlOut);
            filePutString ("ACC_Anhalten;3\n", 15, fhdlOut);
            filePutString ("ACC_Anhalten/ACC_06;3\n", 22, fhdlOut);
            filePutString ("ACC_Anhalten/ACC06;3\n", 21, fhdlOut);
            filePutString ("ACC_Minimale_Bremsung;4\n", 24, fhdlOut);
            filePutString ("ACC_Minimale_Bremsung/ACC_06;4\n", 31, fhdlOut);
            filePutString ("ACC_Minimale_Bremsung/ACC06;4\n", 30, fhdlOut);
            filePutString ("ACC_Sollbeschleunigung_02;5\n", 28, fhdlOut);
            filePutString ("ACC_Sollbeschleunigung_02/ACC_06;5\n", 35, fhdlOut);
            filePutString ("ACC_Sollbeschleunigung_02/ACC06;5\n", 34, fhdlOut);
            filePutString ("ACC_StartStopp_Info;6\n", 22, fhdlOut);
            filePutString ("ACC_StartStopp_Info/ACC_06;6\n", 29, fhdlOut);
            filePutString ("ACC_StartStopp_Info/ACC06;6\n", 28, fhdlOut);
            filePutString ("ACC_Status_ACC;7\n", 17, fhdlOut);
            filePutString ("ACC_Status_ACC/ACC_06;7\n", 24, fhdlOut);
            filePutString ("ACC_Status_ACC/ACC06;7\n", 23, fhdlOut);
            filePutString ("ACC_Typ;8\n", 10, fhdlOut);
            filePutString ("ACC_Typ/ACC_06;8\n", 17, fhdlOut);
            filePutString ("ACC_Typ/ACC06;8\n", 16, fhdlOut);
            filePutString ("ACC_limitierte_Anfahrdyn;9\n", 27, fhdlOut);
            filePutString ("ACC_limitierte_Anfahrdyn/ACC_06;9\n", 34, fhdlOut);
            filePutString ("ACC_limitierte_Anfahrdyn/ACC06;9\n", 33, fhdlOut);
            filePutString ("ACC_neg_Sollbeschl_Grad_02;10\n", 30, fhdlOut);
            filePutString ("ACC_neg_Sollbeschl_Grad_02/ACC_06;10\n", 37, fhdlOut);
            filePutString ("ACC_neg_Sollbeschl_Grad_02/ACC06;10\n", 36, fhdlOut);
            filePutString ("ACC_pos_Sollbeschl_Grad_02;11\n", 30, fhdlOut);
            filePutString ("ACC_pos_Sollbeschl_Grad_02/ACC_06;11\n", 37, fhdlOut);
            filePutString ("ACC_pos_Sollbeschl_Grad_02/ACC06;11\n", 36, fhdlOut);
            filePutString ("ACC_zul_Regelabw_oben;12\n", 25, fhdlOut);
            filePutString ("ACC_zul_Regelabw_oben/ACC_06;12\n", 32, fhdlOut);
            filePutString ("ACC_zul_Regelabw_oben/ACC06;12\n", 31, fhdlOut);
            filePutString ("ACC_zul_Regelabw_unten;13\n", 26, fhdlOut);
            filePutString ("ACC_zul_Regelabw_unten/ACC_06;13\n", 33, fhdlOut);
            filePutString ("ACC_zul_Regelabw_unten/ACC06;13\n", 32, fhdlOut);
            filePutString ("AB_Anzeige_Fussg;256\n", 21, fhdlOut);
            filePutString ("AB_Anzeige_Fussg/Airbag_01;256\n", 31, fhdlOut);
            filePutString ("AB_Anzeige_Fussg/AIRBG01;256\n", 29, fhdlOut);
            filePutString ("AB_Crash_Int;257\n", 17, fhdlOut);
            filePutString ("AB_Crash_Int/Airbag_01;257\n", 27, fhdlOut);
            filePutString ("AB_Crash_Int/AIRBG01;257\n", 25, fhdlOut);
            filePutString ("AB_Deaktiviert;258\n", 19, fhdlOut);
            filePutString ("AB_Deaktiviert/Airbag_01;258\n", 29, fhdlOut);
            filePutString ("AB_Deaktiviert/AIRBG01;258\n", 27, fhdlOut);
            filePutString ("AB_Deaktivierung_HV;259\n", 24, fhdlOut);
            filePutString ("AB_Deaktivierung_HV/Airbag_01;259\n", 34, fhdlOut);
            filePutString ("AB_Deaktivierung_HV/AIRBG01;259\n", 32, fhdlOut);
            filePutString ("AB_Diagnose;260\n", 16, fhdlOut);
            filePutString ("AB_Diagnose/Airbag_01;260\n", 26, fhdlOut);
            filePutString ("AB_Diagnose/AIRBG01;260\n", 24, fhdlOut);
            filePutString ("AB_Erh_Auf_VB;261\n", 18, fhdlOut);
            filePutString ("AB_Erh_Auf_VB/Airbag_01;261\n", 28, fhdlOut);
            filePutString ("AB_Erh_Auf_VB/AIRBG01;261\n", 26, fhdlOut);
            filePutString ("AB_Front_Crash;262\n", 19, fhdlOut);
            filePutString ("AB_Front_Crash/Airbag_01;262\n", 29, fhdlOut);
            filePutString ("AB_Front_Crash/AIRBG01;262\n", 27, fhdlOut);
            filePutString ("AB_Gurtwarn_VB;263\n", 19, fhdlOut);
            filePutString ("AB_Gurtwarn_VB/Airbag_01;263\n", 29, fhdlOut);
            filePutString ("AB_Gurtwarn_VB/AIRBG01;263\n", 27, fhdlOut);
            filePutString ("AB_Gurtwarn_VF;264\n", 19, fhdlOut);
            filePutString ("AB_Gurtwarn_VF/Airbag_01;264\n", 29, fhdlOut);
            filePutString ("AB_Gurtwarn_VF/AIRBG01;264\n", 27, fhdlOut);
            filePutString ("AB_Heck_Crash;265\n", 18, fhdlOut);
            filePutString ("AB_Heck_Crash/Airbag_01;265\n", 28, fhdlOut);
            filePutString ("AB_Heck_Crash/AIRBG01;265\n", 26, fhdlOut);
            filePutString ("AB_Lampe;266\n", 13, fhdlOut);
            filePutString ("AB_Lampe/Airbag_01;266\n", 23, fhdlOut);
            filePutString ("AB_Lampe/AIRBG01;266\n", 21, fhdlOut);
            filePutString ("AB_MKB_Anforderung;267\n", 23, fhdlOut);
            filePutString ("AB_MKB_Anforderung/Airbag_01;267\n", 33, fhdlOut);
            filePutString ("AB_MKB_Anforderung/AIRBG01;267\n", 31, fhdlOut);
            filePutString ("AB_MKB_gueltig;268\n", 19, fhdlOut);
            filePutString ("AB_MKB_gueltig/Airbag_01;268\n", 29, fhdlOut);
            filePutString ("AB_MKB_gueltig/AIRBG01;268\n", 27, fhdlOut);
            filePutString ("AB_PAO_Leuchte_Anf;269\n", 23, fhdlOut);
            filePutString ("AB_PAO_Leuchte_Anf/Airbag_01;269\n", 33, fhdlOut);
            filePutString ("AB_PAO_Leuchte_Anf/AIRBG01;269\n", 31, fhdlOut);
            filePutString ("AB_RGS_Anst;270\n", 16, fhdlOut);
            filePutString ("AB_RGS_Anst/Airbag_01;270\n", 26, fhdlOut);
            filePutString ("AB_RGS_Anst/AIRBG01;270\n", 24, fhdlOut);
            filePutString ("AB_Rollover_Crash;271\n", 22, fhdlOut);
            filePutString ("AB_Rollover_Crash/Airbag_01;271\n", 32, fhdlOut);
            filePutString ("AB_Rollover_Crash/AIRBG01;271\n", 30, fhdlOut);
            filePutString ("AB_SB_Crash;272\n", 16, fhdlOut);
            filePutString ("AB_SB_Crash/Airbag_01;272\n", 26, fhdlOut);
            filePutString ("AB_SB_Crash/AIRBG01;272\n", 24, fhdlOut);
            filePutString ("AB_SF_Crash;273\n", 16, fhdlOut);
            filePutString ("AB_SF_Crash/Airbag_01;273\n", 26, fhdlOut);
            filePutString ("AB_SF_Crash/AIRBG01;273\n", 24, fhdlOut);
            filePutString ("AB_Stellgliedtest;274\n", 22, fhdlOut);
            filePutString ("AB_Stellgliedtest/Airbag_01;274\n", 32, fhdlOut);
            filePutString ("AB_Stellgliedtest/AIRBG01;274\n", 30, fhdlOut);
            filePutString ("AB_Systemfehler;275\n", 20, fhdlOut);
            filePutString ("AB_Systemfehler/Airbag_01;275\n", 30, fhdlOut);
            filePutString ("AB_Systemfehler/AIRBG01;275\n", 28, fhdlOut);
            filePutString ("AB_Texte_AKS;276\n", 17, fhdlOut);
            filePutString ("AB_Texte_AKS/Airbag_01;276\n", 27, fhdlOut);
            filePutString ("AB_Texte_AKS/AIRBG01;276\n", 25, fhdlOut);
            filePutString ("AB_VB_deaktiviert;277\n", 22, fhdlOut);
            filePutString ("AB_VB_deaktiviert/Airbag_01;277\n", 32, fhdlOut);
            filePutString ("AB_VB_deaktiviert/AIRBG01;277\n", 30, fhdlOut);
            filePutString ("AB_Versorgungsspannung;278\n", 27, fhdlOut);
            filePutString ("AB_Versorgungsspannung/Airbag_01;278\n", 37, fhdlOut);
            filePutString ("AB_Versorgungsspannung/AIRBG01;278\n", 35, fhdlOut);
            filePutString ("Airbag_01_BZ;279\n", 17, fhdlOut);
            filePutString ("Airbag_01_BZ/Airbag_01;279\n", 27, fhdlOut);
            filePutString ("Airbag_01_BZ/AIRBG01;279\n", 25, fhdlOut);
            filePutString ("Airbag_01_CRC;280\n", 18, fhdlOut);
            filePutString ("Airbag_01_CRC/Airbag_01;280\n", 28, fhdlOut);
            filePutString ("Airbag_01_CRC/AIRBG01;280\n", 26, fhdlOut);
            filePutString ("AB_Belegung_VB;512\n", 19, fhdlOut);
            filePutString ("AB_Belegung_VB/Airbag_02;512\n", 29, fhdlOut);
            filePutString ("AB_Belegung_VB/AIRBG02;512\n", 27, fhdlOut);
            filePutString ("AB_Gurtschloss_BF;513\n", 22, fhdlOut);
            filePutString ("AB_Gurtschloss_BF/Airbag_02;513\n", 32, fhdlOut);
            filePutString ("AB_Gurtschloss_BF/AIRBG02;513\n", 30, fhdlOut);
            filePutString ("AB_Gurtschloss_FA;514\n", 22, fhdlOut);
            filePutString ("AB_Gurtschloss_FA/Airbag_02;514\n", 32, fhdlOut);
            filePutString ("AB_Gurtschloss_FA/AIRBG02;514\n", 30, fhdlOut);
            filePutString ("AB_Gurtschloss_Reihe2_BF;515\n", 29, fhdlOut);
            filePutString ("AB_Gurtschloss_Reihe2_BF/Airbag_02;515\n", 39, fhdlOut);
            filePutString ("AB_Gurtschloss_Reihe2_BF/AIRBG02;515\n", 37, fhdlOut);
            filePutString ("AB_Gurtschloss_Reihe2_FA;516\n", 29, fhdlOut);
            filePutString ("AB_Gurtschloss_Reihe2_FA/Airbag_02;516\n", 39, fhdlOut);
            filePutString ("AB_Gurtschloss_Reihe2_FA/AIRBG02;516\n", 37, fhdlOut);
            filePutString ("AB_Gurtschloss_Reihe2_MI;517\n", 29, fhdlOut);
            filePutString ("AB_Gurtschloss_Reihe2_MI/Airbag_02;517\n", 39, fhdlOut);
            filePutString ("AB_Gurtschloss_Reihe2_MI/AIRBG02;517\n", 37, fhdlOut);
            filePutString ("AB_Gurtschloss_Reihe3_BF;518\n", 29, fhdlOut);
            filePutString ("AB_Gurtschloss_Reihe3_BF/Airbag_02;518\n", 39, fhdlOut);
            filePutString ("AB_Gurtschloss_Reihe3_BF/AIRBG02;518\n", 37, fhdlOut);
            filePutString ("AB_Gurtschloss_Reihe3_FA;519\n", 29, fhdlOut);
            filePutString ("AB_Gurtschloss_Reihe3_FA/Airbag_02;519\n", 39, fhdlOut);
            filePutString ("AB_Gurtschloss_Reihe3_FA/AIRBG02;519\n", 37, fhdlOut);
            filePutString ("AB_Gurtschloss_Reihe3_MI;520\n", 29, fhdlOut);
            filePutString ("AB_Gurtschloss_Reihe3_MI/Airbag_02;520\n", 39, fhdlOut);
            filePutString ("AB_Gurtschloss_Reihe3_MI/AIRBG02;520\n", 37, fhdlOut);
            filePutString ("AB_Sitzpos_Sens_BF;521\n", 23, fhdlOut);
            filePutString ("AB_Sitzpos_Sens_BF/Airbag_02;521\n", 33, fhdlOut);
            filePutString ("AB_Sitzpos_Sens_BF/AIRBG02;521\n", 31, fhdlOut);
            filePutString ("AB_Sitzpos_Sens_FA;522\n", 23, fhdlOut);
            filePutString ("AB_Sitzpos_Sens_FA/Airbag_02;522\n", 33, fhdlOut);
            filePutString ("AB_Sitzpos_Sens_FA/AIRBG02;522\n", 31, fhdlOut);
            filePutString ("Airbag_02_BZ;523\n", 17, fhdlOut);
            filePutString ("Airbag_02_BZ/Airbag_02;523\n", 27, fhdlOut);
            filePutString ("Airbag_02_BZ/AIRBG02;523\n", 25, fhdlOut);
            filePutString ("Airbag_02_CRC;524\n", 18, fhdlOut);
            filePutString ("Airbag_02_CRC/Airbag_02;524\n", 28, fhdlOut);
            filePutString ("Airbag_02_CRC/AIRBG02;524\n", 26, fhdlOut);
            filePutString ("AAG_AVS_Fehler_02;768\n", 22, fhdlOut);
            filePutString ("AAG_AVS_Fehler_02/Anhaenger_01;768\n", 35, fhdlOut);
            filePutString ("AAG_AVS_Fehler_02/TRLR01;768\n", 29, fhdlOut);
            filePutString ("AAG_AVS_Stati;769\n", 18, fhdlOut);
            filePutString ("AAG_AVS_Stati/Anhaenger_01;769\n", 31, fhdlOut);
            filePutString ("AAG_AVS_Stati/TRLR01;769\n", 25, fhdlOut);
            filePutString ("AAG_Anhaenger_abgesteckt;770\n", 29, fhdlOut);
            filePutString ("AAG_Anhaenger_abgesteckt/Anhaenger_01;770\n", 42, fhdlOut);
            filePutString ("AAG_Anhaenger_abgesteckt/TRLR01;770\n", 36, fhdlOut);
            filePutString ("AAG_Anhaenger_erkannt;771\n", 26, fhdlOut);
            filePutString ("AAG_Anhaenger_erkannt/Anhaenger_01;771\n", 39, fhdlOut);
            filePutString ("AAG_Anhaenger_erkannt/TRLR01;771\n", 33, fhdlOut);
            filePutString ("AAG_BZ;772\n", 11, fhdlOut);
            filePutString ("AAG_BZ/Anhaenger_01;772\n", 24, fhdlOut);
            filePutString ("AAG_BZ/TRLR01;772\n", 18, fhdlOut);
            filePutString ("AAG_Blinker_HL_def;773\n", 23, fhdlOut);
            filePutString ("AAG_Blinker_HL_def/Anhaenger_01;773\n", 36, fhdlOut);
            filePutString ("AAG_Blinker_HL_def/TRLR01;773\n", 30, fhdlOut);
            filePutString ("AAG_Blinker_HR_def;774\n", 23, fhdlOut);
            filePutString ("AAG_Blinker_HR_def/Anhaenger_01;774\n", 36, fhdlOut);
            filePutString ("AAG_Blinker_HR_def/TRLR01;774\n", 30, fhdlOut);
            filePutString ("AAG_Blinker_H_aktiv;775\n", 24, fhdlOut);
            filePutString ("AAG_Blinker_H_aktiv/Anhaenger_01;775\n", 37, fhdlOut);
            filePutString ("AAG_Blinker_H_aktiv/TRLR01;775\n", 31, fhdlOut);
            filePutString ("AAG_Bremsl_durch_ECD;776\n", 25, fhdlOut);
            filePutString ("AAG_Bremsl_durch_ECD/Anhaenger_01;776\n", 38, fhdlOut);
            filePutString ("AAG_Bremsl_durch_ECD/TRLR01;776\n", 32, fhdlOut);
            filePutString ("AAG_Bremslicht_H_def;777\n", 25, fhdlOut);
            filePutString ("AAG_Bremslicht_H_def/Anhaenger_01;777\n", 38, fhdlOut);
            filePutString ("AAG_Bremslicht_H_def/TRLR01;777\n", 32, fhdlOut);
            filePutString ("AAG_NSL_aktiv;778\n", 18, fhdlOut);
            filePutString ("AAG_NSL_aktiv/Anhaenger_01;778\n", 31, fhdlOut);
            filePutString ("AAG_NSL_aktiv/TRLR01;778\n", 25, fhdlOut);
            filePutString ("AAG_Schlusslicht_HL_def;779\n", 28, fhdlOut);
            filePutString ("AAG_Schlusslicht_HL_def/Anhaenger_01;779\n", 41, fhdlOut);
            filePutString ("AAG_Schlusslicht_HL_def/TRLR01;779\n", 35, fhdlOut);
            filePutString ("AAG_Schlusslicht_HR_def;780\n", 28, fhdlOut);
            filePutString ("AAG_Schlusslicht_HR_def/Anhaenger_01;780\n", 41, fhdlOut);
            filePutString ("AAG_Schlusslicht_HR_def/TRLR01;780\n", 35, fhdlOut);
            filePutString ("BCM1_AFS_Lampe;1024\n", 20, fhdlOut);
            filePutString ("BCM1_AFS_Lampe/BCM_01;1024\n", 27, fhdlOut);
            filePutString ("BCM1_AFS_Lampe/BCM01;1024\n", 26, fhdlOut);
            filePutString ("BCM1_Kl_15_HW_erkannt;1025\n", 27, fhdlOut);
            filePutString ("BCM1_Kl_15_HW_erkannt/BCM_01;1025\n", 34, fhdlOut);
            filePutString ("BCM1_Kl_15_HW_erkannt/BCM01;1025\n", 33, fhdlOut);
            filePutString ("BCM1_Licht_Warn;1026\n", 21, fhdlOut);
            filePutString ("BCM1_Licht_Warn/BCM_01;1026\n", 28, fhdlOut);
            filePutString ("BCM1_Licht_Warn/BCM01;1026\n", 27, fhdlOut);
            filePutString ("BCM1_Lichtwarn_Texte;1027\n", 26, fhdlOut);
            filePutString ("BCM1_Lichtwarn_Texte/BCM_01;1027\n", 33, fhdlOut);
            filePutString ("BCM1_Lichtwarn_Texte/BCM01;1027\n", 32, fhdlOut);
            filePutString ("BCM1_MH_Schalter;1028\n", 22, fhdlOut);
            filePutString ("BCM1_MH_Schalter/BCM_01;1028\n", 29, fhdlOut);
            filePutString ("BCM1_MH_Schalter/BCM01;1028\n", 28, fhdlOut);
            filePutString ("BCM1_MH_WIV_Schalter;1029\n", 26, fhdlOut);
            filePutString ("BCM1_MH_WIV_Schalter/BCM_01;1029\n", 33, fhdlOut);
            filePutString ("BCM1_MH_WIV_Schalter/BCM01;1029\n", 32, fhdlOut);
            filePutString ("BCM1_NV_Taster;1030\n", 20, fhdlOut);
            filePutString ("BCM1_NV_Taster/BCM_01;1030\n", 27, fhdlOut);
            filePutString ("BCM1_NV_Taster/BCM01;1030\n", 26, fhdlOut);
            filePutString ("BCM1_Reisemodus_Texte;1031\n", 27, fhdlOut);
            filePutString ("BCM1_Reisemodus_Texte/BCM_01;1031\n", 34, fhdlOut);
            filePutString ("BCM1_Reisemodus_Texte/BCM01;1031\n", 33, fhdlOut);
            filePutString ("BCM1_Rueckfahrlicht_Schalter;1032\n", 34, fhdlOut);
            filePutString ("BCM1_Rueckfahrlicht_Schalter/BCM_01;1032\n", 41, fhdlOut);
            filePutString ("BCM1_Rueckfahrlicht_Schalter/BCM01;1032\n", 40, fhdlOut);
            filePutString ("BCM1_Valet_Parking_Taster;1033\n", 31, fhdlOut);
            filePutString ("BCM1_Valet_Parking_Taster/BCM_01;1033\n", 38, fhdlOut);
            filePutString ("BCM1_Valet_Parking_Taster/BCM01;1033\n", 37, fhdlOut);
            filePutString ("BCM1_Warnblink_Taster;1034\n", 27, fhdlOut);
            filePutString ("BCM1_Warnblink_Taster/BCM_01;1034\n", 34, fhdlOut);
            filePutString ("BCM1_Warnblink_Taster/BCM01;1034\n", 33, fhdlOut);
            filePutString ("BCM_Bremsbelag_Sensor;1035\n", 27, fhdlOut);
            filePutString ("BCM_Bremsbelag_Sensor/BCM_01;1035\n", 34, fhdlOut);
            filePutString ("BCM_Bremsbelag_Sensor/BCM01;1035\n", 33, fhdlOut);
            filePutString ("BCM_Bremsfluessigkeit_Sensor;1036\n", 34, fhdlOut);
            filePutString ("BCM_Bremsfluessigkeit_Sensor/BCM_01;1036\n", 41, fhdlOut);
            filePutString ("BCM_Bremsfluessigkeit_Sensor/BCM01;1036\n", 40, fhdlOut);
            filePutString ("BCM_Eco_Charisma_Taste;1037\n", 28, fhdlOut);
            filePutString ("BCM_Eco_Charisma_Taste/BCM_01;1037\n", 35, fhdlOut);
            filePutString ("BCM_Eco_Charisma_Taste/BCM01;1037\n", 34, fhdlOut);
            filePutString ("BCM_Hybrid_StartStopp_Taste;1038\n", 33, fhdlOut);
            filePutString ("BCM_Hybrid_StartStopp_Taste/BCM_01;1038\n", 40, fhdlOut);
            filePutString ("BCM_Hybrid_StartStopp_Taste/BCM01;1038\n", 39, fhdlOut);
            filePutString ("BCM_Kuehlmittel_Sensor;1039\n", 28, fhdlOut);
            filePutString ("BCM_Kuehlmittel_Sensor/BCM_01;1039\n", 35, fhdlOut);
            filePutString ("BCM_Kuehlmittel_Sensor/BCM01;1039\n", 34, fhdlOut);
            filePutString ("BCM_Waschwasser_Sensor;1040\n", 28, fhdlOut);
            filePutString ("BCM_Waschwasser_Sensor/BCM_01;1040\n", 35, fhdlOut);
            filePutString ("BCM_Waschwasser_Sensor/BCM01;1040\n", 34, fhdlOut);
            filePutString ("Gong_TFL_Umschaltung;1041\n", 26, fhdlOut);
            filePutString ("Gong_TFL_Umschaltung/BCM_01;1041\n", 33, fhdlOut);
            filePutString ("Gong_TFL_Umschaltung/BCM01;1041\n", 32, fhdlOut);
            filePutString ("UGDO_Function;1042\n", 19, fhdlOut);
            filePutString ("UGDO_Function/BCM_01;1042\n", 26, fhdlOut);
            filePutString ("UGDO_Function/BCM01;1042\n", 25, fhdlOut);
            filePutString ("BEM_01_Abschaltstufen;1280\n", 27, fhdlOut);
            filePutString ("BEM_01_Abschaltstufen/BEM_05;1280\n", 34, fhdlOut);
            filePutString ("BEM_01_Abschaltstufen/BEM05;1280\n", 33, fhdlOut);
            filePutString ("BEM_Anf_KL;1281\n", 16, fhdlOut);
            filePutString ("BEM_Anf_KL/BEM_05;1281\n", 23, fhdlOut);
            filePutString ("BEM_Anf_KL/BEM05;1281\n", 22, fhdlOut);
            filePutString ("BEM_Batt_Ab;1282\n", 17, fhdlOut);
            filePutString ("BEM_Batt_Ab/BEM_05;1282\n", 24, fhdlOut);
            filePutString ("BEM_Batt_Ab/BEM05;1282\n", 23, fhdlOut);
            filePutString ("BEM_DFM;1283\n", 13, fhdlOut);
            filePutString ("BEM_DFM/BEM_05;1283\n", 20, fhdlOut);
            filePutString ("BEM_DFM/BEM05;1283\n", 19, fhdlOut);
            filePutString ("BEM_EMLIN_ungueltig;1284\n", 25, fhdlOut);
            filePutString ("BEM_EMLIN_ungueltig/BEM_05;1284\n", 32, fhdlOut);
            filePutString ("BEM_EMLIN_ungueltig/BEM05;1284\n", 31, fhdlOut);
            filePutString ("BEM_HYB_DC_uMinLV;1285\n", 23, fhdlOut);
            filePutString ("BEM_HYB_DC_uMinLV/BEM_05;1285\n", 30, fhdlOut);
            filePutString ("BEM_HYB_DC_uMinLV/BEM05;1285\n", 29, fhdlOut);
            filePutString ("BEM_HYB_DC_uSollLV;1286\n", 24, fhdlOut);
            filePutString ("BEM_HYB_DC_uSollLV/BEM_05;1286\n", 31, fhdlOut);
            filePutString ("BEM_HYB_DC_uSollLV/BEM05;1286\n", 30, fhdlOut);
            filePutString ("BEM_Hybrid_Info;1287\n", 21, fhdlOut);
            filePutString ("BEM_Hybrid_Info/BEM_05;1287\n", 28, fhdlOut);
            filePutString ("BEM_Hybrid_Info/BEM05;1287\n", 27, fhdlOut);
            filePutString ("BEM_NV_NachladAnf;1288\n", 23, fhdlOut);
            filePutString ("BEM_NV_NachladAnf/BEM_05;1288\n", 30, fhdlOut);
            filePutString ("BEM_NV_NachladAnf/BEM05;1288\n", 29, fhdlOut);
            filePutString ("BEM_P_Generator;1289\n", 21, fhdlOut);
            filePutString ("BEM_P_Generator/BEM_05;1289\n", 28, fhdlOut);
            filePutString ("BEM_P_Generator/BEM05;1289\n", 27, fhdlOut);
            filePutString ("BEM_Segel_Info;1290\n", 20, fhdlOut);
            filePutString ("BEM_Segel_Info/BEM_05;1290\n", 27, fhdlOut);
            filePutString ("BEM_Segel_Info/BEM05;1290\n", 26, fhdlOut);
            filePutString ("BEM_StartStopp_Info;1291\n", 25, fhdlOut);
            filePutString ("BEM_StartStopp_Info/BEM_05;1291\n", 32, fhdlOut);
            filePutString ("BEM_StartStopp_Info/BEM05;1291\n", 31, fhdlOut);
            filePutString ("BEM_n_LLA;1292\n", 15, fhdlOut);
            filePutString ("BEM_n_LLA/BEM_05;1292\n", 22, fhdlOut);
            filePutString ("BEM_n_LLA/BEM05;1292\n", 21, fhdlOut);
            filePutString ("NVEM_DC_LangsRegelung_Anf;1293\n", 31, fhdlOut);
            filePutString ("NVEM_DC_LangsRegelung_Anf/BEM_05;1293\n", 38, fhdlOut);
            filePutString ("NVEM_DC_LangsRegelung_Anf/BEM05;1293\n", 37, fhdlOut);
            filePutString ("Bremse_EV_01_BZ;1536\n", 21, fhdlOut);
            filePutString ("Bremse_EV_01_BZ/Bremse_EV_01;1536\n", 34, fhdlOut);
            filePutString ("Bremse_EV_01_BZ/BRKEV01;1536\n", 29, fhdlOut);
            filePutString ("Bremse_EV_01_CRC;1537\n", 22, fhdlOut);
            filePutString ("Bremse_EV_01_CRC/Bremse_EV_01;1537\n", 35, fhdlOut);
            filePutString ("Bremse_EV_01_CRC/BRKEV01;1537\n", 30, fhdlOut);
            filePutString ("EBKV_Bremspedalweg;1538\n", 24, fhdlOut);
            filePutString ("EBKV_Bremspedalweg/Bremse_EV_01;1538\n", 37, fhdlOut);
            filePutString ("EBKV_Bremspedalweg/BRKEV01;1538\n", 32, fhdlOut);
            filePutString ("EBKV_Fahrer_bremst;1539\n", 24, fhdlOut);
            filePutString ("EBKV_Fahrer_bremst/Bremse_EV_01;1539\n", 37, fhdlOut);
            filePutString ("EBKV_Fahrer_bremst/BRKEV01;1539\n", 32, fhdlOut);
            filePutString ("EBKV_Generatorsollmoment;1540\n", 30, fhdlOut);
            filePutString ("EBKV_Generatorsollmoment/Bremse_EV_01;1540\n", 43, fhdlOut);
            filePutString ("EBKV_Generatorsollmoment/BRKEV01;1540\n", 38, fhdlOut);
            filePutString ("EBKV_M_Brems_ASM_soll;1541\n", 27, fhdlOut);
            filePutString ("EBKV_M_Brems_ASM_soll/Bremse_EV_01;1541\n", 40, fhdlOut);
            filePutString ("EBKV_M_Brems_ASM_soll/BRKEV01;1541\n", 35, fhdlOut);
            filePutString ("EBKV_QBit_Fahrer_bremst;1542\n", 29, fhdlOut);
            filePutString ("EBKV_QBit_Fahrer_bremst/Bremse_EV_01;1542\n", 42, fhdlOut);
            filePutString ("EBKV_QBit_Fahrer_bremst/BRKEV01;1542\n", 37, fhdlOut);
            filePutString ("EBKV_Status;1543\n", 17, fhdlOut);
            filePutString ("EBKV_Status/Bremse_EV_01;1543\n", 30, fhdlOut);
            filePutString ("EBKV_Status/BRKEV01;1543\n", 25, fhdlOut);
            filePutString ("EBKV_BKL_Warnungen;1792\n", 24, fhdlOut);
            filePutString ("EBKV_BKL_Warnungen/Bremse_EV_02;1792\n", 37, fhdlOut);
            filePutString ("EBKV_BKL_Warnungen/BRKEV02;1792\n", 32, fhdlOut);
            filePutString ("EBKV_Hinweise;1793\n", 19, fhdlOut);
            filePutString ("EBKV_Hinweise/Bremse_EV_02;1793\n", 32, fhdlOut);
            filePutString ("EBKV_Hinweise/BRKEV02;1793\n", 27, fhdlOut);
            filePutString ("EBKV_OBD_Status;1794\n", 21, fhdlOut);
            filePutString ("EBKV_OBD_Status/Bremse_EV_02;1794\n", 34, fhdlOut);
            filePutString ("EBKV_OBD_Status/BRKEV02;1794\n", 29, fhdlOut);
            filePutString ("EBKV_Warnungen;1795\n", 20, fhdlOut);
            filePutString ("EBKV_Warnungen/Bremse_EV_02;1795\n", 33, fhdlOut);
            filePutString ("EBKV_Warnungen/BRKEV02;1795\n", 28, fhdlOut);
            filePutString ("CU1RSP_IO1;2048\n", 16, fhdlOut);
            filePutString ("CU1RSP_IO1/CAN_Umsetzer_Resp_01;2048\n", 37, fhdlOut);
            filePutString ("CU1RSP_IO1/CU1RSP;2048\n", 23, fhdlOut);
            filePutString ("CU1RSP_IO1_KS_GND_Fehler;2049\n", 30, fhdlOut);
            filePutString ("CU1RSP_IO1_KS_GND_Fehler/CAN_Umsetzer_Resp_01;2049\n", 51, fhdlOut);
            filePutString ("CU1RSP_IO1_KS_GND_Fehler/CU1RSP;2049\n", 37, fhdlOut);
            filePutString ("CU1RSP_IO1_KS_UBat_Fehler;2050\n", 31, fhdlOut);
            filePutString ("CU1RSP_IO1_KS_UBat_Fehler/CAN_Umsetzer_Resp_01;2050\n", 52, fhdlOut);
            filePutString ("CU1RSP_IO1_KS_UBat_Fehler/CU1RSP;2050\n", 38, fhdlOut);
            filePutString ("CU1RSP_IO1_QBit;2051\n", 21, fhdlOut);
            filePutString ("CU1RSP_IO1_QBit/CAN_Umsetzer_Resp_01;2051\n", 42, fhdlOut);
            filePutString ("CU1RSP_IO1_QBit/CU1RSP;2051\n", 28, fhdlOut);
            filePutString ("CU1RSP_IO1_Taste_Fehler;2052\n", 29, fhdlOut);
            filePutString ("CU1RSP_IO1_Taste_Fehler/CAN_Umsetzer_Resp_01;2052\n", 50, fhdlOut);
            filePutString ("CU1RSP_IO1_Taste_Fehler/CU1RSP;2052\n", 36, fhdlOut);
            filePutString ("CU1RSP_IO1_analog_Eing;2053\n", 28, fhdlOut);
            filePutString ("CU1RSP_IO1_analog_Eing/CAN_Umsetzer_Resp_01;2053\n", 49, fhdlOut);
            filePutString ("CU1RSP_IO1_analog_Eing/CU1RSP;2053\n", 35, fhdlOut);
            filePutString ("CU1RSP_IO1_digital_Eing;2054\n", 29, fhdlOut);
            filePutString ("CU1RSP_IO1_digital_Eing/CAN_Umsetzer_Resp_01;2054\n", 50, fhdlOut);
            filePutString ("CU1RSP_IO1_digital_Eing/CU1RSP;2054\n", 36, fhdlOut);
            filePutString ("CU1RSP_IO1_digital_analog;2055\n", 31, fhdlOut);
            filePutString ("CU1RSP_IO1_digital_analog/CAN_Umsetzer_Resp_01;2055\n", 52, fhdlOut);
            filePutString ("CU1RSP_IO1_digital_analog/CU1RSP;2055\n", 38, fhdlOut);
            filePutString ("CU1RSP_IO2;2056\n", 16, fhdlOut);
            filePutString ("CU1RSP_IO2/CAN_Umsetzer_Resp_01;2056\n", 37, fhdlOut);
            filePutString ("CU1RSP_IO2/CU1RSP;2056\n", 23, fhdlOut);
            filePutString ("CU1RSP_IO2_KS_Fehler;2057\n", 26, fhdlOut);
            filePutString ("CU1RSP_IO2_KS_Fehler/CAN_Umsetzer_Resp_01;2057\n", 47, fhdlOut);
            filePutString ("CU1RSP_IO2_KS_Fehler/CU1RSP;2057\n", 33, fhdlOut);
            filePutString ("CU1RSP_IO2_KS_UBat_Fehler;2058\n", 31, fhdlOut);
            filePutString ("CU1RSP_IO2_KS_UBat_Fehler/CAN_Umsetzer_Resp_01;2058\n", 52, fhdlOut);
            filePutString ("CU1RSP_IO2_KS_UBat_Fehler/CU1RSP;2058\n", 38, fhdlOut);
            filePutString ("CU1RSP_IO2_OpenLoad;2059\n", 25, fhdlOut);
            filePutString ("CU1RSP_IO2_OpenLoad/CAN_Umsetzer_Resp_01;2059\n", 46, fhdlOut);
            filePutString ("CU1RSP_IO2_OpenLoad/CU1RSP;2059\n", 32, fhdlOut);
            filePutString ("CU1RSP_IO2_QBit;2060\n", 21, fhdlOut);
            filePutString ("CU1RSP_IO2_QBit/CAN_Umsetzer_Resp_01;2060\n", 42, fhdlOut);
            filePutString ("CU1RSP_IO2_QBit/CU1RSP;2060\n", 28, fhdlOut);
            filePutString ("CU1RSP_IO2_digital_Eing;2061\n", 29, fhdlOut);
            filePutString ("CU1RSP_IO2_digital_Eing/CAN_Umsetzer_Resp_01;2061\n", 50, fhdlOut);
            filePutString ("CU1RSP_IO2_digital_Eing/CU1RSP;2061\n", 36, fhdlOut);
            filePutString ("CU1RSP_IO3;2062\n", 16, fhdlOut);
            filePutString ("CU1RSP_IO3/CAN_Umsetzer_Resp_01;2062\n", 37, fhdlOut);
            filePutString ("CU1RSP_IO3/CU1RSP;2062\n", 23, fhdlOut);
            filePutString ("CU1RSP_IO3_KS_Fehler;2063\n", 26, fhdlOut);
            filePutString ("CU1RSP_IO3_KS_Fehler/CAN_Umsetzer_Resp_01;2063\n", 47, fhdlOut);
            filePutString ("CU1RSP_IO3_KS_Fehler/CU1RSP;2063\n", 33, fhdlOut);
            filePutString ("CU1RSP_IO3_KS_UBat_Fehler;2064\n", 31, fhdlOut);
            filePutString ("CU1RSP_IO3_KS_UBat_Fehler/CAN_Umsetzer_Resp_01;2064\n", 52, fhdlOut);
            filePutString ("CU1RSP_IO3_KS_UBat_Fehler/CU1RSP;2064\n", 38, fhdlOut);
            filePutString ("CU1RSP_IO3_OpenLoad;2065\n", 25, fhdlOut);
            filePutString ("CU1RSP_IO3_OpenLoad/CAN_Umsetzer_Resp_01;2065\n", 46, fhdlOut);
            filePutString ("CU1RSP_IO3_OpenLoad/CU1RSP;2065\n", 32, fhdlOut);
            filePutString ("CU1RSP_IO3_QBit;2066\n", 21, fhdlOut);
            filePutString ("CU1RSP_IO3_QBit/CAN_Umsetzer_Resp_01;2066\n", 42, fhdlOut);
            filePutString ("CU1RSP_IO3_QBit/CU1RSP;2066\n", 28, fhdlOut);
            filePutString ("CU1RSP_IO3_digital_Eing;2067\n", 29, fhdlOut);
            filePutString ("CU1RSP_IO3_digital_Eing/CAN_Umsetzer_Resp_01;2067\n", 50, fhdlOut);
            filePutString ("CU1RSP_IO3_digital_Eing/CU1RSP;2067\n", 36, fhdlOut);
            filePutString ("CU1RSP_Timeout_Fehler;2068\n", 27, fhdlOut);
            filePutString ("CU1RSP_Timeout_Fehler/CAN_Umsetzer_Resp_01;2068\n", 48, fhdlOut);
            filePutString ("CU1RSP_Timeout_Fehler/CU1RSP;2068\n", 34, fhdlOut);
            filePutString ("CHA_Fahrer_Umschaltung;2304\n", 28, fhdlOut);
            filePutString ("CHA_Fahrer_Umschaltung/Charisma_01;2304\n", 40, fhdlOut);
            filePutString ("CHA_Fahrer_Umschaltung/CHRSM01;2304\n", 36, fhdlOut);
            filePutString ("CHA_Ziel_FahrPr_ACC;2305\n", 25, fhdlOut);
            filePutString ("CHA_Ziel_FahrPr_ACC/Charisma_01;2305\n", 37, fhdlOut);
            filePutString ("CHA_Ziel_FahrPr_ACC/CHRSM01;2305\n", 33, fhdlOut);
            filePutString ("CHA_Ziel_FahrPr_AFS;2306\n", 25, fhdlOut);
            filePutString ("CHA_Ziel_FahrPr_AFS/Charisma_01;2306\n", 37, fhdlOut);
            filePutString ("CHA_Ziel_FahrPr_AFS/CHRSM01;2306\n", 33, fhdlOut);
            filePutString ("CHA_Ziel_FahrPr_AGA;2307\n", 25, fhdlOut);
            filePutString ("CHA_Ziel_FahrPr_AGA/Charisma_01;2307\n", 37, fhdlOut);
            filePutString ("CHA_Ziel_FahrPr_AGA/CHRSM01;2307\n", 33, fhdlOut);
            filePutString ("CHA_Ziel_FahrPr_DR;2308\n", 24, fhdlOut);
            filePutString ("CHA_Ziel_FahrPr_DR/Charisma_01;2308\n", 36, fhdlOut);
            filePutString ("CHA_Ziel_FahrPr_DR/CHRSM01;2308\n", 32, fhdlOut);
            filePutString ("CHA_Ziel_FahrPr_EPS;2309\n", 25, fhdlOut);
            filePutString ("CHA_Ziel_FahrPr_EPS/Charisma_01;2309\n", 37, fhdlOut);
            filePutString ("CHA_Ziel_FahrPr_EPS/CHRSM01;2309\n", 33, fhdlOut);
            filePutString ("CHA_Ziel_FahrPr_ESP;2310\n", 25, fhdlOut);
            filePutString ("CHA_Ziel_FahrPr_ESP/Charisma_01;2310\n", 37, fhdlOut);
            filePutString ("CHA_Ziel_FahrPr_ESP/CHRSM01;2310\n", 33, fhdlOut);
            filePutString ("CHA_Ziel_FahrPr_Freilauf;2311\n", 30, fhdlOut);
            filePutString ("CHA_Ziel_FahrPr_Freilauf/Charisma_01;2311\n", 42, fhdlOut);
            filePutString ("CHA_Ziel_FahrPr_Freilauf/CHRSM01;2311\n", 38, fhdlOut);
            filePutString ("CHA_Ziel_FahrPr_GE;2312\n", 24, fhdlOut);
            filePutString ("CHA_Ziel_FahrPr_GE/Charisma_01;2312\n", 36, fhdlOut);
            filePutString ("CHA_Ziel_FahrPr_GE/CHRSM01;2312\n", 32, fhdlOut);
            filePutString ("CHA_Ziel_FahrPr_MO;2313\n", 24, fhdlOut);
            filePutString ("CHA_Ziel_FahrPr_MO/Charisma_01;2313\n", 36, fhdlOut);
            filePutString ("CHA_Ziel_FahrPr_MO/CHRSM01;2313\n", 32, fhdlOut);
            filePutString ("CHA_Ziel_FahrPr_MO_StSt;2314\n", 29, fhdlOut);
            filePutString ("CHA_Ziel_FahrPr_MO_StSt/Charisma_01;2314\n", 41, fhdlOut);
            filePutString ("CHA_Ziel_FahrPr_MO_StSt/CHRSM01;2314\n", 37, fhdlOut);
            filePutString ("CHA_Ziel_FahrPr_QS;2315\n", 24, fhdlOut);
            filePutString ("CHA_Ziel_FahrPr_QS/Charisma_01;2315\n", 36, fhdlOut);
            filePutString ("CHA_Ziel_FahrPr_QS/CHRSM01;2315\n", 32, fhdlOut);
            filePutString ("CHA_Ziel_FahrPr_RGS;2316\n", 25, fhdlOut);
            filePutString ("CHA_Ziel_FahrPr_RGS/Charisma_01;2316\n", 37, fhdlOut);
            filePutString ("CHA_Ziel_FahrPr_RGS/CHRSM01;2316\n", 33, fhdlOut);
            filePutString ("CHA_Ziel_FahrPr_SAK;2317\n", 25, fhdlOut);
            filePutString ("CHA_Ziel_FahrPr_SAK/Charisma_01;2317\n", 37, fhdlOut);
            filePutString ("CHA_Ziel_FahrPr_SAK/CHRSM01;2317\n", 33, fhdlOut);
            filePutString ("CHA_Ziel_FahrPr_SCU;2318\n", 25, fhdlOut);
            filePutString ("CHA_Ziel_FahrPr_SCU/Charisma_01;2318\n", 37, fhdlOut);
            filePutString ("CHA_Ziel_FahrPr_SCU/CHRSM01;2318\n", 33, fhdlOut);
            filePutString ("CHA_Ziel_FahrPr_ST;2319\n", 24, fhdlOut);
            filePutString ("CHA_Ziel_FahrPr_ST/Charisma_01;2319\n", 36, fhdlOut);
            filePutString ("CHA_Ziel_FahrPr_ST/CHRSM01;2319\n", 32, fhdlOut);
            filePutString ("DGN_Verlernzaehler;2560\n", 24, fhdlOut);
            filePutString ("DGN_Verlernzaehler/Diagnose_01;2560\n", 36, fhdlOut);
            filePutString ("DGN_Verlernzaehler/DIA01;2560\n", 30, fhdlOut);
            filePutString ("KBI_Kilometerstand;2561\n", 24, fhdlOut);
            filePutString ("KBI_Kilometerstand/Diagnose_01;2561\n", 36, fhdlOut);
            filePutString ("KBI_Kilometerstand/DIA01;2561\n", 30, fhdlOut);
            filePutString ("Kombi_02_alt;2562\n", 18, fhdlOut);
            filePutString ("Kombi_02_alt/Diagnose_01;2562\n", 30, fhdlOut);
            filePutString ("Kombi_02_alt/DIA01;2562\n", 24, fhdlOut);
            filePutString ("UH_Jahr;2563\n", 13, fhdlOut);
            filePutString ("UH_Jahr/Diagnose_01;2563\n", 25, fhdlOut);
            filePutString ("UH_Jahr/DIA01;2563\n", 19, fhdlOut);
            filePutString ("UH_Minute;2564\n", 15, fhdlOut);
            filePutString ("UH_Minute/Diagnose_01;2564\n", 27, fhdlOut);
            filePutString ("UH_Minute/DIA01;2564\n", 21, fhdlOut);
            filePutString ("UH_Monat;2565\n", 14, fhdlOut);
            filePutString ("UH_Monat/Diagnose_01;2565\n", 26, fhdlOut);
            filePutString ("UH_Monat/DIA01;2565\n", 20, fhdlOut);
            filePutString ("UH_Sekunde;2566\n", 16, fhdlOut);
            filePutString ("UH_Sekunde/Diagnose_01;2566\n", 28, fhdlOut);
            filePutString ("UH_Sekunde/DIA01;2566\n", 22, fhdlOut);
            filePutString ("UH_Stunde;2567\n", 15, fhdlOut);
            filePutString ("UH_Stunde/Diagnose_01;2567\n", 27, fhdlOut);
            filePutString ("UH_Stunde/DIA01;2567\n", 21, fhdlOut);
            filePutString ("UH_Tag;2568\n", 12, fhdlOut);
            filePutString ("UH_Tag/Diagnose_01;2568\n", 24, fhdlOut);
            filePutString ("UH_Tag/DIA01;2568\n", 18, fhdlOut);
            filePutString ("Uhrzeit_01_alt;2569\n", 20, fhdlOut);
            filePutString ("Uhrzeit_01_alt/Diagnose_01;2569\n", 32, fhdlOut);
            filePutString ("Uhrzeit_01_alt/DIA01;2569\n", 26, fhdlOut);
            filePutString ("EPB_01_BZ;2816\n", 15, fhdlOut);
            filePutString ("EPB_01_BZ/EPB_01;2816\n", 22, fhdlOut);
            filePutString ("EPB_01_BZ/EPB01;2816\n", 21, fhdlOut);
            filePutString ("EPB_01_CRC;2817\n", 16, fhdlOut);
            filePutString ("EPB_01_CRC/EPB_01;2817\n", 23, fhdlOut);
            filePutString ("EPB_01_CRC/EPB01;2817\n", 22, fhdlOut);
            filePutString ("EPB_Anfahrwunsch_erkannt;2818\n", 30, fhdlOut);
            filePutString ("EPB_Anfahrwunsch_erkannt/EPB_01;2818\n", 37, fhdlOut);
            filePutString ("EPB_Anfahrwunsch_erkannt/EPB01;2818\n", 36, fhdlOut);
            filePutString ("EPB_BCM2_Motor_Wakeup;2819\n", 27, fhdlOut);
            filePutString ("EPB_BCM2_Motor_Wakeup/EPB_01;2819\n", 34, fhdlOut);
            filePutString ("EPB_BCM2_Motor_Wakeup/EPB01;2819\n", 33, fhdlOut);
            filePutString ("EPB_DAA_Randbed_erf;2820\n", 25, fhdlOut);
            filePutString ("EPB_DAA_Randbed_erf/EPB_01;2820\n", 32, fhdlOut);
            filePutString ("EPB_DAA_Randbed_erf/EPB01;2820\n", 31, fhdlOut);
            filePutString ("EPB_Fehlerstatus;2821\n", 22, fhdlOut);
            filePutString ("EPB_Fehlerstatus/EPB_01;2821\n", 29, fhdlOut);
            filePutString ("EPB_Fehlerstatus/EPB01;2821\n", 28, fhdlOut);
            filePutString ("EPB_Freig_Verzoeg_Anf;2822\n", 27, fhdlOut);
            filePutString ("EPB_Freig_Verzoeg_Anf/EPB_01;2822\n", 34, fhdlOut);
            filePutString ("EPB_Freig_Verzoeg_Anf/EPB01;2822\n", 33, fhdlOut);
            filePutString ("EPB_Konsistenz_ACC;2823\n", 24, fhdlOut);
            filePutString ("EPB_Konsistenz_ACC/EPB_01;2823\n", 31, fhdlOut);
            filePutString ("EPB_Konsistenz_ACC/EPB01;2823\n", 30, fhdlOut);
            filePutString ("EPB_Laengsbeschleunigung;2824\n", 30, fhdlOut);
            filePutString ("EPB_Laengsbeschleunigung/EPB_01;2824\n", 37, fhdlOut);
            filePutString ("EPB_Laengsbeschleunigung/EPB01;2824\n", 36, fhdlOut);
            filePutString ("EPB_Pedalweg_Kuppl;2825\n", 24, fhdlOut);
            filePutString ("EPB_Pedalweg_Kuppl/EPB_01;2825\n", 31, fhdlOut);
            filePutString ("EPB_Pedalweg_Kuppl/EPB01;2825\n", 30, fhdlOut);
            filePutString ("EPB_QBit_Laengsbeschleunigung;2826\n", 35, fhdlOut);
            filePutString ("EPB_QBit_Laengsbeschleunigung/EPB_01;2826\n", 42, fhdlOut);
            filePutString ("EPB_QBit_Laengsbeschleunigung/EPB01;2826\n", 41, fhdlOut);
            filePutString ("EPB_QBit_Pedalweg_Kuppl;2827\n", 29, fhdlOut);
            filePutString ("EPB_QBit_Pedalweg_Kuppl/EPB_01;2827\n", 36, fhdlOut);
            filePutString ("EPB_QBit_Pedalweg_Kuppl/EPB01;2827\n", 35, fhdlOut);
            filePutString ("EPB_QBit_Schalterpos;2828\n", 26, fhdlOut);
            filePutString ("EPB_QBit_Schalterpos/EPB_01;2828\n", 33, fhdlOut);
            filePutString ("EPB_QBit_Schalterpos/EPB01;2828\n", 32, fhdlOut);
            filePutString ("EPB_Schalterposition;2829\n", 26, fhdlOut);
            filePutString ("EPB_Schalterposition/EPB_01;2829\n", 33, fhdlOut);
            filePutString ("EPB_Schalterposition/EPB01;2829\n", 32, fhdlOut);
            filePutString ("EPB_Spannkraft;2830\n", 20, fhdlOut);
            filePutString ("EPB_Spannkraft/EPB_01;2830\n", 27, fhdlOut);
            filePutString ("EPB_Spannkraft/EPB01;2830\n", 26, fhdlOut);
            filePutString ("EPB_Status;2831\n", 16, fhdlOut);
            filePutString ("EPB_Status/EPB_01;2831\n", 23, fhdlOut);
            filePutString ("EPB_Status/EPB01;2831\n", 22, fhdlOut);
            filePutString ("EPB_Verzoeg_Anf;2832\n", 21, fhdlOut);
            filePutString ("EPB_Verzoeg_Anf/EPB_01;2832\n", 28, fhdlOut);
            filePutString ("EPB_Verzoeg_Anf/EPB01;2832\n", 27, fhdlOut);
            filePutString ("ESP_02_BZ;3072\n", 15, fhdlOut);
            filePutString ("ESP_02_BZ/ESP_02;3072\n", 22, fhdlOut);
            filePutString ("ESP_02_BZ/ESP02;3072\n", 21, fhdlOut);
            filePutString ("ESP_02_CRC;3073\n", 16, fhdlOut);
            filePutString ("ESP_02_CRC/ESP_02;3073\n", 23, fhdlOut);
            filePutString ("ESP_02_CRC/ESP02;3073\n", 22, fhdlOut);
            filePutString ("ESP_Gierrate;3074\n", 18, fhdlOut);
            filePutString ("ESP_Gierrate/ESP_02;3074\n", 25, fhdlOut);
            filePutString ("ESP_Gierrate/ESP02;3074\n", 24, fhdlOut);
            filePutString ("ESP_Laengsbeschl;3075\n", 22, fhdlOut);
            filePutString ("ESP_Laengsbeschl/ESP_02;3075\n", 29, fhdlOut);
            filePutString ("ESP_Laengsbeschl/ESP02;3075\n", 28, fhdlOut);
            filePutString ("ESP_Notbremsanzeige;3076\n", 25, fhdlOut);
            filePutString ("ESP_Notbremsanzeige/ESP_02;3076\n", 32, fhdlOut);
            filePutString ("ESP_Notbremsanzeige/ESP02;3076\n", 31, fhdlOut);
            filePutString ("ESP_PLA_Abbruch;3077\n", 21, fhdlOut);
            filePutString ("ESP_PLA_Abbruch/ESP_02;3077\n", 28, fhdlOut);
            filePutString ("ESP_PLA_Abbruch/ESP02;3077\n", 27, fhdlOut);
            filePutString ("ESP_QBit_Anf_Vert_Wank;3078\n", 28, fhdlOut);
            filePutString ("ESP_QBit_Anf_Vert_Wank/ESP_02;3078\n", 35, fhdlOut);
            filePutString ("ESP_QBit_Anf_Vert_Wank/ESP02;3078\n", 34, fhdlOut);
            filePutString ("ESP_QBit_Gierrate;3079\n", 23, fhdlOut);
            filePutString ("ESP_QBit_Gierrate/ESP_02;3079\n", 30, fhdlOut);
            filePutString ("ESP_QBit_Gierrate/ESP02;3079\n", 29, fhdlOut);
            filePutString ("ESP_QBit_Laengsbeschl;3080\n", 27, fhdlOut);
            filePutString ("ESP_QBit_Laengsbeschl/ESP_02;3080\n", 34, fhdlOut);
            filePutString ("ESP_QBit_Laengsbeschl/ESP02;3080\n", 33, fhdlOut);
            filePutString ("ESP_QBit_Querb;3081\n", 20, fhdlOut);
            filePutString ("ESP_QBit_Querb/ESP_02;3081\n", 27, fhdlOut);
            filePutString ("ESP_QBit_Querb/ESP02;3081\n", 26, fhdlOut);
            filePutString ("ESP_Querbeschleunigung;3082\n", 28, fhdlOut);
            filePutString ("ESP_Querbeschleunigung/ESP_02;3082\n", 35, fhdlOut);
            filePutString ("ESP_Querbeschleunigung/ESP02;3082\n", 34, fhdlOut);
            filePutString ("ESP_SpannungsAnf;3083\n", 22, fhdlOut);
            filePutString ("ESP_SpannungsAnf/ESP_02;3083\n", 29, fhdlOut);
            filePutString ("ESP_SpannungsAnf/ESP02;3083\n", 28, fhdlOut);
            filePutString ("ESP_Status_ESP_PLA;3084\n", 24, fhdlOut);
            filePutString ("ESP_Status_ESP_PLA/ESP_02;3084\n", 31, fhdlOut);
            filePutString ("ESP_Status_ESP_PLA/ESP02;3084\n", 30, fhdlOut);
            filePutString ("ESP_Stillstandsflag;3085\n", 25, fhdlOut);
            filePutString ("ESP_Stillstandsflag/ESP_02;3085\n", 32, fhdlOut);
            filePutString ("ESP_Stillstandsflag/ESP02;3085\n", 31, fhdlOut);
            filePutString ("ESP_VZ_Gierrate;3086\n", 21, fhdlOut);
            filePutString ("ESP_VZ_Gierrate/ESP_02;3086\n", 28, fhdlOut);
            filePutString ("ESP_VZ_Gierrate/ESP02;3086\n", 27, fhdlOut);
            filePutString ("ESP_Verteil_Wankmom;3087\n", 25, fhdlOut);
            filePutString ("ESP_Verteil_Wankmom/ESP_02;3087\n", 32, fhdlOut);
            filePutString ("ESP_Verteil_Wankmom/ESP02;3087\n", 31, fhdlOut);
            filePutString ("ECD_Bremslicht;3328\n", 20, fhdlOut);
            filePutString ("ECD_Bremslicht/ESP_05;3328\n", 27, fhdlOut);
            filePutString ("ECD_Bremslicht/ESP05;3328\n", 26, fhdlOut);
            filePutString ("ECD_Fehler;3329\n", 16, fhdlOut);
            filePutString ("ECD_Fehler/ESP_05;3329\n", 23, fhdlOut);
            filePutString ("ECD_Fehler/ESP05;3329\n", 22, fhdlOut);
            filePutString ("ECD_nicht_verfuegbar;3330\n", 26, fhdlOut);
            filePutString ("ECD_nicht_verfuegbar/ESP_05;3330\n", 33, fhdlOut);
            filePutString ("ECD_nicht_verfuegbar/ESP05;3330\n", 32, fhdlOut);
            filePutString ("ESP_05_BZ;3331\n", 15, fhdlOut);
            filePutString ("ESP_05_BZ/ESP_05;3331\n", 22, fhdlOut);
            filePutString ("ESP_05_BZ/ESP05;3331\n", 21, fhdlOut);
            filePutString ("ESP_05_CRC;3332\n", 16, fhdlOut);
            filePutString ("ESP_05_CRC/ESP_05;3332\n", 23, fhdlOut);
            filePutString ("ESP_05_CRC/ESP05;3332\n", 22, fhdlOut);
            filePutString ("ESP_Anforderung_EPB;3333\n", 25, fhdlOut);
            filePutString ("ESP_Anforderung_EPB/ESP_05;3333\n", 32, fhdlOut);
            filePutString ("ESP_Anforderung_EPB/ESP05;3333\n", 31, fhdlOut);
            filePutString ("ESP_Autohold_Standby;3334\n", 26, fhdlOut);
            filePutString ("ESP_Autohold_Standby/ESP_05;3334\n", 33, fhdlOut);
            filePutString ("ESP_Autohold_Standby/ESP05;3334\n", 32, fhdlOut);
            filePutString ("ESP_Autohold_aktiv;3335\n", 24, fhdlOut);
            filePutString ("ESP_Autohold_aktiv/ESP_05;3335\n", 31, fhdlOut);
            filePutString ("ESP_Autohold_aktiv/ESP05;3335\n", 30, fhdlOut);
            filePutString ("ESP_BKV_Unterdruck;3336\n", 24, fhdlOut);
            filePutString ("ESP_BKV_Unterdruck/ESP_05;3336\n", 31, fhdlOut);
            filePutString ("ESP_BKV_Unterdruck/ESP05;3336\n", 30, fhdlOut);
            filePutString ("ESP_Bremsdruck;3337\n", 20, fhdlOut);
            filePutString ("ESP_Bremsdruck/ESP_05;3337\n", 27, fhdlOut);
            filePutString ("ESP_Bremsdruck/ESP05;3337\n", 26, fhdlOut);
            filePutString ("ESP_Bremsruck_AWV2;3338\n", 24, fhdlOut);
            filePutString ("ESP_Bremsruck_AWV2/ESP_05;3338\n", 31, fhdlOut);
            filePutString ("ESP_Bremsruck_AWV2/ESP05;3338\n", 30, fhdlOut);
            filePutString ("ESP_Eingr_HL;3339\n", 18, fhdlOut);
            filePutString ("ESP_Eingr_HL/ESP_05;3339\n", 25, fhdlOut);
            filePutString ("ESP_Eingr_HL/ESP05;3339\n", 24, fhdlOut);
            filePutString ("ESP_Eingr_HR;3340\n", 18, fhdlOut);
            filePutString ("ESP_Eingr_HR/ESP_05;3340\n", 25, fhdlOut);
            filePutString ("ESP_Eingr_HR/ESP05;3340\n", 24, fhdlOut);
            filePutString ("ESP_Eingr_VL;3341\n", 18, fhdlOut);
            filePutString ("ESP_Eingr_VL/ESP_05;3341\n", 25, fhdlOut);
            filePutString ("ESP_Eingr_VL/ESP05;3341\n", 24, fhdlOut);
            filePutString ("ESP_Eingr_VR;3342\n", 18, fhdlOut);
            filePutString ("ESP_Eingr_VR/ESP_05;3342\n", 25, fhdlOut);
            filePutString ("ESP_Eingr_VR/ESP05;3342\n", 24, fhdlOut);
            filePutString ("ESP_FStatus_Anfahrhilfe;3343\n", 29, fhdlOut);
            filePutString ("ESP_FStatus_Anfahrhilfe/ESP_05;3343\n", 36, fhdlOut);
            filePutString ("ESP_FStatus_Anfahrhilfe/ESP05;3343\n", 35, fhdlOut);
            filePutString ("ESP_Fahrer_bremst;3344\n", 23, fhdlOut);
            filePutString ("ESP_Fahrer_bremst/ESP_05;3344\n", 30, fhdlOut);
            filePutString ("ESP_Fahrer_bremst/ESP05;3344\n", 29, fhdlOut);
            filePutString ("ESP_HBA_aktiv;3345\n", 19, fhdlOut);
            filePutString ("ESP_HBA_aktiv/ESP_05;3345\n", 26, fhdlOut);
            filePutString ("ESP_HBA_aktiv/ESP05;3345\n", 25, fhdlOut);
            filePutString ("ESP_HDC_Standby;3346\n", 21, fhdlOut);
            filePutString ("ESP_HDC_Standby/ESP_05;3346\n", 28, fhdlOut);
            filePutString ("ESP_HDC_Standby/ESP05;3346\n", 27, fhdlOut);
            filePutString ("ESP_HDC_aktiv;3347\n", 19, fhdlOut);
            filePutString ("ESP_HDC_aktiv/ESP_05;3347\n", 26, fhdlOut);
            filePutString ("ESP_HDC_aktiv/ESP05;3347\n", 25, fhdlOut);
            filePutString ("ESP_Konsistenz_AWV2;3348\n", 25, fhdlOut);
            filePutString ("ESP_Konsistenz_AWV2/ESP_05;3348\n", 32, fhdlOut);
            filePutString ("ESP_Konsistenz_AWV2/ESP05;3348\n", 31, fhdlOut);
            filePutString ("ESP_Konsistenz_TSK;3349\n", 24, fhdlOut);
            filePutString ("ESP_Konsistenz_TSK/ESP_05;3349\n", 31, fhdlOut);
            filePutString ("ESP_Konsistenz_TSK/ESP05;3349\n", 30, fhdlOut);
            filePutString ("ESP_Lenkeingriff_ADS;3350\n", 26, fhdlOut);
            filePutString ("ESP_Lenkeingriff_ADS/ESP_05;3350\n", 33, fhdlOut);
            filePutString ("ESP_Lenkeingriff_ADS/ESP05;3350\n", 32, fhdlOut);
            filePutString ("ESP_Prefill_ausgeloest;3351\n", 28, fhdlOut);
            filePutString ("ESP_Prefill_ausgeloest/ESP_05;3351\n", 35, fhdlOut);
            filePutString ("ESP_Prefill_ausgeloest/ESP05;3351\n", 34, fhdlOut);
            filePutString ("ESP_QBit_Bremsdruck;3352\n", 25, fhdlOut);
            filePutString ("ESP_QBit_Bremsdruck/ESP_05;3352\n", 32, fhdlOut);
            filePutString ("ESP_QBit_Bremsdruck/ESP05;3352\n", 31, fhdlOut);
            filePutString ("ESP_QBit_Fahrer_bremst;3353\n", 28, fhdlOut);
            filePutString ("ESP_QBit_Fahrer_bremst/ESP_05;3353\n", 35, fhdlOut);
            filePutString ("ESP_QBit_Fahrer_bremst/ESP05;3353\n", 34, fhdlOut);
            filePutString ("ESP_Rueckwaertsfahrt_erkannt;3354\n", 34, fhdlOut);
            filePutString ("ESP_Rueckwaertsfahrt_erkannt/ESP_05;3354\n", 41, fhdlOut);
            filePutString ("ESP_Rueckwaertsfahrt_erkannt/ESP05;3354\n", 40, fhdlOut);
            filePutString ("ESP_Schwelle_Unterdruck;3355\n", 29, fhdlOut);
            filePutString ("ESP_Schwelle_Unterdruck/ESP_05;3355\n", 36, fhdlOut);
            filePutString ("ESP_Schwelle_Unterdruck/ESP05;3355\n", 35, fhdlOut);
            filePutString ("ESP_StartStopp_Info;3356\n", 25, fhdlOut);
            filePutString ("ESP_StartStopp_Info/ESP_05;3356\n", 32, fhdlOut);
            filePutString ("ESP_StartStopp_Info/ESP05;3356\n", 31, fhdlOut);
            filePutString ("ESP_Status_Anfahrhilfe;3357\n", 28, fhdlOut);
            filePutString ("ESP_Status_Anfahrhilfe/ESP_05;3357\n", 35, fhdlOut);
            filePutString ("ESP_Status_Anfahrhilfe/ESP05;3357\n", 34, fhdlOut);
            filePutString ("ESP_Status_Bremsdruck;3358\n", 27, fhdlOut);
            filePutString ("ESP_Status_Bremsdruck/ESP_05;3358\n", 34, fhdlOut);
            filePutString ("ESP_Status_Bremsdruck/ESP05;3358\n", 33, fhdlOut);
            filePutString ("ESP_Status_Bremsentemp;3359\n", 28, fhdlOut);
            filePutString ("ESP_Status_Bremsentemp/ESP_05;3359\n", 35, fhdlOut);
            filePutString ("ESP_Status_Bremsentemp/ESP05;3359\n", 34, fhdlOut);
            filePutString ("ESP_Verz_EPB_aktiv;3360\n", 24, fhdlOut);
            filePutString ("ESP_Verz_EPB_aktiv/ESP_05;3360\n", 31, fhdlOut);
            filePutString ("ESP_Verz_EPB_aktiv/ESP05;3360\n", 30, fhdlOut);
            filePutString ("ESP_Verz_TSK_aktiv;3361\n", 24, fhdlOut);
            filePutString ("ESP_Verz_TSK_aktiv/ESP_05;3361\n", 31, fhdlOut);
            filePutString ("ESP_Verz_TSK_aktiv/ESP05;3361\n", 30, fhdlOut);
            filePutString ("ESP_Verzoeg_EPB_verf;3362\n", 26, fhdlOut);
            filePutString ("ESP_Verzoeg_EPB_verf/ESP_05;3362\n", 33, fhdlOut);
            filePutString ("ESP_Verzoeg_EPB_verf/ESP05;3362\n", 32, fhdlOut);
            filePutString ("ESP_07_BZ;3584\n", 15, fhdlOut);
            filePutString ("ESP_07_BZ/ESP_07;3584\n", 22, fhdlOut);
            filePutString ("ESP_07_BZ/ESP07;3584\n", 21, fhdlOut);
            filePutString ("ESP_07_CRC;3585\n", 16, fhdlOut);
            filePutString ("ESP_07_CRC/ESP_07;3585\n", 23, fhdlOut);
            filePutString ("ESP_07_CRC/ESP07;3585\n", 22, fhdlOut);
            filePutString ("ESP_ACC_LDE;3586\n", 17, fhdlOut);
            filePutString ("ESP_ACC_LDE/ESP_07;3586\n", 24, fhdlOut);
            filePutString ("ESP_ACC_LDE/ESP07;3586\n", 23, fhdlOut);
            filePutString ("ESP_CM_Variante;3587\n", 21, fhdlOut);
            filePutString ("ESP_CM_Variante/ESP_07;3587\n", 28, fhdlOut);
            filePutString ("ESP_CM_Variante/ESP07;3587\n", 27, fhdlOut);
            filePutString ("ESP_Codierung_ADS;3588\n", 23, fhdlOut);
            filePutString ("ESP_Codierung_ADS/ESP_07;3588\n", 30, fhdlOut);
            filePutString ("ESP_Codierung_ADS/ESP07;3588\n", 29, fhdlOut);
            filePutString ("ESP_MKB_ausloesbar;3589\n", 24, fhdlOut);
            filePutString ("ESP_MKB_ausloesbar/ESP_07;3589\n", 31, fhdlOut);
            filePutString ("ESP_MKB_ausloesbar/ESP07;3589\n", 30, fhdlOut);
            filePutString ("ESP_OBD_Status;3590\n", 20, fhdlOut);
            filePutString ("ESP_OBD_Status/ESP_07;3590\n", 27, fhdlOut);
            filePutString ("ESP_OBD_Status/ESP07;3590\n", 26, fhdlOut);
            filePutString ("ESP_Offroad_Modus;3591\n", 23, fhdlOut);
            filePutString ("ESP_Offroad_Modus/ESP_07;3591\n", 30, fhdlOut);
            filePutString ("ESP_Offroad_Modus/ESP07;3591\n", 29, fhdlOut);
            filePutString ("ESP_Qualifizierung_Antriebsart;3592\n", 36, fhdlOut);
            filePutString ("ESP_Qualifizierung_Antriebsart/ESP_07;3592\n", 43, fhdlOut);
            filePutString ("ESP_Qualifizierung_Antriebsart/ESP07;3592\n", 42, fhdlOut);
            filePutString ("ESP_Quattro_Antrieb;3593\n", 25, fhdlOut);
            filePutString ("ESP_Quattro_Antrieb/ESP_07;3593\n", 32, fhdlOut);
            filePutString ("ESP_Quattro_Antrieb/ESP07;3593\n", 31, fhdlOut);
            filePutString ("ESP_RTA_HL;3594\n", 16, fhdlOut);
            filePutString ("ESP_RTA_HL/ESP_07;3594\n", 23, fhdlOut);
            filePutString ("ESP_RTA_HL/ESP07;3594\n", 22, fhdlOut);
            filePutString ("ESP_RTA_HR;3595\n", 16, fhdlOut);
            filePutString ("ESP_RTA_HR/ESP_07;3595\n", 23, fhdlOut);
            filePutString ("ESP_RTA_HR/ESP07;3595\n", 22, fhdlOut);
            filePutString ("ESP_RTA_VR;3596\n", 16, fhdlOut);
            filePutString ("ESP_RTA_VR/ESP_07;3596\n", 23, fhdlOut);
            filePutString ("ESP_RTA_VR/ESP07;3596\n", 22, fhdlOut);
            filePutString ("ESP_Rollenmodus_Deaktivieren;3597\n", 34, fhdlOut);
            filePutString ("ESP_Rollenmodus_Deaktivieren/ESP_07;3597\n", 41, fhdlOut);
            filePutString ("ESP_Rollenmodus_Deaktivieren/ESP07;3597\n", 40, fhdlOut);
            filePutString ("ESP_Stat_FallBack_eBKV;3598\n", 28, fhdlOut);
            filePutString ("ESP_Stat_FallBack_eBKV/ESP_07;3598\n", 35, fhdlOut);
            filePutString ("ESP_Stat_FallBack_eBKV/ESP07;3598\n", 34, fhdlOut);
            filePutString ("ESP_nachtr_Stopp_Anf;3599\n", 26, fhdlOut);
            filePutString ("ESP_nachtr_Stopp_Anf/ESP_07;3599\n", 33, fhdlOut);
            filePutString ("ESP_nachtr_Stopp_Anf/ESP07;3599\n", 32, fhdlOut);
            filePutString ("OBD_Fehler_Radsensor_HL;3600\n", 29, fhdlOut);
            filePutString ("OBD_Fehler_Radsensor_HL/ESP_07;3600\n", 36, fhdlOut);
            filePutString ("OBD_Fehler_Radsensor_HL/ESP07;3600\n", 35, fhdlOut);
            filePutString ("OBD_Fehler_Radsensor_HR;3601\n", 29, fhdlOut);
            filePutString ("OBD_Fehler_Radsensor_HR/ESP_07;3601\n", 36, fhdlOut);
            filePutString ("OBD_Fehler_Radsensor_HR/ESP07;3601\n", 35, fhdlOut);
            filePutString ("OBD_Fehler_Radsensor_VL;3602\n", 29, fhdlOut);
            filePutString ("OBD_Fehler_Radsensor_VL/ESP_07;3602\n", 36, fhdlOut);
            filePutString ("OBD_Fehler_Radsensor_VL/ESP07;3602\n", 35, fhdlOut);
            filePutString ("OBD_Fehler_Radsensor_VR;3603\n", 29, fhdlOut);
            filePutString ("OBD_Fehler_Radsensor_VR/ESP_07;3603\n", 36, fhdlOut);
            filePutString ("OBD_Fehler_Radsensor_VR/ESP07;3603\n", 35, fhdlOut);
            filePutString ("ESP_10_BZ;3840\n", 15, fhdlOut);
            filePutString ("ESP_10_BZ/ESP_10;3840\n", 22, fhdlOut);
            filePutString ("ESP_10_BZ/ESPK10;3840\n", 22, fhdlOut);
            filePutString ("ESP_10_CRC;3841\n", 16, fhdlOut);
            filePutString ("ESP_10_CRC/ESP_10;3841\n", 23, fhdlOut);
            filePutString ("ESP_10_CRC/ESPK10;3841\n", 23, fhdlOut);
            filePutString ("ESP_HL_Fahrtrichtung;3842\n", 26, fhdlOut);
            filePutString ("ESP_HL_Fahrtrichtung/ESP_10;3842\n", 33, fhdlOut);
            filePutString ("ESP_HL_Fahrtrichtung/ESPK10;3842\n", 33, fhdlOut);
            filePutString ("ESP_HR_Fahrtrichtung;3843\n", 26, fhdlOut);
            filePutString ("ESP_HR_Fahrtrichtung/ESP_10;3843\n", 33, fhdlOut);
            filePutString ("ESP_HR_Fahrtrichtung/ESPK10;3843\n", 33, fhdlOut);
            filePutString ("ESP_QBit_Wegimpuls_HL;3844\n", 27, fhdlOut);
            filePutString ("ESP_QBit_Wegimpuls_HL/ESP_10;3844\n", 34, fhdlOut);
            filePutString ("ESP_QBit_Wegimpuls_HL/ESPK10;3844\n", 34, fhdlOut);
            filePutString ("ESP_QBit_Wegimpuls_HR;3845\n", 27, fhdlOut);
            filePutString ("ESP_QBit_Wegimpuls_HR/ESP_10;3845\n", 34, fhdlOut);
            filePutString ("ESP_QBit_Wegimpuls_HR/ESPK10;3845\n", 34, fhdlOut);
            filePutString ("ESP_QBit_Wegimpuls_VL;3846\n", 27, fhdlOut);
            filePutString ("ESP_QBit_Wegimpuls_VL/ESP_10;3846\n", 34, fhdlOut);
            filePutString ("ESP_QBit_Wegimpuls_VL/ESPK10;3846\n", 34, fhdlOut);
            filePutString ("ESP_QBit_Wegimpuls_VR;3847\n", 27, fhdlOut);
            filePutString ("ESP_QBit_Wegimpuls_VR/ESP_10;3847\n", 34, fhdlOut);
            filePutString ("ESP_QBit_Wegimpuls_VR/ESPK10;3847\n", 34, fhdlOut);
            filePutString ("ESP_VL_Fahrtrichtung;3848\n", 26, fhdlOut);
            filePutString ("ESP_VL_Fahrtrichtung/ESP_10;3848\n", 33, fhdlOut);
            filePutString ("ESP_VL_Fahrtrichtung/ESPK10;3848\n", 33, fhdlOut);
            filePutString ("ESP_VR_Fahrtrichtung;3849\n", 26, fhdlOut);
            filePutString ("ESP_VR_Fahrtrichtung/ESP_10;3849\n", 33, fhdlOut);
            filePutString ("ESP_VR_Fahrtrichtung/ESPK10;3849\n", 33, fhdlOut);
            filePutString ("ESP_Wegimpuls_HL;3850\n", 22, fhdlOut);
            filePutString ("ESP_Wegimpuls_HL/ESP_10;3850\n", 29, fhdlOut);
            filePutString ("ESP_Wegimpuls_HL/ESPK10;3850\n", 29, fhdlOut);
            filePutString ("ESP_Wegimpuls_HR;3851\n", 22, fhdlOut);
            filePutString ("ESP_Wegimpuls_HR/ESP_10;3851\n", 29, fhdlOut);
            filePutString ("ESP_Wegimpuls_HR/ESPK10;3851\n", 29, fhdlOut);
            filePutString ("ESP_Wegimpuls_VL;3852\n", 22, fhdlOut);
            filePutString ("ESP_Wegimpuls_VL/ESP_10;3852\n", 29, fhdlOut);
            filePutString ("ESP_Wegimpuls_VL/ESPK10;3852\n", 29, fhdlOut);
            filePutString ("ESP_Wegimpuls_VR;3853\n", 22, fhdlOut);
            filePutString ("ESP_Wegimpuls_VR/ESP_10;3853\n", 29, fhdlOut);
            filePutString ("ESP_Wegimpuls_VR/ESPK10;3853\n", 29, fhdlOut);
            filePutString ("ESP_HL_Radgeschw_02;4096\n", 25, fhdlOut);
            filePutString ("ESP_HL_Radgeschw_02/ESP_19;4096\n", 32, fhdlOut);
            filePutString ("ESP_HL_Radgeschw_02/ESP19;4096\n", 31, fhdlOut);
            filePutString ("ESP_HR_Radgeschw_02;4097\n", 25, fhdlOut);
            filePutString ("ESP_HR_Radgeschw_02/ESP_19;4097\n", 32, fhdlOut);
            filePutString ("ESP_HR_Radgeschw_02/ESP19;4097\n", 31, fhdlOut);
            filePutString ("ESP_VL_Radgeschw_02;4098\n", 25, fhdlOut);
            filePutString ("ESP_VL_Radgeschw_02/ESP_19;4098\n", 32, fhdlOut);
            filePutString ("ESP_VL_Radgeschw_02/ESP19;4098\n", 31, fhdlOut);
            filePutString ("ESP_VR_Radgeschw_02;4099\n", 25, fhdlOut);
            filePutString ("ESP_VR_Radgeschw_02/ESP_19;4099\n", 32, fhdlOut);
            filePutString ("ESP_VR_Radgeschw_02/ESP19;4099\n", 31, fhdlOut);
            filePutString ("BR_QBit_Reifenumfang;4352\n", 26, fhdlOut);
            filePutString ("BR_QBit_Reifenumfang/ESP_20;4352\n", 33, fhdlOut);
            filePutString ("BR_QBit_Reifenumfang/ESP20;4352\n", 32, fhdlOut);
            filePutString ("BR_Reifenumfang;4353\n", 21, fhdlOut);
            filePutString ("BR_Reifenumfang/ESP_20;4353\n", 28, fhdlOut);
            filePutString ("BR_Reifenumfang/ESP20;4353\n", 27, fhdlOut);
            filePutString ("BR_Systemart;4354\n", 18, fhdlOut);
            filePutString ("BR_Systemart/ESP_20;4354\n", 25, fhdlOut);
            filePutString ("BR_Systemart/ESP20;4354\n", 24, fhdlOut);
            filePutString ("ESP_20_BZ;4355\n", 15, fhdlOut);
            filePutString ("ESP_20_BZ/ESP_20;4355\n", 22, fhdlOut);
            filePutString ("ESP_20_BZ/ESP20;4355\n", 21, fhdlOut);
            filePutString ("ESP_20_CRC;4356\n", 16, fhdlOut);
            filePutString ("ESP_20_CRC/ESP_20;4356\n", 23, fhdlOut);
            filePutString ("ESP_20_CRC/ESP20;4356\n", 22, fhdlOut);
            filePutString ("ESP_Charisma_FahrPr;4357\n", 25, fhdlOut);
            filePutString ("ESP_Charisma_FahrPr/ESP_20;4357\n", 32, fhdlOut);
            filePutString ("ESP_Charisma_FahrPr/ESP20;4357\n", 31, fhdlOut);
            filePutString ("ESP_Charisma_Status;4358\n", 25, fhdlOut);
            filePutString ("ESP_Charisma_Status/ESP_20;4358\n", 32, fhdlOut);
            filePutString ("ESP_Charisma_Status/ESP20;4358\n", 31, fhdlOut);
            filePutString ("ESP_Dachrelingsensor;4359\n", 26, fhdlOut);
            filePutString ("ESP_Dachrelingsensor/ESP_20;4359\n", 33, fhdlOut);
            filePutString ("ESP_Dachrelingsensor/ESP20;4359\n", 32, fhdlOut);
            filePutString ("ESP_Stoppverbot_Anz_01;4360\n", 28, fhdlOut);
            filePutString ("ESP_Stoppverbot_Anz_01/ESP_20;4360\n", 35, fhdlOut);
            filePutString ("ESP_Stoppverbot_Anz_01/ESP20;4360\n", 34, fhdlOut);
            filePutString ("ESP_Stoppverbot_Anz_02;4361\n", 28, fhdlOut);
            filePutString ("ESP_Stoppverbot_Anz_02/ESP_20;4361\n", 35, fhdlOut);
            filePutString ("ESP_Stoppverbot_Anz_02/ESP20;4361\n", 34, fhdlOut);
            filePutString ("ESP_Stoppverbot_Anz_03;4362\n", 28, fhdlOut);
            filePutString ("ESP_Stoppverbot_Anz_03/ESP_20;4362\n", 35, fhdlOut);
            filePutString ("ESP_Stoppverbot_Anz_03/ESP20;4362\n", 34, fhdlOut);
            filePutString ("ESP_Stoppverbot_Anz_04;4363\n", 28, fhdlOut);
            filePutString ("ESP_Stoppverbot_Anz_04/ESP_20;4363\n", 35, fhdlOut);
            filePutString ("ESP_Stoppverbot_Anz_04/ESP20;4363\n", 34, fhdlOut);
            filePutString ("ESP_Stoppverbot_Anz_05;4364\n", 28, fhdlOut);
            filePutString ("ESP_Stoppverbot_Anz_05/ESP_20;4364\n", 35, fhdlOut);
            filePutString ("ESP_Stoppverbot_Anz_05/ESP20;4364\n", 34, fhdlOut);
            filePutString ("ESP_Stoppverbot_Anz_06;4365\n", 28, fhdlOut);
            filePutString ("ESP_Stoppverbot_Anz_06/ESP_20;4365\n", 35, fhdlOut);
            filePutString ("ESP_Stoppverbot_Anz_06/ESP20;4365\n", 34, fhdlOut);
            filePutString ("ESP_Stoppverbot_Anz_07;4366\n", 28, fhdlOut);
            filePutString ("ESP_Stoppverbot_Anz_07/ESP_20;4366\n", 35, fhdlOut);
            filePutString ("ESP_Stoppverbot_Anz_07/ESP20;4366\n", 34, fhdlOut);
            filePutString ("ESP_Stoppverbot_Anz_Std;4367\n", 29, fhdlOut);
            filePutString ("ESP_Stoppverbot_Anz_Std/ESP_20;4367\n", 36, fhdlOut);
            filePutString ("ESP_Stoppverbot_Anz_Std/ESP20;4367\n", 35, fhdlOut);
            filePutString ("ESP_Wiederstart_Anz_01;4368\n", 28, fhdlOut);
            filePutString ("ESP_Wiederstart_Anz_01/ESP_20;4368\n", 35, fhdlOut);
            filePutString ("ESP_Wiederstart_Anz_01/ESP20;4368\n", 34, fhdlOut);
            filePutString ("ESP_Wiederstart_Anz_02;4369\n", 28, fhdlOut);
            filePutString ("ESP_Wiederstart_Anz_02/ESP_20;4369\n", 35, fhdlOut);
            filePutString ("ESP_Wiederstart_Anz_02/ESP20;4369\n", 34, fhdlOut);
            filePutString ("ESP_Wiederstart_Anz_03;4370\n", 28, fhdlOut);
            filePutString ("ESP_Wiederstart_Anz_03/ESP_20;4370\n", 35, fhdlOut);
            filePutString ("ESP_Wiederstart_Anz_03/ESP20;4370\n", 34, fhdlOut);
            filePutString ("ESP_Wiederstart_Anz_Std;4371\n", 29, fhdlOut);
            filePutString ("ESP_Wiederstart_Anz_Std/ESP_20;4371\n", 36, fhdlOut);
            filePutString ("ESP_Wiederstart_Anz_Std/ESP20;4371\n", 35, fhdlOut);
            filePutString ("ESP_Zaehnezahl;4372\n", 20, fhdlOut);
            filePutString ("ESP_Zaehnezahl/ESP_20;4372\n", 27, fhdlOut);
            filePutString ("ESP_Zaehnezahl/ESP20;4372\n", 26, fhdlOut);
            filePutString ("ABS_Bremsung;4608\n", 18, fhdlOut);
            filePutString ("ABS_Bremsung/ESP_21;4608\n", 25, fhdlOut);
            filePutString ("ABS_Bremsung/ESP21;4608\n", 24, fhdlOut);
            filePutString ("ASR_Anf;4609\n", 13, fhdlOut);
            filePutString ("ASR_Anf/ESP_21;4609\n", 20, fhdlOut);
            filePutString ("ASR_Anf/ESP21;4609\n", 19, fhdlOut);
            filePutString ("ASR_Schalteingriff;4610\n", 24, fhdlOut);
            filePutString ("ASR_Schalteingriff/ESP_21;4610\n", 31, fhdlOut);
            filePutString ("ASR_Schalteingriff/ESP21;4610\n", 30, fhdlOut);
            filePutString ("ASR_Tastung_passiv;4611\n", 24, fhdlOut);
            filePutString ("ASR_Tastung_passiv/ESP_21;4611\n", 31, fhdlOut);
            filePutString ("ASR_Tastung_passiv/ESP21;4611\n", 30, fhdlOut);
            filePutString ("BR_Eingriffsmoment;4612\n", 24, fhdlOut);
            filePutString ("BR_Eingriffsmoment/ESP_21;4612\n", 31, fhdlOut);
            filePutString ("BR_Eingriffsmoment/ESP21;4612\n", 30, fhdlOut);
            filePutString ("EBV_Eingriff;4613\n", 18, fhdlOut);
            filePutString ("EBV_Eingriff/ESP_21;4613\n", 25, fhdlOut);
            filePutString ("EBV_Eingriff/ESP21;4613\n", 24, fhdlOut);
            filePutString ("EDS_Eingriff;4614\n", 18, fhdlOut);
            filePutString ("EDS_Eingriff/ESP_21;4614\n", 25, fhdlOut);
            filePutString ("EDS_Eingriff/ESP21;4614\n", 24, fhdlOut);
            filePutString ("ESP_21_BZ;4615\n", 15, fhdlOut);
            filePutString ("ESP_21_BZ/ESP_21;4615\n", 22, fhdlOut);
            filePutString ("ESP_21_BZ/ESP21;4615\n", 21, fhdlOut);
            filePutString ("ESP_21_CRC;4616\n", 16, fhdlOut);
            filePutString ("ESP_21_CRC/ESP_21;4616\n", 23, fhdlOut);
            filePutString ("ESP_21_CRC/ESP21;4616\n", 22, fhdlOut);
            filePutString ("ESP_ASP;4617\n", 13, fhdlOut);
            filePutString ("ESP_ASP/ESP_21;4617\n", 20, fhdlOut);
            filePutString ("ESP_ASP/ESP21;4617\n", 19, fhdlOut);
            filePutString ("ESP_AWV3_Brems_aktiv;4618\n", 26, fhdlOut);
            filePutString ("ESP_AWV3_Brems_aktiv/ESP_21;4618\n", 33, fhdlOut);
            filePutString ("ESP_AWV3_Brems_aktiv/ESP21;4618\n", 32, fhdlOut);
            filePutString ("ESP_Anhaltevorgang_ACC_aktiv;4619\n", 34, fhdlOut);
            filePutString ("ESP_Anhaltevorgang_ACC_aktiv/ESP_21;4619\n", 41, fhdlOut);
            filePutString ("ESP_Anhaltevorgang_ACC_aktiv/ESP21;4619\n", 40, fhdlOut);
            filePutString ("ESP_Diagnose;4620\n", 18, fhdlOut);
            filePutString ("ESP_Diagnose/ESP_21;4620\n", 25, fhdlOut);
            filePutString ("ESP_Diagnose/ESP21;4620\n", 24, fhdlOut);
            filePutString ("ESP_Eingriff;4621\n", 18, fhdlOut);
            filePutString ("ESP_Eingriff/ESP_21;4621\n", 25, fhdlOut);
            filePutString ("ESP_Eingriff/ESP21;4621\n", 24, fhdlOut);
            filePutString ("ESP_Haltebestaetigung;4622\n", 27, fhdlOut);
            filePutString ("ESP_Haltebestaetigung/ESP_21;4622\n", 34, fhdlOut);
            filePutString ("ESP_Haltebestaetigung/ESP21;4622\n", 33, fhdlOut);
            filePutString ("ESP_MKB_Abbruch_Geschw;4623\n", 28, fhdlOut);
            filePutString ("ESP_MKB_Abbruch_Geschw/ESP_21;4623\n", 35, fhdlOut);
            filePutString ("ESP_MKB_Abbruch_Geschw/ESP21;4623\n", 34, fhdlOut);
            filePutString ("ESP_PLA_Bremseingriff;4624\n", 27, fhdlOut);
            filePutString ("ESP_PLA_Bremseingriff/ESP_21;4624\n", 34, fhdlOut);
            filePutString ("ESP_PLA_Bremseingriff/ESP21;4624\n", 33, fhdlOut);
            filePutString ("ESP_QBit_v_Signal;4625\n", 23, fhdlOut);
            filePutString ("ESP_QBit_v_Signal/ESP_21;4625\n", 30, fhdlOut);
            filePutString ("ESP_QBit_v_Signal/ESP21;4625\n", 29, fhdlOut);
            filePutString ("ESP_Systemstatus;4626\n", 22, fhdlOut);
            filePutString ("ESP_Systemstatus/ESP_21;4626\n", 29, fhdlOut);
            filePutString ("ESP_Systemstatus/ESP21;4626\n", 28, fhdlOut);
            filePutString ("ESP_Tastung_passiv;4627\n", 24, fhdlOut);
            filePutString ("ESP_Tastung_passiv/ESP_21;4627\n", 31, fhdlOut);
            filePutString ("ESP_Tastung_passiv/ESP21;4627\n", 30, fhdlOut);
            filePutString ("ESP_v_Signal;4628\n", 18, fhdlOut);
            filePutString ("ESP_v_Signal/ESP_21;4628\n", 25, fhdlOut);
            filePutString ("ESP_v_Signal/ESP21;4628\n", 24, fhdlOut);
            filePutString ("MSR_Anf;4629\n", 13, fhdlOut);
            filePutString ("MSR_Anf/ESP_21;4629\n", 20, fhdlOut);
            filePutString ("MSR_Anf/ESP21;4629\n", 19, fhdlOut);
            filePutString ("OBD_QBit_Schlechtweg;4630\n", 26, fhdlOut);
            filePutString ("OBD_QBit_Schlechtweg/ESP_21;4630\n", 33, fhdlOut);
            filePutString ("OBD_QBit_Schlechtweg/ESP21;4630\n", 32, fhdlOut);
            filePutString ("OBD_Schlechtweg;4631\n", 21, fhdlOut);
            filePutString ("OBD_Schlechtweg/ESP_21;4631\n", 28, fhdlOut);
            filePutString ("OBD_Schlechtweg/ESP21;4631\n", 27, fhdlOut);
            filePutString ("KBI_Einheit_Datum;4864\n", 23, fhdlOut);
            filePutString ("KBI_Einheit_Datum/Einheiten_01;4864\n", 36, fhdlOut);
            filePutString ("KBI_Einheit_Datum/EINH01;4864\n", 30, fhdlOut);
            filePutString ("KBI_Einheit_Druck;4865\n", 23, fhdlOut);
            filePutString ("KBI_Einheit_Druck/Einheiten_01;4865\n", 36, fhdlOut);
            filePutString ("KBI_Einheit_Druck/EINH01;4865\n", 30, fhdlOut);
            filePutString ("KBI_Einheit_Sprache;4866\n", 25, fhdlOut);
            filePutString ("KBI_Einheit_Sprache/Einheiten_01;4866\n", 38, fhdlOut);
            filePutString ("KBI_Einheit_Sprache/EINH01;4866\n", 32, fhdlOut);
            filePutString ("KBI_Einheit_Streckenanz;4867\n", 29, fhdlOut);
            filePutString ("KBI_Einheit_Streckenanz/Einheiten_01;4867\n", 42, fhdlOut);
            filePutString ("KBI_Einheit_Streckenanz/EINH01;4867\n", 36, fhdlOut);
            filePutString ("KBI_Einheit_Temp;4868\n", 22, fhdlOut);
            filePutString ("KBI_Einheit_Temp/Einheiten_01;4868\n", 35, fhdlOut);
            filePutString ("KBI_Einheit_Temp/EINH01;4868\n", 29, fhdlOut);
            filePutString ("KBI_Einheit_Uhrzeit;4869\n", 25, fhdlOut);
            filePutString ("KBI_Einheit_Uhrzeit/Einheiten_01;4869\n", 38, fhdlOut);
            filePutString ("KBI_Einheit_Uhrzeit/EINH01;4869\n", 32, fhdlOut);
            filePutString ("KBI_Einheit_Verbrauch;4870\n", 27, fhdlOut);
            filePutString ("KBI_Einheit_Verbrauch/Einheiten_01;4870\n", 40, fhdlOut);
            filePutString ("KBI_Einheit_Verbrauch/EINH01;4870\n", 34, fhdlOut);
            filePutString ("KBI_Einheit_Volumen;4871\n", 25, fhdlOut);
            filePutString ("KBI_Einheit_Volumen/Einheiten_01;4871\n", 38, fhdlOut);
            filePutString ("KBI_Einheit_Volumen/EINH01;4871\n", 32, fhdlOut);
            filePutString ("KBI_MFA_v_Einheit_02;4872\n", 26, fhdlOut);
            filePutString ("KBI_MFA_v_Einheit_02/Einheiten_01;4872\n", 39, fhdlOut);
            filePutString ("KBI_MFA_v_Einheit_02/EINH01;4872\n", 33, fhdlOut);
            filePutString ("GRA_ACC_01_BZ;5120\n", 19, fhdlOut);
            filePutString ("GRA_ACC_01_BZ/GRA_ACC_01;5120\n", 30, fhdlOut);
            filePutString ("GRA_ACC_01_BZ/GRAACC01;5120\n", 28, fhdlOut);
            filePutString ("GRA_ACC_01_CRC;5121\n", 20, fhdlOut);
            filePutString ("GRA_ACC_01_CRC/GRA_ACC_01;5121\n", 31, fhdlOut);
            filePutString ("GRA_ACC_01_CRC/GRAACC01;5121\n", 29, fhdlOut);
            filePutString ("GRA_Abbrechen;5122\n", 19, fhdlOut);
            filePutString ("GRA_Abbrechen/GRA_ACC_01;5122\n", 30, fhdlOut);
            filePutString ("GRA_Abbrechen/GRAACC01;5122\n", 28, fhdlOut);
            filePutString ("GRA_Codierung;5123\n", 19, fhdlOut);
            filePutString ("GRA_Codierung/GRA_ACC_01;5123\n", 30, fhdlOut);
            filePutString ("GRA_Codierung/GRAACC01;5123\n", 28, fhdlOut);
            filePutString ("GRA_Fehler;5124\n", 16, fhdlOut);
            filePutString ("GRA_Fehler/GRA_ACC_01;5124\n", 27, fhdlOut);
            filePutString ("GRA_Fehler/GRAACC01;5124\n", 25, fhdlOut);
            filePutString ("GRA_Hauptschalter;5125\n", 23, fhdlOut);
            filePutString ("GRA_Hauptschalter/GRA_ACC_01;5125\n", 34, fhdlOut);
            filePutString ("GRA_Hauptschalter/GRAACC01;5125\n", 32, fhdlOut);
            filePutString ("GRA_LIM_Taste_verfuegbar;5126\n", 30, fhdlOut);
            filePutString ("GRA_LIM_Taste_verfuegbar/GRA_ACC_01;5126\n", 41, fhdlOut);
            filePutString ("GRA_LIM_Taste_verfuegbar/GRAACC01;5126\n", 39, fhdlOut);
            filePutString ("GRA_Limiter;5127\n", 17, fhdlOut);
            filePutString ("GRA_Limiter/GRA_ACC_01;5127\n", 28, fhdlOut);
            filePutString ("GRA_Limiter/GRAACC01;5127\n", 26, fhdlOut);
            filePutString ("GRA_Tip_Hoch;5128\n", 18, fhdlOut);
            filePutString ("GRA_Tip_Hoch/GRA_ACC_01;5128\n", 29, fhdlOut);
            filePutString ("GRA_Tip_Hoch/GRAACC01;5128\n", 27, fhdlOut);
            filePutString ("GRA_Tip_Runter;5129\n", 20, fhdlOut);
            filePutString ("GRA_Tip_Runter/GRA_ACC_01;5129\n", 31, fhdlOut);
            filePutString ("GRA_Tip_Runter/GRAACC01;5129\n", 29, fhdlOut);
            filePutString ("GRA_Tip_Setzen;5130\n", 20, fhdlOut);
            filePutString ("GRA_Tip_Setzen/GRA_ACC_01;5130\n", 31, fhdlOut);
            filePutString ("GRA_Tip_Setzen/GRAACC01;5130\n", 29, fhdlOut);
            filePutString ("GRA_Tip_Stufe_2;5131\n", 21, fhdlOut);
            filePutString ("GRA_Tip_Stufe_2/GRA_ACC_01;5131\n", 32, fhdlOut);
            filePutString ("GRA_Tip_Stufe_2/GRAACC01;5131\n", 30, fhdlOut);
            filePutString ("GRA_Tip_Wiederaufnahme;5132\n", 28, fhdlOut);
            filePutString ("GRA_Tip_Wiederaufnahme/GRA_ACC_01;5132\n", 39, fhdlOut);
            filePutString ("GRA_Tip_Wiederaufnahme/GRAACC01;5132\n", 37, fhdlOut);
            filePutString ("GRA_Typ_Bedienteil;5133\n", 24, fhdlOut);
            filePutString ("GRA_Typ_Bedienteil/GRA_ACC_01;5133\n", 35, fhdlOut);
            filePutString ("GRA_Typ_Bedienteil/GRAACC01;5133\n", 33, fhdlOut);
            filePutString ("GRA_Typ_Hauptschalter;5134\n", 27, fhdlOut);
            filePutString ("GRA_Typ_Hauptschalter/GRA_ACC_01;5134\n", 38, fhdlOut);
            filePutString ("GRA_Typ_Hauptschalter/GRAACC01;5134\n", 36, fhdlOut);
            filePutString ("GRA_Verstellung_Zeitluecke;5135\n", 32, fhdlOut);
            filePutString ("GRA_Verstellung_Zeitluecke/GRA_ACC_01;5135\n", 43, fhdlOut);
            filePutString ("GRA_Verstellung_Zeitluecke/GRAACC01;5135\n", 41, fhdlOut);
            filePutString ("GRA_reserveByte4;5136\n", 22, fhdlOut);
            filePutString ("GRA_reserveByte4/GRA_ACC_01;5136\n", 33, fhdlOut);
            filePutString ("GRA_reserveByte4/GRAACC01;5136\n", 31, fhdlOut);
            filePutString ("GRA_reserveByte5;5137\n", 22, fhdlOut);
            filePutString ("GRA_reserveByte5/GRA_ACC_01;5137\n", 33, fhdlOut);
            filePutString ("GRA_reserveByte5/GRAACC01;5137\n", 31, fhdlOut);
            filePutString ("GRA_reserveByte6;5138\n", 22, fhdlOut);
            filePutString ("GRA_reserveByte6/GRA_ACC_01;5138\n", 33, fhdlOut);
            filePutString ("GRA_reserveByte6/GRAACC01;5138\n", 31, fhdlOut);
            filePutString ("GRA_reserveByte7;5139\n", 22, fhdlOut);
            filePutString ("GRA_reserveByte7/GRA_ACC_01;5139\n", 33, fhdlOut);
            filePutString ("GRA_reserveByte7/GRAACC01;5139\n", 31, fhdlOut);
            filePutString ("GRA_reserveByte8;5140\n", 22, fhdlOut);
            filePutString ("GRA_reserveByte8/GRA_ACC_01;5140\n", 33, fhdlOut);
            filePutString ("GRA_reserveByte8/GRAACC01;5140\n", 31, fhdlOut);
            filePutString ("AAG_Anhaenger_erkannt;5376\n", 27, fhdlOut);
            filePutString ("AAG_Anhaenger_erkannt/Gateway_72;5376\n", 38, fhdlOut);
            filePutString ("AAG_Anhaenger_erkannt/GW72;5376\n", 32, fhdlOut);
            filePutString ("Anhaenger_01_alt;5377\n", 22, fhdlOut);
            filePutString ("Anhaenger_01_alt/Gateway_72;5377\n", 33, fhdlOut);
            filePutString ("Anhaenger_01_alt/GW72;5377\n", 27, fhdlOut);
            filePutString ("BCM1_Aussen_Temp_ungef;5378\n", 28, fhdlOut);
            filePutString ("BCM1_Aussen_Temp_ungef/Gateway_72;5378\n", 39, fhdlOut);
            filePutString ("BCM1_Aussen_Temp_ungef/GW72;5378\n", 33, fhdlOut);
            filePutString ("BCM1_MH_Schalter;5379\n", 22, fhdlOut);
            filePutString ("BCM1_MH_Schalter/Gateway_72;5379\n", 33, fhdlOut);
            filePutString ("BCM1_MH_Schalter/GW72;5379\n", 27, fhdlOut);
            filePutString ("BCM1_OBD_FStatus_ATemp;5380\n", 28, fhdlOut);
            filePutString ("BCM1_OBD_FStatus_ATemp/Gateway_72;5380\n", 39, fhdlOut);
            filePutString ("BCM1_OBD_FStatus_ATemp/GW72;5380\n", 33, fhdlOut);
            filePutString ("BCM1_Rueckfahrlicht_Schalter;5381\n", 34, fhdlOut);
            filePutString ("BCM1_Rueckfahrlicht_Schalter/Gateway_72;5381\n", 45, fhdlOut);
            filePutString ("BCM1_Rueckfahrlicht_Schalter/GW72;5381\n", 39, fhdlOut);
            filePutString ("BCM_01_alt;5382\n", 16, fhdlOut);
            filePutString ("BCM_01_alt/Gateway_72;5382\n", 27, fhdlOut);
            filePutString ("BCM_01_alt/GW72;5382\n", 21, fhdlOut);
            filePutString ("BCM_Rueckfahrlicht_Anf;5383\n", 28, fhdlOut);
            filePutString ("BCM_Rueckfahrlicht_Anf/Gateway_72;5383\n", 39, fhdlOut);
            filePutString ("BCM_Rueckfahrlicht_Anf/GW72;5383\n", 33, fhdlOut);
            filePutString ("BH_Blinker_li;5384\n", 19, fhdlOut);
            filePutString ("BH_Blinker_li/Gateway_72;5384\n", 30, fhdlOut);
            filePutString ("BH_Blinker_li/GW72;5384\n", 24, fhdlOut);
            filePutString ("BH_Blinker_re;5385\n", 19, fhdlOut);
            filePutString ("BH_Blinker_re/Gateway_72;5385\n", 30, fhdlOut);
            filePutString ("BH_Blinker_re/GW72;5385\n", 24, fhdlOut);
            filePutString ("BH_Fernlicht;5386\n", 18, fhdlOut);
            filePutString ("BH_Fernlicht/Gateway_72;5386\n", 29, fhdlOut);
            filePutString ("BH_Fernlicht/GW72;5386\n", 23, fhdlOut);
            filePutString ("KL_Thermomanagement;5387\n", 25, fhdlOut);
            filePutString ("KL_Thermomanagement/Gateway_72;5387\n", 36, fhdlOut);
            filePutString ("KL_Thermomanagement/GW72;5387\n", 30, fhdlOut);
            filePutString ("Klima_11_alt;5388\n", 18, fhdlOut);
            filePutString ("Klima_11_alt/Gateway_72;5388\n", 29, fhdlOut);
            filePutString ("Klima_11_alt/GW72;5388\n", 23, fhdlOut);
            filePutString ("Klima_Sensor_02_alt;5389\n", 25, fhdlOut);
            filePutString ("Klima_Sensor_02_alt/Gateway_72;5389\n", 36, fhdlOut);
            filePutString ("Klima_Sensor_02_alt/GW72;5389\n", 30, fhdlOut);
            filePutString ("Licht_Anf_01_alt;5390\n", 22, fhdlOut);
            filePutString ("Licht_Anf_01_alt/Gateway_72;5390\n", 33, fhdlOut);
            filePutString ("Licht_Anf_01_alt/GW72;5390\n", 27, fhdlOut);
            filePutString ("SMLS_01_alt;5391\n", 17, fhdlOut);
            filePutString ("SMLS_01_alt/Gateway_72;5391\n", 28, fhdlOut);
            filePutString ("SMLS_01_alt/GW72;5391\n", 22, fhdlOut);
            filePutString ("VS_VD_entriegelt;5392\n", 22, fhdlOut);
            filePutString ("VS_VD_entriegelt/Gateway_72;5392\n", 33, fhdlOut);
            filePutString ("VS_VD_entriegelt/GW72;5392\n", 27, fhdlOut);
            filePutString ("VS_VD_offen_ver;5393\n", 21, fhdlOut);
            filePutString ("VS_VD_offen_ver/Gateway_72;5393\n", 32, fhdlOut);
            filePutString ("VS_VD_offen_ver/GW72;5393\n", 26, fhdlOut);
            filePutString ("VS_VD_zu_ver;5394\n", 18, fhdlOut);
            filePutString ("VS_VD_zu_ver/Gateway_72;5394\n", 29, fhdlOut);
            filePutString ("VS_VD_zu_ver/GW72;5394\n", 23, fhdlOut);
            filePutString ("VS_Verdeck_Anf;5395\n", 20, fhdlOut);
            filePutString ("VS_Verdeck_Anf/Gateway_72;5395\n", 31, fhdlOut);
            filePutString ("VS_Verdeck_Anf/GW72;5395\n", 25, fhdlOut);
            filePutString ("Verdeck_01_alt;5396\n", 20, fhdlOut);
            filePutString ("Verdeck_01_alt/Gateway_72;5396\n", 31, fhdlOut);
            filePutString ("Verdeck_01_alt/GW72;5396\n", 25, fhdlOut);
            filePutString ("WFS_01_alt;5397\n", 16, fhdlOut);
            filePutString ("WFS_01_alt/Gateway_72;5397\n", 27, fhdlOut);
            filePutString ("WFS_01_alt/GW72;5397\n", 21, fhdlOut);
            filePutString ("WFS_ID_Geb_autorisiert_in_Kl15;5398\n", 36, fhdlOut);
            filePutString ("WFS_ID_Geb_autorisiert_in_Kl15/Gateway_72;5398\n", 47, fhdlOut);
            filePutString ("WFS_ID_Geb_autorisiert_in_Kl15/GW72;5398\n", 41, fhdlOut);
            filePutString ("WFS_Schluessel_Fahrberecht;5399\n", 32, fhdlOut);
            filePutString ("WFS_Schluessel_Fahrberecht/Gateway_72;5399\n", 43, fhdlOut);
            filePutString ("WFS_Schluessel_Fahrberecht/GW72;5399\n", 37, fhdlOut);
            filePutString ("WWSs_01_alt;5400\n", 17, fhdlOut);
            filePutString ("WWSs_01_alt/Gateway_72;5400\n", 28, fhdlOut);
            filePutString ("WWSs_01_alt/GW72;5400\n", 22, fhdlOut);
            filePutString ("Waschen_vorne_aktiv;5401\n", 25, fhdlOut);
            filePutString ("Waschen_vorne_aktiv/Gateway_72;5401\n", 36, fhdlOut);
            filePutString ("Waschen_vorne_aktiv/GW72;5401\n", 30, fhdlOut);
            filePutString ("Wischer_01_alt;5402\n", 20, fhdlOut);
            filePutString ("Wischer_01_alt/Gateway_72;5402\n", 31, fhdlOut);
            filePutString ("Wischer_01_alt/GW72;5402\n", 25, fhdlOut);
            filePutString ("Wischer_vorne_aktiv;5403\n", 25, fhdlOut);
            filePutString ("Wischer_vorne_aktiv/Gateway_72;5403\n", 36, fhdlOut);
            filePutString ("Wischer_vorne_aktiv/GW72;5403\n", 30, fhdlOut);
            filePutString ("ZV_02_alt;5404\n", 15, fhdlOut);
            filePutString ("ZV_02_alt/Gateway_72;5404\n", 26, fhdlOut);
            filePutString ("ZV_02_alt/GW72;5404\n", 20, fhdlOut);
            filePutString ("ZV_BT_offen;5405\n", 17, fhdlOut);
            filePutString ("ZV_BT_offen/Gateway_72;5405\n", 28, fhdlOut);
            filePutString ("ZV_BT_offen/GW72;5405\n", 22, fhdlOut);
            filePutString ("ZV_FT_offen;5406\n", 17, fhdlOut);
            filePutString ("ZV_FT_offen/Gateway_72;5406\n", 28, fhdlOut);
            filePutString ("ZV_FT_offen/GW72;5406\n", 22, fhdlOut);
            filePutString ("ZV_HBFS_offen;5407\n", 19, fhdlOut);
            filePutString ("ZV_HBFS_offen/Gateway_72;5407\n", 30, fhdlOut);
            filePutString ("ZV_HBFS_offen/GW72;5407\n", 24, fhdlOut);
            filePutString ("ZV_HD_offen;5408\n", 17, fhdlOut);
            filePutString ("ZV_HD_offen/Gateway_72;5408\n", 28, fhdlOut);
            filePutString ("ZV_HD_offen/GW72;5408\n", 22, fhdlOut);
            filePutString ("ZV_HFS_offen;5409\n", 18, fhdlOut);
            filePutString ("ZV_HFS_offen/Gateway_72;5409\n", 29, fhdlOut);
            filePutString ("ZV_HFS_offen/GW72;5409\n", 23, fhdlOut);
            filePutString ("ELV_01_alt;5632\n", 16, fhdlOut);
            filePutString ("ELV_01_alt/Gateway_74;5632\n", 27, fhdlOut);
            filePutString ("ELV_01_alt/GW74;5632\n", 21, fhdlOut);
            filePutString ("ELV_Anf_Klemme_50;5633\n", 23, fhdlOut);
            filePutString ("ELV_Anf_Klemme_50/Gateway_74;5633\n", 34, fhdlOut);
            filePutString ("ELV_Anf_Klemme_50/GW74;5633\n", 28, fhdlOut);
            filePutString ("EPS_Lenkerposition;5634\n", 24, fhdlOut);
            filePutString ("EPS_Lenkerposition/Gateway_74;5634\n", 35, fhdlOut);
            filePutString ("EPS_Lenkerposition/GW74;5634\n", 29, fhdlOut);
            filePutString ("GW_Status_GRA;5635\n", 19, fhdlOut);
            filePutString ("GW_Status_GRA/Gateway_74;5635\n", 30, fhdlOut);
            filePutString ("GW_Status_GRA/GW74;5635\n", 24, fhdlOut);
            filePutString ("HLR_01_alt;5636\n", 16, fhdlOut);
            filePutString ("HLR_01_alt/Gateway_74;5636\n", 27, fhdlOut);
            filePutString ("HLR_01_alt/GW74;5636\n", 21, fhdlOut);
            filePutString ("KL_Geblspng_Soll;5637\n", 22, fhdlOut);
            filePutString ("KL_Geblspng_Soll/Gateway_74;5637\n", 33, fhdlOut);
            filePutString ("KL_Geblspng_Soll/GW74;5637\n", 27, fhdlOut);
            filePutString ("KL_PTC_Verbauinfo;5638\n", 23, fhdlOut);
            filePutString ("KL_PTC_Verbauinfo/Gateway_74;5638\n", 34, fhdlOut);
            filePutString ("KL_PTC_Verbauinfo/GW74;5638\n", 28, fhdlOut);
            filePutString ("KL_Umluftklappe_Status;5639\n", 28, fhdlOut);
            filePutString ("KL_Umluftklappe_Status/Gateway_74;5639\n", 39, fhdlOut);
            filePutString ("KL_Umluftklappe_Status/GW74;5639\n", 33, fhdlOut);
            filePutString ("KY_StartStopp_Info;5640\n", 24, fhdlOut);
            filePutString ("KY_StartStopp_Info/Gateway_74;5640\n", 35, fhdlOut);
            filePutString ("KY_StartStopp_Info/GW74;5640\n", 29, fhdlOut);
            filePutString ("Kessy_04_alt;5641\n", 18, fhdlOut);
            filePutString ("Kessy_04_alt/Gateway_74;5641\n", 29, fhdlOut);
            filePutString ("Kessy_04_alt/GW74;5641\n", 23, fhdlOut);
            filePutString ("Klima_12_alt;5642\n", 18, fhdlOut);
            filePutString ("Klima_12_alt/Gateway_74;5642\n", 29, fhdlOut);
            filePutString ("Klima_12_alt/GW74;5642\n", 23, fhdlOut);
            filePutString ("LH_EPS_01_alt;5643\n", 19, fhdlOut);
            filePutString ("LH_EPS_01_alt/Gateway_74;5643\n", 30, fhdlOut);
            filePutString ("LH_EPS_01_alt/GW74;5643\n", 24, fhdlOut);
            filePutString ("LIN_2_alt;5644\n", 15, fhdlOut);
            filePutString ("LIN_2_alt/Gateway_74;5644\n", 26, fhdlOut);
            filePutString ("LIN_2_alt/GW74;5644\n", 20, fhdlOut);
            filePutString ("LS_Tiptronic_Fehler;5645\n", 25, fhdlOut);
            filePutString ("LS_Tiptronic_Fehler/Gateway_74;5645\n", 36, fhdlOut);
            filePutString ("LS_Tiptronic_Fehler/GW74;5645\n", 30, fhdlOut);
            filePutString ("MFG_01_alt;5646\n", 16, fhdlOut);
            filePutString ("MFG_01_alt/Gateway_74;5646\n", 27, fhdlOut);
            filePutString ("MFG_01_alt/GW74;5646\n", 21, fhdlOut);
            filePutString ("MFL_Tip_Down;5647\n", 18, fhdlOut);
            filePutString ("MFL_Tip_Down/Gateway_74;5647\n", 29, fhdlOut);
            filePutString ("MFL_Tip_Down/GW74;5647\n", 23, fhdlOut);
            filePutString ("MFL_Tip_Up;5648\n", 16, fhdlOut);
            filePutString ("MFL_Tip_Up/Gateway_74;5648\n", 27, fhdlOut);
            filePutString ("MFL_Tip_Up/GW74;5648\n", 21, fhdlOut);
            filePutString ("MF_Anlassersperre;5649\n", 23, fhdlOut);
            filePutString ("MF_Anlassersperre/Gateway_74;5649\n", 34, fhdlOut);
            filePutString ("MF_Anlassersperre/GW74;5649\n", 28, fhdlOut);
            filePutString ("MF_StartStopp_Info;5650\n", 24, fhdlOut);
            filePutString ("MF_StartStopp_Info/Gateway_74;5650\n", 35, fhdlOut);
            filePutString ("MF_StartStopp_Info/GW74;5650\n", 29, fhdlOut);
            filePutString ("PH_StartStopp_Info;5651\n", 24, fhdlOut);
            filePutString ("PH_StartStopp_Info/Gateway_74;5651\n", 35, fhdlOut);
            filePutString ("PH_StartStopp_Info/GW74;5651\n", 29, fhdlOut);
            filePutString ("PH_nachtr_Stopp_Anf;5652\n", 25, fhdlOut);
            filePutString ("PH_nachtr_Stopp_Anf/Gateway_74;5652\n", 36, fhdlOut);
            filePutString ("PH_nachtr_Stopp_Anf/GW74;5652\n", 30, fhdlOut);
            filePutString ("PTC_Freigabe;5653\n", 18, fhdlOut);
            filePutString ("PTC_Freigabe/Gateway_74;5653\n", 29, fhdlOut);
            filePutString ("PTC_Freigabe/GW74;5653\n", 23, fhdlOut);
            filePutString ("Parkhilfe_01_alt;5654\n", 22, fhdlOut);
            filePutString ("Parkhilfe_01_alt/Gateway_74;5654\n", 33, fhdlOut);
            filePutString ("Parkhilfe_01_alt/GW74;5654\n", 27, fhdlOut);
            filePutString ("GE_Fahrstufe;5888\n", 18, fhdlOut);
            filePutString ("GE_Fahrstufe/Getriebe_11;5888\n", 30, fhdlOut);
            filePutString ("GE_Fahrstufe/GBX11;5888\n", 24, fhdlOut);
            filePutString ("GE_Freig_MMom_Vorhalt;5889\n", 27, fhdlOut);
            filePutString ("GE_Freig_MMom_Vorhalt/Getriebe_11;5889\n", 39, fhdlOut);
            filePutString ("GE_Freig_MMom_Vorhalt/GBX11;5889\n", 33, fhdlOut);
            filePutString ("GE_MMom_Soll_02;5890\n", 21, fhdlOut);
            filePutString ("GE_MMom_Soll_02/Getriebe_11;5890\n", 33, fhdlOut);
            filePutString ("GE_MMom_Soll_02/GBX11;5890\n", 27, fhdlOut);
            filePutString ("GE_MMom_Status;5891\n", 20, fhdlOut);
            filePutString ("GE_MMom_Status/Getriebe_11;5891\n", 32, fhdlOut);
            filePutString ("GE_MMom_Status/GBX11;5891\n", 26, fhdlOut);
            filePutString ("GE_MMom_Status_02;5892\n", 23, fhdlOut);
            filePutString ("GE_MMom_Status_02/Getriebe_11;5892\n", 35, fhdlOut);
            filePutString ("GE_MMom_Status_02/GBX11;5892\n", 29, fhdlOut);
            filePutString ("GE_MMom_Vorhalt_02;5893\n", 24, fhdlOut);
            filePutString ("GE_MMom_Vorhalt_02/Getriebe_11;5893\n", 36, fhdlOut);
            filePutString ("GE_MMom_Vorhalt_02/GBX11;5893\n", 30, fhdlOut);
            filePutString ("GE_Schaltablauf;5894\n", 21, fhdlOut);
            filePutString ("GE_Schaltablauf/Getriebe_11;5894\n", 33, fhdlOut);
            filePutString ("GE_Schaltablauf/GBX11;5894\n", 27, fhdlOut);
            filePutString ("GE_Status_Kraftschluss;5895\n", 28, fhdlOut);
            filePutString ("GE_Status_Kraftschluss/Getriebe_11;5895\n", 40, fhdlOut);
            filePutString ("GE_Status_Kraftschluss/GBX11;5895\n", 34, fhdlOut);
            filePutString ("GE_Uefkt;5896\n", 14, fhdlOut);
            filePutString ("GE_Uefkt/Getriebe_11;5896\n", 26, fhdlOut);
            filePutString ("GE_Uefkt/GBX11;5896\n", 20, fhdlOut);
            filePutString ("GE_Verbot_Ausblendung;5897\n", 27, fhdlOut);
            filePutString ("GE_Verbot_Ausblendung/Getriebe_11;5897\n", 39, fhdlOut);
            filePutString ("GE_Verbot_Ausblendung/GBX11;5897\n", 33, fhdlOut);
            filePutString ("GE_Zielgang;5898\n", 17, fhdlOut);
            filePutString ("GE_Zielgang/Getriebe_11;5898\n", 29, fhdlOut);
            filePutString ("GE_Zielgang/GBX11;5898\n", 23, fhdlOut);
            filePutString ("GE_reserv_Fahrstufe;5899\n", 25, fhdlOut);
            filePutString ("GE_reserv_Fahrstufe/Getriebe_11;5899\n", 37, fhdlOut);
            filePutString ("GE_reserv_Fahrstufe/GBX11;5899\n", 31, fhdlOut);
            filePutString ("Getriebe_11_BZ;5900\n", 20, fhdlOut);
            filePutString ("Getriebe_11_BZ/Getriebe_11;5900\n", 32, fhdlOut);
            filePutString ("Getriebe_11_BZ/GBX11;5900\n", 26, fhdlOut);
            filePutString ("Getriebe_11_CRC;5901\n", 21, fhdlOut);
            filePutString ("Getriebe_11_CRC/Getriebe_11;5901\n", 33, fhdlOut);
            filePutString ("Getriebe_11_CRC/GBX11;5901\n", 27, fhdlOut);
            filePutString ("GE_Anheb_Solldrehz_Leerlauf;6144\n", 33, fhdlOut);
            filePutString ("GE_Anheb_Solldrehz_Leerlauf/Getriebe_12;6144\n", 45, fhdlOut);
            filePutString ("GE_Anheb_Solldrehz_Leerlauf/GBX12;6144\n", 39, fhdlOut);
            filePutString ("GE_Aufnahmemoment;6145\n", 23, fhdlOut);
            filePutString ("GE_Aufnahmemoment/Getriebe_12;6145\n", 35, fhdlOut);
            filePutString ("GE_Aufnahmemoment/GBX12;6145\n", 29, fhdlOut);
            filePutString ("GE_Drehzahlmesser_Daempfung;6146\n", 33, fhdlOut);
            filePutString ("GE_Drehzahlmesser_Daempfung/Getriebe_12;6146\n", 45, fhdlOut);
            filePutString ("GE_Drehzahlmesser_Daempfung/GBX12;6146\n", 39, fhdlOut);
            filePutString ("GE_Freigabe_Synchro;6147\n", 25, fhdlOut);
            filePutString ("GE_Freigabe_Synchro/Getriebe_12;6147\n", 37, fhdlOut);
            filePutString ("GE_Freigabe_Synchro/GBX12;6147\n", 31, fhdlOut);
            filePutString ("GE_HYB_DZ_Eingriff;6148\n", 24, fhdlOut);
            filePutString ("GE_HYB_DZ_Eingriff/Getriebe_12;6148\n", 36, fhdlOut);
            filePutString ("GE_HYB_DZ_Eingriff/GBX12;6148\n", 30, fhdlOut);
            filePutString ("GE_Mom_Begr_Gradient;6149\n", 26, fhdlOut);
            filePutString ("GE_Mom_Begr_Gradient/Getriebe_12;6149\n", 38, fhdlOut);
            filePutString ("GE_Mom_Begr_Gradient/GBX12;6149\n", 32, fhdlOut);
            filePutString ("GE_Schubabschalt_Unt;6150\n", 26, fhdlOut);
            filePutString ("GE_Schubabschalt_Unt/Getriebe_12;6150\n", 38, fhdlOut);
            filePutString ("GE_Schubabschalt_Unt/GBX12;6150\n", 32, fhdlOut);
            filePutString ("GE_Synchro_Status;6151\n", 23, fhdlOut);
            filePutString ("GE_Synchro_Status/Getriebe_12;6151\n", 35, fhdlOut);
            filePutString ("GE_Synchro_Status/GBX12;6151\n", 29, fhdlOut);
            filePutString ("GE_Synchro_Wunschdrehz;6152\n", 28, fhdlOut);
            filePutString ("GE_Synchro_Wunschdrehz/Getriebe_12;6152\n", 40, fhdlOut);
            filePutString ("GE_Synchro_Wunschdrehz/GBX12;6152\n", 34, fhdlOut);
            filePutString ("GE_Synchro_Zeit;6153\n", 21, fhdlOut);
            filePutString ("GE_Synchro_Zeit/Getriebe_12;6153\n", 33, fhdlOut);
            filePutString ("GE_Synchro_Zeit/GBX12;6153\n", 27, fhdlOut);
            filePutString ("Getriebe_12_BZ;6154\n", 20, fhdlOut);
            filePutString ("Getriebe_12_BZ/Getriebe_12;6154\n", 32, fhdlOut);
            filePutString ("Getriebe_12_BZ/GBX12;6154\n", 26, fhdlOut);
            filePutString ("Getriebe_12_CRC;6155\n", 21, fhdlOut);
            filePutString ("Getriebe_12_CRC/Getriebe_12;6155\n", 33, fhdlOut);
            filePutString ("Getriebe_12_CRC/GBX12;6155\n", 27, fhdlOut);
            filePutString ("GE_Anf_Zylabsch;6400\n", 21, fhdlOut);
            filePutString ("GE_Anf_Zylabsch/Getriebe_13;6400\n", 33, fhdlOut);
            filePutString ("GE_Anf_Zylabsch/GBX13;6400\n", 27, fhdlOut);
            filePutString ("GE_Eingangsdrehz;6401\n", 22, fhdlOut);
            filePutString ("GE_Eingangsdrehz/Getriebe_13;6401\n", 34, fhdlOut);
            filePutString ("GE_Eingangsdrehz/GBX13;6401\n", 28, fhdlOut);
            filePutString ("GE_Entkopplung_Status;6402\n", 27, fhdlOut);
            filePutString ("GE_Entkopplung_Status/Getriebe_13;6402\n", 39, fhdlOut);
            filePutString ("GE_Entkopplung_Status/GBX13;6402\n", 33, fhdlOut);
            filePutString ("GE_Freig_Langfr_Schutzmom;6403\n", 31, fhdlOut);
            filePutString ("GE_Freig_Langfr_Schutzmom/Getriebe_13;6403\n", 43, fhdlOut);
            filePutString ("GE_Freig_Langfr_Schutzmom/GBX13;6403\n", 37, fhdlOut);
            filePutString ("GE_Grenzkriechmoment;6404\n", 26, fhdlOut);
            filePutString ("GE_Grenzkriechmoment/Getriebe_13;6404\n", 38, fhdlOut);
            filePutString ("GE_Grenzkriechmoment/GBX13;6404\n", 32, fhdlOut);
            filePutString ("GE_Langfr_Schutzmom_02;6405\n", 28, fhdlOut);
            filePutString ("GE_Langfr_Schutzmom_02/Getriebe_13;6405\n", 40, fhdlOut);
            filePutString ("GE_Langfr_Schutzmom_02/GBX13;6405\n", 34, fhdlOut);
            filePutString ("GE_Notlauf;6406\n", 16, fhdlOut);
            filePutString ("GE_Notlauf/Getriebe_13;6406\n", 28, fhdlOut);
            filePutString ("GE_Notlauf/GBX13;6406\n", 22, fhdlOut);
            filePutString ("GE_StartStopp_Info;6407\n", 24, fhdlOut);
            filePutString ("GE_StartStopp_Info/Getriebe_13;6407\n", 36, fhdlOut);
            filePutString ("GE_StartStopp_Info/GBX13;6407\n", 30, fhdlOut);
            filePutString ("GE_Verlustmoment_02;6408\n", 25, fhdlOut);
            filePutString ("GE_Verlustmoment_02/Getriebe_13;6408\n", 37, fhdlOut);
            filePutString ("GE_Verlustmoment_02/GBX13;6408\n", 31, fhdlOut);
            filePutString ("Getriebe_13_BZ;6409\n", 20, fhdlOut);
            filePutString ("Getriebe_13_BZ/Getriebe_13;6409\n", 32, fhdlOut);
            filePutString ("Getriebe_13_BZ/GBX13;6409\n", 26, fhdlOut);
            filePutString ("Getriebe_13_CRC;6410\n", 21, fhdlOut);
            filePutString ("Getriebe_13_CRC/Getriebe_13;6410\n", 33, fhdlOut);
            filePutString ("Getriebe_13_CRC/GBX13;6410\n", 27, fhdlOut);
            filePutString ("Freilauf_Charisma_FahrPr;6656\n", 30, fhdlOut);
            filePutString ("Freilauf_Charisma_FahrPr/Getriebe_14;6656\n", 42, fhdlOut);
            filePutString ("Freilauf_Charisma_FahrPr/GBX14;6656\n", 36, fhdlOut);
            filePutString ("Freilauf_Charisma_Status;6657\n", 30, fhdlOut);
            filePutString ("Freilauf_Charisma_Status/Getriebe_14;6657\n", 42, fhdlOut);
            filePutString ("Freilauf_Charisma_Status/GBX14;6657\n", 36, fhdlOut);
            filePutString ("GE_Charisma_FahrPr;6658\n", 24, fhdlOut);
            filePutString ("GE_Charisma_FahrPr/Getriebe_14;6658\n", 36, fhdlOut);
            filePutString ("GE_Charisma_FahrPr/GBX14;6658\n", 30, fhdlOut);
            filePutString ("GE_Charisma_Status;6659\n", 24, fhdlOut);
            filePutString ("GE_Charisma_Status/Getriebe_14;6659\n", 36, fhdlOut);
            filePutString ("GE_Charisma_Status/GBX14;6659\n", 30, fhdlOut);
            filePutString ("GE_Codierung_MSG;6660\n", 22, fhdlOut);
            filePutString ("GE_Codierung_MSG/Getriebe_14;6660\n", 34, fhdlOut);
            filePutString ("GE_Codierung_MSG/GBX14;6660\n", 28, fhdlOut);
            filePutString ("GE_Freigabe_Verfallsinfo_WFS;6661\n", 34, fhdlOut);
            filePutString ("GE_Freigabe_Verfallsinfo_WFS/Getriebe_14;6661\n", 46, fhdlOut);
            filePutString ("GE_Freigabe_Verfallsinfo_WFS/GBX14;6661\n", 40, fhdlOut);
            filePutString ("GE_Heizwunsch;6662\n", 19, fhdlOut);
            filePutString ("GE_Heizwunsch/Getriebe_14;6662\n", 31, fhdlOut);
            filePutString ("GE_Heizwunsch/GBX14;6662\n", 25, fhdlOut);
            filePutString ("GE_LFR_Adaption;6663\n", 21, fhdlOut);
            filePutString ("GE_LFR_Adaption/Getriebe_14;6663\n", 33, fhdlOut);
            filePutString ("GE_LFR_Adaption/GBX14;6663\n", 27, fhdlOut);
            filePutString ("GE_LaunchControl;6664\n", 22, fhdlOut);
            filePutString ("GE_LaunchControl/Getriebe_14;6664\n", 34, fhdlOut);
            filePutString ("GE_LaunchControl/GBX14;6664\n", 28, fhdlOut);
            filePutString ("GE_OBD_AbsperrVent;6665\n", 24, fhdlOut);
            filePutString ("GE_OBD_AbsperrVent/Getriebe_14;6665\n", 36, fhdlOut);
            filePutString ("GE_OBD_AbsperrVent/GBX14;6665\n", 30, fhdlOut);
            filePutString ("GE_OBD_Status;6666\n", 19, fhdlOut);
            filePutString ("GE_OBD_Status/Getriebe_14;6666\n", 31, fhdlOut);
            filePutString ("GE_OBD_Status/GBX14;6666\n", 25, fhdlOut);
            filePutString ("GE_Sumpftemperatur;6667\n", 24, fhdlOut);
            filePutString ("GE_Sumpftemperatur/Getriebe_14;6667\n", 36, fhdlOut);
            filePutString ("GE_Sumpftemperatur/GBX14;6667\n", 30, fhdlOut);
            filePutString ("GE_Verlustmoment_02;6668\n", 25, fhdlOut);
            filePutString ("GE_Verlustmoment_02/Getriebe_14;6668\n", 37, fhdlOut);
            filePutString ("GE_Verlustmoment_02/GBX14;6668\n", 31, fhdlOut);
            filePutString ("GE_Zustand_Kuppltemp;6669\n", 26, fhdlOut);
            filePutString ("GE_Zustand_Kuppltemp/Getriebe_14;6669\n", 38, fhdlOut);
            filePutString ("GE_Zustand_Kuppltemp/GBX14;6669\n", 32, fhdlOut);
            filePutString ("GE_amax_moeglich;6670\n", 22, fhdlOut);
            filePutString ("GE_amax_moeglich/Getriebe_14;6670\n", 34, fhdlOut);
            filePutString ("GE_amax_moeglich/GBX14;6670\n", 28, fhdlOut);
            filePutString ("GE_HYB_Fehlerstatus;6912\n", 25, fhdlOut);
            filePutString ("GE_HYB_Fehlerstatus/Getriebe_Hybrid_01;6912\n", 44, fhdlOut);
            filePutString ("GE_HYB_Fehlerstatus/GBXHYB01;6912\n", 34, fhdlOut);
            filePutString ("GE_HYB_Filt_MomAufbau;6913\n", 27, fhdlOut);
            filePutString ("GE_HYB_Filt_MomAufbau/Getriebe_Hybrid_01;6913\n", 46, fhdlOut);
            filePutString ("GE_HYB_Filt_MomAufbau/GBXHYB01;6913\n", 36, fhdlOut);
            filePutString ("GE_HYB_Freig_VM_EM_Stop;6914\n", 29, fhdlOut);
            filePutString ("GE_HYB_Freig_VM_EM_Stop/Getriebe_Hybrid_01;6914\n", 48, fhdlOut);
            filePutString ("GE_HYB_Freig_VM_EM_Stop/GBXHYB01;6914\n", 38, fhdlOut);
            filePutString ("GE_HYB_Freig_sSchl_K0;6915\n", 27, fhdlOut);
            filePutString ("GE_HYB_Freig_sSchl_K0/Getriebe_Hybrid_01;6915\n", 46, fhdlOut);
            filePutString ("GE_HYB_Freig_sSchl_K0/GBXHYB01;6915\n", 36, fhdlOut);
            filePutString ("GE_HYB_Freigabe_K0;6916\n", 24, fhdlOut);
            filePutString ("GE_HYB_Freigabe_K0/Getriebe_Hybrid_01;6916\n", 43, fhdlOut);
            filePutString ("GE_HYB_Freigabe_K0/GBXHYB01;6916\n", 33, fhdlOut);
            filePutString ("GE_HYB_Freigabe_LL_Reg;6917\n", 28, fhdlOut);
            filePutString ("GE_HYB_Freigabe_LL_Reg/Getriebe_Hybrid_01;6917\n", 47, fhdlOut);
            filePutString ("GE_HYB_Freigabe_LL_Reg/GBXHYB01;6917\n", 37, fhdlOut);
            filePutString ("GE_HYB_MomEingriff_EM;6918\n", 27, fhdlOut);
            filePutString ("GE_HYB_MomEingriff_EM/Getriebe_Hybrid_01;6918\n", 46, fhdlOut);
            filePutString ("GE_HYB_MomEingriff_EM/GBXHYB01;6918\n", 36, fhdlOut);
            filePutString ("GE_HYB_Sportfaktor;6919\n", 24, fhdlOut);
            filePutString ("GE_HYB_Sportfaktor/Getriebe_Hybrid_01;6919\n", 43, fhdlOut);
            filePutString ("GE_HYB_Sportfaktor/GBXHYB01;6919\n", 33, fhdlOut);
            filePutString ("GE_HYB_StartAnf;6920\n", 21, fhdlOut);
            filePutString ("GE_HYB_StartAnf/Getriebe_Hybrid_01;6920\n", 40, fhdlOut);
            filePutString ("GE_HYB_StartAnf/GBXHYB01;6920\n", 30, fhdlOut);
            filePutString ("GE_HYB_VM_Startkontr;6921\n", 26, fhdlOut);
            filePutString ("GE_HYB_VM_Startkontr/Getriebe_Hybrid_01;6921\n", 45, fhdlOut);
            filePutString ("GE_HYB_VM_Startkontr/GBXHYB01;6921\n", 35, fhdlOut);
            filePutString ("GE_HYB_VM_akt_halten;6922\n", 26, fhdlOut);
            filePutString ("GE_HYB_VM_akt_halten/Getriebe_Hybrid_01;6922\n", 45, fhdlOut);
            filePutString ("GE_HYB_VM_akt_halten/GBXHYB01;6922\n", 35, fhdlOut);
            filePutString ("GE_HYB_VZ_MomEingriff_EM;6923\n", 30, fhdlOut);
            filePutString ("GE_HYB_VZ_MomEingriff_EM/Getriebe_Hybrid_01;6923\n", 49, fhdlOut);
            filePutString ("GE_HYB_VZ_MomEingriff_EM/GBXHYB01;6923\n", 39, fhdlOut);
            filePutString ("GE_HYB_Wiederstart;6924\n", 24, fhdlOut);
            filePutString ("GE_HYB_Wiederstart/Getriebe_Hybrid_01;6924\n", 43, fhdlOut);
            filePutString ("GE_HYB_Wiederstart/GBXHYB01;6924\n", 33, fhdlOut);
            filePutString ("GE_HYB_nK0;6925\n", 16, fhdlOut);
            filePutString ("GE_HYB_nK0/Getriebe_Hybrid_01;6925\n", 35, fhdlOut);
            filePutString ("GE_HYB_nK0/GBXHYB01;6925\n", 25, fhdlOut);
            filePutString ("Getriebe_Hybrid_01_BZ;6926\n", 27, fhdlOut);
            filePutString ("Getriebe_Hybrid_01_BZ/Getriebe_Hybrid_01;6926\n", 46, fhdlOut);
            filePutString ("Getriebe_Hybrid_01_BZ/GBXHYB01;6926\n", 36, fhdlOut);
            filePutString ("Getriebe_Hybrid_01_CRC;6927\n", 28, fhdlOut);
            filePutString ("Getriebe_Hybrid_01_CRC/Getriebe_Hybrid_01;6927\n", 47, fhdlOut);
            filePutString ("Getriebe_Hybrid_01_CRC/GBXHYB01;6927\n", 37, fhdlOut);
            filePutString ("HVEM_DauerRed;7168\n", 19, fhdlOut);
            filePutString ("HVEM_DauerRed/HVEM_02;7168\n", 27, fhdlOut);
            filePutString ("HVEM_DauerRed/HVEM02;7168\n", 26, fhdlOut);
            filePutString ("HVEM_FreigabeKlimatisierung;7169\n", 33, fhdlOut);
            filePutString ("HVEM_FreigabeKlimatisierung/HVEM_02;7169\n", 41, fhdlOut);
            filePutString ("HVEM_FreigabeKlimatisierung/HVEM02;7169\n", 40, fhdlOut);
            filePutString ("HVEM_IstLeistungNA;7170\n", 24, fhdlOut);
            filePutString ("HVEM_IstLeistungNA/HVEM_02;7170\n", 32, fhdlOut);
            filePutString ("HVEM_IstLeistungNA/HVEM02;7170\n", 31, fhdlOut);
            filePutString ("HVEM_IstStrom_HVVerbraucher;7171\n", 33, fhdlOut);
            filePutString ("HVEM_IstStrom_HVVerbraucher/HVEM_02;7171\n", 41, fhdlOut);
            filePutString ("HVEM_IstStrom_HVVerbraucher/HVEM02;7171\n", 40, fhdlOut);
            filePutString ("HVEM_LeistungTMEVorgabe;7172\n", 29, fhdlOut);
            filePutString ("HVEM_LeistungTMEVorgabe/HVEM_02;7172\n", 37, fhdlOut);
            filePutString ("HVEM_LeistungTMEVorgabe/HVEM02;7172\n", 36, fhdlOut);
            filePutString ("HVEM_MinLeistungNA;7173\n", 24, fhdlOut);
            filePutString ("HVEM_MinLeistungNA/HVEM_02;7173\n", 32, fhdlOut);
            filePutString ("HVEM_MinLeistungNA/HVEM02;7173\n", 31, fhdlOut);
            filePutString ("HVEM_Temp_Vorkond_Innen;7174\n", 29, fhdlOut);
            filePutString ("HVEM_Temp_Vorkond_Innen/HVEM_02;7174\n", 37, fhdlOut);
            filePutString ("HVEM_Temp_Vorkond_Innen/HVEM02;7174\n", 36, fhdlOut);
            filePutString ("HVEM_Anf_ReichweiteNV;7424\n", 27, fhdlOut);
            filePutString ("HVEM_Anf_ReichweiteNV/HVEM_04;7424\n", 35, fhdlOut);
            filePutString ("HVEM_Anf_ReichweiteNV/HVEM04;7424\n", 34, fhdlOut);
            filePutString ("HVEM_HV_Anf;7425\n", 17, fhdlOut);
            filePutString ("HVEM_HV_Anf/HVEM_04;7425\n", 25, fhdlOut);
            filePutString ("HVEM_HV_Anf/HVEM04;7425\n", 24, fhdlOut);
            filePutString ("HVEM_KlimaMaxHVStrom;7426\n", 26, fhdlOut);
            filePutString ("HVEM_KlimaMaxHVStrom/HVEM_04;7426\n", 34, fhdlOut);
            filePutString ("HVEM_KlimaMaxHVStrom/HVEM04;7426\n", 33, fhdlOut);
            filePutString ("HVEM_LeistungsAnf;7427\n", 23, fhdlOut);
            filePutString ("HVEM_LeistungsAnf/HVEM_04;7427\n", 31, fhdlOut);
            filePutString ("HVEM_LeistungsAnf/HVEM04;7427\n", 30, fhdlOut);
            filePutString ("HVEM_NVLeistungEmpf;7428\n", 25, fhdlOut);
            filePutString ("HVEM_NVLeistungEmpf/HVEM_04;7428\n", 33, fhdlOut);
            filePutString ("HVEM_NVLeistungEmpf/HVEM04;7428\n", 32, fhdlOut);
            filePutString ("HVEM_Nachlad_Status;7429\n", 25, fhdlOut);
            filePutString ("HVEM_Nachlad_Status/HVEM_04;7429\n", 33, fhdlOut);
            filePutString ("HVEM_Nachlad_Status/HVEM04;7429\n", 32, fhdlOut);
            filePutString ("HVEM_Nachladen_Anf;7430\n", 24, fhdlOut);
            filePutString ("HVEM_Nachladen_Anf/HVEM_04;7430\n", 32, fhdlOut);
            filePutString ("HVEM_Nachladen_Anf/HVEM04;7430\n", 31, fhdlOut);
            filePutString ("HVEM_Text_1;7431\n", 17, fhdlOut);
            filePutString ("HVEM_Text_1/HVEM_04;7431\n", 25, fhdlOut);
            filePutString ("HVEM_Text_1/HVEM04;7431\n", 24, fhdlOut);
            filePutString ("BCM_Remotestart_Betrieb;7680\n", 29, fhdlOut);
            filePutString ("BCM_Remotestart_Betrieb/Klemmen_Status_01;7680\n", 47, fhdlOut);
            filePutString ("BCM_Remotestart_Betrieb/STIGN01;7680\n", 37, fhdlOut);
            filePutString ("KST_Fahrerhinweis_1;7681\n", 25, fhdlOut);
            filePutString ("KST_Fahrerhinweis_1/Klemmen_Status_01;7681\n", 43, fhdlOut);
            filePutString ("KST_Fahrerhinweis_1/STIGN01;7681\n", 33, fhdlOut);
            filePutString ("KST_Fahrerhinweis_2;7682\n", 25, fhdlOut);
            filePutString ("KST_Fahrerhinweis_2/Klemmen_Status_01;7682\n", 43, fhdlOut);
            filePutString ("KST_Fahrerhinweis_2/STIGN01;7682\n", 33, fhdlOut);
            filePutString ("KST_Fahrerhinweis_3;7683\n", 25, fhdlOut);
            filePutString ("KST_Fahrerhinweis_3/Klemmen_Status_01;7683\n", 43, fhdlOut);
            filePutString ("KST_Fahrerhinweis_3/STIGN01;7683\n", 33, fhdlOut);
            filePutString ("KST_Fahrerhinweis_4;7684\n", 25, fhdlOut);
            filePutString ("KST_Fahrerhinweis_4/Klemmen_Status_01;7684\n", 43, fhdlOut);
            filePutString ("KST_Fahrerhinweis_4/STIGN01;7684\n", 33, fhdlOut);
            filePutString ("KST_Fahrerhinweis_5;7685\n", 25, fhdlOut);
            filePutString ("KST_Fahrerhinweis_5/Klemmen_Status_01;7685\n", 43, fhdlOut);
            filePutString ("KST_Fahrerhinweis_5/STIGN01;7685\n", 33, fhdlOut);
            filePutString ("KST_Fahrerhinweis_6;7686\n", 25, fhdlOut);
            filePutString ("KST_Fahrerhinweis_6/Klemmen_Status_01;7686\n", 43, fhdlOut);
            filePutString ("KST_Fahrerhinweis_6/STIGN01;7686\n", 33, fhdlOut);
            filePutString ("KST_Warn_P1_ZST_def;7687\n", 25, fhdlOut);
            filePutString ("KST_Warn_P1_ZST_def/Klemmen_Status_01;7687\n", 43, fhdlOut);
            filePutString ("KST_Warn_P1_ZST_def/STIGN01;7687\n", 33, fhdlOut);
            filePutString ("KST_Warn_P2_ZST_def;7688\n", 25, fhdlOut);
            filePutString ("KST_Warn_P2_ZST_def/Klemmen_Status_01;7688\n", 43, fhdlOut);
            filePutString ("KST_Warn_P2_ZST_def/STIGN01;7688\n", 33, fhdlOut);
            filePutString ("Klemmen_Status_01_BZ;7689\n", 26, fhdlOut);
            filePutString ("Klemmen_Status_01_BZ/Klemmen_Status_01;7689\n", 44, fhdlOut);
            filePutString ("Klemmen_Status_01_BZ/STIGN01;7689\n", 34, fhdlOut);
            filePutString ("Klemmen_Status_01_CRC;7690\n", 27, fhdlOut);
            filePutString ("Klemmen_Status_01_CRC/Klemmen_Status_01;7690\n", 45, fhdlOut);
            filePutString ("Klemmen_Status_01_CRC/STIGN01;7690\n", 35, fhdlOut);
            filePutString ("ZAS_Kl_15;7691\n", 15, fhdlOut);
            filePutString ("ZAS_Kl_15/Klemmen_Status_01;7691\n", 33, fhdlOut);
            filePutString ("ZAS_Kl_15/STIGN01;7691\n", 23, fhdlOut);
            filePutString ("ZAS_Kl_50_Startanforderung;7692\n", 32, fhdlOut);
            filePutString ("ZAS_Kl_50_Startanforderung/Klemmen_Status_01;7692\n", 50, fhdlOut);
            filePutString ("ZAS_Kl_50_Startanforderung/STIGN01;7692\n", 40, fhdlOut);
            filePutString ("ZAS_Kl_S;7693\n", 14, fhdlOut);
            filePutString ("ZAS_Kl_S/Klemmen_Status_01;7693\n", 32, fhdlOut);
            filePutString ("ZAS_Kl_S/STIGN01;7693\n", 22, fhdlOut);
            filePutString ("ZAS_Kl_X;7694\n", 14, fhdlOut);
            filePutString ("ZAS_Kl_X/Klemmen_Status_01;7694\n", 32, fhdlOut);
            filePutString ("ZAS_Kl_X/STIGN01;7694\n", 22, fhdlOut);
            filePutString ("KL_AC_Schalter;7936\n", 20, fhdlOut);
            filePutString ("KL_AC_Schalter/Klima_11;7936\n", 29, fhdlOut);
            filePutString ("KL_AC_Schalter/AC11;7936\n", 25, fhdlOut);
            filePutString ("KL_Anf_KL;7937\n", 15, fhdlOut);
            filePutString ("KL_Anf_KL/Klima_11;7937\n", 24, fhdlOut);
            filePutString ("KL_Anf_KL/AC11;7937\n", 20, fhdlOut);
            filePutString ("KL_Ausstattung_Klima;7938\n", 26, fhdlOut);
            filePutString ("KL_Ausstattung_Klima/Klima_11;7938\n", 35, fhdlOut);
            filePutString ("KL_Ausstattung_Klima/AC11;7938\n", 31, fhdlOut);
            filePutString ("KL_Charisma_FahrPr;7939\n", 24, fhdlOut);
            filePutString ("KL_Charisma_FahrPr/Klima_11;7939\n", 33, fhdlOut);
            filePutString ("KL_Charisma_FahrPr/AC11;7939\n", 29, fhdlOut);
            filePutString ("KL_Charisma_Status;7940\n", 24, fhdlOut);
            filePutString ("KL_Charisma_Status/Klima_11;7940\n", 33, fhdlOut);
            filePutString ("KL_Charisma_Status/AC11;7940\n", 29, fhdlOut);
            filePutString ("KL_Comp_enable;7941\n", 20, fhdlOut);
            filePutString ("KL_Comp_enable/Klima_11;7941\n", 29, fhdlOut);
            filePutString ("KL_Comp_enable/AC11;7941\n", 25, fhdlOut);
            filePutString ("KL_Comp_rev_rq;7942\n", 20, fhdlOut);
            filePutString ("KL_Comp_rev_rq/Klima_11;7942\n", 29, fhdlOut);
            filePutString ("KL_Comp_rev_rq/AC11;7942\n", 25, fhdlOut);
            filePutString ("KL_Drehz_Anh;7943\n", 18, fhdlOut);
            filePutString ("KL_Drehz_Anh/Klima_11;7943\n", 27, fhdlOut);
            filePutString ("KL_Drehz_Anh/AC11;7943\n", 23, fhdlOut);
            filePutString ("KL_Komp_Moment_alt;7944\n", 24, fhdlOut);
            filePutString ("KL_Komp_Moment_alt/Klima_11;7944\n", 33, fhdlOut);
            filePutString ("KL_Komp_Moment_alt/AC11;7944\n", 29, fhdlOut);
            filePutString ("KL_Last_Kompr;7945\n", 19, fhdlOut);
            filePutString ("KL_Last_Kompr/Klima_11;7945\n", 28, fhdlOut);
            filePutString ("KL_Last_Kompr/AC11;7945\n", 24, fhdlOut);
            filePutString ("KL_Spannungs_Anf;7946\n", 22, fhdlOut);
            filePutString ("KL_Spannungs_Anf/Klima_11;7946\n", 31, fhdlOut);
            filePutString ("KL_Spannungs_Anf/AC11;7946\n", 27, fhdlOut);
            filePutString ("KL_StartStopp_Info;7947\n", 24, fhdlOut);
            filePutString ("KL_StartStopp_Info/Klima_11;7947\n", 33, fhdlOut);
            filePutString ("KL_StartStopp_Info/AC11;7947\n", 29, fhdlOut);
            filePutString ("KL_Thermomanagement;7948\n", 25, fhdlOut);
            filePutString ("KL_Thermomanagement/Klima_11;7948\n", 34, fhdlOut);
            filePutString ("KL_Thermomanagement/AC11;7948\n", 30, fhdlOut);
            filePutString ("KL_Vorwarn_Komp_ein;7949\n", 25, fhdlOut);
            filePutString ("KL_Vorwarn_Komp_ein/Klima_11;7949\n", 34, fhdlOut);
            filePutString ("KL_Vorwarn_Komp_ein/AC11;7949\n", 30, fhdlOut);
            filePutString ("KL_Vorwarn_Zuheizer_ein;7950\n", 29, fhdlOut);
            filePutString ("KL_Vorwarn_Zuheizer_ein/Klima_11;7950\n", 38, fhdlOut);
            filePutString ("KL_Vorwarn_Zuheizer_ein/AC11;7950\n", 34, fhdlOut);
            filePutString ("KL_Zustand;7951\n", 16, fhdlOut);
            filePutString ("KL_Zustand/Klima_11;7951\n", 25, fhdlOut);
            filePutString ("KL_Zustand/AC11;7951\n", 21, fhdlOut);
            filePutString ("KL_el_Zuheizer_Stufe;7952\n", 26, fhdlOut);
            filePutString ("KL_el_Zuheizer_Stufe/Klima_11;7952\n", 35, fhdlOut);
            filePutString ("KL_el_Zuheizer_Stufe/AC11;7952\n", 31, fhdlOut);
            filePutString ("KL_nachtr_Stopp_Anf;7953\n", 25, fhdlOut);
            filePutString ("KL_nachtr_Stopp_Anf/Klima_11;7953\n", 34, fhdlOut);
            filePutString ("KL_nachtr_Stopp_Anf/AC11;7953\n", 30, fhdlOut);
            filePutString ("KBI_ABS_Lampe;8192\n", 19, fhdlOut);
            filePutString ("KBI_ABS_Lampe/Kombi_01;8192\n", 28, fhdlOut);
            filePutString ("KBI_ABS_Lampe/DSP01;8192\n", 25, fhdlOut);
            filePutString ("KBI_Airbag_Lampe;8193\n", 22, fhdlOut);
            filePutString ("KBI_Airbag_Lampe/Kombi_01;8193\n", 31, fhdlOut);
            filePutString ("KBI_Airbag_Lampe/DSP01;8193\n", 28, fhdlOut);
            filePutString ("KBI_Anzeigefehler_LDW;8194\n", 27, fhdlOut);
            filePutString ("KBI_Anzeigefehler_LDW/Kombi_01;8194\n", 36, fhdlOut);
            filePutString ("KBI_Anzeigefehler_LDW/DSP01;8194\n", 33, fhdlOut);
            filePutString ("KBI_Anzeigefehler_NV;8195\n", 26, fhdlOut);
            filePutString ("KBI_Anzeigefehler_NV/Kombi_01;8195\n", 35, fhdlOut);
            filePutString ("KBI_Anzeigefehler_NV/DSP01;8195\n", 32, fhdlOut);
            filePutString ("KBI_Anzeigefehler_SWA;8196\n", 27, fhdlOut);
            filePutString ("KBI_Anzeigefehler_SWA/Kombi_01;8196\n", 36, fhdlOut);
            filePutString ("KBI_Anzeigefehler_SWA/DSP01;8196\n", 33, fhdlOut);
            filePutString ("KBI_Anzeigestatus_ACC;8197\n", 27, fhdlOut);
            filePutString ("KBI_Anzeigestatus_ACC/Kombi_01;8197\n", 36, fhdlOut);
            filePutString ("KBI_Anzeigestatus_ACC/DSP01;8197\n", 33, fhdlOut);
            filePutString ("KBI_Anzeigestatus_GRA;8198\n", 27, fhdlOut);
            filePutString ("KBI_Anzeigestatus_GRA/Kombi_01;8198\n", 36, fhdlOut);
            filePutString ("KBI_Anzeigestatus_GRA/DSP01;8198\n", 33, fhdlOut);
            filePutString ("KBI_Anzeigestatus_LIM;8199\n", 27, fhdlOut);
            filePutString ("KBI_Anzeigestatus_LIM/Kombi_01;8199\n", 36, fhdlOut);
            filePutString ("KBI_Anzeigestatus_LIM/DSP01;8199\n", 33, fhdlOut);
            filePutString ("KBI_BKL_Lampe;8200\n", 19, fhdlOut);
            filePutString ("KBI_BKL_Lampe/Kombi_01;8200\n", 28, fhdlOut);
            filePutString ("KBI_BKL_Lampe/DSP01;8200\n", 25, fhdlOut);
            filePutString ("KBI_ESP_Lampe;8201\n", 19, fhdlOut);
            filePutString ("KBI_ESP_Lampe/Kombi_01;8201\n", 28, fhdlOut);
            filePutString ("KBI_ESP_Lampe/DSP01;8201\n", 25, fhdlOut);
            filePutString ("KBI_Einheit_Tacho;8202\n", 23, fhdlOut);
            filePutString ("KBI_Einheit_Tacho/Kombi_01;8202\n", 32, fhdlOut);
            filePutString ("KBI_Einheit_Tacho/DSP01;8202\n", 29, fhdlOut);
            filePutString ("KBI_Fehler_Anzeige_ACC;8203\n", 28, fhdlOut);
            filePutString ("KBI_Fehler_Anzeige_ACC/Kombi_01;8203\n", 37, fhdlOut);
            filePutString ("KBI_Fehler_Anzeige_ACC/DSP01;8203\n", 34, fhdlOut);
            filePutString ("KBI_Handbremse;8204\n", 20, fhdlOut);
            filePutString ("KBI_Handbremse/Kombi_01;8204\n", 29, fhdlOut);
            filePutString ("KBI_Handbremse/DSP01;8204\n", 26, fhdlOut);
            filePutString ("KBI_Konsistenz_ACC;8205\n", 24, fhdlOut);
            filePutString ("KBI_Konsistenz_ACC/Kombi_01;8205\n", 33, fhdlOut);
            filePutString ("KBI_Konsistenz_ACC/DSP01;8205\n", 30, fhdlOut);
            filePutString ("KBI_Lenkung_Lampe;8206\n", 23, fhdlOut);
            filePutString ("KBI_Lenkung_Lampe/Kombi_01;8206\n", 32, fhdlOut);
            filePutString ("KBI_Lenkung_Lampe/DSP01;8206\n", 29, fhdlOut);
            filePutString ("KBI_MFA_v_Einheit_01;8207\n", 26, fhdlOut);
            filePutString ("KBI_MFA_v_Einheit_01/Kombi_01;8207\n", 35, fhdlOut);
            filePutString ("KBI_MFA_v_Einheit_01/DSP01;8207\n", 32, fhdlOut);
            filePutString ("KBI_NV_in_Anzeige;8208\n", 23, fhdlOut);
            filePutString ("KBI_NV_in_Anzeige/Kombi_01;8208\n", 32, fhdlOut);
            filePutString ("KBI_NV_in_Anzeige/DSP01;8208\n", 29, fhdlOut);
            filePutString ("KBI_Oeldruck_Schalter;8209\n", 27, fhdlOut);
            filePutString ("KBI_Oeldruck_Schalter/Kombi_01;8209\n", 36, fhdlOut);
            filePutString ("KBI_Oeldruck_Schalter/DSP01;8209\n", 33, fhdlOut);
            filePutString ("KBI_Oeldruckwarnung;8210\n", 25, fhdlOut);
            filePutString ("KBI_Oeldruckwarnung/Kombi_01;8210\n", 34, fhdlOut);
            filePutString ("KBI_Oeldruckwarnung/DSP01;8210\n", 31, fhdlOut);
            filePutString ("KBI_PLA_in_Anzeige;8211\n", 24, fhdlOut);
            filePutString ("KBI_PLA_in_Anzeige/Kombi_01;8211\n", 33, fhdlOut);
            filePutString ("KBI_PLA_in_Anzeige/DSP01;8211\n", 30, fhdlOut);
            filePutString ("KBI_SILA_gueltig;8212\n", 22, fhdlOut);
            filePutString ("KBI_SILA_gueltig/Kombi_01;8212\n", 31, fhdlOut);
            filePutString ("KBI_SILA_gueltig/DSP01;8212\n", 28, fhdlOut);
            filePutString ("KBI_Tankwarnung;8213\n", 21, fhdlOut);
            filePutString ("KBI_Tankwarnung/Kombi_01;8213\n", 30, fhdlOut);
            filePutString ("KBI_Tankwarnung/DSP01;8213\n", 27, fhdlOut);
            filePutString ("KBI_V_Digital;8214\n", 19, fhdlOut);
            filePutString ("KBI_V_Digital/Kombi_01;8214\n", 28, fhdlOut);
            filePutString ("KBI_V_Digital/DSP01;8214\n", 25, fhdlOut);
            filePutString ("KBI_Vorglueh_System_Lampe;8215\n", 31, fhdlOut);
            filePutString ("KBI_Vorglueh_System_Lampe/Kombi_01;8215\n", 40, fhdlOut);
            filePutString ("KBI_Vorglueh_System_Lampe/DSP01;8215\n", 37, fhdlOut);
            filePutString ("KBI_angez_Geschw;8216\n", 22, fhdlOut);
            filePutString ("KBI_angez_Geschw/Kombi_01;8216\n", 31, fhdlOut);
            filePutString ("KBI_angez_Geschw/DSP01;8216\n", 28, fhdlOut);
            filePutString ("KBI_im_Stellgliedtest;8217\n", 27, fhdlOut);
            filePutString ("KBI_im_Stellgliedtest/Kombi_01;8217\n", 36, fhdlOut);
            filePutString ("KBI_im_Stellgliedtest/DSP01;8217\n", 33, fhdlOut);
            filePutString ("Kombi_01_BZ;8218\n", 17, fhdlOut);
            filePutString ("Kombi_01_BZ/Kombi_01;8218\n", 26, fhdlOut);
            filePutString ("Kombi_01_BZ/DSP01;8218\n", 23, fhdlOut);
            filePutString ("KBI_Aussen_Temp_gef;8448\n", 25, fhdlOut);
            filePutString ("KBI_Aussen_Temp_gef/Kombi_02;8448\n", 34, fhdlOut);
            filePutString ("KBI_Aussen_Temp_gef/DSP02;8448\n", 31, fhdlOut);
            filePutString ("KBI_FStatus_Tank;8449\n", 22, fhdlOut);
            filePutString ("KBI_FStatus_Tank/Kombi_02;8449\n", 31, fhdlOut);
            filePutString ("KBI_FStatus_Tank/DSP02;8449\n", 28, fhdlOut);
            filePutString ("KBI_Inhalt_Tank;8450\n", 21, fhdlOut);
            filePutString ("KBI_Inhalt_Tank/Kombi_02;8450\n", 30, fhdlOut);
            filePutString ("KBI_Inhalt_Tank/DSP02;8450\n", 27, fhdlOut);
            filePutString ("KBI_Kilometerstand;8451\n", 24, fhdlOut);
            filePutString ("KBI_Kilometerstand/Kombi_02;8451\n", 33, fhdlOut);
            filePutString ("KBI_Kilometerstand/DSP02;8451\n", 30, fhdlOut);
            filePutString ("KBI_Oelwechsel_durchgefuehrt;8452\n", 34, fhdlOut);
            filePutString ("KBI_Oelwechsel_durchgefuehrt/Kombi_02;8452\n", 43, fhdlOut);
            filePutString ("KBI_Oelwechsel_durchgefuehrt/DSP02;8452\n", 40, fhdlOut);
            filePutString ("KBI_QBit_Aussen_Temp_gef;8453\n", 30, fhdlOut);
            filePutString ("KBI_QBit_Aussen_Temp_gef/Kombi_02;8453\n", 39, fhdlOut);
            filePutString ("KBI_QBit_Aussen_Temp_gef/DSP02;8453\n", 36, fhdlOut);
            filePutString ("KBI_RDK_Kalibrier_Anf;8454\n", 27, fhdlOut);
            filePutString ("KBI_RDK_Kalibrier_Anf/Kombi_02;8454\n", 36, fhdlOut);
            filePutString ("KBI_RDK_Kalibrier_Anf/DSP02;8454\n", 33, fhdlOut);
            filePutString ("KBI_Standzeit_02;8455\n", 22, fhdlOut);
            filePutString ("KBI_Standzeit_02/Kombi_02;8455\n", 31, fhdlOut);
            filePutString ("KBI_Standzeit_02/DSP02;8455\n", 28, fhdlOut);
            filePutString ("LWI_01_BZ;8704\n", 15, fhdlOut);
            filePutString ("LWI_01_BZ/LWI_01;8704\n", 22, fhdlOut);
            filePutString ("LWI_01_BZ/LWI01;8704\n", 21, fhdlOut);
            filePutString ("LWI_01_CRC;8705\n", 16, fhdlOut);
            filePutString ("LWI_01_CRC/LWI_01;8705\n", 23, fhdlOut);
            filePutString ("LWI_01_CRC/LWI01;8705\n", 22, fhdlOut);
            filePutString ("LWI_Lenkradw_Geschw;8706\n", 25, fhdlOut);
            filePutString ("LWI_Lenkradw_Geschw/LWI_01;8706\n", 32, fhdlOut);
            filePutString ("LWI_Lenkradw_Geschw/LWI01;8706\n", 31, fhdlOut);
            filePutString ("LWI_Lenkradwinkel;8707\n", 23, fhdlOut);
            filePutString ("LWI_Lenkradwinkel/LWI_01;8707\n", 30, fhdlOut);
            filePutString ("LWI_Lenkradwinkel/LWI01;8707\n", 29, fhdlOut);
            filePutString ("LWI_QBit_Lenkradwinkel;8708\n", 28, fhdlOut);
            filePutString ("LWI_QBit_Lenkradwinkel/LWI_01;8708\n", 35, fhdlOut);
            filePutString ("LWI_QBit_Lenkradwinkel/LWI01;8708\n", 34, fhdlOut);
            filePutString ("LWI_QBit_Sub_Daten;8709\n", 24, fhdlOut);
            filePutString ("LWI_QBit_Sub_Daten/LWI_01;8709\n", 31, fhdlOut);
            filePutString ("LWI_QBit_Sub_Daten/LWI01;8709\n", 30, fhdlOut);
            filePutString ("LWI_Sensorstatus;8710\n", 22, fhdlOut);
            filePutString ("LWI_Sensorstatus/LWI_01;8710\n", 29, fhdlOut);
            filePutString ("LWI_Sensorstatus/LWI01;8710\n", 28, fhdlOut);
            filePutString ("LWI_Sub_Daten;8711\n", 19, fhdlOut);
            filePutString ("LWI_Sub_Daten/LWI_01;8711\n", 26, fhdlOut);
            filePutString ("LWI_Sub_Daten/LWI01;8711\n", 25, fhdlOut);
            filePutString ("LWI_VZ_Lenkradw_Geschw;8712\n", 28, fhdlOut);
            filePutString ("LWI_VZ_Lenkradw_Geschw/LWI_01;8712\n", 35, fhdlOut);
            filePutString ("LWI_VZ_Lenkradw_Geschw/LWI01;8712\n", 34, fhdlOut);
            filePutString ("LWI_VZ_Lenkradwinkel;8713\n", 26, fhdlOut);
            filePutString ("LWI_VZ_Lenkradwinkel/LWI_01;8713\n", 33, fhdlOut);
            filePutString ("LWI_VZ_Lenkradwinkel/LWI01;8713\n", 32, fhdlOut);
            filePutString ("BCM2_Bremsl_durch_ECD;8960\n", 27, fhdlOut);
            filePutString ("BCM2_Bremsl_durch_ECD/Licht_hinten_01;8960\n", 43, fhdlOut);
            filePutString ("BCM2_Bremsl_durch_ECD/LH01;8960\n", 32, fhdlOut);
            filePutString ("LH_3_Bremsl_def;8961\n", 21, fhdlOut);
            filePutString ("LH_3_Bremsl_def/Licht_hinten_01;8961\n", 37, fhdlOut);
            filePutString ("LH_3_Bremsl_def/LH01;8961\n", 26, fhdlOut);
            filePutString ("LH_Aussenlicht_def;8962\n", 24, fhdlOut);
            filePutString ("LH_Aussenlicht_def/Licht_hinten_01;8962\n", 40, fhdlOut);
            filePutString ("LH_Aussenlicht_def/LH01;8962\n", 29, fhdlOut);
            filePutString ("LH_Blinker_HL_akt;8963\n", 23, fhdlOut);
            filePutString ("LH_Blinker_HL_akt/Licht_hinten_01;8963\n", 39, fhdlOut);
            filePutString ("LH_Blinker_HL_akt/LH01;8963\n", 28, fhdlOut);
            filePutString ("LH_Blinker_HR_akt;8964\n", 23, fhdlOut);
            filePutString ("LH_Blinker_HR_akt/Licht_hinten_01;8964\n", 39, fhdlOut);
            filePutString ("LH_Blinker_HR_akt/LH01;8964\n", 28, fhdlOut);
            filePutString ("LH_Blinker_li_def;8965\n", 23, fhdlOut);
            filePutString ("LH_Blinker_li_def/Licht_hinten_01;8965\n", 39, fhdlOut);
            filePutString ("LH_Blinker_li_def/LH01;8965\n", 28, fhdlOut);
            filePutString ("LH_Blinker_re_def;8966\n", 23, fhdlOut);
            filePutString ("LH_Blinker_re_def/Licht_hinten_01;8966\n", 39, fhdlOut);
            filePutString ("LH_Blinker_re_def/LH01;8966\n", 28, fhdlOut);
            filePutString ("LH_Brems_Blk_li_def;8967\n", 25, fhdlOut);
            filePutString ("LH_Brems_Blk_li_def/Licht_hinten_01;8967\n", 41, fhdlOut);
            filePutString ("LH_Brems_Blk_li_def/LH01;8967\n", 30, fhdlOut);
            filePutString ("LH_Brems_Blk_re_def;8968\n", 25, fhdlOut);
            filePutString ("LH_Brems_Blk_re_def/Licht_hinten_01;8968\n", 41, fhdlOut);
            filePutString ("LH_Brems_Blk_re_def/LH01;8968\n", 30, fhdlOut);
            filePutString ("LH_Bremsl_li_def;8969\n", 22, fhdlOut);
            filePutString ("LH_Bremsl_li_def/Licht_hinten_01;8969\n", 38, fhdlOut);
            filePutString ("LH_Bremsl_li_def/LH01;8969\n", 27, fhdlOut);
            filePutString ("LH_Bremsl_li_ges_def;8970\n", 26, fhdlOut);
            filePutString ("LH_Bremsl_li_ges_def/Licht_hinten_01;8970\n", 42, fhdlOut);
            filePutString ("LH_Bremsl_li_ges_def/LH01;8970\n", 31, fhdlOut);
            filePutString ("LH_Bremsl_re_def;8971\n", 22, fhdlOut);
            filePutString ("LH_Bremsl_re_def/Licht_hinten_01;8971\n", 38, fhdlOut);
            filePutString ("LH_Bremsl_re_def/LH01;8971\n", 27, fhdlOut);
            filePutString ("LH_Bremsl_re_ges_def;8972\n", 26, fhdlOut);
            filePutString ("LH_Bremsl_re_ges_def/Licht_hinten_01;8972\n", 42, fhdlOut);
            filePutString ("LH_Bremsl_re_ges_def/LH01;8972\n", 31, fhdlOut);
            filePutString ("LH_Bremslicht_H_aktiv;8973\n", 27, fhdlOut);
            filePutString ("LH_Bremslicht_H_aktiv/Licht_hinten_01;8973\n", 43, fhdlOut);
            filePutString ("LH_Bremslicht_H_aktiv/LH01;8973\n", 32, fhdlOut);
            filePutString ("LH_Kennzl_def;8974\n", 19, fhdlOut);
            filePutString ("LH_Kennzl_def/Licht_hinten_01;8974\n", 35, fhdlOut);
            filePutString ("LH_Kennzl_def/LH01;8974\n", 24, fhdlOut);
            filePutString ("LH_Nebel_li_def;8975\n", 21, fhdlOut);
            filePutString ("LH_Nebel_li_def/Licht_hinten_01;8975\n", 37, fhdlOut);
            filePutString ("LH_Nebel_li_def/LH01;8975\n", 26, fhdlOut);
            filePutString ("LH_Nebel_mi_def;8976\n", 21, fhdlOut);
            filePutString ("LH_Nebel_mi_def/Licht_hinten_01;8976\n", 37, fhdlOut);
            filePutString ("LH_Nebel_mi_def/LH01;8976\n", 26, fhdlOut);
            filePutString ("LH_Nebel_re_def;8977\n", 21, fhdlOut);
            filePutString ("LH_Nebel_re_def/Licht_hinten_01;8977\n", 37, fhdlOut);
            filePutString ("LH_Nebel_re_def/LH01;8977\n", 26, fhdlOut);
            filePutString ("LH_Nebelschluss_aktiv;8978\n", 27, fhdlOut);
            filePutString ("LH_Nebelschluss_aktiv/Licht_hinten_01;8978\n", 43, fhdlOut);
            filePutString ("LH_Nebelschluss_aktiv/LH01;8978\n", 32, fhdlOut);
            filePutString ("LH_Parklicht_HL_aktiv;8979\n", 27, fhdlOut);
            filePutString ("LH_Parklicht_HL_aktiv/Licht_hinten_01;8979\n", 43, fhdlOut);
            filePutString ("LH_Parklicht_HL_aktiv/LH01;8979\n", 32, fhdlOut);
            filePutString ("LH_Parklicht_HR_aktiv;8980\n", 27, fhdlOut);
            filePutString ("LH_Parklicht_HR_aktiv/Licht_hinten_01;8980\n", 43, fhdlOut);
            filePutString ("LH_Parklicht_HR_aktiv/LH01;8980\n", 32, fhdlOut);
            filePutString ("LH_Rueckf_li_def;8981\n", 22, fhdlOut);
            filePutString ("LH_Rueckf_li_def/Licht_hinten_01;8981\n", 38, fhdlOut);
            filePutString ("LH_Rueckf_li_def/LH01;8981\n", 27, fhdlOut);
            filePutString ("LH_Rueckf_mi_def;8982\n", 22, fhdlOut);
            filePutString ("LH_Rueckf_mi_def/Licht_hinten_01;8982\n", 38, fhdlOut);
            filePutString ("LH_Rueckf_mi_def/LH01;8982\n", 27, fhdlOut);
            filePutString ("LH_Rueckf_re_def;8983\n", 22, fhdlOut);
            filePutString ("LH_Rueckf_re_def/Licht_hinten_01;8983\n", 38, fhdlOut);
            filePutString ("LH_Rueckf_re_def/LH01;8983\n", 27, fhdlOut);
            filePutString ("LH_Rueckfahrlicht_aktiv;8984\n", 29, fhdlOut);
            filePutString ("LH_Rueckfahrlicht_aktiv/Licht_hinten_01;8984\n", 45, fhdlOut);
            filePutString ("LH_Rueckfahrlicht_aktiv/LH01;8984\n", 34, fhdlOut);
            filePutString ("LH_SL_BRL_BLK_li_def;8985\n", 26, fhdlOut);
            filePutString ("LH_SL_BRL_BLK_li_def/Licht_hinten_01;8985\n", 42, fhdlOut);
            filePutString ("LH_SL_BRL_BLK_li_def/LH01;8985\n", 31, fhdlOut);
            filePutString ("LH_SL_BRL_BLK_re_def;8986\n", 26, fhdlOut);
            filePutString ("LH_SL_BRL_BLK_re_def/Licht_hinten_01;8986\n", 42, fhdlOut);
            filePutString ("LH_SL_BRL_BLK_re_def/LH01;8986\n", 31, fhdlOut);
            filePutString ("LH_Schluss_Brems_Nebel_li_def;8987\n", 35, fhdlOut);
            filePutString ("LH_Schluss_Brems_Nebel_li_def/Licht_hinten_01;8987\n", 51, fhdlOut);
            filePutString ("LH_Schluss_Brems_Nebel_li_def/LH01;8987\n", 40, fhdlOut);
            filePutString ("LH_Schluss_Brems_Nebel_re_def;8988\n", 35, fhdlOut);
            filePutString ("LH_Schluss_Brems_Nebel_re_def/Licht_hinten_01;8988\n", 51, fhdlOut);
            filePutString ("LH_Schluss_Brems_Nebel_re_def/LH01;8988\n", 40, fhdlOut);
            filePutString ("LH_Schluss_Brems_li_def;8989\n", 29, fhdlOut);
            filePutString ("LH_Schluss_Brems_li_def/Licht_hinten_01;8989\n", 45, fhdlOut);
            filePutString ("LH_Schluss_Brems_li_def/LH01;8989\n", 34, fhdlOut);
            filePutString ("LH_Schluss_Brems_re_def;8990\n", 29, fhdlOut);
            filePutString ("LH_Schluss_Brems_re_def/Licht_hinten_01;8990\n", 45, fhdlOut);
            filePutString ("LH_Schluss_Brems_re_def/LH01;8990\n", 34, fhdlOut);
            filePutString ("LH_Schluss_Nebel_li_def;8991\n", 29, fhdlOut);
            filePutString ("LH_Schluss_Nebel_li_def/Licht_hinten_01;8991\n", 45, fhdlOut);
            filePutString ("LH_Schluss_Nebel_li_def/LH01;8991\n", 34, fhdlOut);
            filePutString ("LH_Schluss_Nebel_re_def;8992\n", 29, fhdlOut);
            filePutString ("LH_Schluss_Nebel_re_def/Licht_hinten_01;8992\n", 45, fhdlOut);
            filePutString ("LH_Schluss_Nebel_re_def/LH01;8992\n", 34, fhdlOut);
            filePutString ("LH_Schlusslicht_li_def;8993\n", 28, fhdlOut);
            filePutString ("LH_Schlusslicht_li_def/Licht_hinten_01;8993\n", 44, fhdlOut);
            filePutString ("LH_Schlusslicht_li_def/LH01;8993\n", 33, fhdlOut);
            filePutString ("LH_Schlusslicht_re_def;8994\n", 28, fhdlOut);
            filePutString ("LH_Schlusslicht_re_def/Licht_hinten_01;8994\n", 44, fhdlOut);
            filePutString ("LH_Schlusslicht_re_def/LH01;8994\n", 33, fhdlOut);
            filePutString ("LH_Standlicht_H_aktiv;8995\n", 27, fhdlOut);
            filePutString ("LH_Standlicht_H_aktiv/Licht_hinten_01;8995\n", 43, fhdlOut);
            filePutString ("LH_Standlicht_H_aktiv/LH01;8995\n", 32, fhdlOut);
            filePutString ("Licht_hinten_01_BZ;8996\n", 24, fhdlOut);
            filePutString ("Licht_hinten_01_BZ/Licht_hinten_01;8996\n", 40, fhdlOut);
            filePutString ("Licht_hinten_01_BZ/LH01;8996\n", 29, fhdlOut);
            filePutString ("NM_Gateway_ACAN_Aktivitaet;9216\n", 32, fhdlOut);
            filePutString ("NM_Gateway_ACAN_Aktivitaet/NMH_Gateway;9216\n", 44, fhdlOut);
            filePutString ("NM_Gateway_ACAN_Aktivitaet/NMH_Gateway;9216\n", 44, fhdlOut);
            filePutString ("NM_Gateway_Bedien_LIN_Aktivitaet;9217\n", 38, fhdlOut);
            filePutString ("NM_Gateway_Bedien_LIN_Aktivitaet/NMH_Gateway;9217\n", 50, fhdlOut);
            filePutString ("NM_Gateway_Bedien_LIN_Aktivitaet/NMH_Gateway;9217\n", 50, fhdlOut);
            filePutString ("NM_Gateway_Car_Wakeup;9218\n", 27, fhdlOut);
            filePutString ("NM_Gateway_Car_Wakeup/NMH_Gateway;9218\n", 39, fhdlOut);
            filePutString ("NM_Gateway_Car_Wakeup/NMH_Gateway;9218\n", 39, fhdlOut);
            filePutString ("NM_Gateway_DiagCAN_Aktivitaet;9219\n", 35, fhdlOut);
            filePutString ("NM_Gateway_DiagCAN_Aktivitaet/NMH_Gateway;9219\n", 47, fhdlOut);
            filePutString ("NM_Gateway_DiagCAN_Aktivitaet/NMH_Gateway;9219\n", 47, fhdlOut);
            filePutString ("NM_Gateway_ECAN_Aktivitaet;9220\n", 32, fhdlOut);
            filePutString ("NM_Gateway_ECAN_Aktivitaet/NMH_Gateway;9220\n", 44, fhdlOut);
            filePutString ("NM_Gateway_ECAN_Aktivitaet/NMH_Gateway;9220\n", 44, fhdlOut);
            filePutString ("NM_Gateway_EM_Aktivitaet;9221\n", 30, fhdlOut);
            filePutString ("NM_Gateway_EM_Aktivitaet/NMH_Gateway;9221\n", 42, fhdlOut);
            filePutString ("NM_Gateway_EM_Aktivitaet/NMH_Gateway;9221\n", 42, fhdlOut);
            filePutString ("NM_Gateway_EnergieLIN_Aktivitaet;9222\n", 38, fhdlOut);
            filePutString ("NM_Gateway_EnergieLIN_Aktivitaet/NMH_Gateway;9222\n", 50, fhdlOut);
            filePutString ("NM_Gateway_EnergieLIN_Aktivitaet/NMH_Gateway;9222\n", 50, fhdlOut);
            filePutString ("NM_Gateway_FCAN_Aktivitaet;9223\n", 32, fhdlOut);
            filePutString ("NM_Gateway_FCAN_Aktivitaet/NMH_Gateway;9223\n", 44, fhdlOut);
            filePutString ("NM_Gateway_FCAN_Aktivitaet/NMH_Gateway;9223\n", 44, fhdlOut);
            filePutString ("NM_Gateway_ICAN_Aktivitaet;9224\n", 32, fhdlOut);
            filePutString ("NM_Gateway_ICAN_Aktivitaet/NMH_Gateway;9224\n", 44, fhdlOut);
            filePutString ("NM_Gateway_ICAN_Aktivitaet/NMH_Gateway;9224\n", 44, fhdlOut);
            filePutString ("NM_Gateway_KCAN_Aktivitaet;9225\n", 32, fhdlOut);
            filePutString ("NM_Gateway_KCAN_Aktivitaet/NMH_Gateway;9225\n", 44, fhdlOut);
            filePutString ("NM_Gateway_KCAN_Aktivitaet/NMH_Gateway;9225\n", 44, fhdlOut);
            filePutString ("NM_Gateway_KS_Aktivitaet;9226\n", 30, fhdlOut);
            filePutString ("NM_Gateway_KS_Aktivitaet/NMH_Gateway;9226\n", 42, fhdlOut);
            filePutString ("NM_Gateway_KS_Aktivitaet/NMH_Gateway;9226\n", 42, fhdlOut);
            filePutString ("NM_Gateway_NL_EM;9227\n", 22, fhdlOut);
            filePutString ("NM_Gateway_NL_EM/NMH_Gateway;9227\n", 34, fhdlOut);
            filePutString ("NM_Gateway_NL_EM/NMH_Gateway;9227\n", 34, fhdlOut);
            filePutString ("NM_Gateway_NL_Shutdown;9228\n", 28, fhdlOut);
            filePutString ("NM_Gateway_NL_Shutdown/NMH_Gateway;9228\n", 40, fhdlOut);
            filePutString ("NM_Gateway_NL_Shutdown/NMH_Gateway;9228\n", 40, fhdlOut);
            filePutString ("NM_Gateway_NL_Spg_Messung;9229\n", 31, fhdlOut);
            filePutString ("NM_Gateway_NL_Spg_Messung/NMH_Gateway;9229\n", 43, fhdlOut);
            filePutString ("NM_Gateway_NL_Spg_Messung/NMH_Gateway;9229\n", 43, fhdlOut);
            filePutString ("NM_Gateway_NL_Wakeup_Monitor;9230\n", 34, fhdlOut);
            filePutString ("NM_Gateway_NL_Wakeup_Monitor/NMH_Gateway;9230\n", 46, fhdlOut);
            filePutString ("NM_Gateway_NL_Wakeup_Monitor/NMH_Gateway;9230\n", 46, fhdlOut);
            filePutString ("NM_Gateway_NM_State;9231\n", 25, fhdlOut);
            filePutString ("NM_Gateway_NM_State/NMH_Gateway;9231\n", 37, fhdlOut);
            filePutString ("NM_Gateway_NM_State/NMH_Gateway;9231\n", 37, fhdlOut);
            filePutString ("NM_Gateway_NM_aktiv_Diagnose;9232\n", 34, fhdlOut);
            filePutString ("NM_Gateway_NM_aktiv_Diagnose/NMH_Gateway;9232\n", 46, fhdlOut);
            filePutString ("NM_Gateway_NM_aktiv_Diagnose/NMH_Gateway;9232\n", 46, fhdlOut);
            filePutString ("NM_Gateway_NM_aktiv_KL15;9233\n", 30, fhdlOut);
            filePutString ("NM_Gateway_NM_aktiv_KL15/NMH_Gateway;9233\n", 42, fhdlOut);
            filePutString ("NM_Gateway_NM_aktiv_KL15/NMH_Gateway;9233\n", 42, fhdlOut);
            filePutString ("NM_Gateway_NM_aktiv_Tmin;9234\n", 30, fhdlOut);
            filePutString ("NM_Gateway_NM_aktiv_Tmin/NMH_Gateway;9234\n", 42, fhdlOut);
            filePutString ("NM_Gateway_NM_aktiv_Tmin/NMH_Gateway;9234\n", 42, fhdlOut);
            filePutString ("NM_Gateway_SNI;9235\n", 20, fhdlOut);
            filePutString ("NM_Gateway_SNI/NMH_Gateway;9235\n", 32, fhdlOut);
            filePutString ("NM_Gateway_SNI/NMH_Gateway;9235\n", 32, fhdlOut);
            filePutString ("NM_Gateway_UDS_CC;9236\n", 23, fhdlOut);
            filePutString ("NM_Gateway_UDS_CC/NMH_Gateway;9236\n", 35, fhdlOut);
            filePutString ("NM_Gateway_UDS_CC/NMH_Gateway;9236\n", 35, fhdlOut);
            filePutString ("NM_Gateway_Wakeup;9237\n", 23, fhdlOut);
            filePutString ("NM_Gateway_Wakeup/NMH_Gateway;9237\n", 35, fhdlOut);
            filePutString ("NM_Gateway_Wakeup/NMH_Gateway;9237\n", 35, fhdlOut);
            filePutString ("OBD_TG_F_Status_1;9472\n", 23, fhdlOut);
            filePutString ("OBD_TG_F_Status_1/OBD_Tankgeber_01;9472\n", 40, fhdlOut);
            filePutString ("OBD_TG_F_Status_1/FLS01;9472\n", 29, fhdlOut);
            filePutString ("OBD_TG_F_Status_2;9473\n", 23, fhdlOut);
            filePutString ("OBD_TG_F_Status_2/OBD_Tankgeber_01;9473\n", 40, fhdlOut);
            filePutString ("OBD_TG_F_Status_2/FLS01;9473\n", 29, fhdlOut);
            filePutString ("OBD_TG_F_Status_3;9474\n", 23, fhdlOut);
            filePutString ("OBD_TG_F_Status_3/OBD_Tankgeber_01;9474\n", 40, fhdlOut);
            filePutString ("OBD_TG_F_Status_3/FLS01;9474\n", 29, fhdlOut);
            filePutString ("OBD_TG_F_Status_4;9475\n", 23, fhdlOut);
            filePutString ("OBD_TG_F_Status_4/OBD_Tankgeber_01;9475\n", 40, fhdlOut);
            filePutString ("OBD_TG_F_Status_4/FLS01;9475\n", 29, fhdlOut);
            filePutString ("OBD_TG_Sens_Rohwert_1;9476\n", 27, fhdlOut);
            filePutString ("OBD_TG_Sens_Rohwert_1/OBD_Tankgeber_01;9476\n", 44, fhdlOut);
            filePutString ("OBD_TG_Sens_Rohwert_1/FLS01;9476\n", 33, fhdlOut);
            filePutString ("OBD_TG_Sens_Rohwert_2;9477\n", 27, fhdlOut);
            filePutString ("OBD_TG_Sens_Rohwert_2/OBD_Tankgeber_01;9477\n", 44, fhdlOut);
            filePutString ("OBD_TG_Sens_Rohwert_2/FLS01;9477\n", 33, fhdlOut);
            filePutString ("OBD_TG_Sens_Rohwert_3;9478\n", 27, fhdlOut);
            filePutString ("OBD_TG_Sens_Rohwert_3/OBD_Tankgeber_01;9478\n", 44, fhdlOut);
            filePutString ("OBD_TG_Sens_Rohwert_3/FLS01;9478\n", 33, fhdlOut);
            filePutString ("OBD_TG_Sens_Rohwert_4;9479\n", 27, fhdlOut);
            filePutString ("OBD_TG_Sens_Rohwert_4/OBD_Tankgeber_01;9479\n", 44, fhdlOut);
            filePutString ("OBD_TG_Sens_Rohwert_4/FLS01;9479\n", 33, fhdlOut);
            filePutString ("RSF_Tastencode_1;9728\n", 22, fhdlOut);
            filePutString ("RSF_Tastencode_1/Remotestart_FFB;9728\n", 38, fhdlOut);
            filePutString ("RSF_Tastencode_1/RCS1;9728\n", 27, fhdlOut);
            filePutString ("RSF_Tastencode_2;9729\n", 22, fhdlOut);
            filePutString ("RSF_Tastencode_2/Remotestart_FFB;9729\n", 38, fhdlOut);
            filePutString ("RSF_Tastencode_2/RCS1;9729\n", 27, fhdlOut);
            filePutString ("RSF_Tastencode_Maske;9730\n", 26, fhdlOut);
            filePutString ("RSF_Tastencode_Maske/Remotestart_FFB;9730\n", 42, fhdlOut);
            filePutString ("RSF_Tastencode_Maske/RCS1;9730\n", 31, fhdlOut);
            filePutString ("STH_EKP_Anst;9984\n", 18, fhdlOut);
            filePutString ("STH_EKP_Anst/STH_01;9984\n", 25, fhdlOut);
            filePutString ("STH_EKP_Anst/STH01;9984\n", 24, fhdlOut);
            filePutString ("STH_Fehler_ElWaPu;9985\n", 23, fhdlOut);
            filePutString ("STH_Fehler_ElWaPu/STH_01;9985\n", 30, fhdlOut);
            filePutString ("STH_Fehler_ElWaPu/STH01;9985\n", 29, fhdlOut);
            filePutString ("STH_Fehlerstatus;9986\n", 22, fhdlOut);
            filePutString ("STH_Fehlerstatus/STH_01;9986\n", 29, fhdlOut);
            filePutString ("STH_Fehlerstatus/STH01;9986\n", 28, fhdlOut);
            filePutString ("STH_Funk_aus;9987\n", 18, fhdlOut);
            filePutString ("STH_Funk_aus/STH_01;9987\n", 25, fhdlOut);
            filePutString ("STH_Funk_aus/STH01;9987\n", 24, fhdlOut);
            filePutString ("STH_Funk_ein;9988\n", 18, fhdlOut);
            filePutString ("STH_Funk_ein/STH_01;9988\n", 25, fhdlOut);
            filePutString ("STH_Funk_ein/STH01;9988\n", 24, fhdlOut);
            filePutString ("STH_Geblaese;9989\n", 18, fhdlOut);
            filePutString ("STH_Geblaese/STH_01;9989\n", 25, fhdlOut);
            filePutString ("STH_Geblaese/STH01;9989\n", 24, fhdlOut);
            filePutString ("STH_Heizleistung;9990\n", 22, fhdlOut);
            filePutString ("STH_Heizleistung/STH_01;9990\n", 29, fhdlOut);
            filePutString ("STH_Heizleistung/STH01;9990\n", 28, fhdlOut);
            filePutString ("STH_KD_Fehler;9991\n", 19, fhdlOut);
            filePutString ("STH_KD_Fehler/STH_01;9991\n", 26, fhdlOut);
            filePutString ("STH_KD_Fehler/STH01;9991\n", 25, fhdlOut);
            filePutString ("STH_KVS;9992\n", 13, fhdlOut);
            filePutString ("STH_KVS/STH_01;9992\n", 20, fhdlOut);
            filePutString ("STH_KVS/STH01;9992\n", 19, fhdlOut);
            filePutString ("STH_KVS_Ueberlauf;9993\n", 23, fhdlOut);
            filePutString ("STH_KVS_Ueberlauf/STH_01;9993\n", 30, fhdlOut);
            filePutString ("STH_KVS_Ueberlauf/STH01;9993\n", 29, fhdlOut);
            filePutString ("STH_LED;9994\n", 13, fhdlOut);
            filePutString ("STH_LED/STH_01;9994\n", 20, fhdlOut);
            filePutString ("STH_LED/STH01;9994\n", 19, fhdlOut);
            filePutString ("STH_Motorvorwaermung;9995\n", 26, fhdlOut);
            filePutString ("STH_Motorvorwaermung/STH_01;9995\n", 33, fhdlOut);
            filePutString ("STH_Motorvorwaermung/STH01;9995\n", 32, fhdlOut);
            filePutString ("STH_Pumpe_ein;9996\n", 19, fhdlOut);
            filePutString ("STH_Pumpe_ein/STH_01;9996\n", 26, fhdlOut);
            filePutString ("STH_Pumpe_ein/STH01;9996\n", 25, fhdlOut);
            filePutString ("STH_Pumpen_Anf_extern;9997\n", 27, fhdlOut);
            filePutString ("STH_Pumpen_Anf_extern/STH_01;9997\n", 34, fhdlOut);
            filePutString ("STH_Pumpen_Anf_extern/STH01;9997\n", 33, fhdlOut);
            filePutString ("STH_Servicemode;9998\n", 21, fhdlOut);
            filePutString ("STH_Servicemode/STH_01;9998\n", 28, fhdlOut);
            filePutString ("STH_Servicemode/STH01;9998\n", 27, fhdlOut);
            filePutString ("STH_Start_folgt;9999\n", 21, fhdlOut);
            filePutString ("STH_Start_folgt/STH_01;9999\n", 28, fhdlOut);
            filePutString ("STH_Start_folgt/STH01;9999\n", 27, fhdlOut);
            filePutString ("STH_Texte;10000\n", 16, fhdlOut);
            filePutString ("STH_Texte/STH_01;10000\n", 23, fhdlOut);
            filePutString ("STH_Texte/STH01;10000\n", 22, fhdlOut);
            filePutString ("STH_Ventil_Status;10001\n", 24, fhdlOut);
            filePutString ("STH_Ventil_Status/STH_01;10001\n", 31, fhdlOut);
            filePutString ("STH_Ventil_Status/STH01;10001\n", 30, fhdlOut);
            filePutString ("STH_Ventiloeffnungszeit;10002\n", 30, fhdlOut);
            filePutString ("STH_Ventiloeffnungszeit/STH_01;10002\n", 37, fhdlOut);
            filePutString ("STH_Ventiloeffnungszeit/STH01;10002\n", 36, fhdlOut);
            filePutString ("STH_Waermeeintrag;10003\n", 24, fhdlOut);
            filePutString ("STH_Waermeeintrag/STH_01;10003\n", 31, fhdlOut);
            filePutString ("STH_Waermeeintrag/STH01;10003\n", 30, fhdlOut);
            filePutString ("STH_Wassertemp;10004\n", 21, fhdlOut);
            filePutString ("STH_Wassertemp/STH_01;10004\n", 28, fhdlOut);
            filePutString ("STH_Wassertemp/STH01;10004\n", 27, fhdlOut);
            filePutString ("STH_Zusatzheizung;10005\n", 24, fhdlOut);
            filePutString ("STH_Zusatzheizung/STH_01;10005\n", 31, fhdlOut);
            filePutString ("STH_Zusatzheizung/STH01;10005\n", 30, fhdlOut);
            filePutString ("STH_war_aktiv;10006\n", 20, fhdlOut);
            filePutString ("STH_war_aktiv/STH_01;10006\n", 27, fhdlOut);
            filePutString ("STH_war_aktiv/STH01;10006\n", 26, fhdlOut);
            filePutString ("STS_01_BZ;10240\n", 16, fhdlOut);
            filePutString ("STS_01_BZ/STS_01;10240\n", 23, fhdlOut);
            filePutString ("STS_01_BZ/STS01;10240\n", 22, fhdlOut);
            filePutString ("STS_01_CRC;10241\n", 17, fhdlOut);
            filePutString ("STS_01_CRC/STS_01;10241\n", 24, fhdlOut);
            filePutString ("STS_01_CRC/STS01;10241\n", 23, fhdlOut);
            filePutString ("STS_Alarm_Blinker;10242\n", 24, fhdlOut);
            filePutString ("STS_Alarm_Blinker/STS_01;10242\n", 31, fhdlOut);
            filePutString ("STS_Alarm_Blinker/STS01;10242\n", 30, fhdlOut);
            filePutString ("STS_Alarm_still;10243\n", 22, fhdlOut);
            filePutString ("STS_Alarm_still/STS_01;10243\n", 29, fhdlOut);
            filePutString ("STS_Alarm_still/STS01;10243\n", 28, fhdlOut);
            filePutString ("STS_Anlassersperre;10244\n", 25, fhdlOut);
            filePutString ("STS_Anlassersperre/STS_01;10244\n", 32, fhdlOut);
            filePutString ("STS_Anlassersperre/STS01;10244\n", 31, fhdlOut);
            filePutString ("STS_Car_not_under_theft;10245\n", 30, fhdlOut);
            filePutString ("STS_Car_not_under_theft/STS_01;10245\n", 37, fhdlOut);
            filePutString ("STS_Car_not_under_theft/STS01;10245\n", 36, fhdlOut);
            filePutString ("STS_Car_under_theft;10246\n", 26, fhdlOut);
            filePutString ("STS_Car_under_theft/STS_01;10246\n", 33, fhdlOut);
            filePutString ("STS_Car_under_theft/STS01;10246\n", 32, fhdlOut);
            filePutString ("STS_Fahrlicht;10247\n", 20, fhdlOut);
            filePutString ("STS_Fahrlicht/STS_01;10247\n", 27, fhdlOut);
            filePutString ("STS_Fahrlicht/STS01;10247\n", 26, fhdlOut);
            filePutString ("STS_LIN_aktiv;10248\n", 20, fhdlOut);
            filePutString ("STS_LIN_aktiv/STS_01;10248\n", 27, fhdlOut);
            filePutString ("STS_LIN_aktiv/STS01;10248\n", 26, fhdlOut);
            filePutString ("STS_Laderelais;10249\n", 21, fhdlOut);
            filePutString ("STS_Laderelais/STS_01;10249\n", 28, fhdlOut);
            filePutString ("STS_Laderelais/STS01;10249\n", 27, fhdlOut);
            filePutString ("STS_Leerlaufschaltung;10250\n", 28, fhdlOut);
            filePutString ("STS_Leerlaufschaltung/STS_01;10250\n", 35, fhdlOut);
            filePutString ("STS_Leerlaufschaltung/STS01;10250\n", 34, fhdlOut);
            filePutString ("STS_Notstart;10251\n", 19, fhdlOut);
            filePutString ("STS_Notstart/STS_01;10251\n", 26, fhdlOut);
            filePutString ("STS_Notstart/STS01;10251\n", 25, fhdlOut);
            filePutString ("STS_Signalhorn;10252\n", 21, fhdlOut);
            filePutString ("STS_Signalhorn/STS_01;10252\n", 28, fhdlOut);
            filePutString ("STS_Signalhorn/STS01;10252\n", 27, fhdlOut);
            filePutString ("STS_Standlicht;10253\n", 21, fhdlOut);
            filePutString ("STS_Standlicht/STS_01;10253\n", 28, fhdlOut);
            filePutString ("STS_Standlicht/STS01;10253\n", 27, fhdlOut);
            filePutString ("STS_Summer;10254\n", 17, fhdlOut);
            filePutString ("STS_Summer/STS_01;10254\n", 24, fhdlOut);
            filePutString ("STS_Summer/STS01;10254\n", 23, fhdlOut);
            filePutString ("STS_Texte;10255\n", 16, fhdlOut);
            filePutString ("STS_Texte/STS_01;10255\n", 23, fhdlOut);
            filePutString ("STS_Texte/STS01;10255\n", 22, fhdlOut);
            filePutString ("STS_Typencodierung;10256\n", 25, fhdlOut);
            filePutString ("STS_Typencodierung/STS_01;10256\n", 32, fhdlOut);
            filePutString ("STS_Typencodierung/STS01;10256\n", 31, fhdlOut);
            filePutString ("GW_KD_Fehler;10496\n", 19, fhdlOut);
            filePutString ("GW_KD_Fehler/Systeminfo_01;10496\n", 33, fhdlOut);
            filePutString ("GW_KD_Fehler/SYS01;10496\n", 25, fhdlOut);
            filePutString ("SI_BUS_01;10497\n", 16, fhdlOut);
            filePutString ("SI_BUS_01/Systeminfo_01;10497\n", 30, fhdlOut);
            filePutString ("SI_BUS_01/SYS01;10497\n", 22, fhdlOut);
            filePutString ("SI_BUS_02;10498\n", 16, fhdlOut);
            filePutString ("SI_BUS_02/Systeminfo_01;10498\n", 30, fhdlOut);
            filePutString ("SI_BUS_02/SYS01;10498\n", 22, fhdlOut);
            filePutString ("SI_BUS_03;10499\n", 16, fhdlOut);
            filePutString ("SI_BUS_03/Systeminfo_01;10499\n", 30, fhdlOut);
            filePutString ("SI_BUS_03/SYS01;10499\n", 22, fhdlOut);
            filePutString ("SI_BUS_04;10500\n", 16, fhdlOut);
            filePutString ("SI_BUS_04/Systeminfo_01;10500\n", 30, fhdlOut);
            filePutString ("SI_BUS_04/SYS01;10500\n", 22, fhdlOut);
            filePutString ("SI_BUS_05;10501\n", 16, fhdlOut);
            filePutString ("SI_BUS_05/Systeminfo_01;10501\n", 30, fhdlOut);
            filePutString ("SI_BUS_05/SYS01;10501\n", 22, fhdlOut);
            filePutString ("SI_BUS_06;10502\n", 16, fhdlOut);
            filePutString ("SI_BUS_06/Systeminfo_01;10502\n", 30, fhdlOut);
            filePutString ("SI_BUS_06/SYS01;10502\n", 22, fhdlOut);
            filePutString ("SI_BUS_07;10503\n", 16, fhdlOut);
            filePutString ("SI_BUS_07/Systeminfo_01;10503\n", 30, fhdlOut);
            filePutString ("SI_BUS_07/SYS01;10503\n", 22, fhdlOut);
            filePutString ("SI_BUS_08;10504\n", 16, fhdlOut);
            filePutString ("SI_BUS_08/Systeminfo_01;10504\n", 30, fhdlOut);
            filePutString ("SI_BUS_08/SYS01;10504\n", 22, fhdlOut);
            filePutString ("SI_BUS_09;10505\n", 16, fhdlOut);
            filePutString ("SI_BUS_09/Systeminfo_01;10505\n", 30, fhdlOut);
            filePutString ("SI_BUS_09/SYS01;10505\n", 22, fhdlOut);
            filePutString ("SI_BUS_10;10506\n", 16, fhdlOut);
            filePutString ("SI_BUS_10/Systeminfo_01;10506\n", 30, fhdlOut);
            filePutString ("SI_BUS_10/SYS01;10506\n", 22, fhdlOut);
            filePutString ("SI_BUS_11;10507\n", 16, fhdlOut);
            filePutString ("SI_BUS_11/Systeminfo_01;10507\n", 30, fhdlOut);
            filePutString ("SI_BUS_11/SYS01;10507\n", 22, fhdlOut);
            filePutString ("SI_BUS_12;10508\n", 16, fhdlOut);
            filePutString ("SI_BUS_12/Systeminfo_01;10508\n", 30, fhdlOut);
            filePutString ("SI_BUS_12/SYS01;10508\n", 22, fhdlOut);
            filePutString ("SI_BUS_13;10509\n", 16, fhdlOut);
            filePutString ("SI_BUS_13/Systeminfo_01;10509\n", 30, fhdlOut);
            filePutString ("SI_BUS_13/SYS01;10509\n", 22, fhdlOut);
            filePutString ("SI_BUS_14;10510\n", 16, fhdlOut);
            filePutString ("SI_BUS_14/Systeminfo_01;10510\n", 30, fhdlOut);
            filePutString ("SI_BUS_14/SYS01;10510\n", 22, fhdlOut);
            filePutString ("SI_BUS_15;10511\n", 16, fhdlOut);
            filePutString ("SI_BUS_15/Systeminfo_01;10511\n", 30, fhdlOut);
            filePutString ("SI_BUS_15/SYS01;10511\n", 22, fhdlOut);
            filePutString ("SI_Bus_Identifikation;10512\n", 28, fhdlOut);
            filePutString ("SI_Bus_Identifikation/Systeminfo_01;10512\n", 42, fhdlOut);
            filePutString ("SI_Bus_Identifikation/SYS01;10512\n", 34, fhdlOut);
            filePutString ("SI_NWDF;10513\n", 14, fhdlOut);
            filePutString ("SI_NWDF/Systeminfo_01;10513\n", 28, fhdlOut);
            filePutString ("SI_NWDF/SYS01;10513\n", 20, fhdlOut);
            filePutString ("SI_NWDF_gueltig;10514\n", 22, fhdlOut);
            filePutString ("SI_NWDF_gueltig/Systeminfo_01;10514\n", 36, fhdlOut);
            filePutString ("SI_NWDF_gueltig/SYS01;10514\n", 28, fhdlOut);
            filePutString ("SI_QRS_Mode;10515\n", 18, fhdlOut);
            filePutString ("SI_QRS_Mode/Systeminfo_01;10515\n", 32, fhdlOut);
            filePutString ("SI_QRS_Mode/SYS01;10515\n", 24, fhdlOut);
            filePutString ("SI_Sammel_SG_Fehler;10516\n", 26, fhdlOut);
            filePutString ("SI_Sammel_SG_Fehler/Systeminfo_01;10516\n", 40, fhdlOut);
            filePutString ("SI_Sammel_SG_Fehler/SYS01;10516\n", 32, fhdlOut);
            filePutString ("SI_Sammelfehler;10517\n", 22, fhdlOut);
            filePutString ("SI_Sammelfehler/Systeminfo_01;10517\n", 36, fhdlOut);
            filePutString ("SI_Sammelfehler/SYS01;10517\n", 28, fhdlOut);
            filePutString ("SI_T_Mode;10518\n", 16, fhdlOut);
            filePutString ("SI_T_Mode/Systeminfo_01;10518\n", 30, fhdlOut);
            filePutString ("SI_T_Mode/SYS01;10518\n", 22, fhdlOut);
            filePutString ("SI_T_Schutz;10519\n", 18, fhdlOut);
            filePutString ("SI_T_Schutz/Systeminfo_01;10519\n", 32, fhdlOut);
            filePutString ("SI_T_Schutz/SYS01;10519\n", 24, fhdlOut);
            filePutString ("GE_Sollgang;10752\n", 18, fhdlOut);
            filePutString ("GE_Sollgang/WBA_03;10752\n", 25, fhdlOut);
            filePutString ("GE_Sollgang/WBA03;10752\n", 24, fhdlOut);
            filePutString ("GE_Stoppverbot_Anz_01;10753\n", 28, fhdlOut);
            filePutString ("GE_Stoppverbot_Anz_01/WBA_03;10753\n", 35, fhdlOut);
            filePutString ("GE_Stoppverbot_Anz_01/WBA03;10753\n", 34, fhdlOut);
            filePutString ("GE_Stoppverbot_Anz_02;10754\n", 28, fhdlOut);
            filePutString ("GE_Stoppverbot_Anz_02/WBA_03;10754\n", 35, fhdlOut);
            filePutString ("GE_Stoppverbot_Anz_02/WBA03;10754\n", 34, fhdlOut);
            filePutString ("GE_Stoppverbot_Anz_03;10755\n", 28, fhdlOut);
            filePutString ("GE_Stoppverbot_Anz_03/WBA_03;10755\n", 35, fhdlOut);
            filePutString ("GE_Stoppverbot_Anz_03/WBA03;10755\n", 34, fhdlOut);
            filePutString ("GE_Stoppverbot_Anz_04;10756\n", 28, fhdlOut);
            filePutString ("GE_Stoppverbot_Anz_04/WBA_03;10756\n", 35, fhdlOut);
            filePutString ("GE_Stoppverbot_Anz_04/WBA03;10756\n", 34, fhdlOut);
            filePutString ("GE_Stoppverbot_Anz_05;10757\n", 28, fhdlOut);
            filePutString ("GE_Stoppverbot_Anz_05/WBA_03;10757\n", 35, fhdlOut);
            filePutString ("GE_Stoppverbot_Anz_05/WBA03;10757\n", 34, fhdlOut);
            filePutString ("GE_Stoppverbot_Anz_06;10758\n", 28, fhdlOut);
            filePutString ("GE_Stoppverbot_Anz_06/WBA_03;10758\n", 35, fhdlOut);
            filePutString ("GE_Stoppverbot_Anz_06/WBA03;10758\n", 34, fhdlOut);
            filePutString ("GE_Stoppverbot_Anz_07;10759\n", 28, fhdlOut);
            filePutString ("GE_Stoppverbot_Anz_07/WBA_03;10759\n", 35, fhdlOut);
            filePutString ("GE_Stoppverbot_Anz_07/WBA03;10759\n", 34, fhdlOut);
            filePutString ("GE_Stoppverbot_Anz_Std;10760\n", 29, fhdlOut);
            filePutString ("GE_Stoppverbot_Anz_Std/WBA_03;10760\n", 36, fhdlOut);
            filePutString ("GE_Stoppverbot_Anz_Std/WBA03;10760\n", 35, fhdlOut);
            filePutString ("GE_Tipschaltempf_verfuegbar;10761\n", 34, fhdlOut);
            filePutString ("GE_Tipschaltempf_verfuegbar/WBA_03;10761\n", 41, fhdlOut);
            filePutString ("GE_Tipschaltempf_verfuegbar/WBA03;10761\n", 40, fhdlOut);
            filePutString ("GE_Wiederstart_Anz_Std;10762\n", 29, fhdlOut);
            filePutString ("GE_Wiederstart_Anz_Std/WBA_03;10762\n", 36, fhdlOut);
            filePutString ("GE_Wiederstart_Anz_Std/WBA03;10762\n", 35, fhdlOut);
            filePutString ("WBA_03_BZ;10763\n", 16, fhdlOut);
            filePutString ("WBA_03_BZ/WBA_03;10763\n", 23, fhdlOut);
            filePutString ("WBA_03_BZ/WBA03;10763\n", 22, fhdlOut);
            filePutString ("WBA_03_CRC;10764\n", 17, fhdlOut);
            filePutString ("WBA_03_CRC/WBA_03;10764\n", 24, fhdlOut);
            filePutString ("WBA_03_CRC/WBA03;10764\n", 23, fhdlOut);
            filePutString ("WBA_Fahrstufe_02;10765\n", 23, fhdlOut);
            filePutString ("WBA_Fahrstufe_02/WBA_03;10765\n", 30, fhdlOut);
            filePutString ("WBA_Fahrstufe_02/WBA03;10765\n", 29, fhdlOut);
            filePutString ("WBA_GE_Texte;10766\n", 19, fhdlOut);
            filePutString ("WBA_GE_Texte/WBA_03;10766\n", 26, fhdlOut);
            filePutString ("WBA_GE_Texte/WBA03;10766\n", 25, fhdlOut);
            filePutString ("WBA_GE_Warnung_02;10767\n", 24, fhdlOut);
            filePutString ("WBA_GE_Warnung_02/WBA_03;10767\n", 31, fhdlOut);
            filePutString ("WBA_GE_Warnung_02/WBA03;10767\n", 30, fhdlOut);
            filePutString ("WBA_GE_Zusatzwarnungen;10768\n", 29, fhdlOut);
            filePutString ("WBA_GE_Zusatzwarnungen/WBA_03;10768\n", 36, fhdlOut);
            filePutString ("WBA_GE_Zusatzwarnungen/WBA03;10768\n", 35, fhdlOut);
            filePutString ("WBA_Schaltschema;10769\n", 23, fhdlOut);
            filePutString ("WBA_Schaltschema/WBA_03;10769\n", 30, fhdlOut);
            filePutString ("WBA_Schaltschema/WBA03;10769\n", 29, fhdlOut);
            filePutString ("WBA_Segeln_aktiv;10770\n", 23, fhdlOut);
            filePutString ("WBA_Segeln_aktiv/WBA_03;10770\n", 30, fhdlOut);
            filePutString ("WBA_Segeln_aktiv/WBA03;10770\n", 29, fhdlOut);
            filePutString ("WBA_ZielFahrstufe;10771\n", 24, fhdlOut);
            filePutString ("WBA_ZielFahrstufe/WBA_03;10771\n", 31, fhdlOut);
            filePutString ("WBA_ZielFahrstufe/WBA03;10771\n", 30, fhdlOut);
            filePutString ("WBA_eing_Gang_02;10772\n", 23, fhdlOut);
            filePutString ("WBA_eing_Gang_02/WBA_03;10772\n", 30, fhdlOut);
            filePutString ("WBA_eing_Gang_02/WBA03;10772\n", 29, fhdlOut);

            fileClose(fhdlOut);
        }
    }

    /* ------------------------------------------------------------------------------------------ */
    /*  END frame and signal handle export for remote control of CAPL by Perl script              */
    /* ------------------------------------------------------------------------------------------ */
}
/*@@end*/

/*@@startStart:Start:*/
on start
{
    int FrmIdx;
    int LoopCnt;

    /* start 10ms timer */
    setTimer(Timer_10ms,TIMER_DURATION_10MS);

    for (FrmIdx = 0; FrmIdx < FRM_NUM_MAX; FrmIdx++)
    {
        /* init frame schedule timer */
        FrmSched_SchedTmr[FrmIdx] = 0;
        
        /* enable scheduler for all frames */
        FrmSched_FrmEna[FrmIdx] = 1;

        /* init message counter values */
        Frm_MsgCounter[FrmIdx] = 0;

        /* enable message counter increment */
        Frm_MsgCounterEna[FrmIdx] = 1;

        /* enable checksum calculation */
        Frm_MsgChksmEna[FrmIdx] = 1;

        /* init DLC error status to OK */
        Frm_DLCOk[FrmIdx] = 1;
    }

    
    /* init CAPL control related variables */
    for (LoopCnt = 0; LoopCnt < CAPLCTRL_INPUTBUF_LEN; LoopCnt ++)
    {
        CaplCtrl_InputBuf[LoopCnt] = 0;
    }

    /* ------------------------------------------------------------------------------------------ */
    /*  BEGIN variable initialization                                                             */
    /* ------------------------------------------------------------------------------------------ */

    FrmSched_CycleTime[FRM_HANDLE_ACC_06] = 20;
    FrmSched_CycleTime[FRM_HANDLE_Airbag_01] = 50;
    FrmSched_CycleTime[FRM_HANDLE_Airbag_02] = 200;
    FrmSched_CycleTime[FRM_HANDLE_Anhaenger_01] = 100;
    FrmSched_CycleTime[FRM_HANDLE_BCM_01] = 1000;
    FrmSched_CycleTime[FRM_HANDLE_BEM_05] = 50;
    FrmSched_CycleTime[FRM_HANDLE_Bremse_EV_01] = 10;
    FrmSched_CycleTime[FRM_HANDLE_Bremse_EV_02] = 100;
    FrmSched_CycleTime[FRM_HANDLE_CAN_Umsetzer_Resp_01] = 1000;
    FrmSched_CycleTime[FRM_HANDLE_Charisma_01] = 1000;
    FrmSched_CycleTime[FRM_HANDLE_Diagnose_01] = 1000;
    FrmSched_CycleTime[FRM_HANDLE_EPB_01] = 20;
    FrmSched_CycleTime[FRM_HANDLE_ESP_02] = 20;
    FrmSched_CycleTime[FRM_HANDLE_ESP_05] = 20;
    FrmSched_CycleTime[FRM_HANDLE_ESP_07] = 100;
    FrmSched_CycleTime[FRM_HANDLE_ESP_10] = 20;
    FrmSched_CycleTime[FRM_HANDLE_ESP_19] = 10;
    FrmSched_CycleTime[FRM_HANDLE_ESP_20] = 1000;
    FrmSched_CycleTime[FRM_HANDLE_ESP_21] = 20;
    FrmSched_CycleTime[FRM_HANDLE_Einheiten_01] = 1000;
    FrmSched_CycleTime[FRM_HANDLE_GRA_ACC_01] = 30;
    FrmSched_CycleTime[FRM_HANDLE_Gateway_72] = 100;
    FrmSched_CycleTime[FRM_HANDLE_Gateway_74] = 100;
    FrmSched_CycleTime[FRM_HANDLE_Getriebe_11] = 10;
    FrmSched_CycleTime[FRM_HANDLE_Getriebe_12] = 10;
    FrmSched_CycleTime[FRM_HANDLE_Getriebe_13] = 20;
    FrmSched_CycleTime[FRM_HANDLE_Getriebe_14] = 100;
    FrmSched_CycleTime[FRM_HANDLE_Getriebe_Hybrid_01] = 20;
    FrmSched_CycleTime[FRM_HANDLE_HVEM_02] = 100;
    FrmSched_CycleTime[FRM_HANDLE_HVEM_04] = 500;
    FrmSched_CycleTime[FRM_HANDLE_Klemmen_Status_01] = 100;
    FrmSched_CycleTime[FRM_HANDLE_Klima_11] = 100;
    FrmSched_CycleTime[FRM_HANDLE_Kombi_01] = 50;
    FrmSched_CycleTime[FRM_HANDLE_Kombi_02] = 1000;
    FrmSched_CycleTime[FRM_HANDLE_LWI_01] = 10;
    FrmSched_CycleTime[FRM_HANDLE_Licht_hinten_01] = 100;
    FrmSched_CycleTime[FRM_HANDLE_NMH_Gateway] = 200;
    FrmSched_CycleTime[FRM_HANDLE_OBD_Tankgeber_01] = 500;
    FrmSched_CycleTime[FRM_HANDLE_Remotestart_FFB] = 500;
    FrmSched_CycleTime[FRM_HANDLE_STH_01] = 200;
    FrmSched_CycleTime[FRM_HANDLE_STS_01] = 200;
    FrmSched_CycleTime[FRM_HANDLE_Systeminfo_01] = 1000;
    FrmSched_CycleTime[FRM_HANDLE_WBA_03] = 160;

    Frm_DLC[FRM_HANDLE_ACC_06] = 8;
    Frm_DLC[FRM_HANDLE_Airbag_01] = 8;
    Frm_DLC[FRM_HANDLE_Airbag_02] = 8;
    Frm_DLC[FRM_HANDLE_Anhaenger_01] = 8;
    Frm_DLC[FRM_HANDLE_BCM_01] = 8;
    Frm_DLC[FRM_HANDLE_BEM_05] = 8;
    Frm_DLC[FRM_HANDLE_Bremse_EV_01] = 8;
    Frm_DLC[FRM_HANDLE_Bremse_EV_02] = 8;
    Frm_DLC[FRM_HANDLE_CAN_Umsetzer_Resp_01] = 8;
    Frm_DLC[FRM_HANDLE_Charisma_01] = 8;
    Frm_DLC[FRM_HANDLE_Diagnose_01] = 8;
    Frm_DLC[FRM_HANDLE_EPB_01] = 8;
    Frm_DLC[FRM_HANDLE_ESP_02] = 8;
    Frm_DLC[FRM_HANDLE_ESP_05] = 8;
    Frm_DLC[FRM_HANDLE_ESP_07] = 8;
    Frm_DLC[FRM_HANDLE_ESP_10] = 8;
    Frm_DLC[FRM_HANDLE_ESP_19] = 8;
    Frm_DLC[FRM_HANDLE_ESP_20] = 8;
    Frm_DLC[FRM_HANDLE_ESP_21] = 8;
    Frm_DLC[FRM_HANDLE_Einheiten_01] = 8;
    Frm_DLC[FRM_HANDLE_GRA_ACC_01] = 8;
    Frm_DLC[FRM_HANDLE_Gateway_72] = 8;
    Frm_DLC[FRM_HANDLE_Gateway_74] = 8;
    Frm_DLC[FRM_HANDLE_Getriebe_11] = 8;
    Frm_DLC[FRM_HANDLE_Getriebe_12] = 8;
    Frm_DLC[FRM_HANDLE_Getriebe_13] = 8;
    Frm_DLC[FRM_HANDLE_Getriebe_14] = 8;
    Frm_DLC[FRM_HANDLE_Getriebe_Hybrid_01] = 8;
    Frm_DLC[FRM_HANDLE_HVEM_02] = 8;
    Frm_DLC[FRM_HANDLE_HVEM_04] = 8;
    Frm_DLC[FRM_HANDLE_Klemmen_Status_01] = 4;
    Frm_DLC[FRM_HANDLE_Klima_11] = 8;
    Frm_DLC[FRM_HANDLE_Kombi_01] = 8;
    Frm_DLC[FRM_HANDLE_Kombi_02] = 8;
    Frm_DLC[FRM_HANDLE_LWI_01] = 8;
    Frm_DLC[FRM_HANDLE_Licht_hinten_01] = 8;
    Frm_DLC[FRM_HANDLE_NMH_Gateway] = 8;
    Frm_DLC[FRM_HANDLE_OBD_Tankgeber_01] = 8;
    Frm_DLC[FRM_HANDLE_Remotestart_FFB] = 8;
    Frm_DLC[FRM_HANDLE_STH_01] = 8;
    Frm_DLC[FRM_HANDLE_STS_01] = 8;
    Frm_DLC[FRM_HANDLE_Systeminfo_01] = 8;
    Frm_DLC[FRM_HANDLE_WBA_03] = 8;


    /* ------------------------------------------------------------------------------------------ */
    /*  END variable initialization                                                               */
    /* ------------------------------------------------------------------------------------------ */


    /* ------------------------------------------------------------------------------------------ */
    /*  BEGIN OnStart                                                                             */
    /* ------------------------------------------------------------------------------------------ */

    write("");
    write("#===================================================================");
    write("# CAPL program can_db_mqb.can");
    write("# Generated by:  dbc2capl.pl v1.4.6 (dbcparser.pm 1.3.0)");
    write("# CAPL template: dbc2capl_template.can v1.0.2");
    write("# Generated on:  17.08.2011 16:11:26");
    write("# DBC file:      can_db_mqb.dbc");
    write("#===================================================================");
    write("");


    /* ------------------------------------------------------------------------------------------ */
    /*  END OnStart                                                                               */
    /* ------------------------------------------------------------------------------------------ */

    /* HelpFrameList(); */

    write("Hit '?' to get list of all available frames ...");
    ShowPrompt();
}
/*@@end*/

/*@@key:*:*/
on key *
{
    long InputVal = 0;
    int LevelActvOld;
    char CharBufTmp[CAPLCTRL_CHARBUF_LEN];
    
    /* store current input level to be able to check for level change */
    LevelActvOld = CaplCtrl_LevelActv;

    /* empty string */
    CharBufTmp[0] = 0;


    switch (this)
    {
        /* --- numeric input -------------------------------------------------------------------- */
        case '0':
        case '1':
        case '2':
        case '3':
        case '4':
        case '5':
        case '6':
        case '7':
        case '8':
        case '9':
        {
            /* copy input to input buffer */
            CaplCtrl_InputBuf[CaplCtrl_InputIdx] = this;
            
            /* increment to next buffer value */
            CaplCtrl_InputIdx ++;

            /* limit input to buffer length */
            if (CaplCtrl_InputIdx >= CAPLCTRL_INPUTBUF_LEN)
            {
                CaplCtrl_InputIdx = CAPLCTRL_INPUTBUF_LEN - 1;
            }

            /* make sure that string is terminated properly */
            CaplCtrl_InputBuf[CaplCtrl_InputIdx] = 0;
        }
        break;

        /* --- numeric input -------------------------------------------------------------------- */
        case KEY_ENTER:
        {
            if (CaplCtrl_InputIdx > 0)
            {
                InputVal = atol(CaplCtrl_InputBuf);
            
                /* reset input variables */
                CaplCtrl_InputIdx = 0;
                CaplCtrl_InputBuf[0] = 0;

                switch (CaplCtrl_LevelActv)
                {
                    /* currently no level selected */
                    case CAPLCTRL_LEVEL_NOSEL:
                    {
                        /* select frame only if selection was valid */
                        if (InputVal < FRM_NUM_MAX)
                        {
                            /* switch to next level */
                            CaplCtrl_LevelActv = CAPLCTRL_LEVEL_FRAME;

                            /* select frame */
                            CaplCtrl_FrameActv = InputVal;
                        }
                        break;
                    }

                    case CAPLCTRL_LEVEL_FRAME:
                    {
                        /* switch to next level */
                        CaplCtrl_LevelActv = CAPLCTRL_LEVEL_SIGNAL;
                
                        /* select signal */
                        CaplCtrl_SignalActv = InputVal;
                        break;
                    }
            
                    case CAPLCTRL_LEVEL_SIGNAL:
                    {
                        /* set signal to input value */
                        CaplCtrl_InputValue = InputVal;
                        Frm_SetSignal(CaplCtrl_FrameActv, CaplCtrl_SignalActv, CaplCtrl_InputValue);
                        break;
                    }
                }
            }
        }
        break;

        case KEY_LEVEL_DOWN:
        {
            switch (CaplCtrl_LevelActv)
            {
                /* currently no level selected */
                case CAPLCTRL_LEVEL_NOSEL:
                {
                    /* keep level, do nothing */
                    break;
                }

                case CAPLCTRL_LEVEL_FRAME:
                {
                    /* switch back to above level */
                    CaplCtrl_LevelActv = CAPLCTRL_LEVEL_NOSEL;
                    break;
                }
        
                case CAPLCTRL_LEVEL_SIGNAL:
                {
                    /* switch back to above level */
                    CaplCtrl_LevelActv = CAPLCTRL_LEVEL_FRAME;
                    break;
                }
            }
        }
        break;

        case KEY_BACKSPACE:
        {
            /* update index */
            if (CaplCtrl_InputIdx > 0)
            {
                CaplCtrl_InputIdx --;
            }
            else
            {
                CaplCtrl_InputIdx = 0;
            }

            /* remove last character */
            CaplCtrl_InputBuf[CaplCtrl_InputIdx] = 0;
        }
        break;

        case KEY_TIMEOUT:
        {
            switch (CaplCtrl_LevelActv)
            {
                /* currently no level selected */
                case CAPLCTRL_LEVEL_NOSEL:
                {
                    /* enable/disable all frames */
                    if (FrmSched_FrmEna[0] != 0)
                    {
                        FrmSch_DisableAllFrames();
                        snprintf(CaplCtrl_CharBuf,
                                 CAPLCTRL_CHARBUF_LEN,
                                 "all frames disabled!");
                    }
                    else
                    {
                        FrmSch_EnableAllFrames();
                        snprintf(CaplCtrl_CharBuf,
                                 CAPLCTRL_CHARBUF_LEN,
                                 "all frames enabled!");
                    }
                    CaplCtrl_PromptMode = CAPLCTRL_PROMPTMODE_CHAR;
                    break;
                }

                case CAPLCTRL_LEVEL_FRAME:
                case CAPLCTRL_LEVEL_SIGNAL:
                {
                    /* toggle timeout status for selected frame */
                    FrmSched_FrmEna[CaplCtrl_FrameActv] ^= 1;
                    
                    /* get current frame status */
                    snprintf(CharBufTmp,
                             CAPLCTRL_CHARBUF_LEN,
                             "[tx=%d dlc=%d cs=%d cnt=%d]",
                             FrmSched_FrmEna[CaplCtrl_FrameActv],
                             Frm_DLCOk[CaplCtrl_FrameActv],
                             Frm_MsgChksmEna[CaplCtrl_FrameActv],
                             Frm_MsgCounterEna[CaplCtrl_FrameActv]);

                    if (FrmSched_FrmEna[CaplCtrl_FrameActv] != 0)
                    {
                        snprintf(CaplCtrl_CharBuf,
                                 CAPLCTRL_CHARBUF_LEN,
                                 "%s TX enabled!",
                                 CharBufTmp);
                    }
                    else
                    {
                        snprintf(CaplCtrl_CharBuf,
                                 CAPLCTRL_CHARBUF_LEN,
                                 "%s TX disabled!",
                                 CharBufTmp);
                    }

                    CaplCtrl_PromptMode = CAPLCTRL_PROMPTMODE_CHAR;
                    break;
                }
            }
            break;
        }

        case KEY_MSGCNT:
        {
            switch (CaplCtrl_LevelActv)
            {
                /* currently no level selected */
                case CAPLCTRL_LEVEL_NOSEL:
                {
                    /* keep level, do nothing */
                    break;
                }

                case CAPLCTRL_LEVEL_FRAME:
                case CAPLCTRL_LEVEL_SIGNAL:
                {
                    /* toggle message counter enable status */
                    Frm_MsgCounterEna[CaplCtrl_FrameActv] ^= 1;

                    /* get current frame status */
                    snprintf(CharBufTmp,
                             CAPLCTRL_CHARBUF_LEN,
                             "[tx=%d dlc=%d cs=%d cnt=%d]",
                             FrmSched_FrmEna[CaplCtrl_FrameActv],
                             Frm_DLCOk[CaplCtrl_FrameActv],
                             Frm_MsgChksmEna[CaplCtrl_FrameActv],
                             Frm_MsgCounterEna[CaplCtrl_FrameActv]);

                    if (Frm_MsgCounterEna[CaplCtrl_FrameActv] != 0)
                    {
                        snprintf(CaplCtrl_CharBuf,
                                 CAPLCTRL_CHARBUF_LEN,
                                 "%s Message counter running!",
                                 CharBufTmp);
                    }
                    else
                    {
                        snprintf(CaplCtrl_CharBuf,
                                 CAPLCTRL_CHARBUF_LEN,
                                 "%s Message counter stopped!",
                                 CharBufTmp);
                    }

                    CaplCtrl_PromptMode = CAPLCTRL_PROMPTMODE_CHAR;
                    break;
                }
            }
            break;
        }

        case KEY_CHKSM:
        {
            switch (CaplCtrl_LevelActv)
            {
                /* currently no level selected */
                case CAPLCTRL_LEVEL_NOSEL:
                {
                    /* keep level, do nothing */
                    break;
                }

                case CAPLCTRL_LEVEL_FRAME:
                case CAPLCTRL_LEVEL_SIGNAL:
                {
                    /* toggle checksum enable status */
                    Frm_MsgChksmEna[CaplCtrl_FrameActv] ^= 1;

                    /* get current frame status */
                    snprintf(CharBufTmp,
                             CAPLCTRL_CHARBUF_LEN,
                             "[tx=%d dlc=%d cs=%d cnt=%d]",
                             FrmSched_FrmEna[CaplCtrl_FrameActv],
                             Frm_DLCOk[CaplCtrl_FrameActv],
                             Frm_MsgChksmEna[CaplCtrl_FrameActv],
                             Frm_MsgCounterEna[CaplCtrl_FrameActv]);

                    if (Frm_MsgChksmEna[CaplCtrl_FrameActv] != 0)
                    {
                        snprintf(CaplCtrl_CharBuf,
                                 CAPLCTRL_CHARBUF_LEN,
                                 "%s Checksum calculation enabled!",
                                 CharBufTmp);
                    }
                    else
                    {
                        snprintf(CaplCtrl_CharBuf,
                                 CAPLCTRL_CHARBUF_LEN,
                                 "%s Checksum calculation disabled!",
                                 CharBufTmp);
                    }

                    CaplCtrl_PromptMode = CAPLCTRL_PROMPTMODE_CHAR;
                    break;
                }
            }
            break;
        }

        case KEY_DLC:
        {
            switch (CaplCtrl_LevelActv)
            {
                /* currently no level selected */
                case CAPLCTRL_LEVEL_NOSEL:
                {
                    /* keep level, do nothing */
                    break;
                }

                case CAPLCTRL_LEVEL_FRAME:
                case CAPLCTRL_LEVEL_SIGNAL:
                {
                    /* toggle DLC ok status */
                    Frm_DLCOk[CaplCtrl_FrameActv] ^= 1;

                    /* get current frame status */
                    snprintf(CharBufTmp,
                             CAPLCTRL_CHARBUF_LEN,
                             "[tx=%d dlc=%d cs=%d cnt=%d]",
                             FrmSched_FrmEna[CaplCtrl_FrameActv],
                             Frm_DLCOk[CaplCtrl_FrameActv],
                             Frm_MsgChksmEna[CaplCtrl_FrameActv],
                             Frm_MsgCounterEna[CaplCtrl_FrameActv]);

                    if (Frm_DLCOk[CaplCtrl_FrameActv] != 0)
                    {
                        snprintf(CaplCtrl_CharBuf,
                                 CAPLCTRL_CHARBUF_LEN,
                                 "%s correct DLC!",
                                 CharBufTmp);

                        Frm_SetDLC (CaplCtrl_FrameActv, Frm_DLC[CaplCtrl_FrameActv]);
                    }
                    else
                    {
                        snprintf(CaplCtrl_CharBuf,
                                 CAPLCTRL_CHARBUF_LEN,
                                 "%s incorrect DLC!",
                                 CharBufTmp);

                        Frm_SetDLC (CaplCtrl_FrameActv, 0);
                    }


                    CaplCtrl_PromptMode = CAPLCTRL_PROMPTMODE_CHAR;
                    break;
                }
            }
            break;
        }
        
        case KEY_HELP:
        {
            CaplCtrl_LevelChanged();
            break;
        }

        default:
        {
            break;
        }
    }

    if (LevelActvOld != CaplCtrl_LevelActv)
    {
        //CaplCtrl_LevelChanged();
    }

    ShowPrompt();
    CaplCtrl_PromptMode = CAPLCTRL_PROMPTMODE_NUM;
}
/*@@end*/

/*@@caplFunc:CaplCtrl_LevelChanged():*/
CaplCtrl_LevelChanged ()
{
    switch(CaplCtrl_LevelActv)
    {
        case CAPLCTRL_LEVEL_NOSEL:
        {
           HelpFrameList();
        }
        break;

        case CAPLCTRL_LEVEL_FRAME:
        {
            HelpSignalList();
        }
        break;

        case CAPLCTRL_LEVEL_SIGNAL:
        {
           
        }
        break;
    }
}
/*@@end*/

/*@@msg:*:*/
on message *
{
   output(this);
}
/*@@end*/

/*@@caplFunc:FrmSched_SendFrame(int):*/
FrmSched_SendFrame (int FrmIdx)
{
    switch (FrmIdx)
    {
        case FRM_HANDLE_ACC_06:
            MsgObj_ACC_06.ACC_06_BZ = Frm_CalcMsgCounter(FRM_HANDLE_ACC_06);
            MsgObj_ACC_06.ACC_06_CRC = Frm_CalcChecksumCRC8Dyn(FRM_HANDLE_ACC_06, MsgObj_ACC_06, MsgObj_ACC_06.ACC_06_BZ);
            output(MsgObj_ACC_06);
            break;
        case FRM_HANDLE_Airbag_01:
            MsgObj_Airbag_01.Airbag_01_BZ = Frm_CalcMsgCounter(FRM_HANDLE_Airbag_01);
            MsgObj_Airbag_01.Airbag_01_CRC = Frm_CalcChecksumCRC8Dyn(FRM_HANDLE_Airbag_01, MsgObj_Airbag_01, MsgObj_Airbag_01.Airbag_01_BZ);
            output(MsgObj_Airbag_01);
            break;
        case FRM_HANDLE_Airbag_02:
            MsgObj_Airbag_02.Airbag_02_BZ = Frm_CalcMsgCounter(FRM_HANDLE_Airbag_02);
            MsgObj_Airbag_02.Airbag_02_CRC = Frm_CalcChecksumCRC8Dyn(FRM_HANDLE_Airbag_02, MsgObj_Airbag_02, MsgObj_Airbag_02.Airbag_02_BZ);
            output(MsgObj_Airbag_02);
            break;
        case FRM_HANDLE_Anhaenger_01:
            MsgObj_Anhaenger_01.AAG_BZ = Frm_CalcMsgCounter(FRM_HANDLE_Anhaenger_01);
            output(MsgObj_Anhaenger_01);
            break;
        case FRM_HANDLE_BCM_01:
            output(MsgObj_BCM_01);
            break;
        case FRM_HANDLE_BEM_05:
            output(MsgObj_BEM_05);
            break;
        case FRM_HANDLE_Bremse_EV_01:
            MsgObj_Bremse_EV_01.Bremse_EV_01_BZ = Frm_CalcMsgCounter(FRM_HANDLE_Bremse_EV_01);
            MsgObj_Bremse_EV_01.Bremse_EV_01_CRC = Frm_CalcChecksumCRC8Dyn(FRM_HANDLE_Bremse_EV_01, MsgObj_Bremse_EV_01, MsgObj_Bremse_EV_01.Bremse_EV_01_BZ);
            output(MsgObj_Bremse_EV_01);
            break;
        case FRM_HANDLE_Bremse_EV_02:
            output(MsgObj_Bremse_EV_02);
            break;
        case FRM_HANDLE_CAN_Umsetzer_Resp_01:
            output(MsgObj_CAN_Umsetzer_Resp_01);
            break;
        case FRM_HANDLE_Charisma_01:
            output(MsgObj_Charisma_01);
            break;
        case FRM_HANDLE_Diagnose_01:
            output(MsgObj_Diagnose_01);
            break;
        case FRM_HANDLE_EPB_01:
            MsgObj_EPB_01.EPB_01_BZ = Frm_CalcMsgCounter(FRM_HANDLE_EPB_01);
            MsgObj_EPB_01.EPB_01_CRC = Frm_CalcChecksumCRC8Dyn(FRM_HANDLE_EPB_01, MsgObj_EPB_01, MsgObj_EPB_01.EPB_01_BZ);
            output(MsgObj_EPB_01);
            break;
        case FRM_HANDLE_ESP_02:
            MsgObj_ESP_02.ESP_02_BZ = Frm_CalcMsgCounter(FRM_HANDLE_ESP_02);
            MsgObj_ESP_02.ESP_02_CRC = Frm_CalcChecksumCRC8Dyn(FRM_HANDLE_ESP_02, MsgObj_ESP_02, MsgObj_ESP_02.ESP_02_BZ);
            output(MsgObj_ESP_02);
            break;
        case FRM_HANDLE_ESP_05:
            MsgObj_ESP_05.ESP_05_BZ = Frm_CalcMsgCounter(FRM_HANDLE_ESP_05);
            MsgObj_ESP_05.ESP_05_CRC = Frm_CalcChecksumCRC8Dyn(FRM_HANDLE_ESP_05, MsgObj_ESP_05, MsgObj_ESP_05.ESP_05_BZ);
            output(MsgObj_ESP_05);
            break;
        case FRM_HANDLE_ESP_07:
            MsgObj_ESP_07.ESP_07_BZ = Frm_CalcMsgCounter(FRM_HANDLE_ESP_07);
            MsgObj_ESP_07.ESP_07_CRC = Frm_CalcChecksumCRC8Dyn(FRM_HANDLE_ESP_07, MsgObj_ESP_07, MsgObj_ESP_07.ESP_07_BZ);
            output(MsgObj_ESP_07);
            break;
        case FRM_HANDLE_ESP_10:
            MsgObj_ESP_10.ESP_10_BZ = Frm_CalcMsgCounter(FRM_HANDLE_ESP_10);
            MsgObj_ESP_10.ESP_10_CRC = Frm_CalcChecksumCRC8Dyn(FRM_HANDLE_ESP_10, MsgObj_ESP_10, MsgObj_ESP_10.ESP_10_BZ);
            output(MsgObj_ESP_10);
            break;
        case FRM_HANDLE_ESP_19:
            output(MsgObj_ESP_19);
            break;
        case FRM_HANDLE_ESP_20:
            MsgObj_ESP_20.ESP_20_BZ = Frm_CalcMsgCounter(FRM_HANDLE_ESP_20);
            MsgObj_ESP_20.ESP_20_CRC = Frm_CalcChecksumCRC8Dyn(FRM_HANDLE_ESP_20, MsgObj_ESP_20, MsgObj_ESP_20.ESP_20_BZ);
            output(MsgObj_ESP_20);
            break;
        case FRM_HANDLE_ESP_21:
            MsgObj_ESP_21.ESP_21_BZ = Frm_CalcMsgCounter(FRM_HANDLE_ESP_21);
            MsgObj_ESP_21.ESP_21_CRC = Frm_CalcChecksumCRC8Dyn(FRM_HANDLE_ESP_21, MsgObj_ESP_21, MsgObj_ESP_21.ESP_21_BZ);
            output(MsgObj_ESP_21);
            break;
        case FRM_HANDLE_Einheiten_01:
            output(MsgObj_Einheiten_01);
            break;
        case FRM_HANDLE_GRA_ACC_01:
            MsgObj_GRA_ACC_01.GRA_ACC_01_BZ = Frm_CalcMsgCounter(FRM_HANDLE_GRA_ACC_01);
            MsgObj_GRA_ACC_01.GRA_ACC_01_CRC = Frm_CalcChecksumCRC8Dyn(FRM_HANDLE_GRA_ACC_01, MsgObj_GRA_ACC_01, MsgObj_GRA_ACC_01.GRA_ACC_01_BZ);
            output(MsgObj_GRA_ACC_01);
            break;
        case FRM_HANDLE_Gateway_72:
            output(MsgObj_Gateway_72);
            break;
        case FRM_HANDLE_Gateway_74:
            output(MsgObj_Gateway_74);
            break;
        case FRM_HANDLE_Getriebe_11:
            MsgObj_Getriebe_11.Getriebe_11_BZ = Frm_CalcMsgCounter(FRM_HANDLE_Getriebe_11);
            MsgObj_Getriebe_11.Getriebe_11_CRC = Frm_CalcChecksumCRC8Dyn(FRM_HANDLE_Getriebe_11, MsgObj_Getriebe_11, MsgObj_Getriebe_11.Getriebe_11_BZ);
            output(MsgObj_Getriebe_11);
            break;
        case FRM_HANDLE_Getriebe_12:
            MsgObj_Getriebe_12.Getriebe_12_BZ = Frm_CalcMsgCounter(FRM_HANDLE_Getriebe_12);
            MsgObj_Getriebe_12.Getriebe_12_CRC = Frm_CalcChecksumCRC8Dyn(FRM_HANDLE_Getriebe_12, MsgObj_Getriebe_12, MsgObj_Getriebe_12.Getriebe_12_BZ);
            output(MsgObj_Getriebe_12);
            break;
        case FRM_HANDLE_Getriebe_13:
            MsgObj_Getriebe_13.Getriebe_13_BZ = Frm_CalcMsgCounter(FRM_HANDLE_Getriebe_13);
            MsgObj_Getriebe_13.Getriebe_13_CRC = Frm_CalcChecksumCRC8Dyn(FRM_HANDLE_Getriebe_13, MsgObj_Getriebe_13, MsgObj_Getriebe_13.Getriebe_13_BZ);
            output(MsgObj_Getriebe_13);
            break;
        case FRM_HANDLE_Getriebe_14:
            output(MsgObj_Getriebe_14);
            break;
        case FRM_HANDLE_Getriebe_Hybrid_01:
            MsgObj_Getriebe_Hybrid_01.Getriebe_Hybrid_01_BZ = Frm_CalcMsgCounter(FRM_HANDLE_Getriebe_Hybrid_01);
            MsgObj_Getriebe_Hybrid_01.Getriebe_Hybrid_01_CRC = Frm_CalcChecksumCRC8Dyn(FRM_HANDLE_Getriebe_Hybrid_01, MsgObj_Getriebe_Hybrid_01, MsgObj_Getriebe_Hybrid_01.Getriebe_Hybrid_01_BZ);
            output(MsgObj_Getriebe_Hybrid_01);
            break;
        case FRM_HANDLE_HVEM_02:
            output(MsgObj_HVEM_02);
            break;
        case FRM_HANDLE_HVEM_04:
            output(MsgObj_HVEM_04);
            break;
        case FRM_HANDLE_Klemmen_Status_01:
            MsgObj_Klemmen_Status_01.Klemmen_Status_01_BZ = Frm_CalcMsgCounter(FRM_HANDLE_Klemmen_Status_01);
            MsgObj_Klemmen_Status_01.Klemmen_Status_01_CRC = Frm_CalcChecksumCRC8Dyn(FRM_HANDLE_Klemmen_Status_01, MsgObj_Klemmen_Status_01, MsgObj_Klemmen_Status_01.Klemmen_Status_01_BZ);
            output(MsgObj_Klemmen_Status_01);
            break;
        case FRM_HANDLE_Klima_11:
            output(MsgObj_Klima_11);
            break;
        case FRM_HANDLE_Kombi_01:
            MsgObj_Kombi_01.Kombi_01_BZ = Frm_CalcMsgCounter(FRM_HANDLE_Kombi_01);
            output(MsgObj_Kombi_01);
            break;
        case FRM_HANDLE_Kombi_02:
            output(MsgObj_Kombi_02);
            break;
        case FRM_HANDLE_LWI_01:
            MsgObj_LWI_01.LWI_01_BZ = Frm_CalcMsgCounter(FRM_HANDLE_LWI_01);
            MsgObj_LWI_01.LWI_01_CRC = Frm_CalcChecksumCRC8Dyn(FRM_HANDLE_LWI_01, MsgObj_LWI_01, MsgObj_LWI_01.LWI_01_BZ);
            output(MsgObj_LWI_01);
            break;
        case FRM_HANDLE_Licht_hinten_01:
            MsgObj_Licht_hinten_01.Licht_hinten_01_BZ = Frm_CalcMsgCounter(FRM_HANDLE_Licht_hinten_01);
            output(MsgObj_Licht_hinten_01);
            break;
        case FRM_HANDLE_NMH_Gateway:
            output(MsgObj_NMH_Gateway);
            break;
        case FRM_HANDLE_OBD_Tankgeber_01:
            output(MsgObj_OBD_Tankgeber_01);
            break;
        case FRM_HANDLE_Remotestart_FFB:
            output(MsgObj_Remotestart_FFB);
            break;
        case FRM_HANDLE_STH_01:
            output(MsgObj_STH_01);
            break;
        case FRM_HANDLE_STS_01:
            MsgObj_STS_01.STS_01_BZ = Frm_CalcMsgCounter(FRM_HANDLE_STS_01);
            MsgObj_STS_01.STS_01_CRC = Frm_CalcChecksumCRC8Dyn(FRM_HANDLE_STS_01, MsgObj_STS_01, MsgObj_STS_01.STS_01_BZ);
            output(MsgObj_STS_01);
            break;
        case FRM_HANDLE_Systeminfo_01:
            output(MsgObj_Systeminfo_01);
            break;
        case FRM_HANDLE_WBA_03:
            output(MsgObj_WBA_03);
            break;
    }
}
/*@@end*/

/*@@caplFunc:Frm_SetDLC(long,long):*/
Frm_SetDLC (long FrmIdx, long FrmDLC)
{
    switch (FrmIdx)
    {
        case FRM_HANDLE_ACC_06:
            MsgObj_ACC_06.DLC = FrmDLC;
            break;
        case FRM_HANDLE_Airbag_01:
            MsgObj_Airbag_01.DLC = FrmDLC;
            break;
        case FRM_HANDLE_Airbag_02:
            MsgObj_Airbag_02.DLC = FrmDLC;
            break;
        case FRM_HANDLE_Anhaenger_01:
            MsgObj_Anhaenger_01.DLC = FrmDLC;
            break;
        case FRM_HANDLE_BCM_01:
            MsgObj_BCM_01.DLC = FrmDLC;
            break;
        case FRM_HANDLE_BEM_05:
            MsgObj_BEM_05.DLC = FrmDLC;
            break;
        case FRM_HANDLE_Bremse_EV_01:
            MsgObj_Bremse_EV_01.DLC = FrmDLC;
            break;
        case FRM_HANDLE_Bremse_EV_02:
            MsgObj_Bremse_EV_02.DLC = FrmDLC;
            break;
        case FRM_HANDLE_CAN_Umsetzer_Resp_01:
            MsgObj_CAN_Umsetzer_Resp_01.DLC = FrmDLC;
            break;
        case FRM_HANDLE_Charisma_01:
            MsgObj_Charisma_01.DLC = FrmDLC;
            break;
        case FRM_HANDLE_Diagnose_01:
            MsgObj_Diagnose_01.DLC = FrmDLC;
            break;
        case FRM_HANDLE_EPB_01:
            MsgObj_EPB_01.DLC = FrmDLC;
            break;
        case FRM_HANDLE_ESP_02:
            MsgObj_ESP_02.DLC = FrmDLC;
            break;
        case FRM_HANDLE_ESP_05:
            MsgObj_ESP_05.DLC = FrmDLC;
            break;
        case FRM_HANDLE_ESP_07:
            MsgObj_ESP_07.DLC = FrmDLC;
            break;
        case FRM_HANDLE_ESP_10:
            MsgObj_ESP_10.DLC = FrmDLC;
            break;
        case FRM_HANDLE_ESP_19:
            MsgObj_ESP_19.DLC = FrmDLC;
            break;
        case FRM_HANDLE_ESP_20:
            MsgObj_ESP_20.DLC = FrmDLC;
            break;
        case FRM_HANDLE_ESP_21:
            MsgObj_ESP_21.DLC = FrmDLC;
            break;
        case FRM_HANDLE_Einheiten_01:
            MsgObj_Einheiten_01.DLC = FrmDLC;
            break;
        case FRM_HANDLE_GRA_ACC_01:
            MsgObj_GRA_ACC_01.DLC = FrmDLC;
            break;
        case FRM_HANDLE_Gateway_72:
            MsgObj_Gateway_72.DLC = FrmDLC;
            break;
        case FRM_HANDLE_Gateway_74:
            MsgObj_Gateway_74.DLC = FrmDLC;
            break;
        case FRM_HANDLE_Getriebe_11:
            MsgObj_Getriebe_11.DLC = FrmDLC;
            break;
        case FRM_HANDLE_Getriebe_12:
            MsgObj_Getriebe_12.DLC = FrmDLC;
            break;
        case FRM_HANDLE_Getriebe_13:
            MsgObj_Getriebe_13.DLC = FrmDLC;
            break;
        case FRM_HANDLE_Getriebe_14:
            MsgObj_Getriebe_14.DLC = FrmDLC;
            break;
        case FRM_HANDLE_Getriebe_Hybrid_01:
            MsgObj_Getriebe_Hybrid_01.DLC = FrmDLC;
            break;
        case FRM_HANDLE_HVEM_02:
            MsgObj_HVEM_02.DLC = FrmDLC;
            break;
        case FRM_HANDLE_HVEM_04:
            MsgObj_HVEM_04.DLC = FrmDLC;
            break;
        case FRM_HANDLE_Klemmen_Status_01:
            MsgObj_Klemmen_Status_01.DLC = FrmDLC;
            break;
        case FRM_HANDLE_Klima_11:
            MsgObj_Klima_11.DLC = FrmDLC;
            break;
        case FRM_HANDLE_Kombi_01:
            MsgObj_Kombi_01.DLC = FrmDLC;
            break;
        case FRM_HANDLE_Kombi_02:
            MsgObj_Kombi_02.DLC = FrmDLC;
            break;
        case FRM_HANDLE_LWI_01:
            MsgObj_LWI_01.DLC = FrmDLC;
            break;
        case FRM_HANDLE_Licht_hinten_01:
            MsgObj_Licht_hinten_01.DLC = FrmDLC;
            break;
        case FRM_HANDLE_NMH_Gateway:
            MsgObj_NMH_Gateway.DLC = FrmDLC;
            break;
        case FRM_HANDLE_OBD_Tankgeber_01:
            MsgObj_OBD_Tankgeber_01.DLC = FrmDLC;
            break;
        case FRM_HANDLE_Remotestart_FFB:
            MsgObj_Remotestart_FFB.DLC = FrmDLC;
            break;
        case FRM_HANDLE_STH_01:
            MsgObj_STH_01.DLC = FrmDLC;
            break;
        case FRM_HANDLE_STS_01:
            MsgObj_STS_01.DLC = FrmDLC;
            break;
        case FRM_HANDLE_Systeminfo_01:
            MsgObj_Systeminfo_01.DLC = FrmDLC;
            break;
        case FRM_HANDLE_WBA_03:
            MsgObj_WBA_03.DLC = FrmDLC;
            break;
    }
}
/*@@end*/

/*@@busOff:BusOff:*/
on busOff
{
    resetCan();
}
/*@@end*/

/*@@caplFunc:HelpSignal():*/
HelpCommands ()
{
    write("-------------------------------------------");
    write("Supported commands:");
    write("[a] ... toggle timeout error status");
    write("[b] ... toggle message counter error status");
    write("[c] ... toggle checksumm error status");
    write("[d] ... toggle DLC error status");
    write("[.] ... one level up in command prompt");
    write("-------------------------------------------");
}

/*@@caplFunc:HelpFrameList():*/
HelpFrameList ()
{
    HelpCommands();

    write("[0] ... ACC_06");
    write("[1] ... Airbag_01");
    write("[2] ... Airbag_02");
    write("[3] ... Anhaenger_01");
    write("[4] ... BCM_01");
    write("[5] ... BEM_05");
    write("[6] ... Bremse_EV_01");
    write("[7] ... Bremse_EV_02");
    write("[8] ... CAN_Umsetzer_Resp_01");
    write("[9] ... Charisma_01");
    write("[10] ... Diagnose_01");
    write("[11] ... EPB_01");
    write("[12] ... ESP_02");
    write("[13] ... ESP_05");
    write("[14] ... ESP_07");
    write("[15] ... ESP_10");
    write("[16] ... ESP_19");
    write("[17] ... ESP_20");
    write("[18] ... ESP_21");
    write("[19] ... Einheiten_01");
    write("[20] ... GRA_ACC_01");
    write("[21] ... Gateway_72");
    write("[22] ... Gateway_74");
    write("[23] ... Getriebe_11");
    write("[24] ... Getriebe_12");
    write("[25] ... Getriebe_13");
    write("[26] ... Getriebe_14");
    write("[27] ... Getriebe_Hybrid_01");
    write("[28] ... HVEM_02");
    write("[29] ... HVEM_04");
    write("[30] ... Klemmen_Status_01");
    write("[31] ... Klima_11");
    write("[32] ... Kombi_01");
    write("[33] ... Kombi_02");
    write("[34] ... LWI_01");
    write("[35] ... Licht_hinten_01");
    write("[36] ... NMH_Gateway");
    write("[37] ... OBD_Tankgeber_01");
    write("[38] ... Remotestart_FFB");
    write("[39] ... STH_01");
    write("[40] ... STS_01");
    write("[41] ... Systeminfo_01");
    write("[42] ... WBA_03");

}

/*@@caplFunc:HelpSignalList():*/
HelpSignalList ()
{
    HelpCommands();

    switch(CaplCtrl_FrameActv)
    {
        case FRM_HANDLE_ACC_06:
        {
            write("[0] ... ACC_06_BZ");
            write("[1] ... ACC_06_CRC");
            write("[2] ... ACC_Anfahren");
            write("[3] ... ACC_Anhalten");
            write("[4] ... ACC_Minimale_Bremsung");
            write("[5] ... ACC_Sollbeschleunigung_02");
            write("[6] ... ACC_StartStopp_Info");
            write("[7] ... ACC_Status_ACC");
            write("[8] ... ACC_Typ");
            write("[9] ... ACC_limitierte_Anfahrdyn");
            write("[10] ... ACC_neg_Sollbeschl_Grad_02");
            write("[11] ... ACC_pos_Sollbeschl_Grad_02");
            write("[12] ... ACC_zul_Regelabw_oben");
            write("[13] ... ACC_zul_Regelabw_unten");
        }
        break;
        case FRM_HANDLE_Airbag_01:
        {
            write("[0] ... AB_Anzeige_Fussg");
            write("[1] ... AB_Crash_Int");
            write("[2] ... AB_Deaktiviert");
            write("[3] ... AB_Deaktivierung_HV");
            write("[4] ... AB_Diagnose");
            write("[5] ... AB_Erh_Auf_VB");
            write("[6] ... AB_Front_Crash");
            write("[7] ... AB_Gurtwarn_VB");
            write("[8] ... AB_Gurtwarn_VF");
            write("[9] ... AB_Heck_Crash");
            write("[10] ... AB_Lampe");
            write("[11] ... AB_MKB_Anforderung");
            write("[12] ... AB_MKB_gueltig");
            write("[13] ... AB_PAO_Leuchte_Anf");
            write("[14] ... AB_RGS_Anst");
            write("[15] ... AB_Rollover_Crash");
            write("[16] ... AB_SB_Crash");
            write("[17] ... AB_SF_Crash");
            write("[18] ... AB_Stellgliedtest");
            write("[19] ... AB_Systemfehler");
            write("[20] ... AB_Texte_AKS");
            write("[21] ... AB_VB_deaktiviert");
            write("[22] ... AB_Versorgungsspannung");
            write("[23] ... Airbag_01_BZ");
            write("[24] ... Airbag_01_CRC");
        }
        break;
        case FRM_HANDLE_Airbag_02:
        {
            write("[0] ... AB_Belegung_VB");
            write("[1] ... AB_Gurtschloss_BF");
            write("[2] ... AB_Gurtschloss_FA");
            write("[3] ... AB_Gurtschloss_Reihe2_BF");
            write("[4] ... AB_Gurtschloss_Reihe2_FA");
            write("[5] ... AB_Gurtschloss_Reihe2_MI");
            write("[6] ... AB_Gurtschloss_Reihe3_BF");
            write("[7] ... AB_Gurtschloss_Reihe3_FA");
            write("[8] ... AB_Gurtschloss_Reihe3_MI");
            write("[9] ... AB_Sitzpos_Sens_BF");
            write("[10] ... AB_Sitzpos_Sens_FA");
            write("[11] ... Airbag_02_BZ");
            write("[12] ... Airbag_02_CRC");
        }
        break;
        case FRM_HANDLE_Anhaenger_01:
        {
            write("[0] ... AAG_AVS_Fehler_02");
            write("[1] ... AAG_AVS_Stati");
            write("[2] ... AAG_Anhaenger_abgesteckt");
            write("[3] ... AAG_Anhaenger_erkannt");
            write("[4] ... AAG_BZ");
            write("[5] ... AAG_Blinker_HL_def");
            write("[6] ... AAG_Blinker_HR_def");
            write("[7] ... AAG_Blinker_H_aktiv");
            write("[8] ... AAG_Bremsl_durch_ECD");
            write("[9] ... AAG_Bremslicht_H_def");
            write("[10] ... AAG_NSL_aktiv");
            write("[11] ... AAG_Schlusslicht_HL_def");
            write("[12] ... AAG_Schlusslicht_HR_def");
        }
        break;
        case FRM_HANDLE_BCM_01:
        {
            write("[0] ... BCM1_AFS_Lampe");
            write("[1] ... BCM1_Kl_15_HW_erkannt");
            write("[2] ... BCM1_Licht_Warn");
            write("[3] ... BCM1_Lichtwarn_Texte");
            write("[4] ... BCM1_MH_Schalter");
            write("[5] ... BCM1_MH_WIV_Schalter");
            write("[6] ... BCM1_NV_Taster");
            write("[7] ... BCM1_Reisemodus_Texte");
            write("[8] ... BCM1_Rueckfahrlicht_Schalter");
            write("[9] ... BCM1_Valet_Parking_Taster");
            write("[10] ... BCM1_Warnblink_Taster");
            write("[11] ... BCM_Bremsbelag_Sensor");
            write("[12] ... BCM_Bremsfluessigkeit_Sensor");
            write("[13] ... BCM_Eco_Charisma_Taste");
            write("[14] ... BCM_Hybrid_StartStopp_Taste");
            write("[15] ... BCM_Kuehlmittel_Sensor");
            write("[16] ... BCM_Waschwasser_Sensor");
            write("[17] ... Gong_TFL_Umschaltung");
            write("[18] ... UGDO_Function");
        }
        break;
        case FRM_HANDLE_BEM_05:
        {
            write("[0] ... BEM_01_Abschaltstufen");
            write("[1] ... BEM_Anf_KL");
            write("[2] ... BEM_Batt_Ab");
            write("[3] ... BEM_DFM");
            write("[4] ... BEM_EMLIN_ungueltig");
            write("[5] ... BEM_HYB_DC_uMinLV");
            write("[6] ... BEM_HYB_DC_uSollLV");
            write("[7] ... BEM_Hybrid_Info");
            write("[8] ... BEM_NV_NachladAnf");
            write("[9] ... BEM_P_Generator");
            write("[10] ... BEM_Segel_Info");
            write("[11] ... BEM_StartStopp_Info");
            write("[12] ... BEM_n_LLA");
            write("[13] ... NVEM_DC_LangsRegelung_Anf");
        }
        break;
        case FRM_HANDLE_Bremse_EV_01:
        {
            write("[0] ... Bremse_EV_01_BZ");
            write("[1] ... Bremse_EV_01_CRC");
            write("[2] ... EBKV_Bremspedalweg");
            write("[3] ... EBKV_Fahrer_bremst");
            write("[4] ... EBKV_Generatorsollmoment");
            write("[5] ... EBKV_M_Brems_ASM_soll");
            write("[6] ... EBKV_QBit_Fahrer_bremst");
            write("[7] ... EBKV_Status");
        }
        break;
        case FRM_HANDLE_Bremse_EV_02:
        {
            write("[0] ... EBKV_BKL_Warnungen");
            write("[1] ... EBKV_Hinweise");
            write("[2] ... EBKV_OBD_Status");
            write("[3] ... EBKV_Warnungen");
        }
        break;
        case FRM_HANDLE_CAN_Umsetzer_Resp_01:
        {
            write("[0] ... CU1RSP_IO1");
            write("[1] ... CU1RSP_IO1_KS_GND_Fehler");
            write("[2] ... CU1RSP_IO1_KS_UBat_Fehler");
            write("[3] ... CU1RSP_IO1_QBit");
            write("[4] ... CU1RSP_IO1_Taste_Fehler");
            write("[5] ... CU1RSP_IO1_analog_Eing");
            write("[6] ... CU1RSP_IO1_digital_Eing");
            write("[7] ... CU1RSP_IO1_digital_analog");
            write("[8] ... CU1RSP_IO2");
            write("[9] ... CU1RSP_IO2_KS_Fehler");
            write("[10] ... CU1RSP_IO2_KS_UBat_Fehler");
            write("[11] ... CU1RSP_IO2_OpenLoad");
            write("[12] ... CU1RSP_IO2_QBit");
            write("[13] ... CU1RSP_IO2_digital_Eing");
            write("[14] ... CU1RSP_IO3");
            write("[15] ... CU1RSP_IO3_KS_Fehler");
            write("[16] ... CU1RSP_IO3_KS_UBat_Fehler");
            write("[17] ... CU1RSP_IO3_OpenLoad");
            write("[18] ... CU1RSP_IO3_QBit");
            write("[19] ... CU1RSP_IO3_digital_Eing");
            write("[20] ... CU1RSP_Timeout_Fehler");
        }
        break;
        case FRM_HANDLE_Charisma_01:
        {
            write("[0] ... CHA_Fahrer_Umschaltung");
            write("[1] ... CHA_Ziel_FahrPr_ACC");
            write("[2] ... CHA_Ziel_FahrPr_AFS");
            write("[3] ... CHA_Ziel_FahrPr_AGA");
            write("[4] ... CHA_Ziel_FahrPr_DR");
            write("[5] ... CHA_Ziel_FahrPr_EPS");
            write("[6] ... CHA_Ziel_FahrPr_ESP");
            write("[7] ... CHA_Ziel_FahrPr_Freilauf");
            write("[8] ... CHA_Ziel_FahrPr_GE");
            write("[9] ... CHA_Ziel_FahrPr_MO");
            write("[10] ... CHA_Ziel_FahrPr_MO_StSt");
            write("[11] ... CHA_Ziel_FahrPr_QS");
            write("[12] ... CHA_Ziel_FahrPr_RGS");
            write("[13] ... CHA_Ziel_FahrPr_SAK");
            write("[14] ... CHA_Ziel_FahrPr_SCU");
            write("[15] ... CHA_Ziel_FahrPr_ST");
        }
        break;
        case FRM_HANDLE_Diagnose_01:
        {
            write("[0] ... DGN_Verlernzaehler");
            write("[1] ... KBI_Kilometerstand");
            write("[2] ... Kombi_02_alt");
            write("[3] ... UH_Jahr");
            write("[4] ... UH_Minute");
            write("[5] ... UH_Monat");
            write("[6] ... UH_Sekunde");
            write("[7] ... UH_Stunde");
            write("[8] ... UH_Tag");
            write("[9] ... Uhrzeit_01_alt");
        }
        break;
        case FRM_HANDLE_EPB_01:
        {
            write("[0] ... EPB_01_BZ");
            write("[1] ... EPB_01_CRC");
            write("[2] ... EPB_Anfahrwunsch_erkannt");
            write("[3] ... EPB_BCM2_Motor_Wakeup");
            write("[4] ... EPB_DAA_Randbed_erf");
            write("[5] ... EPB_Fehlerstatus");
            write("[6] ... EPB_Freig_Verzoeg_Anf");
            write("[7] ... EPB_Konsistenz_ACC");
            write("[8] ... EPB_Laengsbeschleunigung");
            write("[9] ... EPB_Pedalweg_Kuppl");
            write("[10] ... EPB_QBit_Laengsbeschleunigung");
            write("[11] ... EPB_QBit_Pedalweg_Kuppl");
            write("[12] ... EPB_QBit_Schalterpos");
            write("[13] ... EPB_Schalterposition");
            write("[14] ... EPB_Spannkraft");
            write("[15] ... EPB_Status");
            write("[16] ... EPB_Verzoeg_Anf");
        }
        break;
        case FRM_HANDLE_ESP_02:
        {
            write("[0] ... ESP_02_BZ");
            write("[1] ... ESP_02_CRC");
            write("[2] ... ESP_Gierrate");
            write("[3] ... ESP_Laengsbeschl");
            write("[4] ... ESP_Notbremsanzeige");
            write("[5] ... ESP_PLA_Abbruch");
            write("[6] ... ESP_QBit_Anf_Vert_Wank");
            write("[7] ... ESP_QBit_Gierrate");
            write("[8] ... ESP_QBit_Laengsbeschl");
            write("[9] ... ESP_QBit_Querb");
            write("[10] ... ESP_Querbeschleunigung");
            write("[11] ... ESP_SpannungsAnf");
            write("[12] ... ESP_Status_ESP_PLA");
            write("[13] ... ESP_Stillstandsflag");
            write("[14] ... ESP_VZ_Gierrate");
            write("[15] ... ESP_Verteil_Wankmom");
        }
        break;
        case FRM_HANDLE_ESP_05:
        {
            write("[0] ... ECD_Bremslicht");
            write("[1] ... ECD_Fehler");
            write("[2] ... ECD_nicht_verfuegbar");
            write("[3] ... ESP_05_BZ");
            write("[4] ... ESP_05_CRC");
            write("[5] ... ESP_Anforderung_EPB");
            write("[6] ... ESP_Autohold_Standby");
            write("[7] ... ESP_Autohold_aktiv");
            write("[8] ... ESP_BKV_Unterdruck");
            write("[9] ... ESP_Bremsdruck");
            write("[10] ... ESP_Bremsruck_AWV2");
            write("[11] ... ESP_Eingr_HL");
            write("[12] ... ESP_Eingr_HR");
            write("[13] ... ESP_Eingr_VL");
            write("[14] ... ESP_Eingr_VR");
            write("[15] ... ESP_FStatus_Anfahrhilfe");
            write("[16] ... ESP_Fahrer_bremst");
            write("[17] ... ESP_HBA_aktiv");
            write("[18] ... ESP_HDC_Standby");
            write("[19] ... ESP_HDC_aktiv");
            write("[20] ... ESP_Konsistenz_AWV2");
            write("[21] ... ESP_Konsistenz_TSK");
            write("[22] ... ESP_Lenkeingriff_ADS");
            write("[23] ... ESP_Prefill_ausgeloest");
            write("[24] ... ESP_QBit_Bremsdruck");
            write("[25] ... ESP_QBit_Fahrer_bremst");
            write("[26] ... ESP_Rueckwaertsfahrt_erkannt");
            write("[27] ... ESP_Schwelle_Unterdruck");
            write("[28] ... ESP_StartStopp_Info");
            write("[29] ... ESP_Status_Anfahrhilfe");
            write("[30] ... ESP_Status_Bremsdruck");
            write("[31] ... ESP_Status_Bremsentemp");
            write("[32] ... ESP_Verz_EPB_aktiv");
            write("[33] ... ESP_Verz_TSK_aktiv");
            write("[34] ... ESP_Verzoeg_EPB_verf");
        }
        break;
        case FRM_HANDLE_ESP_07:
        {
            write("[0] ... ESP_07_BZ");
            write("[1] ... ESP_07_CRC");
            write("[2] ... ESP_ACC_LDE");
            write("[3] ... ESP_CM_Variante");
            write("[4] ... ESP_Codierung_ADS");
            write("[5] ... ESP_MKB_ausloesbar");
            write("[6] ... ESP_OBD_Status");
            write("[7] ... ESP_Offroad_Modus");
            write("[8] ... ESP_Qualifizierung_Antriebsart");
            write("[9] ... ESP_Quattro_Antrieb");
            write("[10] ... ESP_RTA_HL");
            write("[11] ... ESP_RTA_HR");
            write("[12] ... ESP_RTA_VR");
            write("[13] ... ESP_Rollenmodus_Deaktivieren");
            write("[14] ... ESP_Stat_FallBack_eBKV");
            write("[15] ... ESP_nachtr_Stopp_Anf");
            write("[16] ... OBD_Fehler_Radsensor_HL");
            write("[17] ... OBD_Fehler_Radsensor_HR");
            write("[18] ... OBD_Fehler_Radsensor_VL");
            write("[19] ... OBD_Fehler_Radsensor_VR");
        }
        break;
        case FRM_HANDLE_ESP_10:
        {
            write("[0] ... ESP_10_BZ");
            write("[1] ... ESP_10_CRC");
            write("[2] ... ESP_HL_Fahrtrichtung");
            write("[3] ... ESP_HR_Fahrtrichtung");
            write("[4] ... ESP_QBit_Wegimpuls_HL");
            write("[5] ... ESP_QBit_Wegimpuls_HR");
            write("[6] ... ESP_QBit_Wegimpuls_VL");
            write("[7] ... ESP_QBit_Wegimpuls_VR");
            write("[8] ... ESP_VL_Fahrtrichtung");
            write("[9] ... ESP_VR_Fahrtrichtung");
            write("[10] ... ESP_Wegimpuls_HL");
            write("[11] ... ESP_Wegimpuls_HR");
            write("[12] ... ESP_Wegimpuls_VL");
            write("[13] ... ESP_Wegimpuls_VR");
        }
        break;
        case FRM_HANDLE_ESP_19:
        {
            write("[0] ... ESP_HL_Radgeschw_02");
            write("[1] ... ESP_HR_Radgeschw_02");
            write("[2] ... ESP_VL_Radgeschw_02");
            write("[3] ... ESP_VR_Radgeschw_02");
        }
        break;
        case FRM_HANDLE_ESP_20:
        {
            write("[0] ... BR_QBit_Reifenumfang");
            write("[1] ... BR_Reifenumfang");
            write("[2] ... BR_Systemart");
            write("[3] ... ESP_20_BZ");
            write("[4] ... ESP_20_CRC");
            write("[5] ... ESP_Charisma_FahrPr");
            write("[6] ... ESP_Charisma_Status");
            write("[7] ... ESP_Dachrelingsensor");
            write("[8] ... ESP_Stoppverbot_Anz_01");
            write("[9] ... ESP_Stoppverbot_Anz_02");
            write("[10] ... ESP_Stoppverbot_Anz_03");
            write("[11] ... ESP_Stoppverbot_Anz_04");
            write("[12] ... ESP_Stoppverbot_Anz_05");
            write("[13] ... ESP_Stoppverbot_Anz_06");
            write("[14] ... ESP_Stoppverbot_Anz_07");
            write("[15] ... ESP_Stoppverbot_Anz_Std");
            write("[16] ... ESP_Wiederstart_Anz_01");
            write("[17] ... ESP_Wiederstart_Anz_02");
            write("[18] ... ESP_Wiederstart_Anz_03");
            write("[19] ... ESP_Wiederstart_Anz_Std");
            write("[20] ... ESP_Zaehnezahl");
        }
        break;
        case FRM_HANDLE_ESP_21:
        {
            write("[0] ... ABS_Bremsung");
            write("[1] ... ASR_Anf");
            write("[2] ... ASR_Schalteingriff");
            write("[3] ... ASR_Tastung_passiv");
            write("[4] ... BR_Eingriffsmoment");
            write("[5] ... EBV_Eingriff");
            write("[6] ... EDS_Eingriff");
            write("[7] ... ESP_21_BZ");
            write("[8] ... ESP_21_CRC");
            write("[9] ... ESP_ASP");
            write("[10] ... ESP_AWV3_Brems_aktiv");
            write("[11] ... ESP_Anhaltevorgang_ACC_aktiv");
            write("[12] ... ESP_Diagnose");
            write("[13] ... ESP_Eingriff");
            write("[14] ... ESP_Haltebestaetigung");
            write("[15] ... ESP_MKB_Abbruch_Geschw");
            write("[16] ... ESP_PLA_Bremseingriff");
            write("[17] ... ESP_QBit_v_Signal");
            write("[18] ... ESP_Systemstatus");
            write("[19] ... ESP_Tastung_passiv");
            write("[20] ... ESP_v_Signal");
            write("[21] ... MSR_Anf");
            write("[22] ... OBD_QBit_Schlechtweg");
            write("[23] ... OBD_Schlechtweg");
        }
        break;
        case FRM_HANDLE_Einheiten_01:
        {
            write("[0] ... KBI_Einheit_Datum");
            write("[1] ... KBI_Einheit_Druck");
            write("[2] ... KBI_Einheit_Sprache");
            write("[3] ... KBI_Einheit_Streckenanz");
            write("[4] ... KBI_Einheit_Temp");
            write("[5] ... KBI_Einheit_Uhrzeit");
            write("[6] ... KBI_Einheit_Verbrauch");
            write("[7] ... KBI_Einheit_Volumen");
            write("[8] ... KBI_MFA_v_Einheit_02");
        }
        break;
        case FRM_HANDLE_GRA_ACC_01:
        {
            write("[0] ... GRA_ACC_01_BZ");
            write("[1] ... GRA_ACC_01_CRC");
            write("[2] ... GRA_Abbrechen");
            write("[3] ... GRA_Codierung");
            write("[4] ... GRA_Fehler");
            write("[5] ... GRA_Hauptschalter");
            write("[6] ... GRA_LIM_Taste_verfuegbar");
            write("[7] ... GRA_Limiter");
            write("[8] ... GRA_Tip_Hoch");
            write("[9] ... GRA_Tip_Runter");
            write("[10] ... GRA_Tip_Setzen");
            write("[11] ... GRA_Tip_Stufe_2");
            write("[12] ... GRA_Tip_Wiederaufnahme");
            write("[13] ... GRA_Typ_Bedienteil");
            write("[14] ... GRA_Typ_Hauptschalter");
            write("[15] ... GRA_Verstellung_Zeitluecke");
            write("[16] ... GRA_reserveByte4");
            write("[17] ... GRA_reserveByte5");
            write("[18] ... GRA_reserveByte6");
            write("[19] ... GRA_reserveByte7");
            write("[20] ... GRA_reserveByte8");
        }
        break;
        case FRM_HANDLE_Gateway_72:
        {
            write("[0] ... AAG_Anhaenger_erkannt");
            write("[1] ... Anhaenger_01_alt");
            write("[2] ... BCM1_Aussen_Temp_ungef");
            write("[3] ... BCM1_MH_Schalter");
            write("[4] ... BCM1_OBD_FStatus_ATemp");
            write("[5] ... BCM1_Rueckfahrlicht_Schalter");
            write("[6] ... BCM_01_alt");
            write("[7] ... BCM_Rueckfahrlicht_Anf");
            write("[8] ... BH_Blinker_li");
            write("[9] ... BH_Blinker_re");
            write("[10] ... BH_Fernlicht");
            write("[11] ... KL_Thermomanagement");
            write("[12] ... Klima_11_alt");
            write("[13] ... Klima_Sensor_02_alt");
            write("[14] ... Licht_Anf_01_alt");
            write("[15] ... SMLS_01_alt");
            write("[16] ... VS_VD_entriegelt");
            write("[17] ... VS_VD_offen_ver");
            write("[18] ... VS_VD_zu_ver");
            write("[19] ... VS_Verdeck_Anf");
            write("[20] ... Verdeck_01_alt");
            write("[21] ... WFS_01_alt");
            write("[22] ... WFS_ID_Geb_autorisiert_in_Kl15");
            write("[23] ... WFS_Schluessel_Fahrberecht");
            write("[24] ... WWSs_01_alt");
            write("[25] ... Waschen_vorne_aktiv");
            write("[26] ... Wischer_01_alt");
            write("[27] ... Wischer_vorne_aktiv");
            write("[28] ... ZV_02_alt");
            write("[29] ... ZV_BT_offen");
            write("[30] ... ZV_FT_offen");
            write("[31] ... ZV_HBFS_offen");
            write("[32] ... ZV_HD_offen");
            write("[33] ... ZV_HFS_offen");
        }
        break;
        case FRM_HANDLE_Gateway_74:
        {
            write("[0] ... ELV_01_alt");
            write("[1] ... ELV_Anf_Klemme_50");
            write("[2] ... EPS_Lenkerposition");
            write("[3] ... GW_Status_GRA");
            write("[4] ... HLR_01_alt");
            write("[5] ... KL_Geblspng_Soll");
            write("[6] ... KL_PTC_Verbauinfo");
            write("[7] ... KL_Umluftklappe_Status");
            write("[8] ... KY_StartStopp_Info");
            write("[9] ... Kessy_04_alt");
            write("[10] ... Klima_12_alt");
            write("[11] ... LH_EPS_01_alt");
            write("[12] ... LIN_2_alt");
            write("[13] ... LS_Tiptronic_Fehler");
            write("[14] ... MFG_01_alt");
            write("[15] ... MFL_Tip_Down");
            write("[16] ... MFL_Tip_Up");
            write("[17] ... MF_Anlassersperre");
            write("[18] ... MF_StartStopp_Info");
            write("[19] ... PH_StartStopp_Info");
            write("[20] ... PH_nachtr_Stopp_Anf");
            write("[21] ... PTC_Freigabe");
            write("[22] ... Parkhilfe_01_alt");
        }
        break;
        case FRM_HANDLE_Getriebe_11:
        {
            write("[0] ... GE_Fahrstufe");
            write("[1] ... GE_Freig_MMom_Vorhalt");
            write("[2] ... GE_MMom_Soll_02");
            write("[3] ... GE_MMom_Status");
            write("[4] ... GE_MMom_Status_02");
            write("[5] ... GE_MMom_Vorhalt_02");
            write("[6] ... GE_Schaltablauf");
            write("[7] ... GE_Status_Kraftschluss");
            write("[8] ... GE_Uefkt");
            write("[9] ... GE_Verbot_Ausblendung");
            write("[10] ... GE_Zielgang");
            write("[11] ... GE_reserv_Fahrstufe");
            write("[12] ... Getriebe_11_BZ");
            write("[13] ... Getriebe_11_CRC");
        }
        break;
        case FRM_HANDLE_Getriebe_12:
        {
            write("[0] ... GE_Anheb_Solldrehz_Leerlauf");
            write("[1] ... GE_Aufnahmemoment");
            write("[2] ... GE_Drehzahlmesser_Daempfung");
            write("[3] ... GE_Freigabe_Synchro");
            write("[4] ... GE_HYB_DZ_Eingriff");
            write("[5] ... GE_Mom_Begr_Gradient");
            write("[6] ... GE_Schubabschalt_Unt");
            write("[7] ... GE_Synchro_Status");
            write("[8] ... GE_Synchro_Wunschdrehz");
            write("[9] ... GE_Synchro_Zeit");
            write("[10] ... Getriebe_12_BZ");
            write("[11] ... Getriebe_12_CRC");
        }
        break;
        case FRM_HANDLE_Getriebe_13:
        {
            write("[0] ... GE_Anf_Zylabsch");
            write("[1] ... GE_Eingangsdrehz");
            write("[2] ... GE_Entkopplung_Status");
            write("[3] ... GE_Freig_Langfr_Schutzmom");
            write("[4] ... GE_Grenzkriechmoment");
            write("[5] ... GE_Langfr_Schutzmom_02");
            write("[6] ... GE_Notlauf");
            write("[7] ... GE_StartStopp_Info");
            write("[8] ... GE_Verlustmoment_02");
            write("[9] ... Getriebe_13_BZ");
            write("[10] ... Getriebe_13_CRC");
        }
        break;
        case FRM_HANDLE_Getriebe_14:
        {
            write("[0] ... Freilauf_Charisma_FahrPr");
            write("[1] ... Freilauf_Charisma_Status");
            write("[2] ... GE_Charisma_FahrPr");
            write("[3] ... GE_Charisma_Status");
            write("[4] ... GE_Codierung_MSG");
            write("[5] ... GE_Freigabe_Verfallsinfo_WFS");
            write("[6] ... GE_Heizwunsch");
            write("[7] ... GE_LFR_Adaption");
            write("[8] ... GE_LaunchControl");
            write("[9] ... GE_OBD_AbsperrVent");
            write("[10] ... GE_OBD_Status");
            write("[11] ... GE_Sumpftemperatur");
            write("[12] ... GE_Verlustmoment_02");
            write("[13] ... GE_Zustand_Kuppltemp");
            write("[14] ... GE_amax_moeglich");
        }
        break;
        case FRM_HANDLE_Getriebe_Hybrid_01:
        {
            write("[0] ... GE_HYB_Fehlerstatus");
            write("[1] ... GE_HYB_Filt_MomAufbau");
            write("[2] ... GE_HYB_Freig_VM_EM_Stop");
            write("[3] ... GE_HYB_Freig_sSchl_K0");
            write("[4] ... GE_HYB_Freigabe_K0");
            write("[5] ... GE_HYB_Freigabe_LL_Reg");
            write("[6] ... GE_HYB_MomEingriff_EM");
            write("[7] ... GE_HYB_Sportfaktor");
            write("[8] ... GE_HYB_StartAnf");
            write("[9] ... GE_HYB_VM_Startkontr");
            write("[10] ... GE_HYB_VM_akt_halten");
            write("[11] ... GE_HYB_VZ_MomEingriff_EM");
            write("[12] ... GE_HYB_Wiederstart");
            write("[13] ... GE_HYB_nK0");
            write("[14] ... Getriebe_Hybrid_01_BZ");
            write("[15] ... Getriebe_Hybrid_01_CRC");
        }
        break;
        case FRM_HANDLE_HVEM_02:
        {
            write("[0] ... HVEM_DauerRed");
            write("[1] ... HVEM_FreigabeKlimatisierung");
            write("[2] ... HVEM_IstLeistungNA");
            write("[3] ... HVEM_IstStrom_HVVerbraucher");
            write("[4] ... HVEM_LeistungTMEVorgabe");
            write("[5] ... HVEM_MinLeistungNA");
            write("[6] ... HVEM_Temp_Vorkond_Innen");
        }
        break;
        case FRM_HANDLE_HVEM_04:
        {
            write("[0] ... HVEM_Anf_ReichweiteNV");
            write("[1] ... HVEM_HV_Anf");
            write("[2] ... HVEM_KlimaMaxHVStrom");
            write("[3] ... HVEM_LeistungsAnf");
            write("[4] ... HVEM_NVLeistungEmpf");
            write("[5] ... HVEM_Nachlad_Status");
            write("[6] ... HVEM_Nachladen_Anf");
            write("[7] ... HVEM_Text_1");
        }
        break;
        case FRM_HANDLE_Klemmen_Status_01:
        {
            write("[0] ... BCM_Remotestart_Betrieb");
            write("[1] ... KST_Fahrerhinweis_1");
            write("[2] ... KST_Fahrerhinweis_2");
            write("[3] ... KST_Fahrerhinweis_3");
            write("[4] ... KST_Fahrerhinweis_4");
            write("[5] ... KST_Fahrerhinweis_5");
            write("[6] ... KST_Fahrerhinweis_6");
            write("[7] ... KST_Warn_P1_ZST_def");
            write("[8] ... KST_Warn_P2_ZST_def");
            write("[9] ... Klemmen_Status_01_BZ");
            write("[10] ... Klemmen_Status_01_CRC");
            write("[11] ... ZAS_Kl_15");
            write("[12] ... ZAS_Kl_50_Startanforderung");
            write("[13] ... ZAS_Kl_S");
            write("[14] ... ZAS_Kl_X");
        }
        break;
        case FRM_HANDLE_Klima_11:
        {
            write("[0] ... KL_AC_Schalter");
            write("[1] ... KL_Anf_KL");
            write("[2] ... KL_Ausstattung_Klima");
            write("[3] ... KL_Charisma_FahrPr");
            write("[4] ... KL_Charisma_Status");
            write("[5] ... KL_Comp_enable");
            write("[6] ... KL_Comp_rev_rq");
            write("[7] ... KL_Drehz_Anh");
            write("[8] ... KL_Komp_Moment_alt");
            write("[9] ... KL_Last_Kompr");
            write("[10] ... KL_Spannungs_Anf");
            write("[11] ... KL_StartStopp_Info");
            write("[12] ... KL_Thermomanagement");
            write("[13] ... KL_Vorwarn_Komp_ein");
            write("[14] ... KL_Vorwarn_Zuheizer_ein");
            write("[15] ... KL_Zustand");
            write("[16] ... KL_el_Zuheizer_Stufe");
            write("[17] ... KL_nachtr_Stopp_Anf");
        }
        break;
        case FRM_HANDLE_Kombi_01:
        {
            write("[0] ... KBI_ABS_Lampe");
            write("[1] ... KBI_Airbag_Lampe");
            write("[2] ... KBI_Anzeigefehler_LDW");
            write("[3] ... KBI_Anzeigefehler_NV");
            write("[4] ... KBI_Anzeigefehler_SWA");
            write("[5] ... KBI_Anzeigestatus_ACC");
            write("[6] ... KBI_Anzeigestatus_GRA");
            write("[7] ... KBI_Anzeigestatus_LIM");
            write("[8] ... KBI_BKL_Lampe");
            write("[9] ... KBI_ESP_Lampe");
            write("[10] ... KBI_Einheit_Tacho");
            write("[11] ... KBI_Fehler_Anzeige_ACC");
            write("[12] ... KBI_Handbremse");
            write("[13] ... KBI_Konsistenz_ACC");
            write("[14] ... KBI_Lenkung_Lampe");
            write("[15] ... KBI_MFA_v_Einheit_01");
            write("[16] ... KBI_NV_in_Anzeige");
            write("[17] ... KBI_Oeldruck_Schalter");
            write("[18] ... KBI_Oeldruckwarnung");
            write("[19] ... KBI_PLA_in_Anzeige");
            write("[20] ... KBI_SILA_gueltig");
            write("[21] ... KBI_Tankwarnung");
            write("[22] ... KBI_V_Digital");
            write("[23] ... KBI_Vorglueh_System_Lampe");
            write("[24] ... KBI_angez_Geschw");
            write("[25] ... KBI_im_Stellgliedtest");
            write("[26] ... Kombi_01_BZ");
        }
        break;
        case FRM_HANDLE_Kombi_02:
        {
            write("[0] ... KBI_Aussen_Temp_gef");
            write("[1] ... KBI_FStatus_Tank");
            write("[2] ... KBI_Inhalt_Tank");
            write("[3] ... KBI_Kilometerstand");
            write("[4] ... KBI_Oelwechsel_durchgefuehrt");
            write("[5] ... KBI_QBit_Aussen_Temp_gef");
            write("[6] ... KBI_RDK_Kalibrier_Anf");
            write("[7] ... KBI_Standzeit_02");
        }
        break;
        case FRM_HANDLE_LWI_01:
        {
            write("[0] ... LWI_01_BZ");
            write("[1] ... LWI_01_CRC");
            write("[2] ... LWI_Lenkradw_Geschw");
            write("[3] ... LWI_Lenkradwinkel");
            write("[4] ... LWI_QBit_Lenkradwinkel");
            write("[5] ... LWI_QBit_Sub_Daten");
            write("[6] ... LWI_Sensorstatus");
            write("[7] ... LWI_Sub_Daten");
            write("[8] ... LWI_VZ_Lenkradw_Geschw");
            write("[9] ... LWI_VZ_Lenkradwinkel");
        }
        break;
        case FRM_HANDLE_Licht_hinten_01:
        {
            write("[0] ... BCM2_Bremsl_durch_ECD");
            write("[1] ... LH_3_Bremsl_def");
            write("[2] ... LH_Aussenlicht_def");
            write("[3] ... LH_Blinker_HL_akt");
            write("[4] ... LH_Blinker_HR_akt");
            write("[5] ... LH_Blinker_li_def");
            write("[6] ... LH_Blinker_re_def");
            write("[7] ... LH_Brems_Blk_li_def");
            write("[8] ... LH_Brems_Blk_re_def");
            write("[9] ... LH_Bremsl_li_def");
            write("[10] ... LH_Bremsl_li_ges_def");
            write("[11] ... LH_Bremsl_re_def");
            write("[12] ... LH_Bremsl_re_ges_def");
            write("[13] ... LH_Bremslicht_H_aktiv");
            write("[14] ... LH_Kennzl_def");
            write("[15] ... LH_Nebel_li_def");
            write("[16] ... LH_Nebel_mi_def");
            write("[17] ... LH_Nebel_re_def");
            write("[18] ... LH_Nebelschluss_aktiv");
            write("[19] ... LH_Parklicht_HL_aktiv");
            write("[20] ... LH_Parklicht_HR_aktiv");
            write("[21] ... LH_Rueckf_li_def");
            write("[22] ... LH_Rueckf_mi_def");
            write("[23] ... LH_Rueckf_re_def");
            write("[24] ... LH_Rueckfahrlicht_aktiv");
            write("[25] ... LH_SL_BRL_BLK_li_def");
            write("[26] ... LH_SL_BRL_BLK_re_def");
            write("[27] ... LH_Schluss_Brems_Nebel_li_def");
            write("[28] ... LH_Schluss_Brems_Nebel_re_def");
            write("[29] ... LH_Schluss_Brems_li_def");
            write("[30] ... LH_Schluss_Brems_re_def");
            write("[31] ... LH_Schluss_Nebel_li_def");
            write("[32] ... LH_Schluss_Nebel_re_def");
            write("[33] ... LH_Schlusslicht_li_def");
            write("[34] ... LH_Schlusslicht_re_def");
            write("[35] ... LH_Standlicht_H_aktiv");
            write("[36] ... Licht_hinten_01_BZ");
        }
        break;
        case FRM_HANDLE_NMH_Gateway:
        {
            write("[0] ... NM_Gateway_ACAN_Aktivitaet");
            write("[1] ... NM_Gateway_Bedien_LIN_Aktivitaet");
            write("[2] ... NM_Gateway_Car_Wakeup");
            write("[3] ... NM_Gateway_DiagCAN_Aktivitaet");
            write("[4] ... NM_Gateway_ECAN_Aktivitaet");
            write("[5] ... NM_Gateway_EM_Aktivitaet");
            write("[6] ... NM_Gateway_EnergieLIN_Aktivitaet");
            write("[7] ... NM_Gateway_FCAN_Aktivitaet");
            write("[8] ... NM_Gateway_ICAN_Aktivitaet");
            write("[9] ... NM_Gateway_KCAN_Aktivitaet");
            write("[10] ... NM_Gateway_KS_Aktivitaet");
            write("[11] ... NM_Gateway_NL_EM");
            write("[12] ... NM_Gateway_NL_Shutdown");
            write("[13] ... NM_Gateway_NL_Spg_Messung");
            write("[14] ... NM_Gateway_NL_Wakeup_Monitor");
            write("[15] ... NM_Gateway_NM_State");
            write("[16] ... NM_Gateway_NM_aktiv_Diagnose");
            write("[17] ... NM_Gateway_NM_aktiv_KL15");
            write("[18] ... NM_Gateway_NM_aktiv_Tmin");
            write("[19] ... NM_Gateway_SNI");
            write("[20] ... NM_Gateway_UDS_CC");
            write("[21] ... NM_Gateway_Wakeup");
        }
        break;
        case FRM_HANDLE_OBD_Tankgeber_01:
        {
            write("[0] ... OBD_TG_F_Status_1");
            write("[1] ... OBD_TG_F_Status_2");
            write("[2] ... OBD_TG_F_Status_3");
            write("[3] ... OBD_TG_F_Status_4");
            write("[4] ... OBD_TG_Sens_Rohwert_1");
            write("[5] ... OBD_TG_Sens_Rohwert_2");
            write("[6] ... OBD_TG_Sens_Rohwert_3");
            write("[7] ... OBD_TG_Sens_Rohwert_4");
        }
        break;
        case FRM_HANDLE_Remotestart_FFB:
        {
            write("[0] ... RSF_Tastencode_1");
            write("[1] ... RSF_Tastencode_2");
            write("[2] ... RSF_Tastencode_Maske");
        }
        break;
        case FRM_HANDLE_STH_01:
        {
            write("[0] ... STH_EKP_Anst");
            write("[1] ... STH_Fehler_ElWaPu");
            write("[2] ... STH_Fehlerstatus");
            write("[3] ... STH_Funk_aus");
            write("[4] ... STH_Funk_ein");
            write("[5] ... STH_Geblaese");
            write("[6] ... STH_Heizleistung");
            write("[7] ... STH_KD_Fehler");
            write("[8] ... STH_KVS");
            write("[9] ... STH_KVS_Ueberlauf");
            write("[10] ... STH_LED");
            write("[11] ... STH_Motorvorwaermung");
            write("[12] ... STH_Pumpe_ein");
            write("[13] ... STH_Pumpen_Anf_extern");
            write("[14] ... STH_Servicemode");
            write("[15] ... STH_Start_folgt");
            write("[16] ... STH_Texte");
            write("[17] ... STH_Ventil_Status");
            write("[18] ... STH_Ventiloeffnungszeit");
            write("[19] ... STH_Waermeeintrag");
            write("[20] ... STH_Wassertemp");
            write("[21] ... STH_Zusatzheizung");
            write("[22] ... STH_war_aktiv");
        }
        break;
        case FRM_HANDLE_STS_01:
        {
            write("[0] ... STS_01_BZ");
            write("[1] ... STS_01_CRC");
            write("[2] ... STS_Alarm_Blinker");
            write("[3] ... STS_Alarm_still");
            write("[4] ... STS_Anlassersperre");
            write("[5] ... STS_Car_not_under_theft");
            write("[6] ... STS_Car_under_theft");
            write("[7] ... STS_Fahrlicht");
            write("[8] ... STS_LIN_aktiv");
            write("[9] ... STS_Laderelais");
            write("[10] ... STS_Leerlaufschaltung");
            write("[11] ... STS_Notstart");
            write("[12] ... STS_Signalhorn");
            write("[13] ... STS_Standlicht");
            write("[14] ... STS_Summer");
            write("[15] ... STS_Texte");
            write("[16] ... STS_Typencodierung");
        }
        break;
        case FRM_HANDLE_Systeminfo_01:
        {
            write("[0] ... GW_KD_Fehler");
            write("[1] ... SI_BUS_01");
            write("[2] ... SI_BUS_02");
            write("[3] ... SI_BUS_03");
            write("[4] ... SI_BUS_04");
            write("[5] ... SI_BUS_05");
            write("[6] ... SI_BUS_06");
            write("[7] ... SI_BUS_07");
            write("[8] ... SI_BUS_08");
            write("[9] ... SI_BUS_09");
            write("[10] ... SI_BUS_10");
            write("[11] ... SI_BUS_11");
            write("[12] ... SI_BUS_12");
            write("[13] ... SI_BUS_13");
            write("[14] ... SI_BUS_14");
            write("[15] ... SI_BUS_15");
            write("[16] ... SI_Bus_Identifikation");
            write("[17] ... SI_NWDF");
            write("[18] ... SI_NWDF_gueltig");
            write("[19] ... SI_QRS_Mode");
            write("[20] ... SI_Sammel_SG_Fehler");
            write("[21] ... SI_Sammelfehler");
            write("[22] ... SI_T_Mode");
            write("[23] ... SI_T_Schutz");
        }
        break;
        case FRM_HANDLE_WBA_03:
        {
            write("[0] ... GE_Sollgang");
            write("[1] ... GE_Stoppverbot_Anz_01");
            write("[2] ... GE_Stoppverbot_Anz_02");
            write("[3] ... GE_Stoppverbot_Anz_03");
            write("[4] ... GE_Stoppverbot_Anz_04");
            write("[5] ... GE_Stoppverbot_Anz_05");
            write("[6] ... GE_Stoppverbot_Anz_06");
            write("[7] ... GE_Stoppverbot_Anz_07");
            write("[8] ... GE_Stoppverbot_Anz_Std");
            write("[9] ... GE_Tipschaltempf_verfuegbar");
            write("[10] ... GE_Wiederstart_Anz_Std");
            write("[11] ... WBA_03_BZ");
            write("[12] ... WBA_03_CRC");
            write("[13] ... WBA_Fahrstufe_02");
            write("[14] ... WBA_GE_Texte");
            write("[15] ... WBA_GE_Warnung_02");
            write("[16] ... WBA_GE_Zusatzwarnungen");
            write("[17] ... WBA_Schaltschema");
            write("[18] ... WBA_Segeln_aktiv");
            write("[19] ... WBA_ZielFahrstufe");
            write("[20] ... WBA_eing_Gang_02");
        }
        break;

    }
}

/*@@caplFunc:HelpSignal():*/
HelpSignal ()
{
    //REPLACE_HELP_SIGNAL
}
/*@@end*/

/*@@caplFunc:GetFrameName(int):*/
GetFrameName (int FrmIdx)
{
    switch (FrmIdx)
    {
        case FRM_HANDLE_ACC_06:
            strncpy(CaplCtrl_FrameName, "ACC_06", 7);
            break;
        case FRM_HANDLE_Airbag_01:
            strncpy(CaplCtrl_FrameName, "Airbag_01", 10);
            break;
        case FRM_HANDLE_Airbag_02:
            strncpy(CaplCtrl_FrameName, "Airbag_02", 10);
            break;
        case FRM_HANDLE_Anhaenger_01:
            strncpy(CaplCtrl_FrameName, "Anhaenger_01", 13);
            break;
        case FRM_HANDLE_BCM_01:
            strncpy(CaplCtrl_FrameName, "BCM_01", 7);
            break;
        case FRM_HANDLE_BEM_05:
            strncpy(CaplCtrl_FrameName, "BEM_05", 7);
            break;
        case FRM_HANDLE_Bremse_EV_01:
            strncpy(CaplCtrl_FrameName, "Bremse_EV_01", 13);
            break;
        case FRM_HANDLE_Bremse_EV_02:
            strncpy(CaplCtrl_FrameName, "Bremse_EV_02", 13);
            break;
        case FRM_HANDLE_CAN_Umsetzer_Resp_01:
            strncpy(CaplCtrl_FrameName, "CAN_Umsetzer_Resp_01", 21);
            break;
        case FRM_HANDLE_Charisma_01:
            strncpy(CaplCtrl_FrameName, "Charisma_01", 12);
            break;
        case FRM_HANDLE_Diagnose_01:
            strncpy(CaplCtrl_FrameName, "Diagnose_01", 12);
            break;
        case FRM_HANDLE_EPB_01:
            strncpy(CaplCtrl_FrameName, "EPB_01", 7);
            break;
        case FRM_HANDLE_ESP_02:
            strncpy(CaplCtrl_FrameName, "ESP_02", 7);
            break;
        case FRM_HANDLE_ESP_05:
            strncpy(CaplCtrl_FrameName, "ESP_05", 7);
            break;
        case FRM_HANDLE_ESP_07:
            strncpy(CaplCtrl_FrameName, "ESP_07", 7);
            break;
        case FRM_HANDLE_ESP_10:
            strncpy(CaplCtrl_FrameName, "ESP_10", 7);
            break;
        case FRM_HANDLE_ESP_19:
            strncpy(CaplCtrl_FrameName, "ESP_19", 7);
            break;
        case FRM_HANDLE_ESP_20:
            strncpy(CaplCtrl_FrameName, "ESP_20", 7);
            break;
        case FRM_HANDLE_ESP_21:
            strncpy(CaplCtrl_FrameName, "ESP_21", 7);
            break;
        case FRM_HANDLE_Einheiten_01:
            strncpy(CaplCtrl_FrameName, "Einheiten_01", 13);
            break;
        case FRM_HANDLE_GRA_ACC_01:
            strncpy(CaplCtrl_FrameName, "GRA_ACC_01", 11);
            break;
        case FRM_HANDLE_Gateway_72:
            strncpy(CaplCtrl_FrameName, "Gateway_72", 11);
            break;
        case FRM_HANDLE_Gateway_74:
            strncpy(CaplCtrl_FrameName, "Gateway_74", 11);
            break;
        case FRM_HANDLE_Getriebe_11:
            strncpy(CaplCtrl_FrameName, "Getriebe_11", 12);
            break;
        case FRM_HANDLE_Getriebe_12:
            strncpy(CaplCtrl_FrameName, "Getriebe_12", 12);
            break;
        case FRM_HANDLE_Getriebe_13:
            strncpy(CaplCtrl_FrameName, "Getriebe_13", 12);
            break;
        case FRM_HANDLE_Getriebe_14:
            strncpy(CaplCtrl_FrameName, "Getriebe_14", 12);
            break;
        case FRM_HANDLE_Getriebe_Hybrid_01:
            strncpy(CaplCtrl_FrameName, "Getriebe_Hybrid_01", 19);
            break;
        case FRM_HANDLE_HVEM_02:
            strncpy(CaplCtrl_FrameName, "HVEM_02", 8);
            break;
        case FRM_HANDLE_HVEM_04:
            strncpy(CaplCtrl_FrameName, "HVEM_04", 8);
            break;
        case FRM_HANDLE_Klemmen_Status_01:
            strncpy(CaplCtrl_FrameName, "Klemmen_Status_01", 18);
            break;
        case FRM_HANDLE_Klima_11:
            strncpy(CaplCtrl_FrameName, "Klima_11", 9);
            break;
        case FRM_HANDLE_Kombi_01:
            strncpy(CaplCtrl_FrameName, "Kombi_01", 9);
            break;
        case FRM_HANDLE_Kombi_02:
            strncpy(CaplCtrl_FrameName, "Kombi_02", 9);
            break;
        case FRM_HANDLE_LWI_01:
            strncpy(CaplCtrl_FrameName, "LWI_01", 7);
            break;
        case FRM_HANDLE_Licht_hinten_01:
            strncpy(CaplCtrl_FrameName, "Licht_hinten_01", 16);
            break;
        case FRM_HANDLE_NMH_Gateway:
            strncpy(CaplCtrl_FrameName, "NMH_Gateway", 12);
            break;
        case FRM_HANDLE_OBD_Tankgeber_01:
            strncpy(CaplCtrl_FrameName, "OBD_Tankgeber_01", 17);
            break;
        case FRM_HANDLE_Remotestart_FFB:
            strncpy(CaplCtrl_FrameName, "Remotestart_FFB", 16);
            break;
        case FRM_HANDLE_STH_01:
            strncpy(CaplCtrl_FrameName, "STH_01", 7);
            break;
        case FRM_HANDLE_STS_01:
            strncpy(CaplCtrl_FrameName, "STS_01", 7);
            break;
        case FRM_HANDLE_Systeminfo_01:
            strncpy(CaplCtrl_FrameName, "Systeminfo_01", 14);
            break;
        case FRM_HANDLE_WBA_03:
            strncpy(CaplCtrl_FrameName, "WBA_03", 7);
            break;
    }
}
/*@@end*/

/*@@caplFunc:GetSignalName(int,int):*/
GetSignalName (int FrmIdx, int SigIdx)
{
    switch (FrmIdx)
    {
        case FRM_HANDLE_ACC_06:
        {
            switch (SigIdx)
            {
                case 0:
                    strncpy(CaplCtrl_SignalName, "ACC_06_BZ", 10);
                    break;
                case 1:
                    strncpy(CaplCtrl_SignalName, "ACC_06_CRC", 11);
                    break;
                case 2:
                    strncpy(CaplCtrl_SignalName, "ACC_Anfahren", 13);
                    break;
                case 3:
                    strncpy(CaplCtrl_SignalName, "ACC_Anhalten", 13);
                    break;
                case 4:
                    strncpy(CaplCtrl_SignalName, "ACC_Minimale_Bremsung", 22);
                    break;
                case 5:
                    strncpy(CaplCtrl_SignalName, "ACC_Sollbeschleunigung_02", 26);
                    break;
                case 6:
                    strncpy(CaplCtrl_SignalName, "ACC_StartStopp_Info", 20);
                    break;
                case 7:
                    strncpy(CaplCtrl_SignalName, "ACC_Status_ACC", 15);
                    break;
                case 8:
                    strncpy(CaplCtrl_SignalName, "ACC_Typ", 8);
                    break;
                case 9:
                    strncpy(CaplCtrl_SignalName, "ACC_limitierte_Anfahrdyn", 25);
                    break;
                case 10:
                    strncpy(CaplCtrl_SignalName, "ACC_neg_Sollbeschl_Grad_02", 27);
                    break;
                case 11:
                    strncpy(CaplCtrl_SignalName, "ACC_pos_Sollbeschl_Grad_02", 27);
                    break;
                case 12:
                    strncpy(CaplCtrl_SignalName, "ACC_zul_Regelabw_oben", 22);
                    break;
                case 13:
                    strncpy(CaplCtrl_SignalName, "ACC_zul_Regelabw_unten", 23);
                    break;
            }
        }
        break;
        case FRM_HANDLE_Airbag_01:
        {
            switch (SigIdx)
            {
                case 0:
                    strncpy(CaplCtrl_SignalName, "AB_Anzeige_Fussg", 17);
                    break;
                case 1:
                    strncpy(CaplCtrl_SignalName, "AB_Crash_Int", 13);
                    break;
                case 2:
                    strncpy(CaplCtrl_SignalName, "AB_Deaktiviert", 15);
                    break;
                case 3:
                    strncpy(CaplCtrl_SignalName, "AB_Deaktivierung_HV", 20);
                    break;
                case 4:
                    strncpy(CaplCtrl_SignalName, "AB_Diagnose", 12);
                    break;
                case 5:
                    strncpy(CaplCtrl_SignalName, "AB_Erh_Auf_VB", 14);
                    break;
                case 6:
                    strncpy(CaplCtrl_SignalName, "AB_Front_Crash", 15);
                    break;
                case 7:
                    strncpy(CaplCtrl_SignalName, "AB_Gurtwarn_VB", 15);
                    break;
                case 8:
                    strncpy(CaplCtrl_SignalName, "AB_Gurtwarn_VF", 15);
                    break;
                case 9:
                    strncpy(CaplCtrl_SignalName, "AB_Heck_Crash", 14);
                    break;
                case 10:
                    strncpy(CaplCtrl_SignalName, "AB_Lampe", 9);
                    break;
                case 11:
                    strncpy(CaplCtrl_SignalName, "AB_MKB_Anforderung", 19);
                    break;
                case 12:
                    strncpy(CaplCtrl_SignalName, "AB_MKB_gueltig", 15);
                    break;
                case 13:
                    strncpy(CaplCtrl_SignalName, "AB_PAO_Leuchte_Anf", 19);
                    break;
                case 14:
                    strncpy(CaplCtrl_SignalName, "AB_RGS_Anst", 12);
                    break;
                case 15:
                    strncpy(CaplCtrl_SignalName, "AB_Rollover_Crash", 18);
                    break;
                case 16:
                    strncpy(CaplCtrl_SignalName, "AB_SB_Crash", 12);
                    break;
                case 17:
                    strncpy(CaplCtrl_SignalName, "AB_SF_Crash", 12);
                    break;
                case 18:
                    strncpy(CaplCtrl_SignalName, "AB_Stellgliedtest", 18);
                    break;
                case 19:
                    strncpy(CaplCtrl_SignalName, "AB_Systemfehler", 16);
                    break;
                case 20:
                    strncpy(CaplCtrl_SignalName, "AB_Texte_AKS", 13);
                    break;
                case 21:
                    strncpy(CaplCtrl_SignalName, "AB_VB_deaktiviert", 18);
                    break;
                case 22:
                    strncpy(CaplCtrl_SignalName, "AB_Versorgungsspannung", 23);
                    break;
                case 23:
                    strncpy(CaplCtrl_SignalName, "Airbag_01_BZ", 13);
                    break;
                case 24:
                    strncpy(CaplCtrl_SignalName, "Airbag_01_CRC", 14);
                    break;
            }
        }
        break;
        case FRM_HANDLE_Airbag_02:
        {
            switch (SigIdx)
            {
                case 0:
                    strncpy(CaplCtrl_SignalName, "AB_Belegung_VB", 15);
                    break;
                case 1:
                    strncpy(CaplCtrl_SignalName, "AB_Gurtschloss_BF", 18);
                    break;
                case 2:
                    strncpy(CaplCtrl_SignalName, "AB_Gurtschloss_FA", 18);
                    break;
                case 3:
                    strncpy(CaplCtrl_SignalName, "AB_Gurtschloss_Reihe2_BF", 25);
                    break;
                case 4:
                    strncpy(CaplCtrl_SignalName, "AB_Gurtschloss_Reihe2_FA", 25);
                    break;
                case 5:
                    strncpy(CaplCtrl_SignalName, "AB_Gurtschloss_Reihe2_MI", 25);
                    break;
                case 6:
                    strncpy(CaplCtrl_SignalName, "AB_Gurtschloss_Reihe3_BF", 25);
                    break;
                case 7:
                    strncpy(CaplCtrl_SignalName, "AB_Gurtschloss_Reihe3_FA", 25);
                    break;
                case 8:
                    strncpy(CaplCtrl_SignalName, "AB_Gurtschloss_Reihe3_MI", 25);
                    break;
                case 9:
                    strncpy(CaplCtrl_SignalName, "AB_Sitzpos_Sens_BF", 19);
                    break;
                case 10:
                    strncpy(CaplCtrl_SignalName, "AB_Sitzpos_Sens_FA", 19);
                    break;
                case 11:
                    strncpy(CaplCtrl_SignalName, "Airbag_02_BZ", 13);
                    break;
                case 12:
                    strncpy(CaplCtrl_SignalName, "Airbag_02_CRC", 14);
                    break;
            }
        }
        break;
        case FRM_HANDLE_Anhaenger_01:
        {
            switch (SigIdx)
            {
                case 0:
                    strncpy(CaplCtrl_SignalName, "AAG_AVS_Fehler_02", 18);
                    break;
                case 1:
                    strncpy(CaplCtrl_SignalName, "AAG_AVS_Stati", 14);
                    break;
                case 2:
                    strncpy(CaplCtrl_SignalName, "AAG_Anhaenger_abgesteckt", 25);
                    break;
                case 3:
                    strncpy(CaplCtrl_SignalName, "AAG_Anhaenger_erkannt", 22);
                    break;
                case 4:
                    strncpy(CaplCtrl_SignalName, "AAG_BZ", 7);
                    break;
                case 5:
                    strncpy(CaplCtrl_SignalName, "AAG_Blinker_HL_def", 19);
                    break;
                case 6:
                    strncpy(CaplCtrl_SignalName, "AAG_Blinker_HR_def", 19);
                    break;
                case 7:
                    strncpy(CaplCtrl_SignalName, "AAG_Blinker_H_aktiv", 20);
                    break;
                case 8:
                    strncpy(CaplCtrl_SignalName, "AAG_Bremsl_durch_ECD", 21);
                    break;
                case 9:
                    strncpy(CaplCtrl_SignalName, "AAG_Bremslicht_H_def", 21);
                    break;
                case 10:
                    strncpy(CaplCtrl_SignalName, "AAG_NSL_aktiv", 14);
                    break;
                case 11:
                    strncpy(CaplCtrl_SignalName, "AAG_Schlusslicht_HL_def", 24);
                    break;
                case 12:
                    strncpy(CaplCtrl_SignalName, "AAG_Schlusslicht_HR_def", 24);
                    break;
            }
        }
        break;
        case FRM_HANDLE_BCM_01:
        {
            switch (SigIdx)
            {
                case 0:
                    strncpy(CaplCtrl_SignalName, "BCM1_AFS_Lampe", 15);
                    break;
                case 1:
                    strncpy(CaplCtrl_SignalName, "BCM1_Kl_15_HW_erkannt", 22);
                    break;
                case 2:
                    strncpy(CaplCtrl_SignalName, "BCM1_Licht_Warn", 16);
                    break;
                case 3:
                    strncpy(CaplCtrl_SignalName, "BCM1_Lichtwarn_Texte", 21);
                    break;
                case 4:
                    strncpy(CaplCtrl_SignalName, "BCM1_MH_Schalter", 17);
                    break;
                case 5:
                    strncpy(CaplCtrl_SignalName, "BCM1_MH_WIV_Schalter", 21);
                    break;
                case 6:
                    strncpy(CaplCtrl_SignalName, "BCM1_NV_Taster", 15);
                    break;
                case 7:
                    strncpy(CaplCtrl_SignalName, "BCM1_Reisemodus_Texte", 22);
                    break;
                case 8:
                    strncpy(CaplCtrl_SignalName, "BCM1_Rueckfahrlicht_Schalter", 29);
                    break;
                case 9:
                    strncpy(CaplCtrl_SignalName, "BCM1_Valet_Parking_Taster", 26);
                    break;
                case 10:
                    strncpy(CaplCtrl_SignalName, "BCM1_Warnblink_Taster", 22);
                    break;
                case 11:
                    strncpy(CaplCtrl_SignalName, "BCM_Bremsbelag_Sensor", 22);
                    break;
                case 12:
                    strncpy(CaplCtrl_SignalName, "BCM_Bremsfluessigkeit_Sensor", 29);
                    break;
                case 13:
                    strncpy(CaplCtrl_SignalName, "BCM_Eco_Charisma_Taste", 23);
                    break;
                case 14:
                    strncpy(CaplCtrl_SignalName, "BCM_Hybrid_StartStopp_Taste", 28);
                    break;
                case 15:
                    strncpy(CaplCtrl_SignalName, "BCM_Kuehlmittel_Sensor", 23);
                    break;
                case 16:
                    strncpy(CaplCtrl_SignalName, "BCM_Waschwasser_Sensor", 23);
                    break;
                case 17:
                    strncpy(CaplCtrl_SignalName, "Gong_TFL_Umschaltung", 21);
                    break;
                case 18:
                    strncpy(CaplCtrl_SignalName, "UGDO_Function", 14);
                    break;
            }
        }
        break;
        case FRM_HANDLE_BEM_05:
        {
            switch (SigIdx)
            {
                case 0:
                    strncpy(CaplCtrl_SignalName, "BEM_01_Abschaltstufen", 22);
                    break;
                case 1:
                    strncpy(CaplCtrl_SignalName, "BEM_Anf_KL", 11);
                    break;
                case 2:
                    strncpy(CaplCtrl_SignalName, "BEM_Batt_Ab", 12);
                    break;
                case 3:
                    strncpy(CaplCtrl_SignalName, "BEM_DFM", 8);
                    break;
                case 4:
                    strncpy(CaplCtrl_SignalName, "BEM_EMLIN_ungueltig", 20);
                    break;
                case 5:
                    strncpy(CaplCtrl_SignalName, "BEM_HYB_DC_uMinLV", 18);
                    break;
                case 6:
                    strncpy(CaplCtrl_SignalName, "BEM_HYB_DC_uSollLV", 19);
                    break;
                case 7:
                    strncpy(CaplCtrl_SignalName, "BEM_Hybrid_Info", 16);
                    break;
                case 8:
                    strncpy(CaplCtrl_SignalName, "BEM_NV_NachladAnf", 18);
                    break;
                case 9:
                    strncpy(CaplCtrl_SignalName, "BEM_P_Generator", 16);
                    break;
                case 10:
                    strncpy(CaplCtrl_SignalName, "BEM_Segel_Info", 15);
                    break;
                case 11:
                    strncpy(CaplCtrl_SignalName, "BEM_StartStopp_Info", 20);
                    break;
                case 12:
                    strncpy(CaplCtrl_SignalName, "BEM_n_LLA", 10);
                    break;
                case 13:
                    strncpy(CaplCtrl_SignalName, "NVEM_DC_LangsRegelung_Anf", 26);
                    break;
            }
        }
        break;
        case FRM_HANDLE_Bremse_EV_01:
        {
            switch (SigIdx)
            {
                case 0:
                    strncpy(CaplCtrl_SignalName, "Bremse_EV_01_BZ", 16);
                    break;
                case 1:
                    strncpy(CaplCtrl_SignalName, "Bremse_EV_01_CRC", 17);
                    break;
                case 2:
                    strncpy(CaplCtrl_SignalName, "EBKV_Bremspedalweg", 19);
                    break;
                case 3:
                    strncpy(CaplCtrl_SignalName, "EBKV_Fahrer_bremst", 19);
                    break;
                case 4:
                    strncpy(CaplCtrl_SignalName, "EBKV_Generatorsollmoment", 25);
                    break;
                case 5:
                    strncpy(CaplCtrl_SignalName, "EBKV_M_Brems_ASM_soll", 22);
                    break;
                case 6:
                    strncpy(CaplCtrl_SignalName, "EBKV_QBit_Fahrer_bremst", 24);
                    break;
                case 7:
                    strncpy(CaplCtrl_SignalName, "EBKV_Status", 12);
                    break;
            }
        }
        break;
        case FRM_HANDLE_Bremse_EV_02:
        {
            switch (SigIdx)
            {
                case 0:
                    strncpy(CaplCtrl_SignalName, "EBKV_BKL_Warnungen", 19);
                    break;
                case 1:
                    strncpy(CaplCtrl_SignalName, "EBKV_Hinweise", 14);
                    break;
                case 2:
                    strncpy(CaplCtrl_SignalName, "EBKV_OBD_Status", 16);
                    break;
                case 3:
                    strncpy(CaplCtrl_SignalName, "EBKV_Warnungen", 15);
                    break;
            }
        }
        break;
        case FRM_HANDLE_CAN_Umsetzer_Resp_01:
        {
            switch (SigIdx)
            {
                case 0:
                    strncpy(CaplCtrl_SignalName, "CU1RSP_IO1", 11);
                    break;
                case 1:
                    strncpy(CaplCtrl_SignalName, "CU1RSP_IO1_KS_GND_Fehler", 25);
                    break;
                case 2:
                    strncpy(CaplCtrl_SignalName, "CU1RSP_IO1_KS_UBat_Fehler", 26);
                    break;
                case 3:
                    strncpy(CaplCtrl_SignalName, "CU1RSP_IO1_QBit", 16);
                    break;
                case 4:
                    strncpy(CaplCtrl_SignalName, "CU1RSP_IO1_Taste_Fehler", 24);
                    break;
                case 5:
                    strncpy(CaplCtrl_SignalName, "CU1RSP_IO1_analog_Eing", 23);
                    break;
                case 6:
                    strncpy(CaplCtrl_SignalName, "CU1RSP_IO1_digital_Eing", 24);
                    break;
                case 7:
                    strncpy(CaplCtrl_SignalName, "CU1RSP_IO1_digital_analog", 26);
                    break;
                case 8:
                    strncpy(CaplCtrl_SignalName, "CU1RSP_IO2", 11);
                    break;
                case 9:
                    strncpy(CaplCtrl_SignalName, "CU1RSP_IO2_KS_Fehler", 21);
                    break;
                case 10:
                    strncpy(CaplCtrl_SignalName, "CU1RSP_IO2_KS_UBat_Fehler", 26);
                    break;
                case 11:
                    strncpy(CaplCtrl_SignalName, "CU1RSP_IO2_OpenLoad", 20);
                    break;
                case 12:
                    strncpy(CaplCtrl_SignalName, "CU1RSP_IO2_QBit", 16);
                    break;
                case 13:
                    strncpy(CaplCtrl_SignalName, "CU1RSP_IO2_digital_Eing", 24);
                    break;
                case 14:
                    strncpy(CaplCtrl_SignalName, "CU1RSP_IO3", 11);
                    break;
                case 15:
                    strncpy(CaplCtrl_SignalName, "CU1RSP_IO3_KS_Fehler", 21);
                    break;
                case 16:
                    strncpy(CaplCtrl_SignalName, "CU1RSP_IO3_KS_UBat_Fehler", 26);
                    break;
                case 17:
                    strncpy(CaplCtrl_SignalName, "CU1RSP_IO3_OpenLoad", 20);
                    break;
                case 18:
                    strncpy(CaplCtrl_SignalName, "CU1RSP_IO3_QBit", 16);
                    break;
                case 19:
                    strncpy(CaplCtrl_SignalName, "CU1RSP_IO3_digital_Eing", 24);
                    break;
                case 20:
                    strncpy(CaplCtrl_SignalName, "CU1RSP_Timeout_Fehler", 22);
                    break;
            }
        }
        break;
        case FRM_HANDLE_Charisma_01:
        {
            switch (SigIdx)
            {
                case 0:
                    strncpy(CaplCtrl_SignalName, "CHA_Fahrer_Umschaltung", 23);
                    break;
                case 1:
                    strncpy(CaplCtrl_SignalName, "CHA_Ziel_FahrPr_ACC", 20);
                    break;
                case 2:
                    strncpy(CaplCtrl_SignalName, "CHA_Ziel_FahrPr_AFS", 20);
                    break;
                case 3:
                    strncpy(CaplCtrl_SignalName, "CHA_Ziel_FahrPr_AGA", 20);
                    break;
                case 4:
                    strncpy(CaplCtrl_SignalName, "CHA_Ziel_FahrPr_DR", 19);
                    break;
                case 5:
                    strncpy(CaplCtrl_SignalName, "CHA_Ziel_FahrPr_EPS", 20);
                    break;
                case 6:
                    strncpy(CaplCtrl_SignalName, "CHA_Ziel_FahrPr_ESP", 20);
                    break;
                case 7:
                    strncpy(CaplCtrl_SignalName, "CHA_Ziel_FahrPr_Freilauf", 25);
                    break;
                case 8:
                    strncpy(CaplCtrl_SignalName, "CHA_Ziel_FahrPr_GE", 19);
                    break;
                case 9:
                    strncpy(CaplCtrl_SignalName, "CHA_Ziel_FahrPr_MO", 19);
                    break;
                case 10:
                    strncpy(CaplCtrl_SignalName, "CHA_Ziel_FahrPr_MO_StSt", 24);
                    break;
                case 11:
                    strncpy(CaplCtrl_SignalName, "CHA_Ziel_FahrPr_QS", 19);
                    break;
                case 12:
                    strncpy(CaplCtrl_SignalName, "CHA_Ziel_FahrPr_RGS", 20);
                    break;
                case 13:
                    strncpy(CaplCtrl_SignalName, "CHA_Ziel_FahrPr_SAK", 20);
                    break;
                case 14:
                    strncpy(CaplCtrl_SignalName, "CHA_Ziel_FahrPr_SCU", 20);
                    break;
                case 15:
                    strncpy(CaplCtrl_SignalName, "CHA_Ziel_FahrPr_ST", 19);
                    break;
            }
        }
        break;
        case FRM_HANDLE_Diagnose_01:
        {
            switch (SigIdx)
            {
                case 0:
                    strncpy(CaplCtrl_SignalName, "DGN_Verlernzaehler", 19);
                    break;
                case 1:
                    strncpy(CaplCtrl_SignalName, "KBI_Kilometerstand", 19);
                    break;
                case 2:
                    strncpy(CaplCtrl_SignalName, "Kombi_02_alt", 13);
                    break;
                case 3:
                    strncpy(CaplCtrl_SignalName, "UH_Jahr", 8);
                    break;
                case 4:
                    strncpy(CaplCtrl_SignalName, "UH_Minute", 10);
                    break;
                case 5:
                    strncpy(CaplCtrl_SignalName, "UH_Monat", 9);
                    break;
                case 6:
                    strncpy(CaplCtrl_SignalName, "UH_Sekunde", 11);
                    break;
                case 7:
                    strncpy(CaplCtrl_SignalName, "UH_Stunde", 10);
                    break;
                case 8:
                    strncpy(CaplCtrl_SignalName, "UH_Tag", 7);
                    break;
                case 9:
                    strncpy(CaplCtrl_SignalName, "Uhrzeit_01_alt", 15);
                    break;
            }
        }
        break;
        case FRM_HANDLE_EPB_01:
        {
            switch (SigIdx)
            {
                case 0:
                    strncpy(CaplCtrl_SignalName, "EPB_01_BZ", 10);
                    break;
                case 1:
                    strncpy(CaplCtrl_SignalName, "EPB_01_CRC", 11);
                    break;
                case 2:
                    strncpy(CaplCtrl_SignalName, "EPB_Anfahrwunsch_erkannt", 25);
                    break;
                case 3:
                    strncpy(CaplCtrl_SignalName, "EPB_BCM2_Motor_Wakeup", 22);
                    break;
                case 4:
                    strncpy(CaplCtrl_SignalName, "EPB_DAA_Randbed_erf", 20);
                    break;
                case 5:
                    strncpy(CaplCtrl_SignalName, "EPB_Fehlerstatus", 17);
                    break;
                case 6:
                    strncpy(CaplCtrl_SignalName, "EPB_Freig_Verzoeg_Anf", 22);
                    break;
                case 7:
                    strncpy(CaplCtrl_SignalName, "EPB_Konsistenz_ACC", 19);
                    break;
                case 8:
                    strncpy(CaplCtrl_SignalName, "EPB_Laengsbeschleunigung", 25);
                    break;
                case 9:
                    strncpy(CaplCtrl_SignalName, "EPB_Pedalweg_Kuppl", 19);
                    break;
                case 10:
                    strncpy(CaplCtrl_SignalName, "EPB_QBit_Laengsbeschleunigung", 30);
                    break;
                case 11:
                    strncpy(CaplCtrl_SignalName, "EPB_QBit_Pedalweg_Kuppl", 24);
                    break;
                case 12:
                    strncpy(CaplCtrl_SignalName, "EPB_QBit_Schalterpos", 21);
                    break;
                case 13:
                    strncpy(CaplCtrl_SignalName, "EPB_Schalterposition", 21);
                    break;
                case 14:
                    strncpy(CaplCtrl_SignalName, "EPB_Spannkraft", 15);
                    break;
                case 15:
                    strncpy(CaplCtrl_SignalName, "EPB_Status", 11);
                    break;
                case 16:
                    strncpy(CaplCtrl_SignalName, "EPB_Verzoeg_Anf", 16);
                    break;
            }
        }
        break;
        case FRM_HANDLE_ESP_02:
        {
            switch (SigIdx)
            {
                case 0:
                    strncpy(CaplCtrl_SignalName, "ESP_02_BZ", 10);
                    break;
                case 1:
                    strncpy(CaplCtrl_SignalName, "ESP_02_CRC", 11);
                    break;
                case 2:
                    strncpy(CaplCtrl_SignalName, "ESP_Gierrate", 13);
                    break;
                case 3:
                    strncpy(CaplCtrl_SignalName, "ESP_Laengsbeschl", 17);
                    break;
                case 4:
                    strncpy(CaplCtrl_SignalName, "ESP_Notbremsanzeige", 20);
                    break;
                case 5:
                    strncpy(CaplCtrl_SignalName, "ESP_PLA_Abbruch", 16);
                    break;
                case 6:
                    strncpy(CaplCtrl_SignalName, "ESP_QBit_Anf_Vert_Wank", 23);
                    break;
                case 7:
                    strncpy(CaplCtrl_SignalName, "ESP_QBit_Gierrate", 18);
                    break;
                case 8:
                    strncpy(CaplCtrl_SignalName, "ESP_QBit_Laengsbeschl", 22);
                    break;
                case 9:
                    strncpy(CaplCtrl_SignalName, "ESP_QBit_Querb", 15);
                    break;
                case 10:
                    strncpy(CaplCtrl_SignalName, "ESP_Querbeschleunigung", 23);
                    break;
                case 11:
                    strncpy(CaplCtrl_SignalName, "ESP_SpannungsAnf", 17);
                    break;
                case 12:
                    strncpy(CaplCtrl_SignalName, "ESP_Status_ESP_PLA", 19);
                    break;
                case 13:
                    strncpy(CaplCtrl_SignalName, "ESP_Stillstandsflag", 20);
                    break;
                case 14:
                    strncpy(CaplCtrl_SignalName, "ESP_VZ_Gierrate", 16);
                    break;
                case 15:
                    strncpy(CaplCtrl_SignalName, "ESP_Verteil_Wankmom", 20);
                    break;
            }
        }
        break;
        case FRM_HANDLE_ESP_05:
        {
            switch (SigIdx)
            {
                case 0:
                    strncpy(CaplCtrl_SignalName, "ECD_Bremslicht", 15);
                    break;
                case 1:
                    strncpy(CaplCtrl_SignalName, "ECD_Fehler", 11);
                    break;
                case 2:
                    strncpy(CaplCtrl_SignalName, "ECD_nicht_verfuegbar", 21);
                    break;
                case 3:
                    strncpy(CaplCtrl_SignalName, "ESP_05_BZ", 10);
                    break;
                case 4:
                    strncpy(CaplCtrl_SignalName, "ESP_05_CRC", 11);
                    break;
                case 5:
                    strncpy(CaplCtrl_SignalName, "ESP_Anforderung_EPB", 20);
                    break;
                case 6:
                    strncpy(CaplCtrl_SignalName, "ESP_Autohold_Standby", 21);
                    break;
                case 7:
                    strncpy(CaplCtrl_SignalName, "ESP_Autohold_aktiv", 19);
                    break;
                case 8:
                    strncpy(CaplCtrl_SignalName, "ESP_BKV_Unterdruck", 19);
                    break;
                case 9:
                    strncpy(CaplCtrl_SignalName, "ESP_Bremsdruck", 15);
                    break;
                case 10:
                    strncpy(CaplCtrl_SignalName, "ESP_Bremsruck_AWV2", 19);
                    break;
                case 11:
                    strncpy(CaplCtrl_SignalName, "ESP_Eingr_HL", 13);
                    break;
                case 12:
                    strncpy(CaplCtrl_SignalName, "ESP_Eingr_HR", 13);
                    break;
                case 13:
                    strncpy(CaplCtrl_SignalName, "ESP_Eingr_VL", 13);
                    break;
                case 14:
                    strncpy(CaplCtrl_SignalName, "ESP_Eingr_VR", 13);
                    break;
                case 15:
                    strncpy(CaplCtrl_SignalName, "ESP_FStatus_Anfahrhilfe", 24);
                    break;
                case 16:
                    strncpy(CaplCtrl_SignalName, "ESP_Fahrer_bremst", 18);
                    break;
                case 17:
                    strncpy(CaplCtrl_SignalName, "ESP_HBA_aktiv", 14);
                    break;
                case 18:
                    strncpy(CaplCtrl_SignalName, "ESP_HDC_Standby", 16);
                    break;
                case 19:
                    strncpy(CaplCtrl_SignalName, "ESP_HDC_aktiv", 14);
                    break;
                case 20:
                    strncpy(CaplCtrl_SignalName, "ESP_Konsistenz_AWV2", 20);
                    break;
                case 21:
                    strncpy(CaplCtrl_SignalName, "ESP_Konsistenz_TSK", 19);
                    break;
                case 22:
                    strncpy(CaplCtrl_SignalName, "ESP_Lenkeingriff_ADS", 21);
                    break;
                case 23:
                    strncpy(CaplCtrl_SignalName, "ESP_Prefill_ausgeloest", 23);
                    break;
                case 24:
                    strncpy(CaplCtrl_SignalName, "ESP_QBit_Bremsdruck", 20);
                    break;
                case 25:
                    strncpy(CaplCtrl_SignalName, "ESP_QBit_Fahrer_bremst", 23);
                    break;
                case 26:
                    strncpy(CaplCtrl_SignalName, "ESP_Rueckwaertsfahrt_erkannt", 29);
                    break;
                case 27:
                    strncpy(CaplCtrl_SignalName, "ESP_Schwelle_Unterdruck", 24);
                    break;
                case 28:
                    strncpy(CaplCtrl_SignalName, "ESP_StartStopp_Info", 20);
                    break;
                case 29:
                    strncpy(CaplCtrl_SignalName, "ESP_Status_Anfahrhilfe", 23);
                    break;
                case 30:
                    strncpy(CaplCtrl_SignalName, "ESP_Status_Bremsdruck", 22);
                    break;
                case 31:
                    strncpy(CaplCtrl_SignalName, "ESP_Status_Bremsentemp", 23);
                    break;
                case 32:
                    strncpy(CaplCtrl_SignalName, "ESP_Verz_EPB_aktiv", 19);
                    break;
                case 33:
                    strncpy(CaplCtrl_SignalName, "ESP_Verz_TSK_aktiv", 19);
                    break;
                case 34:
                    strncpy(CaplCtrl_SignalName, "ESP_Verzoeg_EPB_verf", 21);
                    break;
            }
        }
        break;
        case FRM_HANDLE_ESP_07:
        {
            switch (SigIdx)
            {
                case 0:
                    strncpy(CaplCtrl_SignalName, "ESP_07_BZ", 10);
                    break;
                case 1:
                    strncpy(CaplCtrl_SignalName, "ESP_07_CRC", 11);
                    break;
                case 2:
                    strncpy(CaplCtrl_SignalName, "ESP_ACC_LDE", 12);
                    break;
                case 3:
                    strncpy(CaplCtrl_SignalName, "ESP_CM_Variante", 16);
                    break;
                case 4:
                    strncpy(CaplCtrl_SignalName, "ESP_Codierung_ADS", 18);
                    break;
                case 5:
                    strncpy(CaplCtrl_SignalName, "ESP_MKB_ausloesbar", 19);
                    break;
                case 6:
                    strncpy(CaplCtrl_SignalName, "ESP_OBD_Status", 15);
                    break;
                case 7:
                    strncpy(CaplCtrl_SignalName, "ESP_Offroad_Modus", 18);
                    break;
                case 8:
                    strncpy(CaplCtrl_SignalName, "ESP_Qualifizierung_Antriebsart", 31);
                    break;
                case 9:
                    strncpy(CaplCtrl_SignalName, "ESP_Quattro_Antrieb", 20);
                    break;
                case 10:
                    strncpy(CaplCtrl_SignalName, "ESP_RTA_HL", 11);
                    break;
                case 11:
                    strncpy(CaplCtrl_SignalName, "ESP_RTA_HR", 11);
                    break;
                case 12:
                    strncpy(CaplCtrl_SignalName, "ESP_RTA_VR", 11);
                    break;
                case 13:
                    strncpy(CaplCtrl_SignalName, "ESP_Rollenmodus_Deaktivieren", 29);
                    break;
                case 14:
                    strncpy(CaplCtrl_SignalName, "ESP_Stat_FallBack_eBKV", 23);
                    break;
                case 15:
                    strncpy(CaplCtrl_SignalName, "ESP_nachtr_Stopp_Anf", 21);
                    break;
                case 16:
                    strncpy(CaplCtrl_SignalName, "OBD_Fehler_Radsensor_HL", 24);
                    break;
                case 17:
                    strncpy(CaplCtrl_SignalName, "OBD_Fehler_Radsensor_HR", 24);
                    break;
                case 18:
                    strncpy(CaplCtrl_SignalName, "OBD_Fehler_Radsensor_VL", 24);
                    break;
                case 19:
                    strncpy(CaplCtrl_SignalName, "OBD_Fehler_Radsensor_VR", 24);
                    break;
            }
        }
        break;
        case FRM_HANDLE_ESP_10:
        {
            switch (SigIdx)
            {
                case 0:
                    strncpy(CaplCtrl_SignalName, "ESP_10_BZ", 10);
                    break;
                case 1:
                    strncpy(CaplCtrl_SignalName, "ESP_10_CRC", 11);
                    break;
                case 2:
                    strncpy(CaplCtrl_SignalName, "ESP_HL_Fahrtrichtung", 21);
                    break;
                case 3:
                    strncpy(CaplCtrl_SignalName, "ESP_HR_Fahrtrichtung", 21);
                    break;
                case 4:
                    strncpy(CaplCtrl_SignalName, "ESP_QBit_Wegimpuls_HL", 22);
                    break;
                case 5:
                    strncpy(CaplCtrl_SignalName, "ESP_QBit_Wegimpuls_HR", 22);
                    break;
                case 6:
                    strncpy(CaplCtrl_SignalName, "ESP_QBit_Wegimpuls_VL", 22);
                    break;
                case 7:
                    strncpy(CaplCtrl_SignalName, "ESP_QBit_Wegimpuls_VR", 22);
                    break;
                case 8:
                    strncpy(CaplCtrl_SignalName, "ESP_VL_Fahrtrichtung", 21);
                    break;
                case 9:
                    strncpy(CaplCtrl_SignalName, "ESP_VR_Fahrtrichtung", 21);
                    break;
                case 10:
                    strncpy(CaplCtrl_SignalName, "ESP_Wegimpuls_HL", 17);
                    break;
                case 11:
                    strncpy(CaplCtrl_SignalName, "ESP_Wegimpuls_HR", 17);
                    break;
                case 12:
                    strncpy(CaplCtrl_SignalName, "ESP_Wegimpuls_VL", 17);
                    break;
                case 13:
                    strncpy(CaplCtrl_SignalName, "ESP_Wegimpuls_VR", 17);
                    break;
            }
        }
        break;
        case FRM_HANDLE_ESP_19:
        {
            switch (SigIdx)
            {
                case 0:
                    strncpy(CaplCtrl_SignalName, "ESP_HL_Radgeschw_02", 20);
                    break;
                case 1:
                    strncpy(CaplCtrl_SignalName, "ESP_HR_Radgeschw_02", 20);
                    break;
                case 2:
                    strncpy(CaplCtrl_SignalName, "ESP_VL_Radgeschw_02", 20);
                    break;
                case 3:
                    strncpy(CaplCtrl_SignalName, "ESP_VR_Radgeschw_02", 20);
                    break;
            }
        }
        break;
        case FRM_HANDLE_ESP_20:
        {
            switch (SigIdx)
            {
                case 0:
                    strncpy(CaplCtrl_SignalName, "BR_QBit_Reifenumfang", 21);
                    break;
                case 1:
                    strncpy(CaplCtrl_SignalName, "BR_Reifenumfang", 16);
                    break;
                case 2:
                    strncpy(CaplCtrl_SignalName, "BR_Systemart", 13);
                    break;
                case 3:
                    strncpy(CaplCtrl_SignalName, "ESP_20_BZ", 10);
                    break;
                case 4:
                    strncpy(CaplCtrl_SignalName, "ESP_20_CRC", 11);
                    break;
                case 5:
                    strncpy(CaplCtrl_SignalName, "ESP_Charisma_FahrPr", 20);
                    break;
                case 6:
                    strncpy(CaplCtrl_SignalName, "ESP_Charisma_Status", 20);
                    break;
                case 7:
                    strncpy(CaplCtrl_SignalName, "ESP_Dachrelingsensor", 21);
                    break;
                case 8:
                    strncpy(CaplCtrl_SignalName, "ESP_Stoppverbot_Anz_01", 23);
                    break;
                case 9:
                    strncpy(CaplCtrl_SignalName, "ESP_Stoppverbot_Anz_02", 23);
                    break;
                case 10:
                    strncpy(CaplCtrl_SignalName, "ESP_Stoppverbot_Anz_03", 23);
                    break;
                case 11:
                    strncpy(CaplCtrl_SignalName, "ESP_Stoppverbot_Anz_04", 23);
                    break;
                case 12:
                    strncpy(CaplCtrl_SignalName, "ESP_Stoppverbot_Anz_05", 23);
                    break;
                case 13:
                    strncpy(CaplCtrl_SignalName, "ESP_Stoppverbot_Anz_06", 23);
                    break;
                case 14:
                    strncpy(CaplCtrl_SignalName, "ESP_Stoppverbot_Anz_07", 23);
                    break;
                case 15:
                    strncpy(CaplCtrl_SignalName, "ESP_Stoppverbot_Anz_Std", 24);
                    break;
                case 16:
                    strncpy(CaplCtrl_SignalName, "ESP_Wiederstart_Anz_01", 23);
                    break;
                case 17:
                    strncpy(CaplCtrl_SignalName, "ESP_Wiederstart_Anz_02", 23);
                    break;
                case 18:
                    strncpy(CaplCtrl_SignalName, "ESP_Wiederstart_Anz_03", 23);
                    break;
                case 19:
                    strncpy(CaplCtrl_SignalName, "ESP_Wiederstart_Anz_Std", 24);
                    break;
                case 20:
                    strncpy(CaplCtrl_SignalName, "ESP_Zaehnezahl", 15);
                    break;
            }
        }
        break;
        case FRM_HANDLE_ESP_21:
        {
            switch (SigIdx)
            {
                case 0:
                    strncpy(CaplCtrl_SignalName, "ABS_Bremsung", 13);
                    break;
                case 1:
                    strncpy(CaplCtrl_SignalName, "ASR_Anf", 8);
                    break;
                case 2:
                    strncpy(CaplCtrl_SignalName, "ASR_Schalteingriff", 19);
                    break;
                case 3:
                    strncpy(CaplCtrl_SignalName, "ASR_Tastung_passiv", 19);
                    break;
                case 4:
                    strncpy(CaplCtrl_SignalName, "BR_Eingriffsmoment", 19);
                    break;
                case 5:
                    strncpy(CaplCtrl_SignalName, "EBV_Eingriff", 13);
                    break;
                case 6:
                    strncpy(CaplCtrl_SignalName, "EDS_Eingriff", 13);
                    break;
                case 7:
                    strncpy(CaplCtrl_SignalName, "ESP_21_BZ", 10);
                    break;
                case 8:
                    strncpy(CaplCtrl_SignalName, "ESP_21_CRC", 11);
                    break;
                case 9:
                    strncpy(CaplCtrl_SignalName, "ESP_ASP", 8);
                    break;
                case 10:
                    strncpy(CaplCtrl_SignalName, "ESP_AWV3_Brems_aktiv", 21);
                    break;
                case 11:
                    strncpy(CaplCtrl_SignalName, "ESP_Anhaltevorgang_ACC_aktiv", 29);
                    break;
                case 12:
                    strncpy(CaplCtrl_SignalName, "ESP_Diagnose", 13);
                    break;
                case 13:
                    strncpy(CaplCtrl_SignalName, "ESP_Eingriff", 13);
                    break;
                case 14:
                    strncpy(CaplCtrl_SignalName, "ESP_Haltebestaetigung", 22);
                    break;
                case 15:
                    strncpy(CaplCtrl_SignalName, "ESP_MKB_Abbruch_Geschw", 23);
                    break;
                case 16:
                    strncpy(CaplCtrl_SignalName, "ESP_PLA_Bremseingriff", 22);
                    break;
                case 17:
                    strncpy(CaplCtrl_SignalName, "ESP_QBit_v_Signal", 18);
                    break;
                case 18:
                    strncpy(CaplCtrl_SignalName, "ESP_Systemstatus", 17);
                    break;
                case 19:
                    strncpy(CaplCtrl_SignalName, "ESP_Tastung_passiv", 19);
                    break;
                case 20:
                    strncpy(CaplCtrl_SignalName, "ESP_v_Signal", 13);
                    break;
                case 21:
                    strncpy(CaplCtrl_SignalName, "MSR_Anf", 8);
                    break;
                case 22:
                    strncpy(CaplCtrl_SignalName, "OBD_QBit_Schlechtweg", 21);
                    break;
                case 23:
                    strncpy(CaplCtrl_SignalName, "OBD_Schlechtweg", 16);
                    break;
            }
        }
        break;
        case FRM_HANDLE_Einheiten_01:
        {
            switch (SigIdx)
            {
                case 0:
                    strncpy(CaplCtrl_SignalName, "KBI_Einheit_Datum", 18);
                    break;
                case 1:
                    strncpy(CaplCtrl_SignalName, "KBI_Einheit_Druck", 18);
                    break;
                case 2:
                    strncpy(CaplCtrl_SignalName, "KBI_Einheit_Sprache", 20);
                    break;
                case 3:
                    strncpy(CaplCtrl_SignalName, "KBI_Einheit_Streckenanz", 24);
                    break;
                case 4:
                    strncpy(CaplCtrl_SignalName, "KBI_Einheit_Temp", 17);
                    break;
                case 5:
                    strncpy(CaplCtrl_SignalName, "KBI_Einheit_Uhrzeit", 20);
                    break;
                case 6:
                    strncpy(CaplCtrl_SignalName, "KBI_Einheit_Verbrauch", 22);
                    break;
                case 7:
                    strncpy(CaplCtrl_SignalName, "KBI_Einheit_Volumen", 20);
                    break;
                case 8:
                    strncpy(CaplCtrl_SignalName, "KBI_MFA_v_Einheit_02", 21);
                    break;
            }
        }
        break;
        case FRM_HANDLE_GRA_ACC_01:
        {
            switch (SigIdx)
            {
                case 0:
                    strncpy(CaplCtrl_SignalName, "GRA_ACC_01_BZ", 14);
                    break;
                case 1:
                    strncpy(CaplCtrl_SignalName, "GRA_ACC_01_CRC", 15);
                    break;
                case 2:
                    strncpy(CaplCtrl_SignalName, "GRA_Abbrechen", 14);
                    break;
                case 3:
                    strncpy(CaplCtrl_SignalName, "GRA_Codierung", 14);
                    break;
                case 4:
                    strncpy(CaplCtrl_SignalName, "GRA_Fehler", 11);
                    break;
                case 5:
                    strncpy(CaplCtrl_SignalName, "GRA_Hauptschalter", 18);
                    break;
                case 6:
                    strncpy(CaplCtrl_SignalName, "GRA_LIM_Taste_verfuegbar", 25);
                    break;
                case 7:
                    strncpy(CaplCtrl_SignalName, "GRA_Limiter", 12);
                    break;
                case 8:
                    strncpy(CaplCtrl_SignalName, "GRA_Tip_Hoch", 13);
                    break;
                case 9:
                    strncpy(CaplCtrl_SignalName, "GRA_Tip_Runter", 15);
                    break;
                case 10:
                    strncpy(CaplCtrl_SignalName, "GRA_Tip_Setzen", 15);
                    break;
                case 11:
                    strncpy(CaplCtrl_SignalName, "GRA_Tip_Stufe_2", 16);
                    break;
                case 12:
                    strncpy(CaplCtrl_SignalName, "GRA_Tip_Wiederaufnahme", 23);
                    break;
                case 13:
                    strncpy(CaplCtrl_SignalName, "GRA_Typ_Bedienteil", 19);
                    break;
                case 14:
                    strncpy(CaplCtrl_SignalName, "GRA_Typ_Hauptschalter", 22);
                    break;
                case 15:
                    strncpy(CaplCtrl_SignalName, "GRA_Verstellung_Zeitluecke", 27);
                    break;
                case 16:
                    strncpy(CaplCtrl_SignalName, "GRA_reserveByte4", 17);
                    break;
                case 17:
                    strncpy(CaplCtrl_SignalName, "GRA_reserveByte5", 17);
                    break;
                case 18:
                    strncpy(CaplCtrl_SignalName, "GRA_reserveByte6", 17);
                    break;
                case 19:
                    strncpy(CaplCtrl_SignalName, "GRA_reserveByte7", 17);
                    break;
                case 20:
                    strncpy(CaplCtrl_SignalName, "GRA_reserveByte8", 17);
                    break;
            }
        }
        break;
        case FRM_HANDLE_Gateway_72:
        {
            switch (SigIdx)
            {
                case 0:
                    strncpy(CaplCtrl_SignalName, "AAG_Anhaenger_erkannt", 22);
                    break;
                case 1:
                    strncpy(CaplCtrl_SignalName, "Anhaenger_01_alt", 17);
                    break;
                case 2:
                    strncpy(CaplCtrl_SignalName, "BCM1_Aussen_Temp_ungef", 23);
                    break;
                case 3:
                    strncpy(CaplCtrl_SignalName, "BCM1_MH_Schalter", 17);
                    break;
                case 4:
                    strncpy(CaplCtrl_SignalName, "BCM1_OBD_FStatus_ATemp", 23);
                    break;
                case 5:
                    strncpy(CaplCtrl_SignalName, "BCM1_Rueckfahrlicht_Schalter", 29);
                    break;
                case 6:
                    strncpy(CaplCtrl_SignalName, "BCM_01_alt", 11);
                    break;
                case 7:
                    strncpy(CaplCtrl_SignalName, "BCM_Rueckfahrlicht_Anf", 23);
                    break;
                case 8:
                    strncpy(CaplCtrl_SignalName, "BH_Blinker_li", 14);
                    break;
                case 9:
                    strncpy(CaplCtrl_SignalName, "BH_Blinker_re", 14);
                    break;
                case 10:
                    strncpy(CaplCtrl_SignalName, "BH_Fernlicht", 13);
                    break;
                case 11:
                    strncpy(CaplCtrl_SignalName, "KL_Thermomanagement", 20);
                    break;
                case 12:
                    strncpy(CaplCtrl_SignalName, "Klima_11_alt", 13);
                    break;
                case 13:
                    strncpy(CaplCtrl_SignalName, "Klima_Sensor_02_alt", 20);
                    break;
                case 14:
                    strncpy(CaplCtrl_SignalName, "Licht_Anf_01_alt", 17);
                    break;
                case 15:
                    strncpy(CaplCtrl_SignalName, "SMLS_01_alt", 12);
                    break;
                case 16:
                    strncpy(CaplCtrl_SignalName, "VS_VD_entriegelt", 17);
                    break;
                case 17:
                    strncpy(CaplCtrl_SignalName, "VS_VD_offen_ver", 16);
                    break;
                case 18:
                    strncpy(CaplCtrl_SignalName, "VS_VD_zu_ver", 13);
                    break;
                case 19:
                    strncpy(CaplCtrl_SignalName, "VS_Verdeck_Anf", 15);
                    break;
                case 20:
                    strncpy(CaplCtrl_SignalName, "Verdeck_01_alt", 15);
                    break;
                case 21:
                    strncpy(CaplCtrl_SignalName, "WFS_01_alt", 11);
                    break;
                case 22:
                    strncpy(CaplCtrl_SignalName, "WFS_ID_Geb_autorisiert_in_Kl15", 31);
                    break;
                case 23:
                    strncpy(CaplCtrl_SignalName, "WFS_Schluessel_Fahrberecht", 27);
                    break;
                case 24:
                    strncpy(CaplCtrl_SignalName, "WWSs_01_alt", 12);
                    break;
                case 25:
                    strncpy(CaplCtrl_SignalName, "Waschen_vorne_aktiv", 20);
                    break;
                case 26:
                    strncpy(CaplCtrl_SignalName, "Wischer_01_alt", 15);
                    break;
                case 27:
                    strncpy(CaplCtrl_SignalName, "Wischer_vorne_aktiv", 20);
                    break;
                case 28:
                    strncpy(CaplCtrl_SignalName, "ZV_02_alt", 10);
                    break;
                case 29:
                    strncpy(CaplCtrl_SignalName, "ZV_BT_offen", 12);
                    break;
                case 30:
                    strncpy(CaplCtrl_SignalName, "ZV_FT_offen", 12);
                    break;
                case 31:
                    strncpy(CaplCtrl_SignalName, "ZV_HBFS_offen", 14);
                    break;
                case 32:
                    strncpy(CaplCtrl_SignalName, "ZV_HD_offen", 12);
                    break;
                case 33:
                    strncpy(CaplCtrl_SignalName, "ZV_HFS_offen", 13);
                    break;
            }
        }
        break;
        case FRM_HANDLE_Gateway_74:
        {
            switch (SigIdx)
            {
                case 0:
                    strncpy(CaplCtrl_SignalName, "ELV_01_alt", 11);
                    break;
                case 1:
                    strncpy(CaplCtrl_SignalName, "ELV_Anf_Klemme_50", 18);
                    break;
                case 2:
                    strncpy(CaplCtrl_SignalName, "EPS_Lenkerposition", 19);
                    break;
                case 3:
                    strncpy(CaplCtrl_SignalName, "GW_Status_GRA", 14);
                    break;
                case 4:
                    strncpy(CaplCtrl_SignalName, "HLR_01_alt", 11);
                    break;
                case 5:
                    strncpy(CaplCtrl_SignalName, "KL_Geblspng_Soll", 17);
                    break;
                case 6:
                    strncpy(CaplCtrl_SignalName, "KL_PTC_Verbauinfo", 18);
                    break;
                case 7:
                    strncpy(CaplCtrl_SignalName, "KL_Umluftklappe_Status", 23);
                    break;
                case 8:
                    strncpy(CaplCtrl_SignalName, "KY_StartStopp_Info", 19);
                    break;
                case 9:
                    strncpy(CaplCtrl_SignalName, "Kessy_04_alt", 13);
                    break;
                case 10:
                    strncpy(CaplCtrl_SignalName, "Klima_12_alt", 13);
                    break;
                case 11:
                    strncpy(CaplCtrl_SignalName, "LH_EPS_01_alt", 14);
                    break;
                case 12:
                    strncpy(CaplCtrl_SignalName, "LIN_2_alt", 10);
                    break;
                case 13:
                    strncpy(CaplCtrl_SignalName, "LS_Tiptronic_Fehler", 20);
                    break;
                case 14:
                    strncpy(CaplCtrl_SignalName, "MFG_01_alt", 11);
                    break;
                case 15:
                    strncpy(CaplCtrl_SignalName, "MFL_Tip_Down", 13);
                    break;
                case 16:
                    strncpy(CaplCtrl_SignalName, "MFL_Tip_Up", 11);
                    break;
                case 17:
                    strncpy(CaplCtrl_SignalName, "MF_Anlassersperre", 18);
                    break;
                case 18:
                    strncpy(CaplCtrl_SignalName, "MF_StartStopp_Info", 19);
                    break;
                case 19:
                    strncpy(CaplCtrl_SignalName, "PH_StartStopp_Info", 19);
                    break;
                case 20:
                    strncpy(CaplCtrl_SignalName, "PH_nachtr_Stopp_Anf", 20);
                    break;
                case 21:
                    strncpy(CaplCtrl_SignalName, "PTC_Freigabe", 13);
                    break;
                case 22:
                    strncpy(CaplCtrl_SignalName, "Parkhilfe_01_alt", 17);
                    break;
            }
        }
        break;
        case FRM_HANDLE_Getriebe_11:
        {
            switch (SigIdx)
            {
                case 0:
                    strncpy(CaplCtrl_SignalName, "GE_Fahrstufe", 13);
                    break;
                case 1:
                    strncpy(CaplCtrl_SignalName, "GE_Freig_MMom_Vorhalt", 22);
                    break;
                case 2:
                    strncpy(CaplCtrl_SignalName, "GE_MMom_Soll_02", 16);
                    break;
                case 3:
                    strncpy(CaplCtrl_SignalName, "GE_MMom_Status", 15);
                    break;
                case 4:
                    strncpy(CaplCtrl_SignalName, "GE_MMom_Status_02", 18);
                    break;
                case 5:
                    strncpy(CaplCtrl_SignalName, "GE_MMom_Vorhalt_02", 19);
                    break;
                case 6:
                    strncpy(CaplCtrl_SignalName, "GE_Schaltablauf", 16);
                    break;
                case 7:
                    strncpy(CaplCtrl_SignalName, "GE_Status_Kraftschluss", 23);
                    break;
                case 8:
                    strncpy(CaplCtrl_SignalName, "GE_Uefkt", 9);
                    break;
                case 9:
                    strncpy(CaplCtrl_SignalName, "GE_Verbot_Ausblendung", 22);
                    break;
                case 10:
                    strncpy(CaplCtrl_SignalName, "GE_Zielgang", 12);
                    break;
                case 11:
                    strncpy(CaplCtrl_SignalName, "GE_reserv_Fahrstufe", 20);
                    break;
                case 12:
                    strncpy(CaplCtrl_SignalName, "Getriebe_11_BZ", 15);
                    break;
                case 13:
                    strncpy(CaplCtrl_SignalName, "Getriebe_11_CRC", 16);
                    break;
            }
        }
        break;
        case FRM_HANDLE_Getriebe_12:
        {
            switch (SigIdx)
            {
                case 0:
                    strncpy(CaplCtrl_SignalName, "GE_Anheb_Solldrehz_Leerlauf", 28);
                    break;
                case 1:
                    strncpy(CaplCtrl_SignalName, "GE_Aufnahmemoment", 18);
                    break;
                case 2:
                    strncpy(CaplCtrl_SignalName, "GE_Drehzahlmesser_Daempfung", 28);
                    break;
                case 3:
                    strncpy(CaplCtrl_SignalName, "GE_Freigabe_Synchro", 20);
                    break;
                case 4:
                    strncpy(CaplCtrl_SignalName, "GE_HYB_DZ_Eingriff", 19);
                    break;
                case 5:
                    strncpy(CaplCtrl_SignalName, "GE_Mom_Begr_Gradient", 21);
                    break;
                case 6:
                    strncpy(CaplCtrl_SignalName, "GE_Schubabschalt_Unt", 21);
                    break;
                case 7:
                    strncpy(CaplCtrl_SignalName, "GE_Synchro_Status", 18);
                    break;
                case 8:
                    strncpy(CaplCtrl_SignalName, "GE_Synchro_Wunschdrehz", 23);
                    break;
                case 9:
                    strncpy(CaplCtrl_SignalName, "GE_Synchro_Zeit", 16);
                    break;
                case 10:
                    strncpy(CaplCtrl_SignalName, "Getriebe_12_BZ", 15);
                    break;
                case 11:
                    strncpy(CaplCtrl_SignalName, "Getriebe_12_CRC", 16);
                    break;
            }
        }
        break;
        case FRM_HANDLE_Getriebe_13:
        {
            switch (SigIdx)
            {
                case 0:
                    strncpy(CaplCtrl_SignalName, "GE_Anf_Zylabsch", 16);
                    break;
                case 1:
                    strncpy(CaplCtrl_SignalName, "GE_Eingangsdrehz", 17);
                    break;
                case 2:
                    strncpy(CaplCtrl_SignalName, "GE_Entkopplung_Status", 22);
                    break;
                case 3:
                    strncpy(CaplCtrl_SignalName, "GE_Freig_Langfr_Schutzmom", 26);
                    break;
                case 4:
                    strncpy(CaplCtrl_SignalName, "GE_Grenzkriechmoment", 21);
                    break;
                case 5:
                    strncpy(CaplCtrl_SignalName, "GE_Langfr_Schutzmom_02", 23);
                    break;
                case 6:
                    strncpy(CaplCtrl_SignalName, "GE_Notlauf", 11);
                    break;
                case 7:
                    strncpy(CaplCtrl_SignalName, "GE_StartStopp_Info", 19);
                    break;
                case 8:
                    strncpy(CaplCtrl_SignalName, "GE_Verlustmoment_02", 20);
                    break;
                case 9:
                    strncpy(CaplCtrl_SignalName, "Getriebe_13_BZ", 15);
                    break;
                case 10:
                    strncpy(CaplCtrl_SignalName, "Getriebe_13_CRC", 16);
                    break;
            }
        }
        break;
        case FRM_HANDLE_Getriebe_14:
        {
            switch (SigIdx)
            {
                case 0:
                    strncpy(CaplCtrl_SignalName, "Freilauf_Charisma_FahrPr", 25);
                    break;
                case 1:
                    strncpy(CaplCtrl_SignalName, "Freilauf_Charisma_Status", 25);
                    break;
                case 2:
                    strncpy(CaplCtrl_SignalName, "GE_Charisma_FahrPr", 19);
                    break;
                case 3:
                    strncpy(CaplCtrl_SignalName, "GE_Charisma_Status", 19);
                    break;
                case 4:
                    strncpy(CaplCtrl_SignalName, "GE_Codierung_MSG", 17);
                    break;
                case 5:
                    strncpy(CaplCtrl_SignalName, "GE_Freigabe_Verfallsinfo_WFS", 29);
                    break;
                case 6:
                    strncpy(CaplCtrl_SignalName, "GE_Heizwunsch", 14);
                    break;
                case 7:
                    strncpy(CaplCtrl_SignalName, "GE_LFR_Adaption", 16);
                    break;
                case 8:
                    strncpy(CaplCtrl_SignalName, "GE_LaunchControl", 17);
                    break;
                case 9:
                    strncpy(CaplCtrl_SignalName, "GE_OBD_AbsperrVent", 19);
                    break;
                case 10:
                    strncpy(CaplCtrl_SignalName, "GE_OBD_Status", 14);
                    break;
                case 11:
                    strncpy(CaplCtrl_SignalName, "GE_Sumpftemperatur", 19);
                    break;
                case 12:
                    strncpy(CaplCtrl_SignalName, "GE_Verlustmoment_02", 20);
                    break;
                case 13:
                    strncpy(CaplCtrl_SignalName, "GE_Zustand_Kuppltemp", 21);
                    break;
                case 14:
                    strncpy(CaplCtrl_SignalName, "GE_amax_moeglich", 17);
                    break;
            }
        }
        break;
        case FRM_HANDLE_Getriebe_Hybrid_01:
        {
            switch (SigIdx)
            {
                case 0:
                    strncpy(CaplCtrl_SignalName, "GE_HYB_Fehlerstatus", 20);
                    break;
                case 1:
                    strncpy(CaplCtrl_SignalName, "GE_HYB_Filt_MomAufbau", 22);
                    break;
                case 2:
                    strncpy(CaplCtrl_SignalName, "GE_HYB_Freig_VM_EM_Stop", 24);
                    break;
                case 3:
                    strncpy(CaplCtrl_SignalName, "GE_HYB_Freig_sSchl_K0", 22);
                    break;
                case 4:
                    strncpy(CaplCtrl_SignalName, "GE_HYB_Freigabe_K0", 19);
                    break;
                case 5:
                    strncpy(CaplCtrl_SignalName, "GE_HYB_Freigabe_LL_Reg", 23);
                    break;
                case 6:
                    strncpy(CaplCtrl_SignalName, "GE_HYB_MomEingriff_EM", 22);
                    break;
                case 7:
                    strncpy(CaplCtrl_SignalName, "GE_HYB_Sportfaktor", 19);
                    break;
                case 8:
                    strncpy(CaplCtrl_SignalName, "GE_HYB_StartAnf", 16);
                    break;
                case 9:
                    strncpy(CaplCtrl_SignalName, "GE_HYB_VM_Startkontr", 21);
                    break;
                case 10:
                    strncpy(CaplCtrl_SignalName, "GE_HYB_VM_akt_halten", 21);
                    break;
                case 11:
                    strncpy(CaplCtrl_SignalName, "GE_HYB_VZ_MomEingriff_EM", 25);
                    break;
                case 12:
                    strncpy(CaplCtrl_SignalName, "GE_HYB_Wiederstart", 19);
                    break;
                case 13:
                    strncpy(CaplCtrl_SignalName, "GE_HYB_nK0", 11);
                    break;
                case 14:
                    strncpy(CaplCtrl_SignalName, "Getriebe_Hybrid_01_BZ", 22);
                    break;
                case 15:
                    strncpy(CaplCtrl_SignalName, "Getriebe_Hybrid_01_CRC", 23);
                    break;
            }
        }
        break;
        case FRM_HANDLE_HVEM_02:
        {
            switch (SigIdx)
            {
                case 0:
                    strncpy(CaplCtrl_SignalName, "HVEM_DauerRed", 14);
                    break;
                case 1:
                    strncpy(CaplCtrl_SignalName, "HVEM_FreigabeKlimatisierung", 28);
                    break;
                case 2:
                    strncpy(CaplCtrl_SignalName, "HVEM_IstLeistungNA", 19);
                    break;
                case 3:
                    strncpy(CaplCtrl_SignalName, "HVEM_IstStrom_HVVerbraucher", 28);
                    break;
                case 4:
                    strncpy(CaplCtrl_SignalName, "HVEM_LeistungTMEVorgabe", 24);
                    break;
                case 5:
                    strncpy(CaplCtrl_SignalName, "HVEM_MinLeistungNA", 19);
                    break;
                case 6:
                    strncpy(CaplCtrl_SignalName, "HVEM_Temp_Vorkond_Innen", 24);
                    break;
            }
        }
        break;
        case FRM_HANDLE_HVEM_04:
        {
            switch (SigIdx)
            {
                case 0:
                    strncpy(CaplCtrl_SignalName, "HVEM_Anf_ReichweiteNV", 22);
                    break;
                case 1:
                    strncpy(CaplCtrl_SignalName, "HVEM_HV_Anf", 12);
                    break;
                case 2:
                    strncpy(CaplCtrl_SignalName, "HVEM_KlimaMaxHVStrom", 21);
                    break;
                case 3:
                    strncpy(CaplCtrl_SignalName, "HVEM_LeistungsAnf", 18);
                    break;
                case 4:
                    strncpy(CaplCtrl_SignalName, "HVEM_NVLeistungEmpf", 20);
                    break;
                case 5:
                    strncpy(CaplCtrl_SignalName, "HVEM_Nachlad_Status", 20);
                    break;
                case 6:
                    strncpy(CaplCtrl_SignalName, "HVEM_Nachladen_Anf", 19);
                    break;
                case 7:
                    strncpy(CaplCtrl_SignalName, "HVEM_Text_1", 12);
                    break;
            }
        }
        break;
        case FRM_HANDLE_Klemmen_Status_01:
        {
            switch (SigIdx)
            {
                case 0:
                    strncpy(CaplCtrl_SignalName, "BCM_Remotestart_Betrieb", 24);
                    break;
                case 1:
                    strncpy(CaplCtrl_SignalName, "KST_Fahrerhinweis_1", 20);
                    break;
                case 2:
                    strncpy(CaplCtrl_SignalName, "KST_Fahrerhinweis_2", 20);
                    break;
                case 3:
                    strncpy(CaplCtrl_SignalName, "KST_Fahrerhinweis_3", 20);
                    break;
                case 4:
                    strncpy(CaplCtrl_SignalName, "KST_Fahrerhinweis_4", 20);
                    break;
                case 5:
                    strncpy(CaplCtrl_SignalName, "KST_Fahrerhinweis_5", 20);
                    break;
                case 6:
                    strncpy(CaplCtrl_SignalName, "KST_Fahrerhinweis_6", 20);
                    break;
                case 7:
                    strncpy(CaplCtrl_SignalName, "KST_Warn_P1_ZST_def", 20);
                    break;
                case 8:
                    strncpy(CaplCtrl_SignalName, "KST_Warn_P2_ZST_def", 20);
                    break;
                case 9:
                    strncpy(CaplCtrl_SignalName, "Klemmen_Status_01_BZ", 21);
                    break;
                case 10:
                    strncpy(CaplCtrl_SignalName, "Klemmen_Status_01_CRC", 22);
                    break;
                case 11:
                    strncpy(CaplCtrl_SignalName, "ZAS_Kl_15", 10);
                    break;
                case 12:
                    strncpy(CaplCtrl_SignalName, "ZAS_Kl_50_Startanforderung", 27);
                    break;
                case 13:
                    strncpy(CaplCtrl_SignalName, "ZAS_Kl_S", 9);
                    break;
                case 14:
                    strncpy(CaplCtrl_SignalName, "ZAS_Kl_X", 9);
                    break;
            }
        }
        break;
        case FRM_HANDLE_Klima_11:
        {
            switch (SigIdx)
            {
                case 0:
                    strncpy(CaplCtrl_SignalName, "KL_AC_Schalter", 15);
                    break;
                case 1:
                    strncpy(CaplCtrl_SignalName, "KL_Anf_KL", 10);
                    break;
                case 2:
                    strncpy(CaplCtrl_SignalName, "KL_Ausstattung_Klima", 21);
                    break;
                case 3:
                    strncpy(CaplCtrl_SignalName, "KL_Charisma_FahrPr", 19);
                    break;
                case 4:
                    strncpy(CaplCtrl_SignalName, "KL_Charisma_Status", 19);
                    break;
                case 5:
                    strncpy(CaplCtrl_SignalName, "KL_Comp_enable", 15);
                    break;
                case 6:
                    strncpy(CaplCtrl_SignalName, "KL_Comp_rev_rq", 15);
                    break;
                case 7:
                    strncpy(CaplCtrl_SignalName, "KL_Drehz_Anh", 13);
                    break;
                case 8:
                    strncpy(CaplCtrl_SignalName, "KL_Komp_Moment_alt", 19);
                    break;
                case 9:
                    strncpy(CaplCtrl_SignalName, "KL_Last_Kompr", 14);
                    break;
                case 10:
                    strncpy(CaplCtrl_SignalName, "KL_Spannungs_Anf", 17);
                    break;
                case 11:
                    strncpy(CaplCtrl_SignalName, "KL_StartStopp_Info", 19);
                    break;
                case 12:
                    strncpy(CaplCtrl_SignalName, "KL_Thermomanagement", 20);
                    break;
                case 13:
                    strncpy(CaplCtrl_SignalName, "KL_Vorwarn_Komp_ein", 20);
                    break;
                case 14:
                    strncpy(CaplCtrl_SignalName, "KL_Vorwarn_Zuheizer_ein", 24);
                    break;
                case 15:
                    strncpy(CaplCtrl_SignalName, "KL_Zustand", 11);
                    break;
                case 16:
                    strncpy(CaplCtrl_SignalName, "KL_el_Zuheizer_Stufe", 21);
                    break;
                case 17:
                    strncpy(CaplCtrl_SignalName, "KL_nachtr_Stopp_Anf", 20);
                    break;
            }
        }
        break;
        case FRM_HANDLE_Kombi_01:
        {
            switch (SigIdx)
            {
                case 0:
                    strncpy(CaplCtrl_SignalName, "KBI_ABS_Lampe", 14);
                    break;
                case 1:
                    strncpy(CaplCtrl_SignalName, "KBI_Airbag_Lampe", 17);
                    break;
                case 2:
                    strncpy(CaplCtrl_SignalName, "KBI_Anzeigefehler_LDW", 22);
                    break;
                case 3:
                    strncpy(CaplCtrl_SignalName, "KBI_Anzeigefehler_NV", 21);
                    break;
                case 4:
                    strncpy(CaplCtrl_SignalName, "KBI_Anzeigefehler_SWA", 22);
                    break;
                case 5:
                    strncpy(CaplCtrl_SignalName, "KBI_Anzeigestatus_ACC", 22);
                    break;
                case 6:
                    strncpy(CaplCtrl_SignalName, "KBI_Anzeigestatus_GRA", 22);
                    break;
                case 7:
                    strncpy(CaplCtrl_SignalName, "KBI_Anzeigestatus_LIM", 22);
                    break;
                case 8:
                    strncpy(CaplCtrl_SignalName, "KBI_BKL_Lampe", 14);
                    break;
                case 9:
                    strncpy(CaplCtrl_SignalName, "KBI_ESP_Lampe", 14);
                    break;
                case 10:
                    strncpy(CaplCtrl_SignalName, "KBI_Einheit_Tacho", 18);
                    break;
                case 11:
                    strncpy(CaplCtrl_SignalName, "KBI_Fehler_Anzeige_ACC", 23);
                    break;
                case 12:
                    strncpy(CaplCtrl_SignalName, "KBI_Handbremse", 15);
                    break;
                case 13:
                    strncpy(CaplCtrl_SignalName, "KBI_Konsistenz_ACC", 19);
                    break;
                case 14:
                    strncpy(CaplCtrl_SignalName, "KBI_Lenkung_Lampe", 18);
                    break;
                case 15:
                    strncpy(CaplCtrl_SignalName, "KBI_MFA_v_Einheit_01", 21);
                    break;
                case 16:
                    strncpy(CaplCtrl_SignalName, "KBI_NV_in_Anzeige", 18);
                    break;
                case 17:
                    strncpy(CaplCtrl_SignalName, "KBI_Oeldruck_Schalter", 22);
                    break;
                case 18:
                    strncpy(CaplCtrl_SignalName, "KBI_Oeldruckwarnung", 20);
                    break;
                case 19:
                    strncpy(CaplCtrl_SignalName, "KBI_PLA_in_Anzeige", 19);
                    break;
                case 20:
                    strncpy(CaplCtrl_SignalName, "KBI_SILA_gueltig", 17);
                    break;
                case 21:
                    strncpy(CaplCtrl_SignalName, "KBI_Tankwarnung", 16);
                    break;
                case 22:
                    strncpy(CaplCtrl_SignalName, "KBI_V_Digital", 14);
                    break;
                case 23:
                    strncpy(CaplCtrl_SignalName, "KBI_Vorglueh_System_Lampe", 26);
                    break;
                case 24:
                    strncpy(CaplCtrl_SignalName, "KBI_angez_Geschw", 17);
                    break;
                case 25:
                    strncpy(CaplCtrl_SignalName, "KBI_im_Stellgliedtest", 22);
                    break;
                case 26:
                    strncpy(CaplCtrl_SignalName, "Kombi_01_BZ", 12);
                    break;
            }
        }
        break;
        case FRM_HANDLE_Kombi_02:
        {
            switch (SigIdx)
            {
                case 0:
                    strncpy(CaplCtrl_SignalName, "KBI_Aussen_Temp_gef", 20);
                    break;
                case 1:
                    strncpy(CaplCtrl_SignalName, "KBI_FStatus_Tank", 17);
                    break;
                case 2:
                    strncpy(CaplCtrl_SignalName, "KBI_Inhalt_Tank", 16);
                    break;
                case 3:
                    strncpy(CaplCtrl_SignalName, "KBI_Kilometerstand", 19);
                    break;
                case 4:
                    strncpy(CaplCtrl_SignalName, "KBI_Oelwechsel_durchgefuehrt", 29);
                    break;
                case 5:
                    strncpy(CaplCtrl_SignalName, "KBI_QBit_Aussen_Temp_gef", 25);
                    break;
                case 6:
                    strncpy(CaplCtrl_SignalName, "KBI_RDK_Kalibrier_Anf", 22);
                    break;
                case 7:
                    strncpy(CaplCtrl_SignalName, "KBI_Standzeit_02", 17);
                    break;
            }
        }
        break;
        case FRM_HANDLE_LWI_01:
        {
            switch (SigIdx)
            {
                case 0:
                    strncpy(CaplCtrl_SignalName, "LWI_01_BZ", 10);
                    break;
                case 1:
                    strncpy(CaplCtrl_SignalName, "LWI_01_CRC", 11);
                    break;
                case 2:
                    strncpy(CaplCtrl_SignalName, "LWI_Lenkradw_Geschw", 20);
                    break;
                case 3:
                    strncpy(CaplCtrl_SignalName, "LWI_Lenkradwinkel", 18);
                    break;
                case 4:
                    strncpy(CaplCtrl_SignalName, "LWI_QBit_Lenkradwinkel", 23);
                    break;
                case 5:
                    strncpy(CaplCtrl_SignalName, "LWI_QBit_Sub_Daten", 19);
                    break;
                case 6:
                    strncpy(CaplCtrl_SignalName, "LWI_Sensorstatus", 17);
                    break;
                case 7:
                    strncpy(CaplCtrl_SignalName, "LWI_Sub_Daten", 14);
                    break;
                case 8:
                    strncpy(CaplCtrl_SignalName, "LWI_VZ_Lenkradw_Geschw", 23);
                    break;
                case 9:
                    strncpy(CaplCtrl_SignalName, "LWI_VZ_Lenkradwinkel", 21);
                    break;
            }
        }
        break;
        case FRM_HANDLE_Licht_hinten_01:
        {
            switch (SigIdx)
            {
                case 0:
                    strncpy(CaplCtrl_SignalName, "BCM2_Bremsl_durch_ECD", 22);
                    break;
                case 1:
                    strncpy(CaplCtrl_SignalName, "LH_3_Bremsl_def", 16);
                    break;
                case 2:
                    strncpy(CaplCtrl_SignalName, "LH_Aussenlicht_def", 19);
                    break;
                case 3:
                    strncpy(CaplCtrl_SignalName, "LH_Blinker_HL_akt", 18);
                    break;
                case 4:
                    strncpy(CaplCtrl_SignalName, "LH_Blinker_HR_akt", 18);
                    break;
                case 5:
                    strncpy(CaplCtrl_SignalName, "LH_Blinker_li_def", 18);
                    break;
                case 6:
                    strncpy(CaplCtrl_SignalName, "LH_Blinker_re_def", 18);
                    break;
                case 7:
                    strncpy(CaplCtrl_SignalName, "LH_Brems_Blk_li_def", 20);
                    break;
                case 8:
                    strncpy(CaplCtrl_SignalName, "LH_Brems_Blk_re_def", 20);
                    break;
                case 9:
                    strncpy(CaplCtrl_SignalName, "LH_Bremsl_li_def", 17);
                    break;
                case 10:
                    strncpy(CaplCtrl_SignalName, "LH_Bremsl_li_ges_def", 21);
                    break;
                case 11:
                    strncpy(CaplCtrl_SignalName, "LH_Bremsl_re_def", 17);
                    break;
                case 12:
                    strncpy(CaplCtrl_SignalName, "LH_Bremsl_re_ges_def", 21);
                    break;
                case 13:
                    strncpy(CaplCtrl_SignalName, "LH_Bremslicht_H_aktiv", 22);
                    break;
                case 14:
                    strncpy(CaplCtrl_SignalName, "LH_Kennzl_def", 14);
                    break;
                case 15:
                    strncpy(CaplCtrl_SignalName, "LH_Nebel_li_def", 16);
                    break;
                case 16:
                    strncpy(CaplCtrl_SignalName, "LH_Nebel_mi_def", 16);
                    break;
                case 17:
                    strncpy(CaplCtrl_SignalName, "LH_Nebel_re_def", 16);
                    break;
                case 18:
                    strncpy(CaplCtrl_SignalName, "LH_Nebelschluss_aktiv", 22);
                    break;
                case 19:
                    strncpy(CaplCtrl_SignalName, "LH_Parklicht_HL_aktiv", 22);
                    break;
                case 20:
                    strncpy(CaplCtrl_SignalName, "LH_Parklicht_HR_aktiv", 22);
                    break;
                case 21:
                    strncpy(CaplCtrl_SignalName, "LH_Rueckf_li_def", 17);
                    break;
                case 22:
                    strncpy(CaplCtrl_SignalName, "LH_Rueckf_mi_def", 17);
                    break;
                case 23:
                    strncpy(CaplCtrl_SignalName, "LH_Rueckf_re_def", 17);
                    break;
                case 24:
                    strncpy(CaplCtrl_SignalName, "LH_Rueckfahrlicht_aktiv", 24);
                    break;
                case 25:
                    strncpy(CaplCtrl_SignalName, "LH_SL_BRL_BLK_li_def", 21);
                    break;
                case 26:
                    strncpy(CaplCtrl_SignalName, "LH_SL_BRL_BLK_re_def", 21);
                    break;
                case 27:
                    strncpy(CaplCtrl_SignalName, "LH_Schluss_Brems_Nebel_li_def", 30);
                    break;
                case 28:
                    strncpy(CaplCtrl_SignalName, "LH_Schluss_Brems_Nebel_re_def", 30);
                    break;
                case 29:
                    strncpy(CaplCtrl_SignalName, "LH_Schluss_Brems_li_def", 24);
                    break;
                case 30:
                    strncpy(CaplCtrl_SignalName, "LH_Schluss_Brems_re_def", 24);
                    break;
                case 31:
                    strncpy(CaplCtrl_SignalName, "LH_Schluss_Nebel_li_def", 24);
                    break;
                case 32:
                    strncpy(CaplCtrl_SignalName, "LH_Schluss_Nebel_re_def", 24);
                    break;
                case 33:
                    strncpy(CaplCtrl_SignalName, "LH_Schlusslicht_li_def", 23);
                    break;
                case 34:
                    strncpy(CaplCtrl_SignalName, "LH_Schlusslicht_re_def", 23);
                    break;
                case 35:
                    strncpy(CaplCtrl_SignalName, "LH_Standlicht_H_aktiv", 22);
                    break;
                case 36:
                    strncpy(CaplCtrl_SignalName, "Licht_hinten_01_BZ", 19);
                    break;
            }
        }
        break;
        case FRM_HANDLE_NMH_Gateway:
        {
            switch (SigIdx)
            {
                case 0:
                    strncpy(CaplCtrl_SignalName, "NM_Gateway_ACAN_Aktivitaet", 27);
                    break;
                case 1:
                    strncpy(CaplCtrl_SignalName, "NM_Gateway_Bedien_LIN_Aktivitaet", 33);
                    break;
                case 2:
                    strncpy(CaplCtrl_SignalName, "NM_Gateway_Car_Wakeup", 22);
                    break;
                case 3:
                    strncpy(CaplCtrl_SignalName, "NM_Gateway_DiagCAN_Aktivitaet", 30);
                    break;
                case 4:
                    strncpy(CaplCtrl_SignalName, "NM_Gateway_ECAN_Aktivitaet", 27);
                    break;
                case 5:
                    strncpy(CaplCtrl_SignalName, "NM_Gateway_EM_Aktivitaet", 25);
                    break;
                case 6:
                    strncpy(CaplCtrl_SignalName, "NM_Gateway_EnergieLIN_Aktivitaet", 33);
                    break;
                case 7:
                    strncpy(CaplCtrl_SignalName, "NM_Gateway_FCAN_Aktivitaet", 27);
                    break;
                case 8:
                    strncpy(CaplCtrl_SignalName, "NM_Gateway_ICAN_Aktivitaet", 27);
                    break;
                case 9:
                    strncpy(CaplCtrl_SignalName, "NM_Gateway_KCAN_Aktivitaet", 27);
                    break;
                case 10:
                    strncpy(CaplCtrl_SignalName, "NM_Gateway_KS_Aktivitaet", 25);
                    break;
                case 11:
                    strncpy(CaplCtrl_SignalName, "NM_Gateway_NL_EM", 17);
                    break;
                case 12:
                    strncpy(CaplCtrl_SignalName, "NM_Gateway_NL_Shutdown", 23);
                    break;
                case 13:
                    strncpy(CaplCtrl_SignalName, "NM_Gateway_NL_Spg_Messung", 26);
                    break;
                case 14:
                    strncpy(CaplCtrl_SignalName, "NM_Gateway_NL_Wakeup_Monitor", 29);
                    break;
                case 15:
                    strncpy(CaplCtrl_SignalName, "NM_Gateway_NM_State", 20);
                    break;
                case 16:
                    strncpy(CaplCtrl_SignalName, "NM_Gateway_NM_aktiv_Diagnose", 29);
                    break;
                case 17:
                    strncpy(CaplCtrl_SignalName, "NM_Gateway_NM_aktiv_KL15", 25);
                    break;
                case 18:
                    strncpy(CaplCtrl_SignalName, "NM_Gateway_NM_aktiv_Tmin", 25);
                    break;
                case 19:
                    strncpy(CaplCtrl_SignalName, "NM_Gateway_SNI", 15);
                    break;
                case 20:
                    strncpy(CaplCtrl_SignalName, "NM_Gateway_UDS_CC", 18);
                    break;
                case 21:
                    strncpy(CaplCtrl_SignalName, "NM_Gateway_Wakeup", 18);
                    break;
            }
        }
        break;
        case FRM_HANDLE_OBD_Tankgeber_01:
        {
            switch (SigIdx)
            {
                case 0:
                    strncpy(CaplCtrl_SignalName, "OBD_TG_F_Status_1", 18);
                    break;
                case 1:
                    strncpy(CaplCtrl_SignalName, "OBD_TG_F_Status_2", 18);
                    break;
                case 2:
                    strncpy(CaplCtrl_SignalName, "OBD_TG_F_Status_3", 18);
                    break;
                case 3:
                    strncpy(CaplCtrl_SignalName, "OBD_TG_F_Status_4", 18);
                    break;
                case 4:
                    strncpy(CaplCtrl_SignalName, "OBD_TG_Sens_Rohwert_1", 22);
                    break;
                case 5:
                    strncpy(CaplCtrl_SignalName, "OBD_TG_Sens_Rohwert_2", 22);
                    break;
                case 6:
                    strncpy(CaplCtrl_SignalName, "OBD_TG_Sens_Rohwert_3", 22);
                    break;
                case 7:
                    strncpy(CaplCtrl_SignalName, "OBD_TG_Sens_Rohwert_4", 22);
                    break;
            }
        }
        break;
        case FRM_HANDLE_Remotestart_FFB:
        {
            switch (SigIdx)
            {
                case 0:
                    strncpy(CaplCtrl_SignalName, "RSF_Tastencode_1", 17);
                    break;
                case 1:
                    strncpy(CaplCtrl_SignalName, "RSF_Tastencode_2", 17);
                    break;
                case 2:
                    strncpy(CaplCtrl_SignalName, "RSF_Tastencode_Maske", 21);
                    break;
            }
        }
        break;
        case FRM_HANDLE_STH_01:
        {
            switch (SigIdx)
            {
                case 0:
                    strncpy(CaplCtrl_SignalName, "STH_EKP_Anst", 13);
                    break;
                case 1:
                    strncpy(CaplCtrl_SignalName, "STH_Fehler_ElWaPu", 18);
                    break;
                case 2:
                    strncpy(CaplCtrl_SignalName, "STH_Fehlerstatus", 17);
                    break;
                case 3:
                    strncpy(CaplCtrl_SignalName, "STH_Funk_aus", 13);
                    break;
                case 4:
                    strncpy(CaplCtrl_SignalName, "STH_Funk_ein", 13);
                    break;
                case 5:
                    strncpy(CaplCtrl_SignalName, "STH_Geblaese", 13);
                    break;
                case 6:
                    strncpy(CaplCtrl_SignalName, "STH_Heizleistung", 17);
                    break;
                case 7:
                    strncpy(CaplCtrl_SignalName, "STH_KD_Fehler", 14);
                    break;
                case 8:
                    strncpy(CaplCtrl_SignalName, "STH_KVS", 8);
                    break;
                case 9:
                    strncpy(CaplCtrl_SignalName, "STH_KVS_Ueberlauf", 18);
                    break;
                case 10:
                    strncpy(CaplCtrl_SignalName, "STH_LED", 8);
                    break;
                case 11:
                    strncpy(CaplCtrl_SignalName, "STH_Motorvorwaermung", 21);
                    break;
                case 12:
                    strncpy(CaplCtrl_SignalName, "STH_Pumpe_ein", 14);
                    break;
                case 13:
                    strncpy(CaplCtrl_SignalName, "STH_Pumpen_Anf_extern", 22);
                    break;
                case 14:
                    strncpy(CaplCtrl_SignalName, "STH_Servicemode", 16);
                    break;
                case 15:
                    strncpy(CaplCtrl_SignalName, "STH_Start_folgt", 16);
                    break;
                case 16:
                    strncpy(CaplCtrl_SignalName, "STH_Texte", 10);
                    break;
                case 17:
                    strncpy(CaplCtrl_SignalName, "STH_Ventil_Status", 18);
                    break;
                case 18:
                    strncpy(CaplCtrl_SignalName, "STH_Ventiloeffnungszeit", 24);
                    break;
                case 19:
                    strncpy(CaplCtrl_SignalName, "STH_Waermeeintrag", 18);
                    break;
                case 20:
                    strncpy(CaplCtrl_SignalName, "STH_Wassertemp", 15);
                    break;
                case 21:
                    strncpy(CaplCtrl_SignalName, "STH_Zusatzheizung", 18);
                    break;
                case 22:
                    strncpy(CaplCtrl_SignalName, "STH_war_aktiv", 14);
                    break;
            }
        }
        break;
        case FRM_HANDLE_STS_01:
        {
            switch (SigIdx)
            {
                case 0:
                    strncpy(CaplCtrl_SignalName, "STS_01_BZ", 10);
                    break;
                case 1:
                    strncpy(CaplCtrl_SignalName, "STS_01_CRC", 11);
                    break;
                case 2:
                    strncpy(CaplCtrl_SignalName, "STS_Alarm_Blinker", 18);
                    break;
                case 3:
                    strncpy(CaplCtrl_SignalName, "STS_Alarm_still", 16);
                    break;
                case 4:
                    strncpy(CaplCtrl_SignalName, "STS_Anlassersperre", 19);
                    break;
                case 5:
                    strncpy(CaplCtrl_SignalName, "STS_Car_not_under_theft", 24);
                    break;
                case 6:
                    strncpy(CaplCtrl_SignalName, "STS_Car_under_theft", 20);
                    break;
                case 7:
                    strncpy(CaplCtrl_SignalName, "STS_Fahrlicht", 14);
                    break;
                case 8:
                    strncpy(CaplCtrl_SignalName, "STS_LIN_aktiv", 14);
                    break;
                case 9:
                    strncpy(CaplCtrl_SignalName, "STS_Laderelais", 15);
                    break;
                case 10:
                    strncpy(CaplCtrl_SignalName, "STS_Leerlaufschaltung", 22);
                    break;
                case 11:
                    strncpy(CaplCtrl_SignalName, "STS_Notstart", 13);
                    break;
                case 12:
                    strncpy(CaplCtrl_SignalName, "STS_Signalhorn", 15);
                    break;
                case 13:
                    strncpy(CaplCtrl_SignalName, "STS_Standlicht", 15);
                    break;
                case 14:
                    strncpy(CaplCtrl_SignalName, "STS_Summer", 11);
                    break;
                case 15:
                    strncpy(CaplCtrl_SignalName, "STS_Texte", 10);
                    break;
                case 16:
                    strncpy(CaplCtrl_SignalName, "STS_Typencodierung", 19);
                    break;
            }
        }
        break;
        case FRM_HANDLE_Systeminfo_01:
        {
            switch (SigIdx)
            {
                case 0:
                    strncpy(CaplCtrl_SignalName, "GW_KD_Fehler", 13);
                    break;
                case 1:
                    strncpy(CaplCtrl_SignalName, "SI_BUS_01", 10);
                    break;
                case 2:
                    strncpy(CaplCtrl_SignalName, "SI_BUS_02", 10);
                    break;
                case 3:
                    strncpy(CaplCtrl_SignalName, "SI_BUS_03", 10);
                    break;
                case 4:
                    strncpy(CaplCtrl_SignalName, "SI_BUS_04", 10);
                    break;
                case 5:
                    strncpy(CaplCtrl_SignalName, "SI_BUS_05", 10);
                    break;
                case 6:
                    strncpy(CaplCtrl_SignalName, "SI_BUS_06", 10);
                    break;
                case 7:
                    strncpy(CaplCtrl_SignalName, "SI_BUS_07", 10);
                    break;
                case 8:
                    strncpy(CaplCtrl_SignalName, "SI_BUS_08", 10);
                    break;
                case 9:
                    strncpy(CaplCtrl_SignalName, "SI_BUS_09", 10);
                    break;
                case 10:
                    strncpy(CaplCtrl_SignalName, "SI_BUS_10", 10);
                    break;
                case 11:
                    strncpy(CaplCtrl_SignalName, "SI_BUS_11", 10);
                    break;
                case 12:
                    strncpy(CaplCtrl_SignalName, "SI_BUS_12", 10);
                    break;
                case 13:
                    strncpy(CaplCtrl_SignalName, "SI_BUS_13", 10);
                    break;
                case 14:
                    strncpy(CaplCtrl_SignalName, "SI_BUS_14", 10);
                    break;
                case 15:
                    strncpy(CaplCtrl_SignalName, "SI_BUS_15", 10);
                    break;
                case 16:
                    strncpy(CaplCtrl_SignalName, "SI_Bus_Identifikation", 22);
                    break;
                case 17:
                    strncpy(CaplCtrl_SignalName, "SI_NWDF", 8);
                    break;
                case 18:
                    strncpy(CaplCtrl_SignalName, "SI_NWDF_gueltig", 16);
                    break;
                case 19:
                    strncpy(CaplCtrl_SignalName, "SI_QRS_Mode", 12);
                    break;
                case 20:
                    strncpy(CaplCtrl_SignalName, "SI_Sammel_SG_Fehler", 20);
                    break;
                case 21:
                    strncpy(CaplCtrl_SignalName, "SI_Sammelfehler", 16);
                    break;
                case 22:
                    strncpy(CaplCtrl_SignalName, "SI_T_Mode", 10);
                    break;
                case 23:
                    strncpy(CaplCtrl_SignalName, "SI_T_Schutz", 12);
                    break;
            }
        }
        break;
        case FRM_HANDLE_WBA_03:
        {
            switch (SigIdx)
            {
                case 0:
                    strncpy(CaplCtrl_SignalName, "GE_Sollgang", 12);
                    break;
                case 1:
                    strncpy(CaplCtrl_SignalName, "GE_Stoppverbot_Anz_01", 22);
                    break;
                case 2:
                    strncpy(CaplCtrl_SignalName, "GE_Stoppverbot_Anz_02", 22);
                    break;
                case 3:
                    strncpy(CaplCtrl_SignalName, "GE_Stoppverbot_Anz_03", 22);
                    break;
                case 4:
                    strncpy(CaplCtrl_SignalName, "GE_Stoppverbot_Anz_04", 22);
                    break;
                case 5:
                    strncpy(CaplCtrl_SignalName, "GE_Stoppverbot_Anz_05", 22);
                    break;
                case 6:
                    strncpy(CaplCtrl_SignalName, "GE_Stoppverbot_Anz_06", 22);
                    break;
                case 7:
                    strncpy(CaplCtrl_SignalName, "GE_Stoppverbot_Anz_07", 22);
                    break;
                case 8:
                    strncpy(CaplCtrl_SignalName, "GE_Stoppverbot_Anz_Std", 23);
                    break;
                case 9:
                    strncpy(CaplCtrl_SignalName, "GE_Tipschaltempf_verfuegbar", 28);
                    break;
                case 10:
                    strncpy(CaplCtrl_SignalName, "GE_Wiederstart_Anz_Std", 23);
                    break;
                case 11:
                    strncpy(CaplCtrl_SignalName, "WBA_03_BZ", 10);
                    break;
                case 12:
                    strncpy(CaplCtrl_SignalName, "WBA_03_CRC", 11);
                    break;
                case 13:
                    strncpy(CaplCtrl_SignalName, "WBA_Fahrstufe_02", 17);
                    break;
                case 14:
                    strncpy(CaplCtrl_SignalName, "WBA_GE_Texte", 13);
                    break;
                case 15:
                    strncpy(CaplCtrl_SignalName, "WBA_GE_Warnung_02", 18);
                    break;
                case 16:
                    strncpy(CaplCtrl_SignalName, "WBA_GE_Zusatzwarnungen", 23);
                    break;
                case 17:
                    strncpy(CaplCtrl_SignalName, "WBA_Schaltschema", 17);
                    break;
                case 18:
                    strncpy(CaplCtrl_SignalName, "WBA_Segeln_aktiv", 17);
                    break;
                case 19:
                    strncpy(CaplCtrl_SignalName, "WBA_ZielFahrstufe", 18);
                    break;
                case 20:
                    strncpy(CaplCtrl_SignalName, "WBA_eing_Gang_02", 17);
                    break;
            }
        }
        break;
    }
}
/*@@end*/

/*@@caplFunc:Frm_SetSignal(long,long,long):*/
Frm_SetSignal (long FrmIdx, long SigIdx, long SigVal)
{
    switch (FrmIdx)
    {
        case FRM_HANDLE_ACC_06:
        {
            switch (SigIdx)
            {
                case 0:
                    MsgObj_ACC_06.ACC_06_BZ = SigVal;
                    break;
                case 1:
                    MsgObj_ACC_06.ACC_06_CRC = SigVal;
                    break;
                case 2:
                    MsgObj_ACC_06.ACC_Anfahren = SigVal;
                    break;
                case 3:
                    MsgObj_ACC_06.ACC_Anhalten = SigVal;
                    break;
                case 4:
                    MsgObj_ACC_06.ACC_Minimale_Bremsung = SigVal;
                    break;
                case 5:
                    MsgObj_ACC_06.ACC_Sollbeschleunigung_02 = SigVal;
                    break;
                case 6:
                    MsgObj_ACC_06.ACC_StartStopp_Info = SigVal;
                    break;
                case 7:
                    MsgObj_ACC_06.ACC_Status_ACC = SigVal;
                    break;
                case 8:
                    MsgObj_ACC_06.ACC_Typ = SigVal;
                    break;
                case 9:
                    MsgObj_ACC_06.ACC_limitierte_Anfahrdyn = SigVal;
                    break;
                case 10:
                    MsgObj_ACC_06.ACC_neg_Sollbeschl_Grad_02 = SigVal;
                    break;
                case 11:
                    MsgObj_ACC_06.ACC_pos_Sollbeschl_Grad_02 = SigVal;
                    break;
                case 12:
                    MsgObj_ACC_06.ACC_zul_Regelabw_oben = SigVal;
                    break;
                case 13:
                    MsgObj_ACC_06.ACC_zul_Regelabw_unten = SigVal;
                    break;
            }
        }
        break;
        case FRM_HANDLE_Airbag_01:
        {
            switch (SigIdx)
            {
                case 0:
                    MsgObj_Airbag_01.AB_Anzeige_Fussg = SigVal;
                    break;
                case 1:
                    MsgObj_Airbag_01.AB_Crash_Int = SigVal;
                    break;
                case 2:
                    MsgObj_Airbag_01.AB_Deaktiviert = SigVal;
                    break;
                case 3:
                    MsgObj_Airbag_01.AB_Deaktivierung_HV = SigVal;
                    break;
                case 4:
                    MsgObj_Airbag_01.AB_Diagnose = SigVal;
                    break;
                case 5:
                    MsgObj_Airbag_01.AB_Erh_Auf_VB = SigVal;
                    break;
                case 6:
                    MsgObj_Airbag_01.AB_Front_Crash = SigVal;
                    break;
                case 7:
                    MsgObj_Airbag_01.AB_Gurtwarn_VB = SigVal;
                    break;
                case 8:
                    MsgObj_Airbag_01.AB_Gurtwarn_VF = SigVal;
                    break;
                case 9:
                    MsgObj_Airbag_01.AB_Heck_Crash = SigVal;
                    break;
                case 10:
                    MsgObj_Airbag_01.AB_Lampe = SigVal;
                    break;
                case 11:
                    MsgObj_Airbag_01.AB_MKB_Anforderung = SigVal;
                    break;
                case 12:
                    MsgObj_Airbag_01.AB_MKB_gueltig = SigVal;
                    break;
                case 13:
                    MsgObj_Airbag_01.AB_PAO_Leuchte_Anf = SigVal;
                    break;
                case 14:
                    MsgObj_Airbag_01.AB_RGS_Anst = SigVal;
                    break;
                case 15:
                    MsgObj_Airbag_01.AB_Rollover_Crash = SigVal;
                    break;
                case 16:
                    MsgObj_Airbag_01.AB_SB_Crash = SigVal;
                    break;
                case 17:
                    MsgObj_Airbag_01.AB_SF_Crash = SigVal;
                    break;
                case 18:
                    MsgObj_Airbag_01.AB_Stellgliedtest = SigVal;
                    break;
                case 19:
                    MsgObj_Airbag_01.AB_Systemfehler = SigVal;
                    break;
                case 20:
                    MsgObj_Airbag_01.AB_Texte_AKS = SigVal;
                    break;
                case 21:
                    MsgObj_Airbag_01.AB_VB_deaktiviert = SigVal;
                    break;
                case 22:
                    MsgObj_Airbag_01.AB_Versorgungsspannung = SigVal;
                    break;
                case 23:
                    MsgObj_Airbag_01.Airbag_01_BZ = SigVal;
                    break;
                case 24:
                    MsgObj_Airbag_01.Airbag_01_CRC = SigVal;
                    break;
            }
        }
        break;
        case FRM_HANDLE_Airbag_02:
        {
            switch (SigIdx)
            {
                case 0:
                    MsgObj_Airbag_02.AB_Belegung_VB = SigVal;
                    break;
                case 1:
                    MsgObj_Airbag_02.AB_Gurtschloss_BF = SigVal;
                    break;
                case 2:
                    MsgObj_Airbag_02.AB_Gurtschloss_FA = SigVal;
                    break;
                case 3:
                    MsgObj_Airbag_02.AB_Gurtschloss_Reihe2_BF = SigVal;
                    break;
                case 4:
                    MsgObj_Airbag_02.AB_Gurtschloss_Reihe2_FA = SigVal;
                    break;
                case 5:
                    MsgObj_Airbag_02.AB_Gurtschloss_Reihe2_MI = SigVal;
                    break;
                case 6:
                    MsgObj_Airbag_02.AB_Gurtschloss_Reihe3_BF = SigVal;
                    break;
                case 7:
                    MsgObj_Airbag_02.AB_Gurtschloss_Reihe3_FA = SigVal;
                    break;
                case 8:
                    MsgObj_Airbag_02.AB_Gurtschloss_Reihe3_MI = SigVal;
                    break;
                case 9:
                    MsgObj_Airbag_02.AB_Sitzpos_Sens_BF = SigVal;
                    break;
                case 10:
                    MsgObj_Airbag_02.AB_Sitzpos_Sens_FA = SigVal;
                    break;
                case 11:
                    MsgObj_Airbag_02.Airbag_02_BZ = SigVal;
                    break;
                case 12:
                    MsgObj_Airbag_02.Airbag_02_CRC = SigVal;
                    break;
            }
        }
        break;
        case FRM_HANDLE_Anhaenger_01:
        {
            switch (SigIdx)
            {
                case 0:
                    MsgObj_Anhaenger_01.AAG_AVS_Fehler_02 = SigVal;
                    break;
                case 1:
                    MsgObj_Anhaenger_01.AAG_AVS_Stati = SigVal;
                    break;
                case 2:
                    MsgObj_Anhaenger_01.AAG_Anhaenger_abgesteckt = SigVal;
                    break;
                case 3:
                    MsgObj_Anhaenger_01.AAG_Anhaenger_erkannt = SigVal;
                    break;
                case 4:
                    MsgObj_Anhaenger_01.AAG_BZ = SigVal;
                    break;
                case 5:
                    MsgObj_Anhaenger_01.AAG_Blinker_HL_def = SigVal;
                    break;
                case 6:
                    MsgObj_Anhaenger_01.AAG_Blinker_HR_def = SigVal;
                    break;
                case 7:
                    MsgObj_Anhaenger_01.AAG_Blinker_H_aktiv = SigVal;
                    break;
                case 8:
                    MsgObj_Anhaenger_01.AAG_Bremsl_durch_ECD = SigVal;
                    break;
                case 9:
                    MsgObj_Anhaenger_01.AAG_Bremslicht_H_def = SigVal;
                    break;
                case 10:
                    MsgObj_Anhaenger_01.AAG_NSL_aktiv = SigVal;
                    break;
                case 11:
                    MsgObj_Anhaenger_01.AAG_Schlusslicht_HL_def = SigVal;
                    break;
                case 12:
                    MsgObj_Anhaenger_01.AAG_Schlusslicht_HR_def = SigVal;
                    break;
            }
        }
        break;
        case FRM_HANDLE_BCM_01:
        {
            switch (SigIdx)
            {
                case 0:
                    MsgObj_BCM_01.BCM1_AFS_Lampe = SigVal;
                    break;
                case 1:
                    MsgObj_BCM_01.BCM1_Kl_15_HW_erkannt = SigVal;
                    break;
                case 2:
                    MsgObj_BCM_01.BCM1_Licht_Warn = SigVal;
                    break;
                case 3:
                    MsgObj_BCM_01.BCM1_Lichtwarn_Texte = SigVal;
                    break;
                case 4:
                    MsgObj_BCM_01.BCM1_MH_Schalter = SigVal;
                    break;
                case 5:
                    MsgObj_BCM_01.BCM1_MH_WIV_Schalter = SigVal;
                    break;
                case 6:
                    MsgObj_BCM_01.BCM1_NV_Taster = SigVal;
                    break;
                case 7:
                    MsgObj_BCM_01.BCM1_Reisemodus_Texte = SigVal;
                    break;
                case 8:
                    MsgObj_BCM_01.BCM1_Rueckfahrlicht_Schalter = SigVal;
                    break;
                case 9:
                    MsgObj_BCM_01.BCM1_Valet_Parking_Taster = SigVal;
                    break;
                case 10:
                    MsgObj_BCM_01.BCM1_Warnblink_Taster = SigVal;
                    break;
                case 11:
                    MsgObj_BCM_01.BCM_Bremsbelag_Sensor = SigVal;
                    break;
                case 12:
                    MsgObj_BCM_01.BCM_Bremsfluessigkeit_Sensor = SigVal;
                    break;
                case 13:
                    MsgObj_BCM_01.BCM_Eco_Charisma_Taste = SigVal;
                    break;
                case 14:
                    MsgObj_BCM_01.BCM_Hybrid_StartStopp_Taste = SigVal;
                    break;
                case 15:
                    MsgObj_BCM_01.BCM_Kuehlmittel_Sensor = SigVal;
                    break;
                case 16:
                    MsgObj_BCM_01.BCM_Waschwasser_Sensor = SigVal;
                    break;
                case 17:
                    MsgObj_BCM_01.Gong_TFL_Umschaltung = SigVal;
                    break;
                case 18:
                    MsgObj_BCM_01.UGDO_Function = SigVal;
                    break;
            }
        }
        break;
        case FRM_HANDLE_BEM_05:
        {
            switch (SigIdx)
            {
                case 0:
                    MsgObj_BEM_05.BEM_01_Abschaltstufen = SigVal;
                    break;
                case 1:
                    MsgObj_BEM_05.BEM_Anf_KL = SigVal;
                    break;
                case 2:
                    MsgObj_BEM_05.BEM_Batt_Ab = SigVal;
                    break;
                case 3:
                    MsgObj_BEM_05.BEM_DFM = SigVal;
                    break;
                case 4:
                    MsgObj_BEM_05.BEM_EMLIN_ungueltig = SigVal;
                    break;
                case 5:
                    MsgObj_BEM_05.BEM_HYB_DC_uMinLV = SigVal;
                    break;
                case 6:
                    MsgObj_BEM_05.BEM_HYB_DC_uSollLV = SigVal;
                    break;
                case 7:
                    MsgObj_BEM_05.BEM_Hybrid_Info = SigVal;
                    break;
                case 8:
                    MsgObj_BEM_05.BEM_NV_NachladAnf = SigVal;
                    break;
                case 9:
                    MsgObj_BEM_05.BEM_P_Generator = SigVal;
                    break;
                case 10:
                    MsgObj_BEM_05.BEM_Segel_Info = SigVal;
                    break;
                case 11:
                    MsgObj_BEM_05.BEM_StartStopp_Info = SigVal;
                    break;
                case 12:
                    MsgObj_BEM_05.BEM_n_LLA = SigVal;
                    break;
                case 13:
                    MsgObj_BEM_05.NVEM_DC_LangsRegelung_Anf = SigVal;
                    break;
            }
        }
        break;
        case FRM_HANDLE_Bremse_EV_01:
        {
            switch (SigIdx)
            {
                case 0:
                    MsgObj_Bremse_EV_01.Bremse_EV_01_BZ = SigVal;
                    break;
                case 1:
                    MsgObj_Bremse_EV_01.Bremse_EV_01_CRC = SigVal;
                    break;
                case 2:
                    MsgObj_Bremse_EV_01.EBKV_Bremspedalweg = SigVal;
                    break;
                case 3:
                    MsgObj_Bremse_EV_01.EBKV_Fahrer_bremst = SigVal;
                    break;
                case 4:
                    MsgObj_Bremse_EV_01.EBKV_Generatorsollmoment = SigVal;
                    break;
                case 5:
                    MsgObj_Bremse_EV_01.EBKV_M_Brems_ASM_soll = SigVal;
                    break;
                case 6:
                    MsgObj_Bremse_EV_01.EBKV_QBit_Fahrer_bremst = SigVal;
                    break;
                case 7:
                    MsgObj_Bremse_EV_01.EBKV_Status = SigVal;
                    break;
            }
        }
        break;
        case FRM_HANDLE_Bremse_EV_02:
        {
            switch (SigIdx)
            {
                case 0:
                    MsgObj_Bremse_EV_02.EBKV_BKL_Warnungen = SigVal;
                    break;
                case 1:
                    MsgObj_Bremse_EV_02.EBKV_Hinweise = SigVal;
                    break;
                case 2:
                    MsgObj_Bremse_EV_02.EBKV_OBD_Status = SigVal;
                    break;
                case 3:
                    MsgObj_Bremse_EV_02.EBKV_Warnungen = SigVal;
                    break;
            }
        }
        break;
        case FRM_HANDLE_CAN_Umsetzer_Resp_01:
        {
            switch (SigIdx)
            {
                case 0:
                    MsgObj_CAN_Umsetzer_Resp_01.CU1RSP_IO1 = SigVal;
                    break;
                case 1:
                    MsgObj_CAN_Umsetzer_Resp_01.CU1RSP_IO1_KS_GND_Fehler = SigVal;
                    break;
                case 2:
                    MsgObj_CAN_Umsetzer_Resp_01.CU1RSP_IO1_KS_UBat_Fehler = SigVal;
                    break;
                case 3:
                    MsgObj_CAN_Umsetzer_Resp_01.CU1RSP_IO1_QBit = SigVal;
                    break;
                case 4:
                    MsgObj_CAN_Umsetzer_Resp_01.CU1RSP_IO1_Taste_Fehler = SigVal;
                    break;
                case 5:
                    MsgObj_CAN_Umsetzer_Resp_01.CU1RSP_IO1_analog_Eing = SigVal;
                    break;
                case 6:
                    MsgObj_CAN_Umsetzer_Resp_01.CU1RSP_IO1_digital_Eing = SigVal;
                    break;
                case 7:
                    MsgObj_CAN_Umsetzer_Resp_01.CU1RSP_IO1_digital_analog = SigVal;
                    break;
                case 8:
                    MsgObj_CAN_Umsetzer_Resp_01.CU1RSP_IO2 = SigVal;
                    break;
                case 9:
                    MsgObj_CAN_Umsetzer_Resp_01.CU1RSP_IO2_KS_Fehler = SigVal;
                    break;
                case 10:
                    MsgObj_CAN_Umsetzer_Resp_01.CU1RSP_IO2_KS_UBat_Fehler = SigVal;
                    break;
                case 11:
                    MsgObj_CAN_Umsetzer_Resp_01.CU1RSP_IO2_OpenLoad = SigVal;
                    break;
                case 12:
                    MsgObj_CAN_Umsetzer_Resp_01.CU1RSP_IO2_QBit = SigVal;
                    break;
                case 13:
                    MsgObj_CAN_Umsetzer_Resp_01.CU1RSP_IO2_digital_Eing = SigVal;
                    break;
                case 14:
                    MsgObj_CAN_Umsetzer_Resp_01.CU1RSP_IO3 = SigVal;
                    break;
                case 15:
                    MsgObj_CAN_Umsetzer_Resp_01.CU1RSP_IO3_KS_Fehler = SigVal;
                    break;
                case 16:
                    MsgObj_CAN_Umsetzer_Resp_01.CU1RSP_IO3_KS_UBat_Fehler = SigVal;
                    break;
                case 17:
                    MsgObj_CAN_Umsetzer_Resp_01.CU1RSP_IO3_OpenLoad = SigVal;
                    break;
                case 18:
                    MsgObj_CAN_Umsetzer_Resp_01.CU1RSP_IO3_QBit = SigVal;
                    break;
                case 19:
                    MsgObj_CAN_Umsetzer_Resp_01.CU1RSP_IO3_digital_Eing = SigVal;
                    break;
                case 20:
                    MsgObj_CAN_Umsetzer_Resp_01.CU1RSP_Timeout_Fehler = SigVal;
                    break;
            }
        }
        break;
        case FRM_HANDLE_Charisma_01:
        {
            switch (SigIdx)
            {
                case 0:
                    MsgObj_Charisma_01.CHA_Fahrer_Umschaltung = SigVal;
                    break;
                case 1:
                    MsgObj_Charisma_01.CHA_Ziel_FahrPr_ACC = SigVal;
                    break;
                case 2:
                    MsgObj_Charisma_01.CHA_Ziel_FahrPr_AFS = SigVal;
                    break;
                case 3:
                    MsgObj_Charisma_01.CHA_Ziel_FahrPr_AGA = SigVal;
                    break;
                case 4:
                    MsgObj_Charisma_01.CHA_Ziel_FahrPr_DR = SigVal;
                    break;
                case 5:
                    MsgObj_Charisma_01.CHA_Ziel_FahrPr_EPS = SigVal;
                    break;
                case 6:
                    MsgObj_Charisma_01.CHA_Ziel_FahrPr_ESP = SigVal;
                    break;
                case 7:
                    MsgObj_Charisma_01.CHA_Ziel_FahrPr_Freilauf = SigVal;
                    break;
                case 8:
                    MsgObj_Charisma_01.CHA_Ziel_FahrPr_GE = SigVal;
                    break;
                case 9:
                    MsgObj_Charisma_01.CHA_Ziel_FahrPr_MO = SigVal;
                    break;
                case 10:
                    MsgObj_Charisma_01.CHA_Ziel_FahrPr_MO_StSt = SigVal;
                    break;
                case 11:
                    MsgObj_Charisma_01.CHA_Ziel_FahrPr_QS = SigVal;
                    break;
                case 12:
                    MsgObj_Charisma_01.CHA_Ziel_FahrPr_RGS = SigVal;
                    break;
                case 13:
                    MsgObj_Charisma_01.CHA_Ziel_FahrPr_SAK = SigVal;
                    break;
                case 14:
                    MsgObj_Charisma_01.CHA_Ziel_FahrPr_SCU = SigVal;
                    break;
                case 15:
                    MsgObj_Charisma_01.CHA_Ziel_FahrPr_ST = SigVal;
                    break;
            }
        }
        break;
        case FRM_HANDLE_Diagnose_01:
        {
            switch (SigIdx)
            {
                case 0:
                    MsgObj_Diagnose_01.DGN_Verlernzaehler = SigVal;
                    break;
                case 1:
                    MsgObj_Diagnose_01.KBI_Kilometerstand = SigVal;
                    break;
                case 2:
                    MsgObj_Diagnose_01.Kombi_02_alt = SigVal;
                    break;
                case 3:
                    MsgObj_Diagnose_01.UH_Jahr = SigVal;
                    break;
                case 4:
                    MsgObj_Diagnose_01.UH_Minute = SigVal;
                    break;
                case 5:
                    MsgObj_Diagnose_01.UH_Monat = SigVal;
                    break;
                case 6:
                    MsgObj_Diagnose_01.UH_Sekunde = SigVal;
                    break;
                case 7:
                    MsgObj_Diagnose_01.UH_Stunde = SigVal;
                    break;
                case 8:
                    MsgObj_Diagnose_01.UH_Tag = SigVal;
                    break;
                case 9:
                    MsgObj_Diagnose_01.Uhrzeit_01_alt = SigVal;
                    break;
            }
        }
        break;
        case FRM_HANDLE_EPB_01:
        {
            switch (SigIdx)
            {
                case 0:
                    MsgObj_EPB_01.EPB_01_BZ = SigVal;
                    break;
                case 1:
                    MsgObj_EPB_01.EPB_01_CRC = SigVal;
                    break;
                case 2:
                    MsgObj_EPB_01.EPB_Anfahrwunsch_erkannt = SigVal;
                    break;
                case 3:
                    MsgObj_EPB_01.EPB_BCM2_Motor_Wakeup = SigVal;
                    break;
                case 4:
                    MsgObj_EPB_01.EPB_DAA_Randbed_erf = SigVal;
                    break;
                case 5:
                    MsgObj_EPB_01.EPB_Fehlerstatus = SigVal;
                    break;
                case 6:
                    MsgObj_EPB_01.EPB_Freig_Verzoeg_Anf = SigVal;
                    break;
                case 7:
                    MsgObj_EPB_01.EPB_Konsistenz_ACC = SigVal;
                    break;
                case 8:
                    MsgObj_EPB_01.EPB_Laengsbeschleunigung = SigVal;
                    break;
                case 9:
                    MsgObj_EPB_01.EPB_Pedalweg_Kuppl = SigVal;
                    break;
                case 10:
                    MsgObj_EPB_01.EPB_QBit_Laengsbeschleunigung = SigVal;
                    break;
                case 11:
                    MsgObj_EPB_01.EPB_QBit_Pedalweg_Kuppl = SigVal;
                    break;
                case 12:
                    MsgObj_EPB_01.EPB_QBit_Schalterpos = SigVal;
                    break;
                case 13:
                    MsgObj_EPB_01.EPB_Schalterposition = SigVal;
                    break;
                case 14:
                    MsgObj_EPB_01.EPB_Spannkraft = SigVal;
                    break;
                case 15:
                    MsgObj_EPB_01.EPB_Status = SigVal;
                    break;
                case 16:
                    MsgObj_EPB_01.EPB_Verzoeg_Anf = SigVal;
                    break;
            }
        }
        break;
        case FRM_HANDLE_ESP_02:
        {
            switch (SigIdx)
            {
                case 0:
                    MsgObj_ESP_02.ESP_02_BZ = SigVal;
                    break;
                case 1:
                    MsgObj_ESP_02.ESP_02_CRC = SigVal;
                    break;
                case 2:
                    MsgObj_ESP_02.ESP_Gierrate = SigVal;
                    break;
                case 3:
                    MsgObj_ESP_02.ESP_Laengsbeschl = SigVal;
                    break;
                case 4:
                    MsgObj_ESP_02.ESP_Notbremsanzeige = SigVal;
                    break;
                case 5:
                    MsgObj_ESP_02.ESP_PLA_Abbruch = SigVal;
                    break;
                case 6:
                    MsgObj_ESP_02.ESP_QBit_Anf_Vert_Wank = SigVal;
                    break;
                case 7:
                    MsgObj_ESP_02.ESP_QBit_Gierrate = SigVal;
                    break;
                case 8:
                    MsgObj_ESP_02.ESP_QBit_Laengsbeschl = SigVal;
                    break;
                case 9:
                    MsgObj_ESP_02.ESP_QBit_Querb = SigVal;
                    break;
                case 10:
                    MsgObj_ESP_02.ESP_Querbeschleunigung = SigVal;
                    break;
                case 11:
                    MsgObj_ESP_02.ESP_SpannungsAnf = SigVal;
                    break;
                case 12:
                    MsgObj_ESP_02.ESP_Status_ESP_PLA = SigVal;
                    break;
                case 13:
                    MsgObj_ESP_02.ESP_Stillstandsflag = SigVal;
                    break;
                case 14:
                    MsgObj_ESP_02.ESP_VZ_Gierrate = SigVal;
                    break;
                case 15:
                    MsgObj_ESP_02.ESP_Verteil_Wankmom = SigVal;
                    break;
            }
        }
        break;
        case FRM_HANDLE_ESP_05:
        {
            switch (SigIdx)
            {
                case 0:
                    MsgObj_ESP_05.ECD_Bremslicht = SigVal;
                    break;
                case 1:
                    MsgObj_ESP_05.ECD_Fehler = SigVal;
                    break;
                case 2:
                    MsgObj_ESP_05.ECD_nicht_verfuegbar = SigVal;
                    break;
                case 3:
                    MsgObj_ESP_05.ESP_05_BZ = SigVal;
                    break;
                case 4:
                    MsgObj_ESP_05.ESP_05_CRC = SigVal;
                    break;
                case 5:
                    MsgObj_ESP_05.ESP_Anforderung_EPB = SigVal;
                    break;
                case 6:
                    MsgObj_ESP_05.ESP_Autohold_Standby = SigVal;
                    break;
                case 7:
                    MsgObj_ESP_05.ESP_Autohold_aktiv = SigVal;
                    break;
                case 8:
                    MsgObj_ESP_05.ESP_BKV_Unterdruck = SigVal;
                    break;
                case 9:
                    MsgObj_ESP_05.ESP_Bremsdruck = SigVal;
                    break;
                case 10:
                    MsgObj_ESP_05.ESP_Bremsruck_AWV2 = SigVal;
                    break;
                case 11:
                    MsgObj_ESP_05.ESP_Eingr_HL = SigVal;
                    break;
                case 12:
                    MsgObj_ESP_05.ESP_Eingr_HR = SigVal;
                    break;
                case 13:
                    MsgObj_ESP_05.ESP_Eingr_VL = SigVal;
                    break;
                case 14:
                    MsgObj_ESP_05.ESP_Eingr_VR = SigVal;
                    break;
                case 15:
                    MsgObj_ESP_05.ESP_FStatus_Anfahrhilfe = SigVal;
                    break;
                case 16:
                    MsgObj_ESP_05.ESP_Fahrer_bremst = SigVal;
                    break;
                case 17:
                    MsgObj_ESP_05.ESP_HBA_aktiv = SigVal;
                    break;
                case 18:
                    MsgObj_ESP_05.ESP_HDC_Standby = SigVal;
                    break;
                case 19:
                    MsgObj_ESP_05.ESP_HDC_aktiv = SigVal;
                    break;
                case 20:
                    MsgObj_ESP_05.ESP_Konsistenz_AWV2 = SigVal;
                    break;
                case 21:
                    MsgObj_ESP_05.ESP_Konsistenz_TSK = SigVal;
                    break;
                case 22:
                    MsgObj_ESP_05.ESP_Lenkeingriff_ADS = SigVal;
                    break;
                case 23:
                    MsgObj_ESP_05.ESP_Prefill_ausgeloest = SigVal;
                    break;
                case 24:
                    MsgObj_ESP_05.ESP_QBit_Bremsdruck = SigVal;
                    break;
                case 25:
                    MsgObj_ESP_05.ESP_QBit_Fahrer_bremst = SigVal;
                    break;
                case 26:
                    MsgObj_ESP_05.ESP_Rueckwaertsfahrt_erkannt = SigVal;
                    break;
                case 27:
                    MsgObj_ESP_05.ESP_Schwelle_Unterdruck = SigVal;
                    break;
                case 28:
                    MsgObj_ESP_05.ESP_StartStopp_Info = SigVal;
                    break;
                case 29:
                    MsgObj_ESP_05.ESP_Status_Anfahrhilfe = SigVal;
                    break;
                case 30:
                    MsgObj_ESP_05.ESP_Status_Bremsdruck = SigVal;
                    break;
                case 31:
                    MsgObj_ESP_05.ESP_Status_Bremsentemp = SigVal;
                    break;
                case 32:
                    MsgObj_ESP_05.ESP_Verz_EPB_aktiv = SigVal;
                    break;
                case 33:
                    MsgObj_ESP_05.ESP_Verz_TSK_aktiv = SigVal;
                    break;
                case 34:
                    MsgObj_ESP_05.ESP_Verzoeg_EPB_verf = SigVal;
                    break;
            }
        }
        break;
        case FRM_HANDLE_ESP_07:
        {
            switch (SigIdx)
            {
                case 0:
                    MsgObj_ESP_07.ESP_07_BZ = SigVal;
                    break;
                case 1:
                    MsgObj_ESP_07.ESP_07_CRC = SigVal;
                    break;
                case 2:
                    MsgObj_ESP_07.ESP_ACC_LDE = SigVal;
                    break;
                case 3:
                    MsgObj_ESP_07.ESP_CM_Variante = SigVal;
                    break;
                case 4:
                    MsgObj_ESP_07.ESP_Codierung_ADS = SigVal;
                    break;
                case 5:
                    MsgObj_ESP_07.ESP_MKB_ausloesbar = SigVal;
                    break;
                case 6:
                    MsgObj_ESP_07.ESP_OBD_Status = SigVal;
                    break;
                case 7:
                    MsgObj_ESP_07.ESP_Offroad_Modus = SigVal;
                    break;
                case 8:
                    MsgObj_ESP_07.ESP_Qualifizierung_Antriebsart = SigVal;
                    break;
                case 9:
                    MsgObj_ESP_07.ESP_Quattro_Antrieb = SigVal;
                    break;
                case 10:
                    MsgObj_ESP_07.ESP_RTA_HL = SigVal;
                    break;
                case 11:
                    MsgObj_ESP_07.ESP_RTA_HR = SigVal;
                    break;
                case 12:
                    MsgObj_ESP_07.ESP_RTA_VR = SigVal;
                    break;
                case 13:
                    MsgObj_ESP_07.ESP_Rollenmodus_Deaktivieren = SigVal;
                    break;
                case 14:
                    MsgObj_ESP_07.ESP_Stat_FallBack_eBKV = SigVal;
                    break;
                case 15:
                    MsgObj_ESP_07.ESP_nachtr_Stopp_Anf = SigVal;
                    break;
                case 16:
                    MsgObj_ESP_07.OBD_Fehler_Radsensor_HL = SigVal;
                    break;
                case 17:
                    MsgObj_ESP_07.OBD_Fehler_Radsensor_HR = SigVal;
                    break;
                case 18:
                    MsgObj_ESP_07.OBD_Fehler_Radsensor_VL = SigVal;
                    break;
                case 19:
                    MsgObj_ESP_07.OBD_Fehler_Radsensor_VR = SigVal;
                    break;
            }
        }
        break;
        case FRM_HANDLE_ESP_10:
        {
            switch (SigIdx)
            {
                case 0:
                    MsgObj_ESP_10.ESP_10_BZ = SigVal;
                    break;
                case 1:
                    MsgObj_ESP_10.ESP_10_CRC = SigVal;
                    break;
                case 2:
                    MsgObj_ESP_10.ESP_HL_Fahrtrichtung = SigVal;
                    break;
                case 3:
                    MsgObj_ESP_10.ESP_HR_Fahrtrichtung = SigVal;
                    break;
                case 4:
                    MsgObj_ESP_10.ESP_QBit_Wegimpuls_HL = SigVal;
                    break;
                case 5:
                    MsgObj_ESP_10.ESP_QBit_Wegimpuls_HR = SigVal;
                    break;
                case 6:
                    MsgObj_ESP_10.ESP_QBit_Wegimpuls_VL = SigVal;
                    break;
                case 7:
                    MsgObj_ESP_10.ESP_QBit_Wegimpuls_VR = SigVal;
                    break;
                case 8:
                    MsgObj_ESP_10.ESP_VL_Fahrtrichtung = SigVal;
                    break;
                case 9:
                    MsgObj_ESP_10.ESP_VR_Fahrtrichtung = SigVal;
                    break;
                case 10:
                    MsgObj_ESP_10.ESP_Wegimpuls_HL = SigVal;
                    break;
                case 11:
                    MsgObj_ESP_10.ESP_Wegimpuls_HR = SigVal;
                    break;
                case 12:
                    MsgObj_ESP_10.ESP_Wegimpuls_VL = SigVal;
                    break;
                case 13:
                    MsgObj_ESP_10.ESP_Wegimpuls_VR = SigVal;
                    break;
            }
        }
        break;
        case FRM_HANDLE_ESP_19:
        {
            switch (SigIdx)
            {
                case 0:
                    MsgObj_ESP_19.ESP_HL_Radgeschw_02 = SigVal;
                    break;
                case 1:
                    MsgObj_ESP_19.ESP_HR_Radgeschw_02 = SigVal;
                    break;
                case 2:
                    MsgObj_ESP_19.ESP_VL_Radgeschw_02 = SigVal;
                    break;
                case 3:
                    MsgObj_ESP_19.ESP_VR_Radgeschw_02 = SigVal;
                    break;
            }
        }
        break;
        case FRM_HANDLE_ESP_20:
        {
            switch (SigIdx)
            {
                case 0:
                    MsgObj_ESP_20.BR_QBit_Reifenumfang = SigVal;
                    break;
                case 1:
                    MsgObj_ESP_20.BR_Reifenumfang = SigVal;
                    break;
                case 2:
                    MsgObj_ESP_20.BR_Systemart = SigVal;
                    break;
                case 3:
                    MsgObj_ESP_20.ESP_20_BZ = SigVal;
                    break;
                case 4:
                    MsgObj_ESP_20.ESP_20_CRC = SigVal;
                    break;
                case 5:
                    MsgObj_ESP_20.ESP_Charisma_FahrPr = SigVal;
                    break;
                case 6:
                    MsgObj_ESP_20.ESP_Charisma_Status = SigVal;
                    break;
                case 7:
                    MsgObj_ESP_20.ESP_Dachrelingsensor = SigVal;
                    break;
                case 8:
                    MsgObj_ESP_20.ESP_Stoppverbot_Anz_01 = SigVal;
                    break;
                case 9:
                    MsgObj_ESP_20.ESP_Stoppverbot_Anz_02 = SigVal;
                    break;
                case 10:
                    MsgObj_ESP_20.ESP_Stoppverbot_Anz_03 = SigVal;
                    break;
                case 11:
                    MsgObj_ESP_20.ESP_Stoppverbot_Anz_04 = SigVal;
                    break;
                case 12:
                    MsgObj_ESP_20.ESP_Stoppverbot_Anz_05 = SigVal;
                    break;
                case 13:
                    MsgObj_ESP_20.ESP_Stoppverbot_Anz_06 = SigVal;
                    break;
                case 14:
                    MsgObj_ESP_20.ESP_Stoppverbot_Anz_07 = SigVal;
                    break;
                case 15:
                    MsgObj_ESP_20.ESP_Stoppverbot_Anz_Std = SigVal;
                    break;
                case 16:
                    MsgObj_ESP_20.ESP_Wiederstart_Anz_01 = SigVal;
                    break;
                case 17:
                    MsgObj_ESP_20.ESP_Wiederstart_Anz_02 = SigVal;
                    break;
                case 18:
                    MsgObj_ESP_20.ESP_Wiederstart_Anz_03 = SigVal;
                    break;
                case 19:
                    MsgObj_ESP_20.ESP_Wiederstart_Anz_Std = SigVal;
                    break;
                case 20:
                    MsgObj_ESP_20.ESP_Zaehnezahl = SigVal;
                    break;
            }
        }
        break;
        case FRM_HANDLE_ESP_21:
        {
            switch (SigIdx)
            {
                case 0:
                    MsgObj_ESP_21.ABS_Bremsung = SigVal;
                    break;
                case 1:
                    MsgObj_ESP_21.ASR_Anf = SigVal;
                    break;
                case 2:
                    MsgObj_ESP_21.ASR_Schalteingriff = SigVal;
                    break;
                case 3:
                    MsgObj_ESP_21.ASR_Tastung_passiv = SigVal;
                    break;
                case 4:
                    MsgObj_ESP_21.BR_Eingriffsmoment = SigVal;
                    break;
                case 5:
                    MsgObj_ESP_21.EBV_Eingriff = SigVal;
                    break;
                case 6:
                    MsgObj_ESP_21.EDS_Eingriff = SigVal;
                    break;
                case 7:
                    MsgObj_ESP_21.ESP_21_BZ = SigVal;
                    break;
                case 8:
                    MsgObj_ESP_21.ESP_21_CRC = SigVal;
                    break;
                case 9:
                    MsgObj_ESP_21.ESP_ASP = SigVal;
                    break;
                case 10:
                    MsgObj_ESP_21.ESP_AWV3_Brems_aktiv = SigVal;
                    break;
                case 11:
                    MsgObj_ESP_21.ESP_Anhaltevorgang_ACC_aktiv = SigVal;
                    break;
                case 12:
                    MsgObj_ESP_21.ESP_Diagnose = SigVal;
                    break;
                case 13:
                    MsgObj_ESP_21.ESP_Eingriff = SigVal;
                    break;
                case 14:
                    MsgObj_ESP_21.ESP_Haltebestaetigung = SigVal;
                    break;
                case 15:
                    MsgObj_ESP_21.ESP_MKB_Abbruch_Geschw = SigVal;
                    break;
                case 16:
                    MsgObj_ESP_21.ESP_PLA_Bremseingriff = SigVal;
                    break;
                case 17:
                    MsgObj_ESP_21.ESP_QBit_v_Signal = SigVal;
                    break;
                case 18:
                    MsgObj_ESP_21.ESP_Systemstatus = SigVal;
                    break;
                case 19:
                    MsgObj_ESP_21.ESP_Tastung_passiv = SigVal;
                    break;
                case 20:
                    MsgObj_ESP_21.ESP_v_Signal = SigVal;
                    break;
                case 21:
                    MsgObj_ESP_21.MSR_Anf = SigVal;
                    break;
                case 22:
                    MsgObj_ESP_21.OBD_QBit_Schlechtweg = SigVal;
                    break;
                case 23:
                    MsgObj_ESP_21.OBD_Schlechtweg = SigVal;
                    break;
            }
        }
        break;
        case FRM_HANDLE_Einheiten_01:
        {
            switch (SigIdx)
            {
                case 0:
                    MsgObj_Einheiten_01.KBI_Einheit_Datum = SigVal;
                    break;
                case 1:
                    MsgObj_Einheiten_01.KBI_Einheit_Druck = SigVal;
                    break;
                case 2:
                    MsgObj_Einheiten_01.KBI_Einheit_Sprache = SigVal;
                    break;
                case 3:
                    MsgObj_Einheiten_01.KBI_Einheit_Streckenanz = SigVal;
                    break;
                case 4:
                    MsgObj_Einheiten_01.KBI_Einheit_Temp = SigVal;
                    break;
                case 5:
                    MsgObj_Einheiten_01.KBI_Einheit_Uhrzeit = SigVal;
                    break;
                case 6:
                    MsgObj_Einheiten_01.KBI_Einheit_Verbrauch = SigVal;
                    break;
                case 7:
                    MsgObj_Einheiten_01.KBI_Einheit_Volumen = SigVal;
                    break;
                case 8:
                    MsgObj_Einheiten_01.KBI_MFA_v_Einheit_02 = SigVal;
                    break;
            }
        }
        break;
        case FRM_HANDLE_GRA_ACC_01:
        {
            switch (SigIdx)
            {
                case 0:
                    MsgObj_GRA_ACC_01.GRA_ACC_01_BZ = SigVal;
                    break;
                case 1:
                    MsgObj_GRA_ACC_01.GRA_ACC_01_CRC = SigVal;
                    break;
                case 2:
                    MsgObj_GRA_ACC_01.GRA_Abbrechen = SigVal;
                    break;
                case 3:
                    MsgObj_GRA_ACC_01.GRA_Codierung = SigVal;
                    break;
                case 4:
                    MsgObj_GRA_ACC_01.GRA_Fehler = SigVal;
                    break;
                case 5:
                    MsgObj_GRA_ACC_01.GRA_Hauptschalter = SigVal;
                    break;
                case 6:
                    MsgObj_GRA_ACC_01.GRA_LIM_Taste_verfuegbar = SigVal;
                    break;
                case 7:
                    MsgObj_GRA_ACC_01.GRA_Limiter = SigVal;
                    break;
                case 8:
                    MsgObj_GRA_ACC_01.GRA_Tip_Hoch = SigVal;
                    break;
                case 9:
                    MsgObj_GRA_ACC_01.GRA_Tip_Runter = SigVal;
                    break;
                case 10:
                    MsgObj_GRA_ACC_01.GRA_Tip_Setzen = SigVal;
                    break;
                case 11:
                    MsgObj_GRA_ACC_01.GRA_Tip_Stufe_2 = SigVal;
                    break;
                case 12:
                    MsgObj_GRA_ACC_01.GRA_Tip_Wiederaufnahme = SigVal;
                    break;
                case 13:
                    MsgObj_GRA_ACC_01.GRA_Typ_Bedienteil = SigVal;
                    break;
                case 14:
                    MsgObj_GRA_ACC_01.GRA_Typ_Hauptschalter = SigVal;
                    break;
                case 15:
                    MsgObj_GRA_ACC_01.GRA_Verstellung_Zeitluecke = SigVal;
                    break;
                case 16:
                    MsgObj_GRA_ACC_01.GRA_reserveByte4 = SigVal;
                    break;
                case 17:
                    MsgObj_GRA_ACC_01.GRA_reserveByte5 = SigVal;
                    break;
                case 18:
                    MsgObj_GRA_ACC_01.GRA_reserveByte6 = SigVal;
                    break;
                case 19:
                    MsgObj_GRA_ACC_01.GRA_reserveByte7 = SigVal;
                    break;
                case 20:
                    MsgObj_GRA_ACC_01.GRA_reserveByte8 = SigVal;
                    break;
            }
        }
        break;
        case FRM_HANDLE_Gateway_72:
        {
            switch (SigIdx)
            {
                case 0:
                    MsgObj_Gateway_72.AAG_Anhaenger_erkannt = SigVal;
                    break;
                case 1:
                    MsgObj_Gateway_72.Anhaenger_01_alt = SigVal;
                    break;
                case 2:
                    MsgObj_Gateway_72.BCM1_Aussen_Temp_ungef = SigVal;
                    break;
                case 3:
                    MsgObj_Gateway_72.BCM1_MH_Schalter = SigVal;
                    break;
                case 4:
                    MsgObj_Gateway_72.BCM1_OBD_FStatus_ATemp = SigVal;
                    break;
                case 5:
                    MsgObj_Gateway_72.BCM1_Rueckfahrlicht_Schalter = SigVal;
                    break;
                case 6:
                    MsgObj_Gateway_72.BCM_01_alt = SigVal;
                    break;
                case 7:
                    MsgObj_Gateway_72.BCM_Rueckfahrlicht_Anf = SigVal;
                    break;
                case 8:
                    MsgObj_Gateway_72.BH_Blinker_li = SigVal;
                    break;
                case 9:
                    MsgObj_Gateway_72.BH_Blinker_re = SigVal;
                    break;
                case 10:
                    MsgObj_Gateway_72.BH_Fernlicht = SigVal;
                    break;
                case 11:
                    MsgObj_Gateway_72.KL_Thermomanagement = SigVal;
                    break;
                case 12:
                    MsgObj_Gateway_72.Klima_11_alt = SigVal;
                    break;
                case 13:
                    MsgObj_Gateway_72.Klima_Sensor_02_alt = SigVal;
                    break;
                case 14:
                    MsgObj_Gateway_72.Licht_Anf_01_alt = SigVal;
                    break;
                case 15:
                    MsgObj_Gateway_72.SMLS_01_alt = SigVal;
                    break;
                case 16:
                    MsgObj_Gateway_72.VS_VD_entriegelt = SigVal;
                    break;
                case 17:
                    MsgObj_Gateway_72.VS_VD_offen_ver = SigVal;
                    break;
                case 18:
                    MsgObj_Gateway_72.VS_VD_zu_ver = SigVal;
                    break;
                case 19:
                    MsgObj_Gateway_72.VS_Verdeck_Anf = SigVal;
                    break;
                case 20:
                    MsgObj_Gateway_72.Verdeck_01_alt = SigVal;
                    break;
                case 21:
                    MsgObj_Gateway_72.WFS_01_alt = SigVal;
                    break;
                case 22:
                    MsgObj_Gateway_72.WFS_ID_Geb_autorisiert_in_Kl15 = SigVal;
                    break;
                case 23:
                    MsgObj_Gateway_72.WFS_Schluessel_Fahrberecht = SigVal;
                    break;
                case 24:
                    MsgObj_Gateway_72.WWSs_01_alt = SigVal;
                    break;
                case 25:
                    MsgObj_Gateway_72.Waschen_vorne_aktiv = SigVal;
                    break;
                case 26:
                    MsgObj_Gateway_72.Wischer_01_alt = SigVal;
                    break;
                case 27:
                    MsgObj_Gateway_72.Wischer_vorne_aktiv = SigVal;
                    break;
                case 28:
                    MsgObj_Gateway_72.ZV_02_alt = SigVal;
                    break;
                case 29:
                    MsgObj_Gateway_72.ZV_BT_offen = SigVal;
                    break;
                case 30:
                    MsgObj_Gateway_72.ZV_FT_offen = SigVal;
                    break;
                case 31:
                    MsgObj_Gateway_72.ZV_HBFS_offen = SigVal;
                    break;
                case 32:
                    MsgObj_Gateway_72.ZV_HD_offen = SigVal;
                    break;
                case 33:
                    MsgObj_Gateway_72.ZV_HFS_offen = SigVal;
                    break;
            }
        }
        break;
        case FRM_HANDLE_Gateway_74:
        {
            switch (SigIdx)
            {
                case 0:
                    MsgObj_Gateway_74.ELV_01_alt = SigVal;
                    break;
                case 1:
                    MsgObj_Gateway_74.ELV_Anf_Klemme_50 = SigVal;
                    break;
                case 2:
                    MsgObj_Gateway_74.EPS_Lenkerposition = SigVal;
                    break;
                case 3:
                    MsgObj_Gateway_74.GW_Status_GRA = SigVal;
                    break;
                case 4:
                    MsgObj_Gateway_74.HLR_01_alt = SigVal;
                    break;
                case 5:
                    MsgObj_Gateway_74.KL_Geblspng_Soll = SigVal;
                    break;
                case 6:
                    MsgObj_Gateway_74.KL_PTC_Verbauinfo = SigVal;
                    break;
                case 7:
                    MsgObj_Gateway_74.KL_Umluftklappe_Status = SigVal;
                    break;
                case 8:
                    MsgObj_Gateway_74.KY_StartStopp_Info = SigVal;
                    break;
                case 9:
                    MsgObj_Gateway_74.Kessy_04_alt = SigVal;
                    break;
                case 10:
                    MsgObj_Gateway_74.Klima_12_alt = SigVal;
                    break;
                case 11:
                    MsgObj_Gateway_74.LH_EPS_01_alt = SigVal;
                    break;
                case 12:
                    MsgObj_Gateway_74.LIN_2_alt = SigVal;
                    break;
                case 13:
                    MsgObj_Gateway_74.LS_Tiptronic_Fehler = SigVal;
                    break;
                case 14:
                    MsgObj_Gateway_74.MFG_01_alt = SigVal;
                    break;
                case 15:
                    MsgObj_Gateway_74.MFL_Tip_Down = SigVal;
                    break;
                case 16:
                    MsgObj_Gateway_74.MFL_Tip_Up = SigVal;
                    break;
                case 17:
                    MsgObj_Gateway_74.MF_Anlassersperre = SigVal;
                    break;
                case 18:
                    MsgObj_Gateway_74.MF_StartStopp_Info = SigVal;
                    break;
                case 19:
                    MsgObj_Gateway_74.PH_StartStopp_Info = SigVal;
                    break;
                case 20:
                    MsgObj_Gateway_74.PH_nachtr_Stopp_Anf = SigVal;
                    break;
                case 21:
                    MsgObj_Gateway_74.PTC_Freigabe = SigVal;
                    break;
                case 22:
                    MsgObj_Gateway_74.Parkhilfe_01_alt = SigVal;
                    break;
            }
        }
        break;
        case FRM_HANDLE_Getriebe_11:
        {
            switch (SigIdx)
            {
                case 0:
                    MsgObj_Getriebe_11.GE_Fahrstufe = SigVal;
                    break;
                case 1:
                    MsgObj_Getriebe_11.GE_Freig_MMom_Vorhalt = SigVal;
                    break;
                case 2:
                    MsgObj_Getriebe_11.GE_MMom_Soll_02 = SigVal;
                    break;
                case 3:
                    MsgObj_Getriebe_11.GE_MMom_Status = SigVal;
                    break;
                case 4:
                    MsgObj_Getriebe_11.GE_MMom_Status_02 = SigVal;
                    break;
                case 5:
                    MsgObj_Getriebe_11.GE_MMom_Vorhalt_02 = SigVal;
                    break;
                case 6:
                    MsgObj_Getriebe_11.GE_Schaltablauf = SigVal;
                    break;
                case 7:
                    MsgObj_Getriebe_11.GE_Status_Kraftschluss = SigVal;
                    break;
                case 8:
                    MsgObj_Getriebe_11.GE_Uefkt = SigVal;
                    break;
                case 9:
                    MsgObj_Getriebe_11.GE_Verbot_Ausblendung = SigVal;
                    break;
                case 10:
                    MsgObj_Getriebe_11.GE_Zielgang = SigVal;
                    break;
                case 11:
                    MsgObj_Getriebe_11.GE_reserv_Fahrstufe = SigVal;
                    break;
                case 12:
                    MsgObj_Getriebe_11.Getriebe_11_BZ = SigVal;
                    break;
                case 13:
                    MsgObj_Getriebe_11.Getriebe_11_CRC = SigVal;
                    break;
            }
        }
        break;
        case FRM_HANDLE_Getriebe_12:
        {
            switch (SigIdx)
            {
                case 0:
                    MsgObj_Getriebe_12.GE_Anheb_Solldrehz_Leerlauf = SigVal;
                    break;
                case 1:
                    MsgObj_Getriebe_12.GE_Aufnahmemoment = SigVal;
                    break;
                case 2:
                    MsgObj_Getriebe_12.GE_Drehzahlmesser_Daempfung = SigVal;
                    break;
                case 3:
                    MsgObj_Getriebe_12.GE_Freigabe_Synchro = SigVal;
                    break;
                case 4:
                    MsgObj_Getriebe_12.GE_HYB_DZ_Eingriff = SigVal;
                    break;
                case 5:
                    MsgObj_Getriebe_12.GE_Mom_Begr_Gradient = SigVal;
                    break;
                case 6:
                    MsgObj_Getriebe_12.GE_Schubabschalt_Unt = SigVal;
                    break;
                case 7:
                    MsgObj_Getriebe_12.GE_Synchro_Status = SigVal;
                    break;
                case 8:
                    MsgObj_Getriebe_12.GE_Synchro_Wunschdrehz = SigVal;
                    break;
                case 9:
                    MsgObj_Getriebe_12.GE_Synchro_Zeit = SigVal;
                    break;
                case 10:
                    MsgObj_Getriebe_12.Getriebe_12_BZ = SigVal;
                    break;
                case 11:
                    MsgObj_Getriebe_12.Getriebe_12_CRC = SigVal;
                    break;
            }
        }
        break;
        case FRM_HANDLE_Getriebe_13:
        {
            switch (SigIdx)
            {
                case 0:
                    MsgObj_Getriebe_13.GE_Anf_Zylabsch = SigVal;
                    break;
                case 1:
                    MsgObj_Getriebe_13.GE_Eingangsdrehz = SigVal;
                    break;
                case 2:
                    MsgObj_Getriebe_13.GE_Entkopplung_Status = SigVal;
                    break;
                case 3:
                    MsgObj_Getriebe_13.GE_Freig_Langfr_Schutzmom = SigVal;
                    break;
                case 4:
                    MsgObj_Getriebe_13.GE_Grenzkriechmoment = SigVal;
                    break;
                case 5:
                    MsgObj_Getriebe_13.GE_Langfr_Schutzmom_02 = SigVal;
                    break;
                case 6:
                    MsgObj_Getriebe_13.GE_Notlauf = SigVal;
                    break;
                case 7:
                    MsgObj_Getriebe_13.GE_StartStopp_Info = SigVal;
                    break;
                case 8:
                    MsgObj_Getriebe_13.GE_Verlustmoment_02 = SigVal;
                    break;
                case 9:
                    MsgObj_Getriebe_13.Getriebe_13_BZ = SigVal;
                    break;
                case 10:
                    MsgObj_Getriebe_13.Getriebe_13_CRC = SigVal;
                    break;
            }
        }
        break;
        case FRM_HANDLE_Getriebe_14:
        {
            switch (SigIdx)
            {
                case 0:
                    MsgObj_Getriebe_14.Freilauf_Charisma_FahrPr = SigVal;
                    break;
                case 1:
                    MsgObj_Getriebe_14.Freilauf_Charisma_Status = SigVal;
                    break;
                case 2:
                    MsgObj_Getriebe_14.GE_Charisma_FahrPr = SigVal;
                    break;
                case 3:
                    MsgObj_Getriebe_14.GE_Charisma_Status = SigVal;
                    break;
                case 4:
                    MsgObj_Getriebe_14.GE_Codierung_MSG = SigVal;
                    break;
                case 5:
                    MsgObj_Getriebe_14.GE_Freigabe_Verfallsinfo_WFS = SigVal;
                    break;
                case 6:
                    MsgObj_Getriebe_14.GE_Heizwunsch = SigVal;
                    break;
                case 7:
                    MsgObj_Getriebe_14.GE_LFR_Adaption = SigVal;
                    break;
                case 8:
                    MsgObj_Getriebe_14.GE_LaunchControl = SigVal;
                    break;
                case 9:
                    MsgObj_Getriebe_14.GE_OBD_AbsperrVent = SigVal;
                    break;
                case 10:
                    MsgObj_Getriebe_14.GE_OBD_Status = SigVal;
                    break;
                case 11:
                    MsgObj_Getriebe_14.GE_Sumpftemperatur = SigVal;
                    break;
                case 12:
                    MsgObj_Getriebe_14.GE_Verlustmoment_02 = SigVal;
                    break;
                case 13:
                    MsgObj_Getriebe_14.GE_Zustand_Kuppltemp = SigVal;
                    break;
                case 14:
                    MsgObj_Getriebe_14.GE_amax_moeglich = SigVal;
                    break;
            }
        }
        break;
        case FRM_HANDLE_Getriebe_Hybrid_01:
        {
            switch (SigIdx)
            {
                case 0:
                    MsgObj_Getriebe_Hybrid_01.GE_HYB_Fehlerstatus = SigVal;
                    break;
                case 1:
                    MsgObj_Getriebe_Hybrid_01.GE_HYB_Filt_MomAufbau = SigVal;
                    break;
                case 2:
                    MsgObj_Getriebe_Hybrid_01.GE_HYB_Freig_VM_EM_Stop = SigVal;
                    break;
                case 3:
                    MsgObj_Getriebe_Hybrid_01.GE_HYB_Freig_sSchl_K0 = SigVal;
                    break;
                case 4:
                    MsgObj_Getriebe_Hybrid_01.GE_HYB_Freigabe_K0 = SigVal;
                    break;
                case 5:
                    MsgObj_Getriebe_Hybrid_01.GE_HYB_Freigabe_LL_Reg = SigVal;
                    break;
                case 6:
                    MsgObj_Getriebe_Hybrid_01.GE_HYB_MomEingriff_EM = SigVal;
                    break;
                case 7:
                    MsgObj_Getriebe_Hybrid_01.GE_HYB_Sportfaktor = SigVal;
                    break;
                case 8:
                    MsgObj_Getriebe_Hybrid_01.GE_HYB_StartAnf = SigVal;
                    break;
                case 9:
                    MsgObj_Getriebe_Hybrid_01.GE_HYB_VM_Startkontr = SigVal;
                    break;
                case 10:
                    MsgObj_Getriebe_Hybrid_01.GE_HYB_VM_akt_halten = SigVal;
                    break;
                case 11:
                    MsgObj_Getriebe_Hybrid_01.GE_HYB_VZ_MomEingriff_EM = SigVal;
                    break;
                case 12:
                    MsgObj_Getriebe_Hybrid_01.GE_HYB_Wiederstart = SigVal;
                    break;
                case 13:
                    MsgObj_Getriebe_Hybrid_01.GE_HYB_nK0 = SigVal;
                    break;
                case 14:
                    MsgObj_Getriebe_Hybrid_01.Getriebe_Hybrid_01_BZ = SigVal;
                    break;
                case 15:
                    MsgObj_Getriebe_Hybrid_01.Getriebe_Hybrid_01_CRC = SigVal;
                    break;
            }
        }
        break;
        case FRM_HANDLE_HVEM_02:
        {
            switch (SigIdx)
            {
                case 0:
                    MsgObj_HVEM_02.HVEM_DauerRed = SigVal;
                    break;
                case 1:
                    MsgObj_HVEM_02.HVEM_FreigabeKlimatisierung = SigVal;
                    break;
                case 2:
                    MsgObj_HVEM_02.HVEM_IstLeistungNA = SigVal;
                    break;
                case 3:
                    MsgObj_HVEM_02.HVEM_IstStrom_HVVerbraucher = SigVal;
                    break;
                case 4:
                    MsgObj_HVEM_02.HVEM_LeistungTMEVorgabe = SigVal;
                    break;
                case 5:
                    MsgObj_HVEM_02.HVEM_MinLeistungNA = SigVal;
                    break;
                case 6:
                    MsgObj_HVEM_02.HVEM_Temp_Vorkond_Innen = SigVal;
                    break;
            }
        }
        break;
        case FRM_HANDLE_HVEM_04:
        {
            switch (SigIdx)
            {
                case 0:
                    MsgObj_HVEM_04.HVEM_Anf_ReichweiteNV = SigVal;
                    break;
                case 1:
                    MsgObj_HVEM_04.HVEM_HV_Anf = SigVal;
                    break;
                case 2:
                    MsgObj_HVEM_04.HVEM_KlimaMaxHVStrom = SigVal;
                    break;
                case 3:
                    MsgObj_HVEM_04.HVEM_LeistungsAnf = SigVal;
                    break;
                case 4:
                    MsgObj_HVEM_04.HVEM_NVLeistungEmpf = SigVal;
                    break;
                case 5:
                    MsgObj_HVEM_04.HVEM_Nachlad_Status = SigVal;
                    break;
                case 6:
                    MsgObj_HVEM_04.HVEM_Nachladen_Anf = SigVal;
                    break;
                case 7:
                    MsgObj_HVEM_04.HVEM_Text_1 = SigVal;
                    break;
            }
        }
        break;
        case FRM_HANDLE_Klemmen_Status_01:
        {
            switch (SigIdx)
            {
                case 0:
                    MsgObj_Klemmen_Status_01.BCM_Remotestart_Betrieb = SigVal;
                    break;
                case 1:
                    MsgObj_Klemmen_Status_01.KST_Fahrerhinweis_1 = SigVal;
                    break;
                case 2:
                    MsgObj_Klemmen_Status_01.KST_Fahrerhinweis_2 = SigVal;
                    break;
                case 3:
                    MsgObj_Klemmen_Status_01.KST_Fahrerhinweis_3 = SigVal;
                    break;
                case 4:
                    MsgObj_Klemmen_Status_01.KST_Fahrerhinweis_4 = SigVal;
                    break;
                case 5:
                    MsgObj_Klemmen_Status_01.KST_Fahrerhinweis_5 = SigVal;
                    break;
                case 6:
                    MsgObj_Klemmen_Status_01.KST_Fahrerhinweis_6 = SigVal;
                    break;
                case 7:
                    MsgObj_Klemmen_Status_01.KST_Warn_P1_ZST_def = SigVal;
                    break;
                case 8:
                    MsgObj_Klemmen_Status_01.KST_Warn_P2_ZST_def = SigVal;
                    break;
                case 9:
                    MsgObj_Klemmen_Status_01.Klemmen_Status_01_BZ = SigVal;
                    break;
                case 10:
                    MsgObj_Klemmen_Status_01.Klemmen_Status_01_CRC = SigVal;
                    break;
                case 11:
                    MsgObj_Klemmen_Status_01.ZAS_Kl_15 = SigVal;
                    break;
                case 12:
                    MsgObj_Klemmen_Status_01.ZAS_Kl_50_Startanforderung = SigVal;
                    break;
                case 13:
                    MsgObj_Klemmen_Status_01.ZAS_Kl_S = SigVal;
                    break;
                case 14:
                    MsgObj_Klemmen_Status_01.ZAS_Kl_X = SigVal;
                    break;
            }
        }
        break;
        case FRM_HANDLE_Klima_11:
        {
            switch (SigIdx)
            {
                case 0:
                    MsgObj_Klima_11.KL_AC_Schalter = SigVal;
                    break;
                case 1:
                    MsgObj_Klima_11.KL_Anf_KL = SigVal;
                    break;
                case 2:
                    MsgObj_Klima_11.KL_Ausstattung_Klima = SigVal;
                    break;
                case 3:
                    MsgObj_Klima_11.KL_Charisma_FahrPr = SigVal;
                    break;
                case 4:
                    MsgObj_Klima_11.KL_Charisma_Status = SigVal;
                    break;
                case 5:
                    MsgObj_Klima_11.KL_Comp_enable = SigVal;
                    break;
                case 6:
                    MsgObj_Klima_11.KL_Comp_rev_rq = SigVal;
                    break;
                case 7:
                    MsgObj_Klima_11.KL_Drehz_Anh = SigVal;
                    break;
                case 8:
                    MsgObj_Klima_11.KL_Komp_Moment_alt = SigVal;
                    break;
                case 9:
                    MsgObj_Klima_11.KL_Last_Kompr = SigVal;
                    break;
                case 10:
                    MsgObj_Klima_11.KL_Spannungs_Anf = SigVal;
                    break;
                case 11:
                    MsgObj_Klima_11.KL_StartStopp_Info = SigVal;
                    break;
                case 12:
                    MsgObj_Klima_11.KL_Thermomanagement = SigVal;
                    break;
                case 13:
                    MsgObj_Klima_11.KL_Vorwarn_Komp_ein = SigVal;
                    break;
                case 14:
                    MsgObj_Klima_11.KL_Vorwarn_Zuheizer_ein = SigVal;
                    break;
                case 15:
                    MsgObj_Klima_11.KL_Zustand = SigVal;
                    break;
                case 16:
                    MsgObj_Klima_11.KL_el_Zuheizer_Stufe = SigVal;
                    break;
                case 17:
                    MsgObj_Klima_11.KL_nachtr_Stopp_Anf = SigVal;
                    break;
            }
        }
        break;
        case FRM_HANDLE_Kombi_01:
        {
            switch (SigIdx)
            {
                case 0:
                    MsgObj_Kombi_01.KBI_ABS_Lampe = SigVal;
                    break;
                case 1:
                    MsgObj_Kombi_01.KBI_Airbag_Lampe = SigVal;
                    break;
                case 2:
                    MsgObj_Kombi_01.KBI_Anzeigefehler_LDW = SigVal;
                    break;
                case 3:
                    MsgObj_Kombi_01.KBI_Anzeigefehler_NV = SigVal;
                    break;
                case 4:
                    MsgObj_Kombi_01.KBI_Anzeigefehler_SWA = SigVal;
                    break;
                case 5:
                    MsgObj_Kombi_01.KBI_Anzeigestatus_ACC = SigVal;
                    break;
                case 6:
                    MsgObj_Kombi_01.KBI_Anzeigestatus_GRA = SigVal;
                    break;
                case 7:
                    MsgObj_Kombi_01.KBI_Anzeigestatus_LIM = SigVal;
                    break;
                case 8:
                    MsgObj_Kombi_01.KBI_BKL_Lampe = SigVal;
                    break;
                case 9:
                    MsgObj_Kombi_01.KBI_ESP_Lampe = SigVal;
                    break;
                case 10:
                    MsgObj_Kombi_01.KBI_Einheit_Tacho = SigVal;
                    break;
                case 11:
                    MsgObj_Kombi_01.KBI_Fehler_Anzeige_ACC = SigVal;
                    break;
                case 12:
                    MsgObj_Kombi_01.KBI_Handbremse = SigVal;
                    break;
                case 13:
                    MsgObj_Kombi_01.KBI_Konsistenz_ACC = SigVal;
                    break;
                case 14:
                    MsgObj_Kombi_01.KBI_Lenkung_Lampe = SigVal;
                    break;
                case 15:
                    MsgObj_Kombi_01.KBI_MFA_v_Einheit_01 = SigVal;
                    break;
                case 16:
                    MsgObj_Kombi_01.KBI_NV_in_Anzeige = SigVal;
                    break;
                case 17:
                    MsgObj_Kombi_01.KBI_Oeldruck_Schalter = SigVal;
                    break;
                case 18:
                    MsgObj_Kombi_01.KBI_Oeldruckwarnung = SigVal;
                    break;
                case 19:
                    MsgObj_Kombi_01.KBI_PLA_in_Anzeige = SigVal;
                    break;
                case 20:
                    MsgObj_Kombi_01.KBI_SILA_gueltig = SigVal;
                    break;
                case 21:
                    MsgObj_Kombi_01.KBI_Tankwarnung = SigVal;
                    break;
                case 22:
                    MsgObj_Kombi_01.KBI_V_Digital = SigVal;
                    break;
                case 23:
                    MsgObj_Kombi_01.KBI_Vorglueh_System_Lampe = SigVal;
                    break;
                case 24:
                    MsgObj_Kombi_01.KBI_angez_Geschw = SigVal;
                    break;
                case 25:
                    MsgObj_Kombi_01.KBI_im_Stellgliedtest = SigVal;
                    break;
                case 26:
                    MsgObj_Kombi_01.Kombi_01_BZ = SigVal;
                    break;
            }
        }
        break;
        case FRM_HANDLE_Kombi_02:
        {
            switch (SigIdx)
            {
                case 0:
                    MsgObj_Kombi_02.KBI_Aussen_Temp_gef = SigVal;
                    break;
                case 1:
                    MsgObj_Kombi_02.KBI_FStatus_Tank = SigVal;
                    break;
                case 2:
                    MsgObj_Kombi_02.KBI_Inhalt_Tank = SigVal;
                    break;
                case 3:
                    MsgObj_Kombi_02.KBI_Kilometerstand = SigVal;
                    break;
                case 4:
                    MsgObj_Kombi_02.KBI_Oelwechsel_durchgefuehrt = SigVal;
                    break;
                case 5:
                    MsgObj_Kombi_02.KBI_QBit_Aussen_Temp_gef = SigVal;
                    break;
                case 6:
                    MsgObj_Kombi_02.KBI_RDK_Kalibrier_Anf = SigVal;
                    break;
                case 7:
                    MsgObj_Kombi_02.KBI_Standzeit_02 = SigVal;
                    break;
            }
        }
        break;
        case FRM_HANDLE_LWI_01:
        {
            switch (SigIdx)
            {
                case 0:
                    MsgObj_LWI_01.LWI_01_BZ = SigVal;
                    break;
                case 1:
                    MsgObj_LWI_01.LWI_01_CRC = SigVal;
                    break;
                case 2:
                    MsgObj_LWI_01.LWI_Lenkradw_Geschw = SigVal;
                    break;
                case 3:
                    MsgObj_LWI_01.LWI_Lenkradwinkel = SigVal;
                    break;
                case 4:
                    MsgObj_LWI_01.LWI_QBit_Lenkradwinkel = SigVal;
                    break;
                case 5:
                    MsgObj_LWI_01.LWI_QBit_Sub_Daten = SigVal;
                    break;
                case 6:
                    MsgObj_LWI_01.LWI_Sensorstatus = SigVal;
                    break;
                case 7:
                    MsgObj_LWI_01.LWI_Sub_Daten = SigVal;
                    break;
                case 8:
                    MsgObj_LWI_01.LWI_VZ_Lenkradw_Geschw = SigVal;
                    break;
                case 9:
                    MsgObj_LWI_01.LWI_VZ_Lenkradwinkel = SigVal;
                    break;
            }
        }
        break;
        case FRM_HANDLE_Licht_hinten_01:
        {
            switch (SigIdx)
            {
                case 0:
                    MsgObj_Licht_hinten_01.BCM2_Bremsl_durch_ECD = SigVal;
                    break;
                case 1:
                    MsgObj_Licht_hinten_01.LH_3_Bremsl_def = SigVal;
                    break;
                case 2:
                    MsgObj_Licht_hinten_01.LH_Aussenlicht_def = SigVal;
                    break;
                case 3:
                    MsgObj_Licht_hinten_01.LH_Blinker_HL_akt = SigVal;
                    break;
                case 4:
                    MsgObj_Licht_hinten_01.LH_Blinker_HR_akt = SigVal;
                    break;
                case 5:
                    MsgObj_Licht_hinten_01.LH_Blinker_li_def = SigVal;
                    break;
                case 6:
                    MsgObj_Licht_hinten_01.LH_Blinker_re_def = SigVal;
                    break;
                case 7:
                    MsgObj_Licht_hinten_01.LH_Brems_Blk_li_def = SigVal;
                    break;
                case 8:
                    MsgObj_Licht_hinten_01.LH_Brems_Blk_re_def = SigVal;
                    break;
                case 9:
                    MsgObj_Licht_hinten_01.LH_Bremsl_li_def = SigVal;
                    break;
                case 10:
                    MsgObj_Licht_hinten_01.LH_Bremsl_li_ges_def = SigVal;
                    break;
                case 11:
                    MsgObj_Licht_hinten_01.LH_Bremsl_re_def = SigVal;
                    break;
                case 12:
                    MsgObj_Licht_hinten_01.LH_Bremsl_re_ges_def = SigVal;
                    break;
                case 13:
                    MsgObj_Licht_hinten_01.LH_Bremslicht_H_aktiv = SigVal;
                    break;
                case 14:
                    MsgObj_Licht_hinten_01.LH_Kennzl_def = SigVal;
                    break;
                case 15:
                    MsgObj_Licht_hinten_01.LH_Nebel_li_def = SigVal;
                    break;
                case 16:
                    MsgObj_Licht_hinten_01.LH_Nebel_mi_def = SigVal;
                    break;
                case 17:
                    MsgObj_Licht_hinten_01.LH_Nebel_re_def = SigVal;
                    break;
                case 18:
                    MsgObj_Licht_hinten_01.LH_Nebelschluss_aktiv = SigVal;
                    break;
                case 19:
                    MsgObj_Licht_hinten_01.LH_Parklicht_HL_aktiv = SigVal;
                    break;
                case 20:
                    MsgObj_Licht_hinten_01.LH_Parklicht_HR_aktiv = SigVal;
                    break;
                case 21:
                    MsgObj_Licht_hinten_01.LH_Rueckf_li_def = SigVal;
                    break;
                case 22:
                    MsgObj_Licht_hinten_01.LH_Rueckf_mi_def = SigVal;
                    break;
                case 23:
                    MsgObj_Licht_hinten_01.LH_Rueckf_re_def = SigVal;
                    break;
                case 24:
                    MsgObj_Licht_hinten_01.LH_Rueckfahrlicht_aktiv = SigVal;
                    break;
                case 25:
                    MsgObj_Licht_hinten_01.LH_SL_BRL_BLK_li_def = SigVal;
                    break;
                case 26:
                    MsgObj_Licht_hinten_01.LH_SL_BRL_BLK_re_def = SigVal;
                    break;
                case 27:
                    MsgObj_Licht_hinten_01.LH_Schluss_Brems_Nebel_li_def = SigVal;
                    break;
                case 28:
                    MsgObj_Licht_hinten_01.LH_Schluss_Brems_Nebel_re_def = SigVal;
                    break;
                case 29:
                    MsgObj_Licht_hinten_01.LH_Schluss_Brems_li_def = SigVal;
                    break;
                case 30:
                    MsgObj_Licht_hinten_01.LH_Schluss_Brems_re_def = SigVal;
                    break;
                case 31:
                    MsgObj_Licht_hinten_01.LH_Schluss_Nebel_li_def = SigVal;
                    break;
                case 32:
                    MsgObj_Licht_hinten_01.LH_Schluss_Nebel_re_def = SigVal;
                    break;
                case 33:
                    MsgObj_Licht_hinten_01.LH_Schlusslicht_li_def = SigVal;
                    break;
                case 34:
                    MsgObj_Licht_hinten_01.LH_Schlusslicht_re_def = SigVal;
                    break;
                case 35:
                    MsgObj_Licht_hinten_01.LH_Standlicht_H_aktiv = SigVal;
                    break;
                case 36:
                    MsgObj_Licht_hinten_01.Licht_hinten_01_BZ = SigVal;
                    break;
            }
        }
        break;
        case FRM_HANDLE_NMH_Gateway:
        {
            switch (SigIdx)
            {
                case 0:
                    MsgObj_NMH_Gateway.NM_Gateway_ACAN_Aktivitaet = SigVal;
                    break;
                case 1:
                    MsgObj_NMH_Gateway.NM_Gateway_Bedien_LIN_Aktivitaet = SigVal;
                    break;
                case 2:
                    MsgObj_NMH_Gateway.NM_Gateway_Car_Wakeup = SigVal;
                    break;
                case 3:
                    MsgObj_NMH_Gateway.NM_Gateway_DiagCAN_Aktivitaet = SigVal;
                    break;
                case 4:
                    MsgObj_NMH_Gateway.NM_Gateway_ECAN_Aktivitaet = SigVal;
                    break;
                case 5:
                    MsgObj_NMH_Gateway.NM_Gateway_EM_Aktivitaet = SigVal;
                    break;
                case 6:
                    MsgObj_NMH_Gateway.NM_Gateway_EnergieLIN_Aktivitaet = SigVal;
                    break;
                case 7:
                    MsgObj_NMH_Gateway.NM_Gateway_FCAN_Aktivitaet = SigVal;
                    break;
                case 8:
                    MsgObj_NMH_Gateway.NM_Gateway_ICAN_Aktivitaet = SigVal;
                    break;
                case 9:
                    MsgObj_NMH_Gateway.NM_Gateway_KCAN_Aktivitaet = SigVal;
                    break;
                case 10:
                    MsgObj_NMH_Gateway.NM_Gateway_KS_Aktivitaet = SigVal;
                    break;
                case 11:
                    MsgObj_NMH_Gateway.NM_Gateway_NL_EM = SigVal;
                    break;
                case 12:
                    MsgObj_NMH_Gateway.NM_Gateway_NL_Shutdown = SigVal;
                    break;
                case 13:
                    MsgObj_NMH_Gateway.NM_Gateway_NL_Spg_Messung = SigVal;
                    break;
                case 14:
                    MsgObj_NMH_Gateway.NM_Gateway_NL_Wakeup_Monitor = SigVal;
                    break;
                case 15:
                    MsgObj_NMH_Gateway.NM_Gateway_NM_State = SigVal;
                    break;
                case 16:
                    MsgObj_NMH_Gateway.NM_Gateway_NM_aktiv_Diagnose = SigVal;
                    break;
                case 17:
                    MsgObj_NMH_Gateway.NM_Gateway_NM_aktiv_KL15 = SigVal;
                    break;
                case 18:
                    MsgObj_NMH_Gateway.NM_Gateway_NM_aktiv_Tmin = SigVal;
                    break;
                case 19:
                    MsgObj_NMH_Gateway.NM_Gateway_SNI = SigVal;
                    break;
                case 20:
                    MsgObj_NMH_Gateway.NM_Gateway_UDS_CC = SigVal;
                    break;
                case 21:
                    MsgObj_NMH_Gateway.NM_Gateway_Wakeup = SigVal;
                    break;
            }
        }
        break;
        case FRM_HANDLE_OBD_Tankgeber_01:
        {
            switch (SigIdx)
            {
                case 0:
                    MsgObj_OBD_Tankgeber_01.OBD_TG_F_Status_1 = SigVal;
                    break;
                case 1:
                    MsgObj_OBD_Tankgeber_01.OBD_TG_F_Status_2 = SigVal;
                    break;
                case 2:
                    MsgObj_OBD_Tankgeber_01.OBD_TG_F_Status_3 = SigVal;
                    break;
                case 3:
                    MsgObj_OBD_Tankgeber_01.OBD_TG_F_Status_4 = SigVal;
                    break;
                case 4:
                    MsgObj_OBD_Tankgeber_01.OBD_TG_Sens_Rohwert_1 = SigVal;
                    break;
                case 5:
                    MsgObj_OBD_Tankgeber_01.OBD_TG_Sens_Rohwert_2 = SigVal;
                    break;
                case 6:
                    MsgObj_OBD_Tankgeber_01.OBD_TG_Sens_Rohwert_3 = SigVal;
                    break;
                case 7:
                    MsgObj_OBD_Tankgeber_01.OBD_TG_Sens_Rohwert_4 = SigVal;
                    break;
            }
        }
        break;
        case FRM_HANDLE_Remotestart_FFB:
        {
            switch (SigIdx)
            {
                case 0:
                    MsgObj_Remotestart_FFB.RSF_Tastencode_1 = SigVal;
                    break;
                case 1:
                    MsgObj_Remotestart_FFB.RSF_Tastencode_2 = SigVal;
                    break;
                case 2:
                    MsgObj_Remotestart_FFB.RSF_Tastencode_Maske = SigVal;
                    break;
            }
        }
        break;
        case FRM_HANDLE_STH_01:
        {
            switch (SigIdx)
            {
                case 0:
                    MsgObj_STH_01.STH_EKP_Anst = SigVal;
                    break;
                case 1:
                    MsgObj_STH_01.STH_Fehler_ElWaPu = SigVal;
                    break;
                case 2:
                    MsgObj_STH_01.STH_Fehlerstatus = SigVal;
                    break;
                case 3:
                    MsgObj_STH_01.STH_Funk_aus = SigVal;
                    break;
                case 4:
                    MsgObj_STH_01.STH_Funk_ein = SigVal;
                    break;
                case 5:
                    MsgObj_STH_01.STH_Geblaese = SigVal;
                    break;
                case 6:
                    MsgObj_STH_01.STH_Heizleistung = SigVal;
                    break;
                case 7:
                    MsgObj_STH_01.STH_KD_Fehler = SigVal;
                    break;
                case 8:
                    MsgObj_STH_01.STH_KVS = SigVal;
                    break;
                case 9:
                    MsgObj_STH_01.STH_KVS_Ueberlauf = SigVal;
                    break;
                case 10:
                    MsgObj_STH_01.STH_LED = SigVal;
                    break;
                case 11:
                    MsgObj_STH_01.STH_Motorvorwaermung = SigVal;
                    break;
                case 12:
                    MsgObj_STH_01.STH_Pumpe_ein = SigVal;
                    break;
                case 13:
                    MsgObj_STH_01.STH_Pumpen_Anf_extern = SigVal;
                    break;
                case 14:
                    MsgObj_STH_01.STH_Servicemode = SigVal;
                    break;
                case 15:
                    MsgObj_STH_01.STH_Start_folgt = SigVal;
                    break;
                case 16:
                    MsgObj_STH_01.STH_Texte = SigVal;
                    break;
                case 17:
                    MsgObj_STH_01.STH_Ventil_Status = SigVal;
                    break;
                case 18:
                    MsgObj_STH_01.STH_Ventiloeffnungszeit = SigVal;
                    break;
                case 19:
                    MsgObj_STH_01.STH_Waermeeintrag = SigVal;
                    break;
                case 20:
                    MsgObj_STH_01.STH_Wassertemp = SigVal;
                    break;
                case 21:
                    MsgObj_STH_01.STH_Zusatzheizung = SigVal;
                    break;
                case 22:
                    MsgObj_STH_01.STH_war_aktiv = SigVal;
                    break;
            }
        }
        break;
        case FRM_HANDLE_STS_01:
        {
            switch (SigIdx)
            {
                case 0:
                    MsgObj_STS_01.STS_01_BZ = SigVal;
                    break;
                case 1:
                    MsgObj_STS_01.STS_01_CRC = SigVal;
                    break;
                case 2:
                    MsgObj_STS_01.STS_Alarm_Blinker = SigVal;
                    break;
                case 3:
                    MsgObj_STS_01.STS_Alarm_still = SigVal;
                    break;
                case 4:
                    MsgObj_STS_01.STS_Anlassersperre = SigVal;
                    break;
                case 5:
                    MsgObj_STS_01.STS_Car_not_under_theft = SigVal;
                    break;
                case 6:
                    MsgObj_STS_01.STS_Car_under_theft = SigVal;
                    break;
                case 7:
                    MsgObj_STS_01.STS_Fahrlicht = SigVal;
                    break;
                case 8:
                    MsgObj_STS_01.STS_LIN_aktiv = SigVal;
                    break;
                case 9:
                    MsgObj_STS_01.STS_Laderelais = SigVal;
                    break;
                case 10:
                    MsgObj_STS_01.STS_Leerlaufschaltung = SigVal;
                    break;
                case 11:
                    MsgObj_STS_01.STS_Notstart = SigVal;
                    break;
                case 12:
                    MsgObj_STS_01.STS_Signalhorn = SigVal;
                    break;
                case 13:
                    MsgObj_STS_01.STS_Standlicht = SigVal;
                    break;
                case 14:
                    MsgObj_STS_01.STS_Summer = SigVal;
                    break;
                case 15:
                    MsgObj_STS_01.STS_Texte = SigVal;
                    break;
                case 16:
                    MsgObj_STS_01.STS_Typencodierung = SigVal;
                    break;
            }
        }
        break;
        case FRM_HANDLE_Systeminfo_01:
        {
            switch (SigIdx)
            {
                case 0:
                    MsgObj_Systeminfo_01.GW_KD_Fehler = SigVal;
                    break;
                case 1:
                    MsgObj_Systeminfo_01.SI_BUS_01 = SigVal;
                    break;
                case 2:
                    MsgObj_Systeminfo_01.SI_BUS_02 = SigVal;
                    break;
                case 3:
                    MsgObj_Systeminfo_01.SI_BUS_03 = SigVal;
                    break;
                case 4:
                    MsgObj_Systeminfo_01.SI_BUS_04 = SigVal;
                    break;
                case 5:
                    MsgObj_Systeminfo_01.SI_BUS_05 = SigVal;
                    break;
                case 6:
                    MsgObj_Systeminfo_01.SI_BUS_06 = SigVal;
                    break;
                case 7:
                    MsgObj_Systeminfo_01.SI_BUS_07 = SigVal;
                    break;
                case 8:
                    MsgObj_Systeminfo_01.SI_BUS_08 = SigVal;
                    break;
                case 9:
                    MsgObj_Systeminfo_01.SI_BUS_09 = SigVal;
                    break;
                case 10:
                    MsgObj_Systeminfo_01.SI_BUS_10 = SigVal;
                    break;
                case 11:
                    MsgObj_Systeminfo_01.SI_BUS_11 = SigVal;
                    break;
                case 12:
                    MsgObj_Systeminfo_01.SI_BUS_12 = SigVal;
                    break;
                case 13:
                    MsgObj_Systeminfo_01.SI_BUS_13 = SigVal;
                    break;
                case 14:
                    MsgObj_Systeminfo_01.SI_BUS_14 = SigVal;
                    break;
                case 15:
                    MsgObj_Systeminfo_01.SI_BUS_15 = SigVal;
                    break;
                case 16:
                    MsgObj_Systeminfo_01.SI_Bus_Identifikation = SigVal;
                    break;
                case 17:
                    MsgObj_Systeminfo_01.SI_NWDF = SigVal;
                    break;
                case 18:
                    MsgObj_Systeminfo_01.SI_NWDF_gueltig = SigVal;
                    break;
                case 19:
                    MsgObj_Systeminfo_01.SI_QRS_Mode = SigVal;
                    break;
                case 20:
                    MsgObj_Systeminfo_01.SI_Sammel_SG_Fehler = SigVal;
                    break;
                case 21:
                    MsgObj_Systeminfo_01.SI_Sammelfehler = SigVal;
                    break;
                case 22:
                    MsgObj_Systeminfo_01.SI_T_Mode = SigVal;
                    break;
                case 23:
                    MsgObj_Systeminfo_01.SI_T_Schutz = SigVal;
                    break;
            }
        }
        break;
        case FRM_HANDLE_WBA_03:
        {
            switch (SigIdx)
            {
                case 0:
                    MsgObj_WBA_03.GE_Sollgang = SigVal;
                    break;
                case 1:
                    MsgObj_WBA_03.GE_Stoppverbot_Anz_01 = SigVal;
                    break;
                case 2:
                    MsgObj_WBA_03.GE_Stoppverbot_Anz_02 = SigVal;
                    break;
                case 3:
                    MsgObj_WBA_03.GE_Stoppverbot_Anz_03 = SigVal;
                    break;
                case 4:
                    MsgObj_WBA_03.GE_Stoppverbot_Anz_04 = SigVal;
                    break;
                case 5:
                    MsgObj_WBA_03.GE_Stoppverbot_Anz_05 = SigVal;
                    break;
                case 6:
                    MsgObj_WBA_03.GE_Stoppverbot_Anz_06 = SigVal;
                    break;
                case 7:
                    MsgObj_WBA_03.GE_Stoppverbot_Anz_07 = SigVal;
                    break;
                case 8:
                    MsgObj_WBA_03.GE_Stoppverbot_Anz_Std = SigVal;
                    break;
                case 9:
                    MsgObj_WBA_03.GE_Tipschaltempf_verfuegbar = SigVal;
                    break;
                case 10:
                    MsgObj_WBA_03.GE_Wiederstart_Anz_Std = SigVal;
                    break;
                case 11:
                    MsgObj_WBA_03.WBA_03_BZ = SigVal;
                    break;
                case 12:
                    MsgObj_WBA_03.WBA_03_CRC = SigVal;
                    break;
                case 13:
                    MsgObj_WBA_03.WBA_Fahrstufe_02 = SigVal;
                    break;
                case 14:
                    MsgObj_WBA_03.WBA_GE_Texte = SigVal;
                    break;
                case 15:
                    MsgObj_WBA_03.WBA_GE_Warnung_02 = SigVal;
                    break;
                case 16:
                    MsgObj_WBA_03.WBA_GE_Zusatzwarnungen = SigVal;
                    break;
                case 17:
                    MsgObj_WBA_03.WBA_Schaltschema = SigVal;
                    break;
                case 18:
                    MsgObj_WBA_03.WBA_Segeln_aktiv = SigVal;
                    break;
                case 19:
                    MsgObj_WBA_03.WBA_ZielFahrstufe = SigVal;
                    break;
                case 20:
                    MsgObj_WBA_03.WBA_eing_Gang_02 = SigVal;
                    break;
            }
        }
        break;
    }
}
/*@@end*/

/*@@caplFunc:GetSignalVal(int,int):*/
int GetSignalVal (int FrmIdx, int SigIdx)
{
    int SigVal;

    switch (FrmIdx)
    {
        case FRM_HANDLE_ACC_06:
        {
            switch (SigIdx)
            {
                case 0:
                    SigVal = MsgObj_ACC_06.ACC_06_BZ;
                    break;
                case 1:
                    SigVal = MsgObj_ACC_06.ACC_06_CRC;
                    break;
                case 2:
                    SigVal = MsgObj_ACC_06.ACC_Anfahren;
                    break;
                case 3:
                    SigVal = MsgObj_ACC_06.ACC_Anhalten;
                    break;
                case 4:
                    SigVal = MsgObj_ACC_06.ACC_Minimale_Bremsung;
                    break;
                case 5:
                    SigVal = MsgObj_ACC_06.ACC_Sollbeschleunigung_02;
                    break;
                case 6:
                    SigVal = MsgObj_ACC_06.ACC_StartStopp_Info;
                    break;
                case 7:
                    SigVal = MsgObj_ACC_06.ACC_Status_ACC;
                    break;
                case 8:
                    SigVal = MsgObj_ACC_06.ACC_Typ;
                    break;
                case 9:
                    SigVal = MsgObj_ACC_06.ACC_limitierte_Anfahrdyn;
                    break;
                case 10:
                    SigVal = MsgObj_ACC_06.ACC_neg_Sollbeschl_Grad_02;
                    break;
                case 11:
                    SigVal = MsgObj_ACC_06.ACC_pos_Sollbeschl_Grad_02;
                    break;
                case 12:
                    SigVal = MsgObj_ACC_06.ACC_zul_Regelabw_oben;
                    break;
                case 13:
                    SigVal = MsgObj_ACC_06.ACC_zul_Regelabw_unten;
                    break;
            }
        }
        break;
        case FRM_HANDLE_Airbag_01:
        {
            switch (SigIdx)
            {
                case 0:
                    SigVal = MsgObj_Airbag_01.AB_Anzeige_Fussg;
                    break;
                case 1:
                    SigVal = MsgObj_Airbag_01.AB_Crash_Int;
                    break;
                case 2:
                    SigVal = MsgObj_Airbag_01.AB_Deaktiviert;
                    break;
                case 3:
                    SigVal = MsgObj_Airbag_01.AB_Deaktivierung_HV;
                    break;
                case 4:
                    SigVal = MsgObj_Airbag_01.AB_Diagnose;
                    break;
                case 5:
                    SigVal = MsgObj_Airbag_01.AB_Erh_Auf_VB;
                    break;
                case 6:
                    SigVal = MsgObj_Airbag_01.AB_Front_Crash;
                    break;
                case 7:
                    SigVal = MsgObj_Airbag_01.AB_Gurtwarn_VB;
                    break;
                case 8:
                    SigVal = MsgObj_Airbag_01.AB_Gurtwarn_VF;
                    break;
                case 9:
                    SigVal = MsgObj_Airbag_01.AB_Heck_Crash;
                    break;
                case 10:
                    SigVal = MsgObj_Airbag_01.AB_Lampe;
                    break;
                case 11:
                    SigVal = MsgObj_Airbag_01.AB_MKB_Anforderung;
                    break;
                case 12:
                    SigVal = MsgObj_Airbag_01.AB_MKB_gueltig;
                    break;
                case 13:
                    SigVal = MsgObj_Airbag_01.AB_PAO_Leuchte_Anf;
                    break;
                case 14:
                    SigVal = MsgObj_Airbag_01.AB_RGS_Anst;
                    break;
                case 15:
                    SigVal = MsgObj_Airbag_01.AB_Rollover_Crash;
                    break;
                case 16:
                    SigVal = MsgObj_Airbag_01.AB_SB_Crash;
                    break;
                case 17:
                    SigVal = MsgObj_Airbag_01.AB_SF_Crash;
                    break;
                case 18:
                    SigVal = MsgObj_Airbag_01.AB_Stellgliedtest;
                    break;
                case 19:
                    SigVal = MsgObj_Airbag_01.AB_Systemfehler;
                    break;
                case 20:
                    SigVal = MsgObj_Airbag_01.AB_Texte_AKS;
                    break;
                case 21:
                    SigVal = MsgObj_Airbag_01.AB_VB_deaktiviert;
                    break;
                case 22:
                    SigVal = MsgObj_Airbag_01.AB_Versorgungsspannung;
                    break;
                case 23:
                    SigVal = MsgObj_Airbag_01.Airbag_01_BZ;
                    break;
                case 24:
                    SigVal = MsgObj_Airbag_01.Airbag_01_CRC;
                    break;
            }
        }
        break;
        case FRM_HANDLE_Airbag_02:
        {
            switch (SigIdx)
            {
                case 0:
                    SigVal = MsgObj_Airbag_02.AB_Belegung_VB;
                    break;
                case 1:
                    SigVal = MsgObj_Airbag_02.AB_Gurtschloss_BF;
                    break;
                case 2:
                    SigVal = MsgObj_Airbag_02.AB_Gurtschloss_FA;
                    break;
                case 3:
                    SigVal = MsgObj_Airbag_02.AB_Gurtschloss_Reihe2_BF;
                    break;
                case 4:
                    SigVal = MsgObj_Airbag_02.AB_Gurtschloss_Reihe2_FA;
                    break;
                case 5:
                    SigVal = MsgObj_Airbag_02.AB_Gurtschloss_Reihe2_MI;
                    break;
                case 6:
                    SigVal = MsgObj_Airbag_02.AB_Gurtschloss_Reihe3_BF;
                    break;
                case 7:
                    SigVal = MsgObj_Airbag_02.AB_Gurtschloss_Reihe3_FA;
                    break;
                case 8:
                    SigVal = MsgObj_Airbag_02.AB_Gurtschloss_Reihe3_MI;
                    break;
                case 9:
                    SigVal = MsgObj_Airbag_02.AB_Sitzpos_Sens_BF;
                    break;
                case 10:
                    SigVal = MsgObj_Airbag_02.AB_Sitzpos_Sens_FA;
                    break;
                case 11:
                    SigVal = MsgObj_Airbag_02.Airbag_02_BZ;
                    break;
                case 12:
                    SigVal = MsgObj_Airbag_02.Airbag_02_CRC;
                    break;
            }
        }
        break;
        case FRM_HANDLE_Anhaenger_01:
        {
            switch (SigIdx)
            {
                case 0:
                    SigVal = MsgObj_Anhaenger_01.AAG_AVS_Fehler_02;
                    break;
                case 1:
                    SigVal = MsgObj_Anhaenger_01.AAG_AVS_Stati;
                    break;
                case 2:
                    SigVal = MsgObj_Anhaenger_01.AAG_Anhaenger_abgesteckt;
                    break;
                case 3:
                    SigVal = MsgObj_Anhaenger_01.AAG_Anhaenger_erkannt;
                    break;
                case 4:
                    SigVal = MsgObj_Anhaenger_01.AAG_BZ;
                    break;
                case 5:
                    SigVal = MsgObj_Anhaenger_01.AAG_Blinker_HL_def;
                    break;
                case 6:
                    SigVal = MsgObj_Anhaenger_01.AAG_Blinker_HR_def;
                    break;
                case 7:
                    SigVal = MsgObj_Anhaenger_01.AAG_Blinker_H_aktiv;
                    break;
                case 8:
                    SigVal = MsgObj_Anhaenger_01.AAG_Bremsl_durch_ECD;
                    break;
                case 9:
                    SigVal = MsgObj_Anhaenger_01.AAG_Bremslicht_H_def;
                    break;
                case 10:
                    SigVal = MsgObj_Anhaenger_01.AAG_NSL_aktiv;
                    break;
                case 11:
                    SigVal = MsgObj_Anhaenger_01.AAG_Schlusslicht_HL_def;
                    break;
                case 12:
                    SigVal = MsgObj_Anhaenger_01.AAG_Schlusslicht_HR_def;
                    break;
            }
        }
        break;
        case FRM_HANDLE_BCM_01:
        {
            switch (SigIdx)
            {
                case 0:
                    SigVal = MsgObj_BCM_01.BCM1_AFS_Lampe;
                    break;
                case 1:
                    SigVal = MsgObj_BCM_01.BCM1_Kl_15_HW_erkannt;
                    break;
                case 2:
                    SigVal = MsgObj_BCM_01.BCM1_Licht_Warn;
                    break;
                case 3:
                    SigVal = MsgObj_BCM_01.BCM1_Lichtwarn_Texte;
                    break;
                case 4:
                    SigVal = MsgObj_BCM_01.BCM1_MH_Schalter;
                    break;
                case 5:
                    SigVal = MsgObj_BCM_01.BCM1_MH_WIV_Schalter;
                    break;
                case 6:
                    SigVal = MsgObj_BCM_01.BCM1_NV_Taster;
                    break;
                case 7:
                    SigVal = MsgObj_BCM_01.BCM1_Reisemodus_Texte;
                    break;
                case 8:
                    SigVal = MsgObj_BCM_01.BCM1_Rueckfahrlicht_Schalter;
                    break;
                case 9:
                    SigVal = MsgObj_BCM_01.BCM1_Valet_Parking_Taster;
                    break;
                case 10:
                    SigVal = MsgObj_BCM_01.BCM1_Warnblink_Taster;
                    break;
                case 11:
                    SigVal = MsgObj_BCM_01.BCM_Bremsbelag_Sensor;
                    break;
                case 12:
                    SigVal = MsgObj_BCM_01.BCM_Bremsfluessigkeit_Sensor;
                    break;
                case 13:
                    SigVal = MsgObj_BCM_01.BCM_Eco_Charisma_Taste;
                    break;
                case 14:
                    SigVal = MsgObj_BCM_01.BCM_Hybrid_StartStopp_Taste;
                    break;
                case 15:
                    SigVal = MsgObj_BCM_01.BCM_Kuehlmittel_Sensor;
                    break;
                case 16:
                    SigVal = MsgObj_BCM_01.BCM_Waschwasser_Sensor;
                    break;
                case 17:
                    SigVal = MsgObj_BCM_01.Gong_TFL_Umschaltung;
                    break;
                case 18:
                    SigVal = MsgObj_BCM_01.UGDO_Function;
                    break;
            }
        }
        break;
        case FRM_HANDLE_BEM_05:
        {
            switch (SigIdx)
            {
                case 0:
                    SigVal = MsgObj_BEM_05.BEM_01_Abschaltstufen;
                    break;
                case 1:
                    SigVal = MsgObj_BEM_05.BEM_Anf_KL;
                    break;
                case 2:
                    SigVal = MsgObj_BEM_05.BEM_Batt_Ab;
                    break;
                case 3:
                    SigVal = MsgObj_BEM_05.BEM_DFM;
                    break;
                case 4:
                    SigVal = MsgObj_BEM_05.BEM_EMLIN_ungueltig;
                    break;
                case 5:
                    SigVal = MsgObj_BEM_05.BEM_HYB_DC_uMinLV;
                    break;
                case 6:
                    SigVal = MsgObj_BEM_05.BEM_HYB_DC_uSollLV;
                    break;
                case 7:
                    SigVal = MsgObj_BEM_05.BEM_Hybrid_Info;
                    break;
                case 8:
                    SigVal = MsgObj_BEM_05.BEM_NV_NachladAnf;
                    break;
                case 9:
                    SigVal = MsgObj_BEM_05.BEM_P_Generator;
                    break;
                case 10:
                    SigVal = MsgObj_BEM_05.BEM_Segel_Info;
                    break;
                case 11:
                    SigVal = MsgObj_BEM_05.BEM_StartStopp_Info;
                    break;
                case 12:
                    SigVal = MsgObj_BEM_05.BEM_n_LLA;
                    break;
                case 13:
                    SigVal = MsgObj_BEM_05.NVEM_DC_LangsRegelung_Anf;
                    break;
            }
        }
        break;
        case FRM_HANDLE_Bremse_EV_01:
        {
            switch (SigIdx)
            {
                case 0:
                    SigVal = MsgObj_Bremse_EV_01.Bremse_EV_01_BZ;
                    break;
                case 1:
                    SigVal = MsgObj_Bremse_EV_01.Bremse_EV_01_CRC;
                    break;
                case 2:
                    SigVal = MsgObj_Bremse_EV_01.EBKV_Bremspedalweg;
                    break;
                case 3:
                    SigVal = MsgObj_Bremse_EV_01.EBKV_Fahrer_bremst;
                    break;
                case 4:
                    SigVal = MsgObj_Bremse_EV_01.EBKV_Generatorsollmoment;
                    break;
                case 5:
                    SigVal = MsgObj_Bremse_EV_01.EBKV_M_Brems_ASM_soll;
                    break;
                case 6:
                    SigVal = MsgObj_Bremse_EV_01.EBKV_QBit_Fahrer_bremst;
                    break;
                case 7:
                    SigVal = MsgObj_Bremse_EV_01.EBKV_Status;
                    break;
            }
        }
        break;
        case FRM_HANDLE_Bremse_EV_02:
        {
            switch (SigIdx)
            {
                case 0:
                    SigVal = MsgObj_Bremse_EV_02.EBKV_BKL_Warnungen;
                    break;
                case 1:
                    SigVal = MsgObj_Bremse_EV_02.EBKV_Hinweise;
                    break;
                case 2:
                    SigVal = MsgObj_Bremse_EV_02.EBKV_OBD_Status;
                    break;
                case 3:
                    SigVal = MsgObj_Bremse_EV_02.EBKV_Warnungen;
                    break;
            }
        }
        break;
        case FRM_HANDLE_CAN_Umsetzer_Resp_01:
        {
            switch (SigIdx)
            {
                case 0:
                    SigVal = MsgObj_CAN_Umsetzer_Resp_01.CU1RSP_IO1;
                    break;
                case 1:
                    SigVal = MsgObj_CAN_Umsetzer_Resp_01.CU1RSP_IO1_KS_GND_Fehler;
                    break;
                case 2:
                    SigVal = MsgObj_CAN_Umsetzer_Resp_01.CU1RSP_IO1_KS_UBat_Fehler;
                    break;
                case 3:
                    SigVal = MsgObj_CAN_Umsetzer_Resp_01.CU1RSP_IO1_QBit;
                    break;
                case 4:
                    SigVal = MsgObj_CAN_Umsetzer_Resp_01.CU1RSP_IO1_Taste_Fehler;
                    break;
                case 5:
                    SigVal = MsgObj_CAN_Umsetzer_Resp_01.CU1RSP_IO1_analog_Eing;
                    break;
                case 6:
                    SigVal = MsgObj_CAN_Umsetzer_Resp_01.CU1RSP_IO1_digital_Eing;
                    break;
                case 7:
                    SigVal = MsgObj_CAN_Umsetzer_Resp_01.CU1RSP_IO1_digital_analog;
                    break;
                case 8:
                    SigVal = MsgObj_CAN_Umsetzer_Resp_01.CU1RSP_IO2;
                    break;
                case 9:
                    SigVal = MsgObj_CAN_Umsetzer_Resp_01.CU1RSP_IO2_KS_Fehler;
                    break;
                case 10:
                    SigVal = MsgObj_CAN_Umsetzer_Resp_01.CU1RSP_IO2_KS_UBat_Fehler;
                    break;
                case 11:
                    SigVal = MsgObj_CAN_Umsetzer_Resp_01.CU1RSP_IO2_OpenLoad;
                    break;
                case 12:
                    SigVal = MsgObj_CAN_Umsetzer_Resp_01.CU1RSP_IO2_QBit;
                    break;
                case 13:
                    SigVal = MsgObj_CAN_Umsetzer_Resp_01.CU1RSP_IO2_digital_Eing;
                    break;
                case 14:
                    SigVal = MsgObj_CAN_Umsetzer_Resp_01.CU1RSP_IO3;
                    break;
                case 15:
                    SigVal = MsgObj_CAN_Umsetzer_Resp_01.CU1RSP_IO3_KS_Fehler;
                    break;
                case 16:
                    SigVal = MsgObj_CAN_Umsetzer_Resp_01.CU1RSP_IO3_KS_UBat_Fehler;
                    break;
                case 17:
                    SigVal = MsgObj_CAN_Umsetzer_Resp_01.CU1RSP_IO3_OpenLoad;
                    break;
                case 18:
                    SigVal = MsgObj_CAN_Umsetzer_Resp_01.CU1RSP_IO3_QBit;
                    break;
                case 19:
                    SigVal = MsgObj_CAN_Umsetzer_Resp_01.CU1RSP_IO3_digital_Eing;
                    break;
                case 20:
                    SigVal = MsgObj_CAN_Umsetzer_Resp_01.CU1RSP_Timeout_Fehler;
                    break;
            }
        }
        break;
        case FRM_HANDLE_Charisma_01:
        {
            switch (SigIdx)
            {
                case 0:
                    SigVal = MsgObj_Charisma_01.CHA_Fahrer_Umschaltung;
                    break;
                case 1:
                    SigVal = MsgObj_Charisma_01.CHA_Ziel_FahrPr_ACC;
                    break;
                case 2:
                    SigVal = MsgObj_Charisma_01.CHA_Ziel_FahrPr_AFS;
                    break;
                case 3:
                    SigVal = MsgObj_Charisma_01.CHA_Ziel_FahrPr_AGA;
                    break;
                case 4:
                    SigVal = MsgObj_Charisma_01.CHA_Ziel_FahrPr_DR;
                    break;
                case 5:
                    SigVal = MsgObj_Charisma_01.CHA_Ziel_FahrPr_EPS;
                    break;
                case 6:
                    SigVal = MsgObj_Charisma_01.CHA_Ziel_FahrPr_ESP;
                    break;
                case 7:
                    SigVal = MsgObj_Charisma_01.CHA_Ziel_FahrPr_Freilauf;
                    break;
                case 8:
                    SigVal = MsgObj_Charisma_01.CHA_Ziel_FahrPr_GE;
                    break;
                case 9:
                    SigVal = MsgObj_Charisma_01.CHA_Ziel_FahrPr_MO;
                    break;
                case 10:
                    SigVal = MsgObj_Charisma_01.CHA_Ziel_FahrPr_MO_StSt;
                    break;
                case 11:
                    SigVal = MsgObj_Charisma_01.CHA_Ziel_FahrPr_QS;
                    break;
                case 12:
                    SigVal = MsgObj_Charisma_01.CHA_Ziel_FahrPr_RGS;
                    break;
                case 13:
                    SigVal = MsgObj_Charisma_01.CHA_Ziel_FahrPr_SAK;
                    break;
                case 14:
                    SigVal = MsgObj_Charisma_01.CHA_Ziel_FahrPr_SCU;
                    break;
                case 15:
                    SigVal = MsgObj_Charisma_01.CHA_Ziel_FahrPr_ST;
                    break;
            }
        }
        break;
        case FRM_HANDLE_Diagnose_01:
        {
            switch (SigIdx)
            {
                case 0:
                    SigVal = MsgObj_Diagnose_01.DGN_Verlernzaehler;
                    break;
                case 1:
                    SigVal = MsgObj_Diagnose_01.KBI_Kilometerstand;
                    break;
                case 2:
                    SigVal = MsgObj_Diagnose_01.Kombi_02_alt;
                    break;
                case 3:
                    SigVal = MsgObj_Diagnose_01.UH_Jahr;
                    break;
                case 4:
                    SigVal = MsgObj_Diagnose_01.UH_Minute;
                    break;
                case 5:
                    SigVal = MsgObj_Diagnose_01.UH_Monat;
                    break;
                case 6:
                    SigVal = MsgObj_Diagnose_01.UH_Sekunde;
                    break;
                case 7:
                    SigVal = MsgObj_Diagnose_01.UH_Stunde;
                    break;
                case 8:
                    SigVal = MsgObj_Diagnose_01.UH_Tag;
                    break;
                case 9:
                    SigVal = MsgObj_Diagnose_01.Uhrzeit_01_alt;
                    break;
            }
        }
        break;
        case FRM_HANDLE_EPB_01:
        {
            switch (SigIdx)
            {
                case 0:
                    SigVal = MsgObj_EPB_01.EPB_01_BZ;
                    break;
                case 1:
                    SigVal = MsgObj_EPB_01.EPB_01_CRC;
                    break;
                case 2:
                    SigVal = MsgObj_EPB_01.EPB_Anfahrwunsch_erkannt;
                    break;
                case 3:
                    SigVal = MsgObj_EPB_01.EPB_BCM2_Motor_Wakeup;
                    break;
                case 4:
                    SigVal = MsgObj_EPB_01.EPB_DAA_Randbed_erf;
                    break;
                case 5:
                    SigVal = MsgObj_EPB_01.EPB_Fehlerstatus;
                    break;
                case 6:
                    SigVal = MsgObj_EPB_01.EPB_Freig_Verzoeg_Anf;
                    break;
                case 7:
                    SigVal = MsgObj_EPB_01.EPB_Konsistenz_ACC;
                    break;
                case 8:
                    SigVal = MsgObj_EPB_01.EPB_Laengsbeschleunigung;
                    break;
                case 9:
                    SigVal = MsgObj_EPB_01.EPB_Pedalweg_Kuppl;
                    break;
                case 10:
                    SigVal = MsgObj_EPB_01.EPB_QBit_Laengsbeschleunigung;
                    break;
                case 11:
                    SigVal = MsgObj_EPB_01.EPB_QBit_Pedalweg_Kuppl;
                    break;
                case 12:
                    SigVal = MsgObj_EPB_01.EPB_QBit_Schalterpos;
                    break;
                case 13:
                    SigVal = MsgObj_EPB_01.EPB_Schalterposition;
                    break;
                case 14:
                    SigVal = MsgObj_EPB_01.EPB_Spannkraft;
                    break;
                case 15:
                    SigVal = MsgObj_EPB_01.EPB_Status;
                    break;
                case 16:
                    SigVal = MsgObj_EPB_01.EPB_Verzoeg_Anf;
                    break;
            }
        }
        break;
        case FRM_HANDLE_ESP_02:
        {
            switch (SigIdx)
            {
                case 0:
                    SigVal = MsgObj_ESP_02.ESP_02_BZ;
                    break;
                case 1:
                    SigVal = MsgObj_ESP_02.ESP_02_CRC;
                    break;
                case 2:
                    SigVal = MsgObj_ESP_02.ESP_Gierrate;
                    break;
                case 3:
                    SigVal = MsgObj_ESP_02.ESP_Laengsbeschl;
                    break;
                case 4:
                    SigVal = MsgObj_ESP_02.ESP_Notbremsanzeige;
                    break;
                case 5:
                    SigVal = MsgObj_ESP_02.ESP_PLA_Abbruch;
                    break;
                case 6:
                    SigVal = MsgObj_ESP_02.ESP_QBit_Anf_Vert_Wank;
                    break;
                case 7:
                    SigVal = MsgObj_ESP_02.ESP_QBit_Gierrate;
                    break;
                case 8:
                    SigVal = MsgObj_ESP_02.ESP_QBit_Laengsbeschl;
                    break;
                case 9:
                    SigVal = MsgObj_ESP_02.ESP_QBit_Querb;
                    break;
                case 10:
                    SigVal = MsgObj_ESP_02.ESP_Querbeschleunigung;
                    break;
                case 11:
                    SigVal = MsgObj_ESP_02.ESP_SpannungsAnf;
                    break;
                case 12:
                    SigVal = MsgObj_ESP_02.ESP_Status_ESP_PLA;
                    break;
                case 13:
                    SigVal = MsgObj_ESP_02.ESP_Stillstandsflag;
                    break;
                case 14:
                    SigVal = MsgObj_ESP_02.ESP_VZ_Gierrate;
                    break;
                case 15:
                    SigVal = MsgObj_ESP_02.ESP_Verteil_Wankmom;
                    break;
            }
        }
        break;
        case FRM_HANDLE_ESP_05:
        {
            switch (SigIdx)
            {
                case 0:
                    SigVal = MsgObj_ESP_05.ECD_Bremslicht;
                    break;
                case 1:
                    SigVal = MsgObj_ESP_05.ECD_Fehler;
                    break;
                case 2:
                    SigVal = MsgObj_ESP_05.ECD_nicht_verfuegbar;
                    break;
                case 3:
                    SigVal = MsgObj_ESP_05.ESP_05_BZ;
                    break;
                case 4:
                    SigVal = MsgObj_ESP_05.ESP_05_CRC;
                    break;
                case 5:
                    SigVal = MsgObj_ESP_05.ESP_Anforderung_EPB;
                    break;
                case 6:
                    SigVal = MsgObj_ESP_05.ESP_Autohold_Standby;
                    break;
                case 7:
                    SigVal = MsgObj_ESP_05.ESP_Autohold_aktiv;
                    break;
                case 8:
                    SigVal = MsgObj_ESP_05.ESP_BKV_Unterdruck;
                    break;
                case 9:
                    SigVal = MsgObj_ESP_05.ESP_Bremsdruck;
                    break;
                case 10:
                    SigVal = MsgObj_ESP_05.ESP_Bremsruck_AWV2;
                    break;
                case 11:
                    SigVal = MsgObj_ESP_05.ESP_Eingr_HL;
                    break;
                case 12:
                    SigVal = MsgObj_ESP_05.ESP_Eingr_HR;
                    break;
                case 13:
                    SigVal = MsgObj_ESP_05.ESP_Eingr_VL;
                    break;
                case 14:
                    SigVal = MsgObj_ESP_05.ESP_Eingr_VR;
                    break;
                case 15:
                    SigVal = MsgObj_ESP_05.ESP_FStatus_Anfahrhilfe;
                    break;
                case 16:
                    SigVal = MsgObj_ESP_05.ESP_Fahrer_bremst;
                    break;
                case 17:
                    SigVal = MsgObj_ESP_05.ESP_HBA_aktiv;
                    break;
                case 18:
                    SigVal = MsgObj_ESP_05.ESP_HDC_Standby;
                    break;
                case 19:
                    SigVal = MsgObj_ESP_05.ESP_HDC_aktiv;
                    break;
                case 20:
                    SigVal = MsgObj_ESP_05.ESP_Konsistenz_AWV2;
                    break;
                case 21:
                    SigVal = MsgObj_ESP_05.ESP_Konsistenz_TSK;
                    break;
                case 22:
                    SigVal = MsgObj_ESP_05.ESP_Lenkeingriff_ADS;
                    break;
                case 23:
                    SigVal = MsgObj_ESP_05.ESP_Prefill_ausgeloest;
                    break;
                case 24:
                    SigVal = MsgObj_ESP_05.ESP_QBit_Bremsdruck;
                    break;
                case 25:
                    SigVal = MsgObj_ESP_05.ESP_QBit_Fahrer_bremst;
                    break;
                case 26:
                    SigVal = MsgObj_ESP_05.ESP_Rueckwaertsfahrt_erkannt;
                    break;
                case 27:
                    SigVal = MsgObj_ESP_05.ESP_Schwelle_Unterdruck;
                    break;
                case 28:
                    SigVal = MsgObj_ESP_05.ESP_StartStopp_Info;
                    break;
                case 29:
                    SigVal = MsgObj_ESP_05.ESP_Status_Anfahrhilfe;
                    break;
                case 30:
                    SigVal = MsgObj_ESP_05.ESP_Status_Bremsdruck;
                    break;
                case 31:
                    SigVal = MsgObj_ESP_05.ESP_Status_Bremsentemp;
                    break;
                case 32:
                    SigVal = MsgObj_ESP_05.ESP_Verz_EPB_aktiv;
                    break;
                case 33:
                    SigVal = MsgObj_ESP_05.ESP_Verz_TSK_aktiv;
                    break;
                case 34:
                    SigVal = MsgObj_ESP_05.ESP_Verzoeg_EPB_verf;
                    break;
            }
        }
        break;
        case FRM_HANDLE_ESP_07:
        {
            switch (SigIdx)
            {
                case 0:
                    SigVal = MsgObj_ESP_07.ESP_07_BZ;
                    break;
                case 1:
                    SigVal = MsgObj_ESP_07.ESP_07_CRC;
                    break;
                case 2:
                    SigVal = MsgObj_ESP_07.ESP_ACC_LDE;
                    break;
                case 3:
                    SigVal = MsgObj_ESP_07.ESP_CM_Variante;
                    break;
                case 4:
                    SigVal = MsgObj_ESP_07.ESP_Codierung_ADS;
                    break;
                case 5:
                    SigVal = MsgObj_ESP_07.ESP_MKB_ausloesbar;
                    break;
                case 6:
                    SigVal = MsgObj_ESP_07.ESP_OBD_Status;
                    break;
                case 7:
                    SigVal = MsgObj_ESP_07.ESP_Offroad_Modus;
                    break;
                case 8:
                    SigVal = MsgObj_ESP_07.ESP_Qualifizierung_Antriebsart;
                    break;
                case 9:
                    SigVal = MsgObj_ESP_07.ESP_Quattro_Antrieb;
                    break;
                case 10:
                    SigVal = MsgObj_ESP_07.ESP_RTA_HL;
                    break;
                case 11:
                    SigVal = MsgObj_ESP_07.ESP_RTA_HR;
                    break;
                case 12:
                    SigVal = MsgObj_ESP_07.ESP_RTA_VR;
                    break;
                case 13:
                    SigVal = MsgObj_ESP_07.ESP_Rollenmodus_Deaktivieren;
                    break;
                case 14:
                    SigVal = MsgObj_ESP_07.ESP_Stat_FallBack_eBKV;
                    break;
                case 15:
                    SigVal = MsgObj_ESP_07.ESP_nachtr_Stopp_Anf;
                    break;
                case 16:
                    SigVal = MsgObj_ESP_07.OBD_Fehler_Radsensor_HL;
                    break;
                case 17:
                    SigVal = MsgObj_ESP_07.OBD_Fehler_Radsensor_HR;
                    break;
                case 18:
                    SigVal = MsgObj_ESP_07.OBD_Fehler_Radsensor_VL;
                    break;
                case 19:
                    SigVal = MsgObj_ESP_07.OBD_Fehler_Radsensor_VR;
                    break;
            }
        }
        break;
        case FRM_HANDLE_ESP_10:
        {
            switch (SigIdx)
            {
                case 0:
                    SigVal = MsgObj_ESP_10.ESP_10_BZ;
                    break;
                case 1:
                    SigVal = MsgObj_ESP_10.ESP_10_CRC;
                    break;
                case 2:
                    SigVal = MsgObj_ESP_10.ESP_HL_Fahrtrichtung;
                    break;
                case 3:
                    SigVal = MsgObj_ESP_10.ESP_HR_Fahrtrichtung;
                    break;
                case 4:
                    SigVal = MsgObj_ESP_10.ESP_QBit_Wegimpuls_HL;
                    break;
                case 5:
                    SigVal = MsgObj_ESP_10.ESP_QBit_Wegimpuls_HR;
                    break;
                case 6:
                    SigVal = MsgObj_ESP_10.ESP_QBit_Wegimpuls_VL;
                    break;
                case 7:
                    SigVal = MsgObj_ESP_10.ESP_QBit_Wegimpuls_VR;
                    break;
                case 8:
                    SigVal = MsgObj_ESP_10.ESP_VL_Fahrtrichtung;
                    break;
                case 9:
                    SigVal = MsgObj_ESP_10.ESP_VR_Fahrtrichtung;
                    break;
                case 10:
                    SigVal = MsgObj_ESP_10.ESP_Wegimpuls_HL;
                    break;
                case 11:
                    SigVal = MsgObj_ESP_10.ESP_Wegimpuls_HR;
                    break;
                case 12:
                    SigVal = MsgObj_ESP_10.ESP_Wegimpuls_VL;
                    break;
                case 13:
                    SigVal = MsgObj_ESP_10.ESP_Wegimpuls_VR;
                    break;
            }
        }
        break;
        case FRM_HANDLE_ESP_19:
        {
            switch (SigIdx)
            {
                case 0:
                    SigVal = MsgObj_ESP_19.ESP_HL_Radgeschw_02;
                    break;
                case 1:
                    SigVal = MsgObj_ESP_19.ESP_HR_Radgeschw_02;
                    break;
                case 2:
                    SigVal = MsgObj_ESP_19.ESP_VL_Radgeschw_02;
                    break;
                case 3:
                    SigVal = MsgObj_ESP_19.ESP_VR_Radgeschw_02;
                    break;
            }
        }
        break;
        case FRM_HANDLE_ESP_20:
        {
            switch (SigIdx)
            {
                case 0:
                    SigVal = MsgObj_ESP_20.BR_QBit_Reifenumfang;
                    break;
                case 1:
                    SigVal = MsgObj_ESP_20.BR_Reifenumfang;
                    break;
                case 2:
                    SigVal = MsgObj_ESP_20.BR_Systemart;
                    break;
                case 3:
                    SigVal = MsgObj_ESP_20.ESP_20_BZ;
                    break;
                case 4:
                    SigVal = MsgObj_ESP_20.ESP_20_CRC;
                    break;
                case 5:
                    SigVal = MsgObj_ESP_20.ESP_Charisma_FahrPr;
                    break;
                case 6:
                    SigVal = MsgObj_ESP_20.ESP_Charisma_Status;
                    break;
                case 7:
                    SigVal = MsgObj_ESP_20.ESP_Dachrelingsensor;
                    break;
                case 8:
                    SigVal = MsgObj_ESP_20.ESP_Stoppverbot_Anz_01;
                    break;
                case 9:
                    SigVal = MsgObj_ESP_20.ESP_Stoppverbot_Anz_02;
                    break;
                case 10:
                    SigVal = MsgObj_ESP_20.ESP_Stoppverbot_Anz_03;
                    break;
                case 11:
                    SigVal = MsgObj_ESP_20.ESP_Stoppverbot_Anz_04;
                    break;
                case 12:
                    SigVal = MsgObj_ESP_20.ESP_Stoppverbot_Anz_05;
                    break;
                case 13:
                    SigVal = MsgObj_ESP_20.ESP_Stoppverbot_Anz_06;
                    break;
                case 14:
                    SigVal = MsgObj_ESP_20.ESP_Stoppverbot_Anz_07;
                    break;
                case 15:
                    SigVal = MsgObj_ESP_20.ESP_Stoppverbot_Anz_Std;
                    break;
                case 16:
                    SigVal = MsgObj_ESP_20.ESP_Wiederstart_Anz_01;
                    break;
                case 17:
                    SigVal = MsgObj_ESP_20.ESP_Wiederstart_Anz_02;
                    break;
                case 18:
                    SigVal = MsgObj_ESP_20.ESP_Wiederstart_Anz_03;
                    break;
                case 19:
                    SigVal = MsgObj_ESP_20.ESP_Wiederstart_Anz_Std;
                    break;
                case 20:
                    SigVal = MsgObj_ESP_20.ESP_Zaehnezahl;
                    break;
            }
        }
        break;
        case FRM_HANDLE_ESP_21:
        {
            switch (SigIdx)
            {
                case 0:
                    SigVal = MsgObj_ESP_21.ABS_Bremsung;
                    break;
                case 1:
                    SigVal = MsgObj_ESP_21.ASR_Anf;
                    break;
                case 2:
                    SigVal = MsgObj_ESP_21.ASR_Schalteingriff;
                    break;
                case 3:
                    SigVal = MsgObj_ESP_21.ASR_Tastung_passiv;
                    break;
                case 4:
                    SigVal = MsgObj_ESP_21.BR_Eingriffsmoment;
                    break;
                case 5:
                    SigVal = MsgObj_ESP_21.EBV_Eingriff;
                    break;
                case 6:
                    SigVal = MsgObj_ESP_21.EDS_Eingriff;
                    break;
                case 7:
                    SigVal = MsgObj_ESP_21.ESP_21_BZ;
                    break;
                case 8:
                    SigVal = MsgObj_ESP_21.ESP_21_CRC;
                    break;
                case 9:
                    SigVal = MsgObj_ESP_21.ESP_ASP;
                    break;
                case 10:
                    SigVal = MsgObj_ESP_21.ESP_AWV3_Brems_aktiv;
                    break;
                case 11:
                    SigVal = MsgObj_ESP_21.ESP_Anhaltevorgang_ACC_aktiv;
                    break;
                case 12:
                    SigVal = MsgObj_ESP_21.ESP_Diagnose;
                    break;
                case 13:
                    SigVal = MsgObj_ESP_21.ESP_Eingriff;
                    break;
                case 14:
                    SigVal = MsgObj_ESP_21.ESP_Haltebestaetigung;
                    break;
                case 15:
                    SigVal = MsgObj_ESP_21.ESP_MKB_Abbruch_Geschw;
                    break;
                case 16:
                    SigVal = MsgObj_ESP_21.ESP_PLA_Bremseingriff;
                    break;
                case 17:
                    SigVal = MsgObj_ESP_21.ESP_QBit_v_Signal;
                    break;
                case 18:
                    SigVal = MsgObj_ESP_21.ESP_Systemstatus;
                    break;
                case 19:
                    SigVal = MsgObj_ESP_21.ESP_Tastung_passiv;
                    break;
                case 20:
                    SigVal = MsgObj_ESP_21.ESP_v_Signal;
                    break;
                case 21:
                    SigVal = MsgObj_ESP_21.MSR_Anf;
                    break;
                case 22:
                    SigVal = MsgObj_ESP_21.OBD_QBit_Schlechtweg;
                    break;
                case 23:
                    SigVal = MsgObj_ESP_21.OBD_Schlechtweg;
                    break;
            }
        }
        break;
        case FRM_HANDLE_Einheiten_01:
        {
            switch (SigIdx)
            {
                case 0:
                    SigVal = MsgObj_Einheiten_01.KBI_Einheit_Datum;
                    break;
                case 1:
                    SigVal = MsgObj_Einheiten_01.KBI_Einheit_Druck;
                    break;
                case 2:
                    SigVal = MsgObj_Einheiten_01.KBI_Einheit_Sprache;
                    break;
                case 3:
                    SigVal = MsgObj_Einheiten_01.KBI_Einheit_Streckenanz;
                    break;
                case 4:
                    SigVal = MsgObj_Einheiten_01.KBI_Einheit_Temp;
                    break;
                case 5:
                    SigVal = MsgObj_Einheiten_01.KBI_Einheit_Uhrzeit;
                    break;
                case 6:
                    SigVal = MsgObj_Einheiten_01.KBI_Einheit_Verbrauch;
                    break;
                case 7:
                    SigVal = MsgObj_Einheiten_01.KBI_Einheit_Volumen;
                    break;
                case 8:
                    SigVal = MsgObj_Einheiten_01.KBI_MFA_v_Einheit_02;
                    break;
            }
        }
        break;
        case FRM_HANDLE_GRA_ACC_01:
        {
            switch (SigIdx)
            {
                case 0:
                    SigVal = MsgObj_GRA_ACC_01.GRA_ACC_01_BZ;
                    break;
                case 1:
                    SigVal = MsgObj_GRA_ACC_01.GRA_ACC_01_CRC;
                    break;
                case 2:
                    SigVal = MsgObj_GRA_ACC_01.GRA_Abbrechen;
                    break;
                case 3:
                    SigVal = MsgObj_GRA_ACC_01.GRA_Codierung;
                    break;
                case 4:
                    SigVal = MsgObj_GRA_ACC_01.GRA_Fehler;
                    break;
                case 5:
                    SigVal = MsgObj_GRA_ACC_01.GRA_Hauptschalter;
                    break;
                case 6:
                    SigVal = MsgObj_GRA_ACC_01.GRA_LIM_Taste_verfuegbar;
                    break;
                case 7:
                    SigVal = MsgObj_GRA_ACC_01.GRA_Limiter;
                    break;
                case 8:
                    SigVal = MsgObj_GRA_ACC_01.GRA_Tip_Hoch;
                    break;
                case 9:
                    SigVal = MsgObj_GRA_ACC_01.GRA_Tip_Runter;
                    break;
                case 10:
                    SigVal = MsgObj_GRA_ACC_01.GRA_Tip_Setzen;
                    break;
                case 11:
                    SigVal = MsgObj_GRA_ACC_01.GRA_Tip_Stufe_2;
                    break;
                case 12:
                    SigVal = MsgObj_GRA_ACC_01.GRA_Tip_Wiederaufnahme;
                    break;
                case 13:
                    SigVal = MsgObj_GRA_ACC_01.GRA_Typ_Bedienteil;
                    break;
                case 14:
                    SigVal = MsgObj_GRA_ACC_01.GRA_Typ_Hauptschalter;
                    break;
                case 15:
                    SigVal = MsgObj_GRA_ACC_01.GRA_Verstellung_Zeitluecke;
                    break;
                case 16:
                    SigVal = MsgObj_GRA_ACC_01.GRA_reserveByte4;
                    break;
                case 17:
                    SigVal = MsgObj_GRA_ACC_01.GRA_reserveByte5;
                    break;
                case 18:
                    SigVal = MsgObj_GRA_ACC_01.GRA_reserveByte6;
                    break;
                case 19:
                    SigVal = MsgObj_GRA_ACC_01.GRA_reserveByte7;
                    break;
                case 20:
                    SigVal = MsgObj_GRA_ACC_01.GRA_reserveByte8;
                    break;
            }
        }
        break;
        case FRM_HANDLE_Gateway_72:
        {
            switch (SigIdx)
            {
                case 0:
                    SigVal = MsgObj_Gateway_72.AAG_Anhaenger_erkannt;
                    break;
                case 1:
                    SigVal = MsgObj_Gateway_72.Anhaenger_01_alt;
                    break;
                case 2:
                    SigVal = MsgObj_Gateway_72.BCM1_Aussen_Temp_ungef;
                    break;
                case 3:
                    SigVal = MsgObj_Gateway_72.BCM1_MH_Schalter;
                    break;
                case 4:
                    SigVal = MsgObj_Gateway_72.BCM1_OBD_FStatus_ATemp;
                    break;
                case 5:
                    SigVal = MsgObj_Gateway_72.BCM1_Rueckfahrlicht_Schalter;
                    break;
                case 6:
                    SigVal = MsgObj_Gateway_72.BCM_01_alt;
                    break;
                case 7:
                    SigVal = MsgObj_Gateway_72.BCM_Rueckfahrlicht_Anf;
                    break;
                case 8:
                    SigVal = MsgObj_Gateway_72.BH_Blinker_li;
                    break;
                case 9:
                    SigVal = MsgObj_Gateway_72.BH_Blinker_re;
                    break;
                case 10:
                    SigVal = MsgObj_Gateway_72.BH_Fernlicht;
                    break;
                case 11:
                    SigVal = MsgObj_Gateway_72.KL_Thermomanagement;
                    break;
                case 12:
                    SigVal = MsgObj_Gateway_72.Klima_11_alt;
                    break;
                case 13:
                    SigVal = MsgObj_Gateway_72.Klima_Sensor_02_alt;
                    break;
                case 14:
                    SigVal = MsgObj_Gateway_72.Licht_Anf_01_alt;
                    break;
                case 15:
                    SigVal = MsgObj_Gateway_72.SMLS_01_alt;
                    break;
                case 16:
                    SigVal = MsgObj_Gateway_72.VS_VD_entriegelt;
                    break;
                case 17:
                    SigVal = MsgObj_Gateway_72.VS_VD_offen_ver;
                    break;
                case 18:
                    SigVal = MsgObj_Gateway_72.VS_VD_zu_ver;
                    break;
                case 19:
                    SigVal = MsgObj_Gateway_72.VS_Verdeck_Anf;
                    break;
                case 20:
                    SigVal = MsgObj_Gateway_72.Verdeck_01_alt;
                    break;
                case 21:
                    SigVal = MsgObj_Gateway_72.WFS_01_alt;
                    break;
                case 22:
                    SigVal = MsgObj_Gateway_72.WFS_ID_Geb_autorisiert_in_Kl15;
                    break;
                case 23:
                    SigVal = MsgObj_Gateway_72.WFS_Schluessel_Fahrberecht;
                    break;
                case 24:
                    SigVal = MsgObj_Gateway_72.WWSs_01_alt;
                    break;
                case 25:
                    SigVal = MsgObj_Gateway_72.Waschen_vorne_aktiv;
                    break;
                case 26:
                    SigVal = MsgObj_Gateway_72.Wischer_01_alt;
                    break;
                case 27:
                    SigVal = MsgObj_Gateway_72.Wischer_vorne_aktiv;
                    break;
                case 28:
                    SigVal = MsgObj_Gateway_72.ZV_02_alt;
                    break;
                case 29:
                    SigVal = MsgObj_Gateway_72.ZV_BT_offen;
                    break;
                case 30:
                    SigVal = MsgObj_Gateway_72.ZV_FT_offen;
                    break;
                case 31:
                    SigVal = MsgObj_Gateway_72.ZV_HBFS_offen;
                    break;
                case 32:
                    SigVal = MsgObj_Gateway_72.ZV_HD_offen;
                    break;
                case 33:
                    SigVal = MsgObj_Gateway_72.ZV_HFS_offen;
                    break;
            }
        }
        break;
        case FRM_HANDLE_Gateway_74:
        {
            switch (SigIdx)
            {
                case 0:
                    SigVal = MsgObj_Gateway_74.ELV_01_alt;
                    break;
                case 1:
                    SigVal = MsgObj_Gateway_74.ELV_Anf_Klemme_50;
                    break;
                case 2:
                    SigVal = MsgObj_Gateway_74.EPS_Lenkerposition;
                    break;
                case 3:
                    SigVal = MsgObj_Gateway_74.GW_Status_GRA;
                    break;
                case 4:
                    SigVal = MsgObj_Gateway_74.HLR_01_alt;
                    break;
                case 5:
                    SigVal = MsgObj_Gateway_74.KL_Geblspng_Soll;
                    break;
                case 6:
                    SigVal = MsgObj_Gateway_74.KL_PTC_Verbauinfo;
                    break;
                case 7:
                    SigVal = MsgObj_Gateway_74.KL_Umluftklappe_Status;
                    break;
                case 8:
                    SigVal = MsgObj_Gateway_74.KY_StartStopp_Info;
                    break;
                case 9:
                    SigVal = MsgObj_Gateway_74.Kessy_04_alt;
                    break;
                case 10:
                    SigVal = MsgObj_Gateway_74.Klima_12_alt;
                    break;
                case 11:
                    SigVal = MsgObj_Gateway_74.LH_EPS_01_alt;
                    break;
                case 12:
                    SigVal = MsgObj_Gateway_74.LIN_2_alt;
                    break;
                case 13:
                    SigVal = MsgObj_Gateway_74.LS_Tiptronic_Fehler;
                    break;
                case 14:
                    SigVal = MsgObj_Gateway_74.MFG_01_alt;
                    break;
                case 15:
                    SigVal = MsgObj_Gateway_74.MFL_Tip_Down;
                    break;
                case 16:
                    SigVal = MsgObj_Gateway_74.MFL_Tip_Up;
                    break;
                case 17:
                    SigVal = MsgObj_Gateway_74.MF_Anlassersperre;
                    break;
                case 18:
                    SigVal = MsgObj_Gateway_74.MF_StartStopp_Info;
                    break;
                case 19:
                    SigVal = MsgObj_Gateway_74.PH_StartStopp_Info;
                    break;
                case 20:
                    SigVal = MsgObj_Gateway_74.PH_nachtr_Stopp_Anf;
                    break;
                case 21:
                    SigVal = MsgObj_Gateway_74.PTC_Freigabe;
                    break;
                case 22:
                    SigVal = MsgObj_Gateway_74.Parkhilfe_01_alt;
                    break;
            }
        }
        break;
        case FRM_HANDLE_Getriebe_11:
        {
            switch (SigIdx)
            {
                case 0:
                    SigVal = MsgObj_Getriebe_11.GE_Fahrstufe;
                    break;
                case 1:
                    SigVal = MsgObj_Getriebe_11.GE_Freig_MMom_Vorhalt;
                    break;
                case 2:
                    SigVal = MsgObj_Getriebe_11.GE_MMom_Soll_02;
                    break;
                case 3:
                    SigVal = MsgObj_Getriebe_11.GE_MMom_Status;
                    break;
                case 4:
                    SigVal = MsgObj_Getriebe_11.GE_MMom_Status_02;
                    break;
                case 5:
                    SigVal = MsgObj_Getriebe_11.GE_MMom_Vorhalt_02;
                    break;
                case 6:
                    SigVal = MsgObj_Getriebe_11.GE_Schaltablauf;
                    break;
                case 7:
                    SigVal = MsgObj_Getriebe_11.GE_Status_Kraftschluss;
                    break;
                case 8:
                    SigVal = MsgObj_Getriebe_11.GE_Uefkt;
                    break;
                case 9:
                    SigVal = MsgObj_Getriebe_11.GE_Verbot_Ausblendung;
                    break;
                case 10:
                    SigVal = MsgObj_Getriebe_11.GE_Zielgang;
                    break;
                case 11:
                    SigVal = MsgObj_Getriebe_11.GE_reserv_Fahrstufe;
                    break;
                case 12:
                    SigVal = MsgObj_Getriebe_11.Getriebe_11_BZ;
                    break;
                case 13:
                    SigVal = MsgObj_Getriebe_11.Getriebe_11_CRC;
                    break;
            }
        }
        break;
        case FRM_HANDLE_Getriebe_12:
        {
            switch (SigIdx)
            {
                case 0:
                    SigVal = MsgObj_Getriebe_12.GE_Anheb_Solldrehz_Leerlauf;
                    break;
                case 1:
                    SigVal = MsgObj_Getriebe_12.GE_Aufnahmemoment;
                    break;
                case 2:
                    SigVal = MsgObj_Getriebe_12.GE_Drehzahlmesser_Daempfung;
                    break;
                case 3:
                    SigVal = MsgObj_Getriebe_12.GE_Freigabe_Synchro;
                    break;
                case 4:
                    SigVal = MsgObj_Getriebe_12.GE_HYB_DZ_Eingriff;
                    break;
                case 5:
                    SigVal = MsgObj_Getriebe_12.GE_Mom_Begr_Gradient;
                    break;
                case 6:
                    SigVal = MsgObj_Getriebe_12.GE_Schubabschalt_Unt;
                    break;
                case 7:
                    SigVal = MsgObj_Getriebe_12.GE_Synchro_Status;
                    break;
                case 8:
                    SigVal = MsgObj_Getriebe_12.GE_Synchro_Wunschdrehz;
                    break;
                case 9:
                    SigVal = MsgObj_Getriebe_12.GE_Synchro_Zeit;
                    break;
                case 10:
                    SigVal = MsgObj_Getriebe_12.Getriebe_12_BZ;
                    break;
                case 11:
                    SigVal = MsgObj_Getriebe_12.Getriebe_12_CRC;
                    break;
            }
        }
        break;
        case FRM_HANDLE_Getriebe_13:
        {
            switch (SigIdx)
            {
                case 0:
                    SigVal = MsgObj_Getriebe_13.GE_Anf_Zylabsch;
                    break;
                case 1:
                    SigVal = MsgObj_Getriebe_13.GE_Eingangsdrehz;
                    break;
                case 2:
                    SigVal = MsgObj_Getriebe_13.GE_Entkopplung_Status;
                    break;
                case 3:
                    SigVal = MsgObj_Getriebe_13.GE_Freig_Langfr_Schutzmom;
                    break;
                case 4:
                    SigVal = MsgObj_Getriebe_13.GE_Grenzkriechmoment;
                    break;
                case 5:
                    SigVal = MsgObj_Getriebe_13.GE_Langfr_Schutzmom_02;
                    break;
                case 6:
                    SigVal = MsgObj_Getriebe_13.GE_Notlauf;
                    break;
                case 7:
                    SigVal = MsgObj_Getriebe_13.GE_StartStopp_Info;
                    break;
                case 8:
                    SigVal = MsgObj_Getriebe_13.GE_Verlustmoment_02;
                    break;
                case 9:
                    SigVal = MsgObj_Getriebe_13.Getriebe_13_BZ;
                    break;
                case 10:
                    SigVal = MsgObj_Getriebe_13.Getriebe_13_CRC;
                    break;
            }
        }
        break;
        case FRM_HANDLE_Getriebe_14:
        {
            switch (SigIdx)
            {
                case 0:
                    SigVal = MsgObj_Getriebe_14.Freilauf_Charisma_FahrPr;
                    break;
                case 1:
                    SigVal = MsgObj_Getriebe_14.Freilauf_Charisma_Status;
                    break;
                case 2:
                    SigVal = MsgObj_Getriebe_14.GE_Charisma_FahrPr;
                    break;
                case 3:
                    SigVal = MsgObj_Getriebe_14.GE_Charisma_Status;
                    break;
                case 4:
                    SigVal = MsgObj_Getriebe_14.GE_Codierung_MSG;
                    break;
                case 5:
                    SigVal = MsgObj_Getriebe_14.GE_Freigabe_Verfallsinfo_WFS;
                    break;
                case 6:
                    SigVal = MsgObj_Getriebe_14.GE_Heizwunsch;
                    break;
                case 7:
                    SigVal = MsgObj_Getriebe_14.GE_LFR_Adaption;
                    break;
                case 8:
                    SigVal = MsgObj_Getriebe_14.GE_LaunchControl;
                    break;
                case 9:
                    SigVal = MsgObj_Getriebe_14.GE_OBD_AbsperrVent;
                    break;
                case 10:
                    SigVal = MsgObj_Getriebe_14.GE_OBD_Status;
                    break;
                case 11:
                    SigVal = MsgObj_Getriebe_14.GE_Sumpftemperatur;
                    break;
                case 12:
                    SigVal = MsgObj_Getriebe_14.GE_Verlustmoment_02;
                    break;
                case 13:
                    SigVal = MsgObj_Getriebe_14.GE_Zustand_Kuppltemp;
                    break;
                case 14:
                    SigVal = MsgObj_Getriebe_14.GE_amax_moeglich;
                    break;
            }
        }
        break;
        case FRM_HANDLE_Getriebe_Hybrid_01:
        {
            switch (SigIdx)
            {
                case 0:
                    SigVal = MsgObj_Getriebe_Hybrid_01.GE_HYB_Fehlerstatus;
                    break;
                case 1:
                    SigVal = MsgObj_Getriebe_Hybrid_01.GE_HYB_Filt_MomAufbau;
                    break;
                case 2:
                    SigVal = MsgObj_Getriebe_Hybrid_01.GE_HYB_Freig_VM_EM_Stop;
                    break;
                case 3:
                    SigVal = MsgObj_Getriebe_Hybrid_01.GE_HYB_Freig_sSchl_K0;
                    break;
                case 4:
                    SigVal = MsgObj_Getriebe_Hybrid_01.GE_HYB_Freigabe_K0;
                    break;
                case 5:
                    SigVal = MsgObj_Getriebe_Hybrid_01.GE_HYB_Freigabe_LL_Reg;
                    break;
                case 6:
                    SigVal = MsgObj_Getriebe_Hybrid_01.GE_HYB_MomEingriff_EM;
                    break;
                case 7:
                    SigVal = MsgObj_Getriebe_Hybrid_01.GE_HYB_Sportfaktor;
                    break;
                case 8:
                    SigVal = MsgObj_Getriebe_Hybrid_01.GE_HYB_StartAnf;
                    break;
                case 9:
                    SigVal = MsgObj_Getriebe_Hybrid_01.GE_HYB_VM_Startkontr;
                    break;
                case 10:
                    SigVal = MsgObj_Getriebe_Hybrid_01.GE_HYB_VM_akt_halten;
                    break;
                case 11:
                    SigVal = MsgObj_Getriebe_Hybrid_01.GE_HYB_VZ_MomEingriff_EM;
                    break;
                case 12:
                    SigVal = MsgObj_Getriebe_Hybrid_01.GE_HYB_Wiederstart;
                    break;
                case 13:
                    SigVal = MsgObj_Getriebe_Hybrid_01.GE_HYB_nK0;
                    break;
                case 14:
                    SigVal = MsgObj_Getriebe_Hybrid_01.Getriebe_Hybrid_01_BZ;
                    break;
                case 15:
                    SigVal = MsgObj_Getriebe_Hybrid_01.Getriebe_Hybrid_01_CRC;
                    break;
            }
        }
        break;
        case FRM_HANDLE_HVEM_02:
        {
            switch (SigIdx)
            {
                case 0:
                    SigVal = MsgObj_HVEM_02.HVEM_DauerRed;
                    break;
                case 1:
                    SigVal = MsgObj_HVEM_02.HVEM_FreigabeKlimatisierung;
                    break;
                case 2:
                    SigVal = MsgObj_HVEM_02.HVEM_IstLeistungNA;
                    break;
                case 3:
                    SigVal = MsgObj_HVEM_02.HVEM_IstStrom_HVVerbraucher;
                    break;
                case 4:
                    SigVal = MsgObj_HVEM_02.HVEM_LeistungTMEVorgabe;
                    break;
                case 5:
                    SigVal = MsgObj_HVEM_02.HVEM_MinLeistungNA;
                    break;
                case 6:
                    SigVal = MsgObj_HVEM_02.HVEM_Temp_Vorkond_Innen;
                    break;
            }
        }
        break;
        case FRM_HANDLE_HVEM_04:
        {
            switch (SigIdx)
            {
                case 0:
                    SigVal = MsgObj_HVEM_04.HVEM_Anf_ReichweiteNV;
                    break;
                case 1:
                    SigVal = MsgObj_HVEM_04.HVEM_HV_Anf;
                    break;
                case 2:
                    SigVal = MsgObj_HVEM_04.HVEM_KlimaMaxHVStrom;
                    break;
                case 3:
                    SigVal = MsgObj_HVEM_04.HVEM_LeistungsAnf;
                    break;
                case 4:
                    SigVal = MsgObj_HVEM_04.HVEM_NVLeistungEmpf;
                    break;
                case 5:
                    SigVal = MsgObj_HVEM_04.HVEM_Nachlad_Status;
                    break;
                case 6:
                    SigVal = MsgObj_HVEM_04.HVEM_Nachladen_Anf;
                    break;
                case 7:
                    SigVal = MsgObj_HVEM_04.HVEM_Text_1;
                    break;
            }
        }
        break;
        case FRM_HANDLE_Klemmen_Status_01:
        {
            switch (SigIdx)
            {
                case 0:
                    SigVal = MsgObj_Klemmen_Status_01.BCM_Remotestart_Betrieb;
                    break;
                case 1:
                    SigVal = MsgObj_Klemmen_Status_01.KST_Fahrerhinweis_1;
                    break;
                case 2:
                    SigVal = MsgObj_Klemmen_Status_01.KST_Fahrerhinweis_2;
                    break;
                case 3:
                    SigVal = MsgObj_Klemmen_Status_01.KST_Fahrerhinweis_3;
                    break;
                case 4:
                    SigVal = MsgObj_Klemmen_Status_01.KST_Fahrerhinweis_4;
                    break;
                case 5:
                    SigVal = MsgObj_Klemmen_Status_01.KST_Fahrerhinweis_5;
                    break;
                case 6:
                    SigVal = MsgObj_Klemmen_Status_01.KST_Fahrerhinweis_6;
                    break;
                case 7:
                    SigVal = MsgObj_Klemmen_Status_01.KST_Warn_P1_ZST_def;
                    break;
                case 8:
                    SigVal = MsgObj_Klemmen_Status_01.KST_Warn_P2_ZST_def;
                    break;
                case 9:
                    SigVal = MsgObj_Klemmen_Status_01.Klemmen_Status_01_BZ;
                    break;
                case 10:
                    SigVal = MsgObj_Klemmen_Status_01.Klemmen_Status_01_CRC;
                    break;
                case 11:
                    SigVal = MsgObj_Klemmen_Status_01.ZAS_Kl_15;
                    break;
                case 12:
                    SigVal = MsgObj_Klemmen_Status_01.ZAS_Kl_50_Startanforderung;
                    break;
                case 13:
                    SigVal = MsgObj_Klemmen_Status_01.ZAS_Kl_S;
                    break;
                case 14:
                    SigVal = MsgObj_Klemmen_Status_01.ZAS_Kl_X;
                    break;
            }
        }
        break;
        case FRM_HANDLE_Klima_11:
        {
            switch (SigIdx)
            {
                case 0:
                    SigVal = MsgObj_Klima_11.KL_AC_Schalter;
                    break;
                case 1:
                    SigVal = MsgObj_Klima_11.KL_Anf_KL;
                    break;
                case 2:
                    SigVal = MsgObj_Klima_11.KL_Ausstattung_Klima;
                    break;
                case 3:
                    SigVal = MsgObj_Klima_11.KL_Charisma_FahrPr;
                    break;
                case 4:
                    SigVal = MsgObj_Klima_11.KL_Charisma_Status;
                    break;
                case 5:
                    SigVal = MsgObj_Klima_11.KL_Comp_enable;
                    break;
                case 6:
                    SigVal = MsgObj_Klima_11.KL_Comp_rev_rq;
                    break;
                case 7:
                    SigVal = MsgObj_Klima_11.KL_Drehz_Anh;
                    break;
                case 8:
                    SigVal = MsgObj_Klima_11.KL_Komp_Moment_alt;
                    break;
                case 9:
                    SigVal = MsgObj_Klima_11.KL_Last_Kompr;
                    break;
                case 10:
                    SigVal = MsgObj_Klima_11.KL_Spannungs_Anf;
                    break;
                case 11:
                    SigVal = MsgObj_Klima_11.KL_StartStopp_Info;
                    break;
                case 12:
                    SigVal = MsgObj_Klima_11.KL_Thermomanagement;
                    break;
                case 13:
                    SigVal = MsgObj_Klima_11.KL_Vorwarn_Komp_ein;
                    break;
                case 14:
                    SigVal = MsgObj_Klima_11.KL_Vorwarn_Zuheizer_ein;
                    break;
                case 15:
                    SigVal = MsgObj_Klima_11.KL_Zustand;
                    break;
                case 16:
                    SigVal = MsgObj_Klima_11.KL_el_Zuheizer_Stufe;
                    break;
                case 17:
                    SigVal = MsgObj_Klima_11.KL_nachtr_Stopp_Anf;
                    break;
            }
        }
        break;
        case FRM_HANDLE_Kombi_01:
        {
            switch (SigIdx)
            {
                case 0:
                    SigVal = MsgObj_Kombi_01.KBI_ABS_Lampe;
                    break;
                case 1:
                    SigVal = MsgObj_Kombi_01.KBI_Airbag_Lampe;
                    break;
                case 2:
                    SigVal = MsgObj_Kombi_01.KBI_Anzeigefehler_LDW;
                    break;
                case 3:
                    SigVal = MsgObj_Kombi_01.KBI_Anzeigefehler_NV;
                    break;
                case 4:
                    SigVal = MsgObj_Kombi_01.KBI_Anzeigefehler_SWA;
                    break;
                case 5:
                    SigVal = MsgObj_Kombi_01.KBI_Anzeigestatus_ACC;
                    break;
                case 6:
                    SigVal = MsgObj_Kombi_01.KBI_Anzeigestatus_GRA;
                    break;
                case 7:
                    SigVal = MsgObj_Kombi_01.KBI_Anzeigestatus_LIM;
                    break;
                case 8:
                    SigVal = MsgObj_Kombi_01.KBI_BKL_Lampe;
                    break;
                case 9:
                    SigVal = MsgObj_Kombi_01.KBI_ESP_Lampe;
                    break;
                case 10:
                    SigVal = MsgObj_Kombi_01.KBI_Einheit_Tacho;
                    break;
                case 11:
                    SigVal = MsgObj_Kombi_01.KBI_Fehler_Anzeige_ACC;
                    break;
                case 12:
                    SigVal = MsgObj_Kombi_01.KBI_Handbremse;
                    break;
                case 13:
                    SigVal = MsgObj_Kombi_01.KBI_Konsistenz_ACC;
                    break;
                case 14:
                    SigVal = MsgObj_Kombi_01.KBI_Lenkung_Lampe;
                    break;
                case 15:
                    SigVal = MsgObj_Kombi_01.KBI_MFA_v_Einheit_01;
                    break;
                case 16:
                    SigVal = MsgObj_Kombi_01.KBI_NV_in_Anzeige;
                    break;
                case 17:
                    SigVal = MsgObj_Kombi_01.KBI_Oeldruck_Schalter;
                    break;
                case 18:
                    SigVal = MsgObj_Kombi_01.KBI_Oeldruckwarnung;
                    break;
                case 19:
                    SigVal = MsgObj_Kombi_01.KBI_PLA_in_Anzeige;
                    break;
                case 20:
                    SigVal = MsgObj_Kombi_01.KBI_SILA_gueltig;
                    break;
                case 21:
                    SigVal = MsgObj_Kombi_01.KBI_Tankwarnung;
                    break;
                case 22:
                    SigVal = MsgObj_Kombi_01.KBI_V_Digital;
                    break;
                case 23:
                    SigVal = MsgObj_Kombi_01.KBI_Vorglueh_System_Lampe;
                    break;
                case 24:
                    SigVal = MsgObj_Kombi_01.KBI_angez_Geschw;
                    break;
                case 25:
                    SigVal = MsgObj_Kombi_01.KBI_im_Stellgliedtest;
                    break;
                case 26:
                    SigVal = MsgObj_Kombi_01.Kombi_01_BZ;
                    break;
            }
        }
        break;
        case FRM_HANDLE_Kombi_02:
        {
            switch (SigIdx)
            {
                case 0:
                    SigVal = MsgObj_Kombi_02.KBI_Aussen_Temp_gef;
                    break;
                case 1:
                    SigVal = MsgObj_Kombi_02.KBI_FStatus_Tank;
                    break;
                case 2:
                    SigVal = MsgObj_Kombi_02.KBI_Inhalt_Tank;
                    break;
                case 3:
                    SigVal = MsgObj_Kombi_02.KBI_Kilometerstand;
                    break;
                case 4:
                    SigVal = MsgObj_Kombi_02.KBI_Oelwechsel_durchgefuehrt;
                    break;
                case 5:
                    SigVal = MsgObj_Kombi_02.KBI_QBit_Aussen_Temp_gef;
                    break;
                case 6:
                    SigVal = MsgObj_Kombi_02.KBI_RDK_Kalibrier_Anf;
                    break;
                case 7:
                    SigVal = MsgObj_Kombi_02.KBI_Standzeit_02;
                    break;
            }
        }
        break;
        case FRM_HANDLE_LWI_01:
        {
            switch (SigIdx)
            {
                case 0:
                    SigVal = MsgObj_LWI_01.LWI_01_BZ;
                    break;
                case 1:
                    SigVal = MsgObj_LWI_01.LWI_01_CRC;
                    break;
                case 2:
                    SigVal = MsgObj_LWI_01.LWI_Lenkradw_Geschw;
                    break;
                case 3:
                    SigVal = MsgObj_LWI_01.LWI_Lenkradwinkel;
                    break;
                case 4:
                    SigVal = MsgObj_LWI_01.LWI_QBit_Lenkradwinkel;
                    break;
                case 5:
                    SigVal = MsgObj_LWI_01.LWI_QBit_Sub_Daten;
                    break;
                case 6:
                    SigVal = MsgObj_LWI_01.LWI_Sensorstatus;
                    break;
                case 7:
                    SigVal = MsgObj_LWI_01.LWI_Sub_Daten;
                    break;
                case 8:
                    SigVal = MsgObj_LWI_01.LWI_VZ_Lenkradw_Geschw;
                    break;
                case 9:
                    SigVal = MsgObj_LWI_01.LWI_VZ_Lenkradwinkel;
                    break;
            }
        }
        break;
        case FRM_HANDLE_Licht_hinten_01:
        {
            switch (SigIdx)
            {
                case 0:
                    SigVal = MsgObj_Licht_hinten_01.BCM2_Bremsl_durch_ECD;
                    break;
                case 1:
                    SigVal = MsgObj_Licht_hinten_01.LH_3_Bremsl_def;
                    break;
                case 2:
                    SigVal = MsgObj_Licht_hinten_01.LH_Aussenlicht_def;
                    break;
                case 3:
                    SigVal = MsgObj_Licht_hinten_01.LH_Blinker_HL_akt;
                    break;
                case 4:
                    SigVal = MsgObj_Licht_hinten_01.LH_Blinker_HR_akt;
                    break;
                case 5:
                    SigVal = MsgObj_Licht_hinten_01.LH_Blinker_li_def;
                    break;
                case 6:
                    SigVal = MsgObj_Licht_hinten_01.LH_Blinker_re_def;
                    break;
                case 7:
                    SigVal = MsgObj_Licht_hinten_01.LH_Brems_Blk_li_def;
                    break;
                case 8:
                    SigVal = MsgObj_Licht_hinten_01.LH_Brems_Blk_re_def;
                    break;
                case 9:
                    SigVal = MsgObj_Licht_hinten_01.LH_Bremsl_li_def;
                    break;
                case 10:
                    SigVal = MsgObj_Licht_hinten_01.LH_Bremsl_li_ges_def;
                    break;
                case 11:
                    SigVal = MsgObj_Licht_hinten_01.LH_Bremsl_re_def;
                    break;
                case 12:
                    SigVal = MsgObj_Licht_hinten_01.LH_Bremsl_re_ges_def;
                    break;
                case 13:
                    SigVal = MsgObj_Licht_hinten_01.LH_Bremslicht_H_aktiv;
                    break;
                case 14:
                    SigVal = MsgObj_Licht_hinten_01.LH_Kennzl_def;
                    break;
                case 15:
                    SigVal = MsgObj_Licht_hinten_01.LH_Nebel_li_def;
                    break;
                case 16:
                    SigVal = MsgObj_Licht_hinten_01.LH_Nebel_mi_def;
                    break;
                case 17:
                    SigVal = MsgObj_Licht_hinten_01.LH_Nebel_re_def;
                    break;
                case 18:
                    SigVal = MsgObj_Licht_hinten_01.LH_Nebelschluss_aktiv;
                    break;
                case 19:
                    SigVal = MsgObj_Licht_hinten_01.LH_Parklicht_HL_aktiv;
                    break;
                case 20:
                    SigVal = MsgObj_Licht_hinten_01.LH_Parklicht_HR_aktiv;
                    break;
                case 21:
                    SigVal = MsgObj_Licht_hinten_01.LH_Rueckf_li_def;
                    break;
                case 22:
                    SigVal = MsgObj_Licht_hinten_01.LH_Rueckf_mi_def;
                    break;
                case 23:
                    SigVal = MsgObj_Licht_hinten_01.LH_Rueckf_re_def;
                    break;
                case 24:
                    SigVal = MsgObj_Licht_hinten_01.LH_Rueckfahrlicht_aktiv;
                    break;
                case 25:
                    SigVal = MsgObj_Licht_hinten_01.LH_SL_BRL_BLK_li_def;
                    break;
                case 26:
                    SigVal = MsgObj_Licht_hinten_01.LH_SL_BRL_BLK_re_def;
                    break;
                case 27:
                    SigVal = MsgObj_Licht_hinten_01.LH_Schluss_Brems_Nebel_li_def;
                    break;
                case 28:
                    SigVal = MsgObj_Licht_hinten_01.LH_Schluss_Brems_Nebel_re_def;
                    break;
                case 29:
                    SigVal = MsgObj_Licht_hinten_01.LH_Schluss_Brems_li_def;
                    break;
                case 30:
                    SigVal = MsgObj_Licht_hinten_01.LH_Schluss_Brems_re_def;
                    break;
                case 31:
                    SigVal = MsgObj_Licht_hinten_01.LH_Schluss_Nebel_li_def;
                    break;
                case 32:
                    SigVal = MsgObj_Licht_hinten_01.LH_Schluss_Nebel_re_def;
                    break;
                case 33:
                    SigVal = MsgObj_Licht_hinten_01.LH_Schlusslicht_li_def;
                    break;
                case 34:
                    SigVal = MsgObj_Licht_hinten_01.LH_Schlusslicht_re_def;
                    break;
                case 35:
                    SigVal = MsgObj_Licht_hinten_01.LH_Standlicht_H_aktiv;
                    break;
                case 36:
                    SigVal = MsgObj_Licht_hinten_01.Licht_hinten_01_BZ;
                    break;
            }
        }
        break;
        case FRM_HANDLE_NMH_Gateway:
        {
            switch (SigIdx)
            {
                case 0:
                    SigVal = MsgObj_NMH_Gateway.NM_Gateway_ACAN_Aktivitaet;
                    break;
                case 1:
                    SigVal = MsgObj_NMH_Gateway.NM_Gateway_Bedien_LIN_Aktivitaet;
                    break;
                case 2:
                    SigVal = MsgObj_NMH_Gateway.NM_Gateway_Car_Wakeup;
                    break;
                case 3:
                    SigVal = MsgObj_NMH_Gateway.NM_Gateway_DiagCAN_Aktivitaet;
                    break;
                case 4:
                    SigVal = MsgObj_NMH_Gateway.NM_Gateway_ECAN_Aktivitaet;
                    break;
                case 5:
                    SigVal = MsgObj_NMH_Gateway.NM_Gateway_EM_Aktivitaet;
                    break;
                case 6:
                    SigVal = MsgObj_NMH_Gateway.NM_Gateway_EnergieLIN_Aktivitaet;
                    break;
                case 7:
                    SigVal = MsgObj_NMH_Gateway.NM_Gateway_FCAN_Aktivitaet;
                    break;
                case 8:
                    SigVal = MsgObj_NMH_Gateway.NM_Gateway_ICAN_Aktivitaet;
                    break;
                case 9:
                    SigVal = MsgObj_NMH_Gateway.NM_Gateway_KCAN_Aktivitaet;
                    break;
                case 10:
                    SigVal = MsgObj_NMH_Gateway.NM_Gateway_KS_Aktivitaet;
                    break;
                case 11:
                    SigVal = MsgObj_NMH_Gateway.NM_Gateway_NL_EM;
                    break;
                case 12:
                    SigVal = MsgObj_NMH_Gateway.NM_Gateway_NL_Shutdown;
                    break;
                case 13:
                    SigVal = MsgObj_NMH_Gateway.NM_Gateway_NL_Spg_Messung;
                    break;
                case 14:
                    SigVal = MsgObj_NMH_Gateway.NM_Gateway_NL_Wakeup_Monitor;
                    break;
                case 15:
                    SigVal = MsgObj_NMH_Gateway.NM_Gateway_NM_State;
                    break;
                case 16:
                    SigVal = MsgObj_NMH_Gateway.NM_Gateway_NM_aktiv_Diagnose;
                    break;
                case 17:
                    SigVal = MsgObj_NMH_Gateway.NM_Gateway_NM_aktiv_KL15;
                    break;
                case 18:
                    SigVal = MsgObj_NMH_Gateway.NM_Gateway_NM_aktiv_Tmin;
                    break;
                case 19:
                    SigVal = MsgObj_NMH_Gateway.NM_Gateway_SNI;
                    break;
                case 20:
                    SigVal = MsgObj_NMH_Gateway.NM_Gateway_UDS_CC;
                    break;
                case 21:
                    SigVal = MsgObj_NMH_Gateway.NM_Gateway_Wakeup;
                    break;
            }
        }
        break;
        case FRM_HANDLE_OBD_Tankgeber_01:
        {
            switch (SigIdx)
            {
                case 0:
                    SigVal = MsgObj_OBD_Tankgeber_01.OBD_TG_F_Status_1;
                    break;
                case 1:
                    SigVal = MsgObj_OBD_Tankgeber_01.OBD_TG_F_Status_2;
                    break;
                case 2:
                    SigVal = MsgObj_OBD_Tankgeber_01.OBD_TG_F_Status_3;
                    break;
                case 3:
                    SigVal = MsgObj_OBD_Tankgeber_01.OBD_TG_F_Status_4;
                    break;
                case 4:
                    SigVal = MsgObj_OBD_Tankgeber_01.OBD_TG_Sens_Rohwert_1;
                    break;
                case 5:
                    SigVal = MsgObj_OBD_Tankgeber_01.OBD_TG_Sens_Rohwert_2;
                    break;
                case 6:
                    SigVal = MsgObj_OBD_Tankgeber_01.OBD_TG_Sens_Rohwert_3;
                    break;
                case 7:
                    SigVal = MsgObj_OBD_Tankgeber_01.OBD_TG_Sens_Rohwert_4;
                    break;
            }
        }
        break;
        case FRM_HANDLE_Remotestart_FFB:
        {
            switch (SigIdx)
            {
                case 0:
                    SigVal = MsgObj_Remotestart_FFB.RSF_Tastencode_1;
                    break;
                case 1:
                    SigVal = MsgObj_Remotestart_FFB.RSF_Tastencode_2;
                    break;
                case 2:
                    SigVal = MsgObj_Remotestart_FFB.RSF_Tastencode_Maske;
                    break;
            }
        }
        break;
        case FRM_HANDLE_STH_01:
        {
            switch (SigIdx)
            {
                case 0:
                    SigVal = MsgObj_STH_01.STH_EKP_Anst;
                    break;
                case 1:
                    SigVal = MsgObj_STH_01.STH_Fehler_ElWaPu;
                    break;
                case 2:
                    SigVal = MsgObj_STH_01.STH_Fehlerstatus;
                    break;
                case 3:
                    SigVal = MsgObj_STH_01.STH_Funk_aus;
                    break;
                case 4:
                    SigVal = MsgObj_STH_01.STH_Funk_ein;
                    break;
                case 5:
                    SigVal = MsgObj_STH_01.STH_Geblaese;
                    break;
                case 6:
                    SigVal = MsgObj_STH_01.STH_Heizleistung;
                    break;
                case 7:
                    SigVal = MsgObj_STH_01.STH_KD_Fehler;
                    break;
                case 8:
                    SigVal = MsgObj_STH_01.STH_KVS;
                    break;
                case 9:
                    SigVal = MsgObj_STH_01.STH_KVS_Ueberlauf;
                    break;
                case 10:
                    SigVal = MsgObj_STH_01.STH_LED;
                    break;
                case 11:
                    SigVal = MsgObj_STH_01.STH_Motorvorwaermung;
                    break;
                case 12:
                    SigVal = MsgObj_STH_01.STH_Pumpe_ein;
                    break;
                case 13:
                    SigVal = MsgObj_STH_01.STH_Pumpen_Anf_extern;
                    break;
                case 14:
                    SigVal = MsgObj_STH_01.STH_Servicemode;
                    break;
                case 15:
                    SigVal = MsgObj_STH_01.STH_Start_folgt;
                    break;
                case 16:
                    SigVal = MsgObj_STH_01.STH_Texte;
                    break;
                case 17:
                    SigVal = MsgObj_STH_01.STH_Ventil_Status;
                    break;
                case 18:
                    SigVal = MsgObj_STH_01.STH_Ventiloeffnungszeit;
                    break;
                case 19:
                    SigVal = MsgObj_STH_01.STH_Waermeeintrag;
                    break;
                case 20:
                    SigVal = MsgObj_STH_01.STH_Wassertemp;
                    break;
                case 21:
                    SigVal = MsgObj_STH_01.STH_Zusatzheizung;
                    break;
                case 22:
                    SigVal = MsgObj_STH_01.STH_war_aktiv;
                    break;
            }
        }
        break;
        case FRM_HANDLE_STS_01:
        {
            switch (SigIdx)
            {
                case 0:
                    SigVal = MsgObj_STS_01.STS_01_BZ;
                    break;
                case 1:
                    SigVal = MsgObj_STS_01.STS_01_CRC;
                    break;
                case 2:
                    SigVal = MsgObj_STS_01.STS_Alarm_Blinker;
                    break;
                case 3:
                    SigVal = MsgObj_STS_01.STS_Alarm_still;
                    break;
                case 4:
                    SigVal = MsgObj_STS_01.STS_Anlassersperre;
                    break;
                case 5:
                    SigVal = MsgObj_STS_01.STS_Car_not_under_theft;
                    break;
                case 6:
                    SigVal = MsgObj_STS_01.STS_Car_under_theft;
                    break;
                case 7:
                    SigVal = MsgObj_STS_01.STS_Fahrlicht;
                    break;
                case 8:
                    SigVal = MsgObj_STS_01.STS_LIN_aktiv;
                    break;
                case 9:
                    SigVal = MsgObj_STS_01.STS_Laderelais;
                    break;
                case 10:
                    SigVal = MsgObj_STS_01.STS_Leerlaufschaltung;
                    break;
                case 11:
                    SigVal = MsgObj_STS_01.STS_Notstart;
                    break;
                case 12:
                    SigVal = MsgObj_STS_01.STS_Signalhorn;
                    break;
                case 13:
                    SigVal = MsgObj_STS_01.STS_Standlicht;
                    break;
                case 14:
                    SigVal = MsgObj_STS_01.STS_Summer;
                    break;
                case 15:
                    SigVal = MsgObj_STS_01.STS_Texte;
                    break;
                case 16:
                    SigVal = MsgObj_STS_01.STS_Typencodierung;
                    break;
            }
        }
        break;
        case FRM_HANDLE_Systeminfo_01:
        {
            switch (SigIdx)
            {
                case 0:
                    SigVal = MsgObj_Systeminfo_01.GW_KD_Fehler;
                    break;
                case 1:
                    SigVal = MsgObj_Systeminfo_01.SI_BUS_01;
                    break;
                case 2:
                    SigVal = MsgObj_Systeminfo_01.SI_BUS_02;
                    break;
                case 3:
                    SigVal = MsgObj_Systeminfo_01.SI_BUS_03;
                    break;
                case 4:
                    SigVal = MsgObj_Systeminfo_01.SI_BUS_04;
                    break;
                case 5:
                    SigVal = MsgObj_Systeminfo_01.SI_BUS_05;
                    break;
                case 6:
                    SigVal = MsgObj_Systeminfo_01.SI_BUS_06;
                    break;
                case 7:
                    SigVal = MsgObj_Systeminfo_01.SI_BUS_07;
                    break;
                case 8:
                    SigVal = MsgObj_Systeminfo_01.SI_BUS_08;
                    break;
                case 9:
                    SigVal = MsgObj_Systeminfo_01.SI_BUS_09;
                    break;
                case 10:
                    SigVal = MsgObj_Systeminfo_01.SI_BUS_10;
                    break;
                case 11:
                    SigVal = MsgObj_Systeminfo_01.SI_BUS_11;
                    break;
                case 12:
                    SigVal = MsgObj_Systeminfo_01.SI_BUS_12;
                    break;
                case 13:
                    SigVal = MsgObj_Systeminfo_01.SI_BUS_13;
                    break;
                case 14:
                    SigVal = MsgObj_Systeminfo_01.SI_BUS_14;
                    break;
                case 15:
                    SigVal = MsgObj_Systeminfo_01.SI_BUS_15;
                    break;
                case 16:
                    SigVal = MsgObj_Systeminfo_01.SI_Bus_Identifikation;
                    break;
                case 17:
                    SigVal = MsgObj_Systeminfo_01.SI_NWDF;
                    break;
                case 18:
                    SigVal = MsgObj_Systeminfo_01.SI_NWDF_gueltig;
                    break;
                case 19:
                    SigVal = MsgObj_Systeminfo_01.SI_QRS_Mode;
                    break;
                case 20:
                    SigVal = MsgObj_Systeminfo_01.SI_Sammel_SG_Fehler;
                    break;
                case 21:
                    SigVal = MsgObj_Systeminfo_01.SI_Sammelfehler;
                    break;
                case 22:
                    SigVal = MsgObj_Systeminfo_01.SI_T_Mode;
                    break;
                case 23:
                    SigVal = MsgObj_Systeminfo_01.SI_T_Schutz;
                    break;
            }
        }
        break;
        case FRM_HANDLE_WBA_03:
        {
            switch (SigIdx)
            {
                case 0:
                    SigVal = MsgObj_WBA_03.GE_Sollgang;
                    break;
                case 1:
                    SigVal = MsgObj_WBA_03.GE_Stoppverbot_Anz_01;
                    break;
                case 2:
                    SigVal = MsgObj_WBA_03.GE_Stoppverbot_Anz_02;
                    break;
                case 3:
                    SigVal = MsgObj_WBA_03.GE_Stoppverbot_Anz_03;
                    break;
                case 4:
                    SigVal = MsgObj_WBA_03.GE_Stoppverbot_Anz_04;
                    break;
                case 5:
                    SigVal = MsgObj_WBA_03.GE_Stoppverbot_Anz_05;
                    break;
                case 6:
                    SigVal = MsgObj_WBA_03.GE_Stoppverbot_Anz_06;
                    break;
                case 7:
                    SigVal = MsgObj_WBA_03.GE_Stoppverbot_Anz_07;
                    break;
                case 8:
                    SigVal = MsgObj_WBA_03.GE_Stoppverbot_Anz_Std;
                    break;
                case 9:
                    SigVal = MsgObj_WBA_03.GE_Tipschaltempf_verfuegbar;
                    break;
                case 10:
                    SigVal = MsgObj_WBA_03.GE_Wiederstart_Anz_Std;
                    break;
                case 11:
                    SigVal = MsgObj_WBA_03.WBA_03_BZ;
                    break;
                case 12:
                    SigVal = MsgObj_WBA_03.WBA_03_CRC;
                    break;
                case 13:
                    SigVal = MsgObj_WBA_03.WBA_Fahrstufe_02;
                    break;
                case 14:
                    SigVal = MsgObj_WBA_03.WBA_GE_Texte;
                    break;
                case 15:
                    SigVal = MsgObj_WBA_03.WBA_GE_Warnung_02;
                    break;
                case 16:
                    SigVal = MsgObj_WBA_03.WBA_GE_Zusatzwarnungen;
                    break;
                case 17:
                    SigVal = MsgObj_WBA_03.WBA_Schaltschema;
                    break;
                case 18:
                    SigVal = MsgObj_WBA_03.WBA_Segeln_aktiv;
                    break;
                case 19:
                    SigVal = MsgObj_WBA_03.WBA_ZielFahrstufe;
                    break;
                case 20:
                    SigVal = MsgObj_WBA_03.WBA_eing_Gang_02;
                    break;
            }
        }
        break;
    }

    return (SigVal);
}
/*@@end*/

/*@@caplFunc:ShowPrompt():*/
ShowPrompt ()
{
    int SigVal = 0;

    switch (CaplCtrl_LevelActv)
    {
        /* currently no level selected */
        case CAPLCTRL_LEVEL_NOSEL:
        {
            if (CaplCtrl_PromptMode == CAPLCTRL_PROMPTMODE_NUM)
            {
                write("# > %s", CaplCtrl_InputBuf);
            }
            else
            {
                write("# > %s", CaplCtrl_CharBuf);
            }
        }
        break;

        case CAPLCTRL_LEVEL_FRAME:
        {
            GetFrameName(CaplCtrl_FrameActv);

            if (CaplCtrl_PromptMode == CAPLCTRL_PROMPTMODE_NUM)
            {
                write("# %s> %s", CaplCtrl_FrameName, CaplCtrl_InputBuf);
            }
            else
            {
                write("# %s> %s", CaplCtrl_FrameName, CaplCtrl_CharBuf);
            }
        }
        break;

        case CAPLCTRL_LEVEL_SIGNAL:
        {
            GetFrameName(CaplCtrl_FrameActv);
            GetSignalName(CaplCtrl_FrameActv, CaplCtrl_SignalActv);

            SigVal = GetSignalVal(CaplCtrl_FrameActv, CaplCtrl_SignalActv);

            if (CaplCtrl_PromptMode == CAPLCTRL_PROMPTMODE_NUM)
            {
                write("# %s.%s = %d> %s", CaplCtrl_FrameName, CaplCtrl_SignalName, SigVal, CaplCtrl_InputBuf);
            }
            else
            {
                write("# %s.%s = %d> %s", CaplCtrl_FrameName, CaplCtrl_SignalName, SigVal, CaplCtrl_CharBuf);
            }
        }
        break;
    }
}
/*@@end*/

/*@@caplFunc:Frm_CalcChecksumCRC8(int,message*,byte):*/
byte Frm_CalcChecksumCRC8(int FrmIdx, message *MsgObj, byte endval)
{
    int idx;
    byte crc;

    /* calculate CRC8 checksum */
    crc = 0xFF;
    /* IMPORTANT NOTE: assumes CRC8 is in byte 0 */
    for (idx = 1; idx < MsgObj.DLC; idx++)
    {
        crc = CRC8_tab_256[(MsgObj.BYTE(idx) ^ crc)];
    }
    crc = CRC8_tab_256[(endval ^ crc)];
    crc = ~crc;

    /* checksum calculation disabled, make sure checksum is wrong */
    if (Frm_MsgChksmEna[FrmIdx] == 0)
    {
        crc = ~crc;
    }

   	return (crc);
}
/*@@end*/

/*@@caplFunc:Frm_CalcChecksumCRC8Id(int,message*):*/
byte Frm_CalcChecksumCRC8Id(int FrmIdx, message *MsgObj)
{
    byte crcid;

    /* XOR high byte and low byte of CAN ID - used as checksum end value */
	crcid = MsgObj.ID;
    crcid = crcid ^ ((MsgObj.ID >> 8) & 0xFF);

    return Frm_CalcChecksumCRC8(FrmIdx, MsgObj, crcid);
}
/*@@end*/

/*@@caplFunc:Frm_CalcChecksumCRC8Dyn(int,message*,int):*/
byte Frm_CalcChecksumCRC8Dyn(int FrmIdx, message *MsgObj, int MsgCnt)
{
    byte crcid;
    byte ChksmEndVal[FRM_NUM_MAX][16] =
    {
        { 0x37,0x7d,0xf3,0xa9,0x18,0x46,0x6d,0x4d,0x3d,0x71,0x92,0x9c,0xe5,0x32,0x10,0xb9 },
        { 0x40,0x40,0x40,0x40,0x40,0x40,0x40,0x40,0x40,0x40,0x40,0x40,0x40,0x40,0x40,0x40 },
        { 0x44,0x44,0x44,0x44,0x44,0x44,0x44,0x44,0x44,0x44,0x44,0x44,0x44,0x44,0x44,0x44 },
        { 0x00,0x00,0x00,0x00,0x00,0x00,0x00,0x00,0x00,0x00,0x00,0x00,0x00,0x00,0x00,0x00 },
        { 0x00,0x00,0x00,0x00,0x00,0x00,0x00,0x00,0x00,0x00,0x00,0x00,0x00,0x00,0x00,0x00 },
        { 0x00,0x00,0x00,0x00,0x00,0x00,0x00,0x00,0x00,0x00,0x00,0x00,0x00,0x00,0x00,0x00 },
        { 0x41,0x41,0x41,0x41,0x41,0x41,0x41,0x41,0x41,0x41,0x41,0x41,0x41,0x41,0x41,0x41 },
        { 0x00,0x00,0x00,0x00,0x00,0x00,0x00,0x00,0x00,0x00,0x00,0x00,0x00,0x00,0x00,0x00 },
        { 0x00,0x00,0x00,0x00,0x00,0x00,0x00,0x00,0x00,0x00,0x00,0x00,0x00,0x00,0x00,0x00 },
        { 0x00,0x00,0x00,0x00,0x00,0x00,0x00,0x00,0x00,0x00,0x00,0x00,0x00,0x00,0x00,0x00 },
        { 0x00,0x00,0x00,0x00,0x00,0x00,0x00,0x00,0x00,0x00,0x00,0x00,0x00,0x00,0x00,0x00 },
        { 0x05,0x05,0x05,0x05,0x05,0x05,0x05,0x05,0x05,0x05,0x05,0x05,0x05,0x05,0x05,0x05 },
        { 0xaa,0xaa,0xaa,0xaa,0xaa,0xaa,0xaa,0xaa,0xaa,0xaa,0xaa,0xaa,0xaa,0xaa,0xaa,0xaa },
        { 0x07,0x07,0x07,0x07,0x07,0x07,0x07,0x07,0x07,0x07,0x07,0x07,0x07,0x07,0x07,0x07 },
        { 0x91,0x91,0x91,0x91,0x91,0x91,0x91,0x91,0x91,0x91,0x91,0x91,0x91,0x91,0x91,0x91 },
        { 0xac,0xac,0xac,0xac,0xac,0xac,0xac,0xac,0xac,0xac,0xac,0xac,0xac,0xac,0xac,0xac },
        { 0x00,0x00,0x00,0x00,0x00,0x00,0x00,0x00,0x00,0x00,0x00,0x00,0x00,0x00,0x00,0x00 },
        { 0xac,0xb3,0xab,0xeb,0x7a,0xe1,0x3b,0xf7,0x73,0xba,0x7c,0x9e,0x06,0x5f,0x02,0xd9 },
        { 0xb4,0xef,0xf8,0x49,0x1e,0xe5,0xc2,0xc0,0x97,0x19,0x3c,0xc9,0xf1,0x98,0xd6,0x61 },
        { 0x00,0x00,0x00,0x00,0x00,0x00,0x00,0x00,0x00,0x00,0x00,0x00,0x00,0x00,0x00,0x00 },
        { 0x6a,0x38,0xb4,0x27,0x22,0xef,0xe1,0xbb,0xf8,0x80,0x84,0x49,0xc7,0x9e,0x1e,0x2b },
        { 0x00,0x00,0x00,0x00,0x00,0x00,0x00,0x00,0x00,0x00,0x00,0x00,0x00,0x00,0x00,0x00 },
        { 0x00,0x00,0x00,0x00,0x00,0x00,0x00,0x00,0x00,0x00,0x00,0x00,0x00,0x00,0x00,0x00 },
        { 0x3f,0x69,0x39,0xdc,0x94,0xf9,0x14,0x64,0xd8,0x6a,0x34,0xce,0xa2,0x55,0xb5,0x2c },
        { 0xe6,0x58,0xed,0xb7,0xcc,0x03,0xf2,0x85,0x1c,0x41,0x3d,0x13,0xc3,0x20,0xc6,0x34 },
        { 0x71,0x8d,0xaa,0x78,0x12,0x0c,0xf1,0x68,0xb3,0x7e,0xd0,0x3a,0xd2,0x5e,0x34,0x31 },
        { 0x00,0x00,0x00,0x00,0x00,0x00,0x00,0x00,0x00,0x00,0x00,0x00,0x00,0x00,0x00,0x00 },
        { 0x9e,0x9e,0x9e,0x9e,0x9e,0x9e,0x9e,0x9e,0x9e,0x9e,0x9e,0x9e,0x9e,0x9e,0x9e,0x9e },
        { 0x00,0x00,0x00,0x00,0x00,0x00,0x00,0x00,0x00,0x00,0x00,0x00,0x00,0x00,0x00,0x00 },
        { 0x00,0x00,0x00,0x00,0x00,0x00,0x00,0x00,0x00,0x00,0x00,0x00,0x00,0x00,0x00,0x00 },
        { 0xc3,0xc3,0xc3,0xc3,0xc3,0xc3,0xc3,0xc3,0xc3,0xc3,0xc3,0xc3,0xc3,0xc3,0xc3,0xc3 },
        { 0x00,0x00,0x00,0x00,0x00,0x00,0x00,0x00,0x00,0x00,0x00,0x00,0x00,0x00,0x00,0x00 },
        { 0x00,0x00,0x00,0x00,0x00,0x00,0x00,0x00,0x00,0x00,0x00,0x00,0x00,0x00,0x00,0x00 },
        { 0x00,0x00,0x00,0x00,0x00,0x00,0x00,0x00,0x00,0x00,0x00,0x00,0x00,0x00,0x00,0x00 },
        { 0x86,0x86,0x86,0x86,0x86,0x86,0x86,0x86,0x86,0x86,0x86,0x86,0x86,0x86,0x86,0x86 },
        { 0x00,0x00,0x00,0x00,0x00,0x00,0x00,0x00,0x00,0x00,0x00,0x00,0x00,0x00,0x00,0x00 },
        { 0x00,0x00,0x00,0x00,0x00,0x00,0x00,0x00,0x00,0x00,0x00,0x00,0x00,0x00,0x00,0x00 },
        { 0x00,0x00,0x00,0x00,0x00,0x00,0x00,0x00,0x00,0x00,0x00,0x00,0x00,0x00,0x00,0x00 },
        { 0x00,0x00,0x00,0x00,0x00,0x00,0x00,0x00,0x00,0x00,0x00,0x00,0x00,0x00,0x00,0x00 },
        { 0x00,0x00,0x00,0x00,0x00,0x00,0x00,0x00,0x00,0x00,0x00,0x00,0x00,0x00,0x00,0x00 },
        { 0x90,0x90,0x90,0x90,0x90,0x90,0x90,0x90,0x90,0x90,0x90,0x90,0x90,0x90,0x90,0x90 },
        { 0x00,0x00,0x00,0x00,0x00,0x00,0x00,0x00,0x00,0x00,0x00,0x00,0x00,0x00,0x00,0x00 },
        { 0x00,0x00,0x00,0x00,0x00,0x00,0x00,0x00,0x00,0x00,0x00,0x00,0x00,0x00,0x00,0x00 }
    };

    /* checksum end value is based on message counter value */
    crcid = ChksmEndVal[FrmIdx][MsgCnt];

    return Frm_CalcChecksumCRC8(FrmIdx, MsgObj, crcid);
}
/*@@end*/

/*@@caplFunc:Frm_CalcChecksumXOR(int,message*,int):*/
byte Frm_CalcChecksumXOR(int FrmIdx, message *MsgObj, int dChksmIdx)
{
    int idx;
    byte chksm;

    /* reset checksum byte */
    MsgObj.BYTE(dChksmIdx) = 0;

    /* init checksum value */
    chksm = 0;

    /* calculate checksum */
    for (idx = 0; idx < MsgObj.DLC; idx++)
    {
        if (idx != dChksmIdx)
        {
            /* XOR all bytes */
            chksm = chksm ^ MsgObj.BYTE(idx);
        }
    }

    /* checksum calculation disabled, make sure checksum is wrong */
    if (Frm_MsgChksmEna[FrmIdx] == 0)
    {
        chksm = ~chksm;
    }

	return (chksm);
}
/*@@end*/

/*@@caplFunc:Frm_CalcChecksumXORID(int,message*,int):*/
byte Frm_CalcChecksumXORID(int FrmIdx, message *MsgObj, int dChksmIdx)
{
    int idx;
    byte chksm;

    /* reset checksum byte */
    MsgObj.BYTE(dChksmIdx) = 0;

    /* init checksum value */
    chksm = 0;

    /* calculate checksum */
    for (idx = 0; idx < MsgObj.DLC; idx++)
    {
        if (idx != dChksmIdx)
        {
            /* XOR all bytes */
            chksm = chksm ^ MsgObj.BYTE(idx);
        }
    }

    /* add high and low byte of CAN ID */
    chksm = chksm ^ (MsgObj.ID & 0xFF);
    chksm = chksm ^ ((MsgObj.ID >> 8) & 0xFF);

    /* checksum calculation disabled, make sure checksum is wrong */
    if (Frm_MsgChksmEna[FrmIdx] == 0)
    {
        chksm = ~chksm;
    }

	return (chksm);
}
/*@@end*/

/*@@caplFunc:Frm_CalcChecksumLW1(int,message*,int):*/
byte Frm_CalcChecksumLW1(int FrmIdx, message *MsgObj, int dChksmIdx)
{
    int idx;
    byte chksm;

    /* reset checksum byte */
    MsgObj.BYTE(dChksmIdx) = 0;

    /* init checksum value */
    chksm = 0;

    /* calculate checksum */
    chksm = ((MsgObj.BYTE(0) + MsgObj.BYTE(1) + MsgObj.BYTE(2) + MsgObj.BYTE(3) + MsgObj.BYTE(5)) & 0xFF);
    chksm = ~chksm;

    /* checksum calculation disabled, make sure checksum is wrong */
    if (Frm_MsgChksmEna[FrmIdx] == 0)
    {
        chksm = ~chksm;
    }

	return (chksm);
}
/*@@end*/

/*@@caplFunc:Frm_CalcMsgCounter(int):*/
int Frm_CalcMsgCounter(int FrmIdx)
{
    /* IMPORTANT NOTE: currently it is assumed that message counter is 4 bit long */
    if (Frm_MsgCounterEna[FrmIdx] != 0)
    {
        Frm_MsgCounter[FrmIdx] ++;
        Frm_MsgCounter[FrmIdx] &= 0x0F;
    }

    return (Frm_MsgCounter[FrmIdx]);
}
/*@@end*/

/*@@caplFunc:FrmSch_EnableFrame(long):*/
FrmSch_EnableFrame(long FrmIdx)
{
    /* enable TX of CAN frame */
    FrmSched_FrmEna[FrmIdx] = 1;
}
/*@@end*/

/*@@caplFunc:FrmSch_DisableFrame(long):*/
FrmSch_DisableFrame(long FrmIdx)
{
    /* enable TX of CAN frame */
    FrmSched_FrmEna[FrmIdx] = 0;
}
/*@@end*/

/*@@caplFunc:FrmSch_EnableAllFrames():*/
FrmSch_EnableAllFrames()
{
    int FrmIdx;

    for (FrmIdx = 0; FrmIdx < FRM_NUM_MAX; FrmIdx++)
    {
        /* enable scheduler for all frames */
        FrmSched_FrmEna[FrmIdx] = 1;
    }
}
/*@@end*/

/*@@caplFunc:FrmSch_DisableAllFrames():*/
FrmSch_DisableAllFrames()
{
    int FrmIdx;

    for (FrmIdx = 0; FrmIdx < FRM_NUM_MAX; FrmIdx++)
    {
        /* disable scheduler for all frames */
        FrmSched_FrmEna[FrmIdx] = 0;
    }
}
/*@@end*/

/*@@caplFunc:Frm_EnableMsgCounter(long):*/
Frm_EnableMsgCounter(long FrmIdx)
{
    /* enable message counter calculation */
    Frm_MsgCounterEna[FrmIdx] = 1;
}
/*@@end*/

/*@@caplFunc:Frm_DisableMsgCounter(long):*/
Frm_DisableMsgCounter(long FrmIdx)
{
    /* disable message counter calculation */
    Frm_MsgCounterEna[FrmIdx] = 0;
}
/*@@end*/

/*@@caplFunc:Frm_EnableChksm(long):*/
Frm_EnableChksm(long FrmIdx)
{
    /* enable checksum calculation */
    Frm_MsgChksmEna[FrmIdx] = 1;
}
/*@@end*/

/*@@caplFunc:Frm_DisableChksm(long):*/
Frm_DisableChksm(long FrmIdx)
{
    /* disable checksum calculation */
    Frm_MsgChksmEna[FrmIdx] = 0;
}
/*@@end*/

