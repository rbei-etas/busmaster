/*@@var:*/
/* TemplateVersion: 1.0.2 */
variables 
{
    /**********************************************************************************************/
    /* BEGIN AUTO                                                                                 */
    /**********************************************************************************************/
    
    message BMS_HYB_02 MsgObj_BMS_HYB_02;
    message BMS_HYB_03 MsgObj_BMS_HYB_03;
    message BMS_HYB_04 MsgObj_BMS_HYB_04;
    message BMS_HYB_06 MsgObj_BMS_HYB_06;
    message CCU_HYB_01 MsgObj_CCU_HYB_01;
    message CCU_HYB_02 MsgObj_CCU_HYB_02;
    message DC_HYB_01 MsgObj_DC_HYB_01;
    message DC_HYB_02 MsgObj_DC_HYB_02;
    message EM_HYB_02 MsgObj_EM_HYB_02;
    message EM_HYB_03 MsgObj_EM_HYB_03;
    message EM_HYB_04 MsgObj_EM_HYB_04;
    message EM_HYB_05 MsgObj_EM_HYB_05;
    message EM_HYB_06 MsgObj_EM_HYB_06;
    message FIS_1 MsgObj_FIS_1;

    const FRM_HANDLE_BMS_HYB_02 = 0;
    const FRM_HANDLE_BMS_HYB_03 = 1;
    const FRM_HANDLE_BMS_HYB_04 = 2;
    const FRM_HANDLE_BMS_HYB_06 = 3;
    const FRM_HANDLE_CCU_HYB_01 = 4;
    const FRM_HANDLE_CCU_HYB_02 = 5;
    const FRM_HANDLE_DC_HYB_01 = 6;
    const FRM_HANDLE_DC_HYB_02 = 7;
    const FRM_HANDLE_EM_HYB_02 = 8;
    const FRM_HANDLE_EM_HYB_03 = 9;
    const FRM_HANDLE_EM_HYB_04 = 10;
    const FRM_HANDLE_EM_HYB_05 = 11;
    const FRM_HANDLE_EM_HYB_06 = 12;
    const FRM_HANDLE_FIS_1 = 13;

    const FRM_NUM_MAX = 14;


    /**********************************************************************************************/
    /* END AUTO                                                                                   */
    /**********************************************************************************************/


    /* ------------------------------------------------------------------------------------------ */
    /*  timer                                                                                     */
    /* ------------------------------------------------------------------------------------------ */
    msTimer Timer_10ms;                   /* 10ms base timer */
    const TIMER_DURATION_10MS = 10;       /* timer duration for 10ms timer */
    

    /* ------------------------------------------------------------------------------------------ */
    /*  frame scheduler                                                                           */
    /* ------------------------------------------------------------------------------------------ */
    int FrmSched_SchedTmr[FRM_NUM_MAX];   /* schedule timer, incremented every 10ms, resolution [1ms] */
    int FrmSched_CycleTime[FRM_NUM_MAX];  /* cycle time of the CAN frame, resolution [1ms] */
    int FrmSched_FrmEna[FRM_NUM_MAX];     /* frame enable status */


    /* ------------------------------------------------------------------------------------------ */
    /*  frame manager                                                                             */
    /* ------------------------------------------------------------------------------------------ */
    int Frm_MsgCounter[FRM_NUM_MAX];      /* current message counter value */
    int Frm_MsgCounterEna[FRM_NUM_MAX];   /* message counter enable status */
    int Frm_MsgChksmEna[FRM_NUM_MAX];     /* checksum enable status */
    int Frm_DLC[FRM_NUM_MAX];             /* DLC */
    int Frm_DLCOk[FRM_NUM_MAX];           /* DLC status (0=DLC wrong, 1=DLC ok) */

    
    /* ------------------------------------------------------------------------------------------ */
    /*  CAPL control                                                                              */
    /* ------------------------------------------------------------------------------------------ */
    const CAPLCTRL_LEVEL_NOSEL = 0;
    const CAPLCTRL_LEVEL_FRAME = 1;
    const CAPLCTRL_LEVEL_SIGNAL = 2;

    const CAPLCTRL_NOVAL = -1;

    const CAPLCTRL_INPUTBUF_LEN = 32;
    const CAPLCTRL_CHARBUF_LEN = 64;

    const CAPLCTRL_PROMPTMODE_NUM = 0;
    const CAPLCTRL_PROMPTMODE_CHAR = 1;

    int  CaplCtrl_LevelActv = CAPLCTRL_LEVEL_NOSEL;  /* current active level */
    int  CaplCtrl_FrameActv = 0;                     /* current selected frame */
    int  CaplCtrl_SignalActv = 0;                    /* current selected signal */
    int  CaplCtrl_InputValue = 0;                    /* current input value */
    char CaplCtrl_InputBuf[CAPLCTRL_INPUTBUF_LEN];   /* user input buffer */
    int  CaplCtrl_InputIdx = 0;                      /* index into input buffer */
    char CaplCtrl_FrameName[32];                     /* buffer to store frame name */
    char CaplCtrl_SignalName[64];                    /* buffer to store signal name */
    int  CaplCtrl_PromptMode;                        /* prompt mode */
    char CaplCtrl_CharBuf[CAPLCTRL_CHARBUF_LEN];     /* buffer for char output in prompt */


    /* ------------------------------------------------------------------------------------------ */
    /*  key codes                                                                                 */
    /* ------------------------------------------------------------------------------------------ */
    const KEY_ENTER = 0x0D;
    const KEY_BACKSPACE = 0x08;
    const KEY_UP = 0x4800;
    const KEY_DOWN = 0x5000;
    const KEY_TAB = 0x09;
    const KEY_LEVEL_DOWN = '.';
    const KEY_TIMEOUT = 'a';
    const KEY_MSGCNT = 'b';
    const KEY_CHKSM = 'c';
    const KEY_DLC = 'd';
    const KEY_HELP = '?';


    /* ------------------------------------------------------------------------------------------ */
    /*  checksum related variables                                                                */
    /* ------------------------------------------------------------------------------------------ */
    byte CRC8_tab_256[256] =
    {
        0x00, 0x2f, 0x5e, 0x71, 0xbc, 0x93, 0xe2, 0xcd,
        0x57, 0x78, 0x09, 0x26, 0xeb, 0xc4, 0xb5, 0x9a,
        0xae, 0x81, 0xf0, 0xdf, 0x12, 0x3d, 0x4c, 0x63,
        0xf9, 0xd6, 0xa7, 0x88, 0x45, 0x6a, 0x1b, 0x34,
        0x73, 0x5c, 0x2d, 0x02, 0xcf, 0xe0, 0x91, 0xbe,
        0x24, 0x0b, 0x7a, 0x55, 0x98, 0xb7, 0xc6, 0xe9,
        0xdd, 0xf2, 0x83, 0xac, 0x61, 0x4e, 0x3f, 0x10,
        0x8a, 0xa5, 0xd4, 0xfb, 0x36, 0x19, 0x68, 0x47,
        0xe6, 0xc9, 0xb8, 0x97, 0x5a, 0x75, 0x04, 0x2b,
        0xb1, 0x9e, 0xef, 0xc0, 0x0d, 0x22, 0x53, 0x7c,
        0x48, 0x67, 0x16, 0x39, 0xf4, 0xdb, 0xaa, 0x85,
        0x1f, 0x30, 0x41, 0x6e, 0xa3, 0x8c, 0xfd, 0xd2,
        0x95, 0xba, 0xcb, 0xe4, 0x29, 0x06, 0x77, 0x58,
        0xc2, 0xed, 0x9c, 0xb3, 0x7e, 0x51, 0x20, 0x0f,
        0x3b, 0x14, 0x65, 0x4a, 0x87, 0xa8, 0xd9, 0xf6,
        0x6c, 0x43, 0x32, 0x1d, 0xd0, 0xff, 0x8e, 0xa1,
        0xe3, 0xcc, 0xbd, 0x92, 0x5f, 0x70, 0x01, 0x2e,
        0xb4, 0x9b, 0xea, 0xc5, 0x08, 0x27, 0x56, 0x79,
        0x4d, 0x62, 0x13, 0x3c, 0xf1, 0xde, 0xaf, 0x80,
        0x1a, 0x35, 0x44, 0x6b, 0xa6, 0x89, 0xf8, 0xd7,
        0x90, 0xbf, 0xce, 0xe1, 0x2c, 0x03, 0x72, 0x5d,
        0xc7, 0xe8, 0x99, 0xb6, 0x7b, 0x54, 0x25, 0x0a,
        0x3e, 0x11, 0x60, 0x4f, 0x82, 0xad, 0xdc, 0xf3,
        0x69, 0x46, 0x37, 0x18, 0xd5, 0xfa, 0x8b, 0xa4,
        0x05, 0x2a, 0x5b, 0x74, 0xb9, 0x96, 0xe7, 0xc8,
        0x52, 0x7d, 0x0c, 0x23, 0xee, 0xc1, 0xb0, 0x9f,
        0xab, 0x84, 0xf5, 0xda, 0x17, 0x38, 0x49, 0x66,
        0xfc, 0xd3, 0xa2, 0x8d, 0x40, 0x6f, 0x1e, 0x31,
        0x76, 0x59, 0x28, 0x07, 0xca, 0xe5, 0x94, 0xbb,
        0x21, 0x0e, 0x7f, 0x50, 0x9d, 0xb2, 0xc3, 0xec,
        0xd8, 0xf7, 0x86, 0xa9, 0x64, 0x4b, 0x3a, 0x15,
        0x8f, 0xa0, 0xd1, 0xfe, 0x33, 0x1c, 0x6d, 0x42
    };
}
/*@@end*/

/*@@timer:Timer_10ms:*/
on timer Timer_10ms
{
    int FrmIdx;

    /* restart the 10ms timer */
    setTimer(Timer_10ms,TIMER_DURATION_10MS);


    /* ------------------------------------------------------------------------------------------ */
    /*  BEGIN Frame Scheduler                                                                     */
    /* ------------------------------------------------------------------------------------------ */

    for (FrmIdx = 0; FrmIdx < FRM_NUM_MAX; FrmIdx++)
    {
        /* check if frame is enabled */
        if (FrmSched_FrmEna[FrmIdx] != 0)
        {
            /* increment schedule timer */
            FrmSched_SchedTmr[FrmIdx] += 10;
        }
        else
        {
            /* frame disabled, stop schedule timer */
            FrmSched_SchedTmr[FrmIdx] = 0;
        }

        /* if schedule timer reaches cycle time, trigger transfer of CAN frame */
        if (FrmSched_SchedTmr[FrmIdx] >= FrmSched_CycleTime[FrmIdx])
        {
            /* reset schedule timer */
            FrmSched_SchedTmr[FrmIdx] = 0;

            /* trigger transmission of frame */
            FrmSched_SendFrame(FrmIdx);
        }
    }

    /* ------------------------------------------------------------------------------------------ */
    /*  END Frame Scheduler                                                                       */
    /* ------------------------------------------------------------------------------------------ */
}
/*@@end*/

/*@@preStart:PreStart:*/
on preStart
{
    dword fhdlIn;
    dword fhdlOut;
    
    /* ------------------------------------------------------------------------------------------ */
    /*  BEGIN frame and signal handle export for remote control of CAPL by Perl script            */
    /* ------------------------------------------------------------------------------------------ */

    /* check if CAPL is remote controlled by CaplCtrl Perl script */
    /* NOTE: Communication between CAPL program and Perl scritp is done via file, since with */
    /*       CANalyzer Version v4 it is not possible to use environment variables, so this is */
    /*       just a workaround. */
    fhdlIn = openFileRead ("caplctrl_req.txt", 0);
    if (fhdlIn != 0)
    {
        /* close input file */
        fileClose(fhdlIn);

        /* export frame and signal handles to file for remote control scripts */
        fhdlOut = openFileWrite ("caplctrl.txt", 0);
        if (fhdlOut != 0)
        {
            /* NOTE:   handles are 2 bytes long. */
            /* LAYOUT: frame handle: lower byte = 0xFF, upper byte = frame handle for CAPL program */
            /*         signal handle: lower byte = signal index, upper byte = frame index */
            filePutString ("BMS_HYB_02;255\n", 15, fhdlOut);
            filePutString ("BMS_HYB_02;BMS2;AliasName\n", 26, fhdlOut);    /* alias frame handle for BMS_HYB_02 */
            filePutString ("BMS_HYB_03;511\n", 15, fhdlOut);
            filePutString ("BMS_HYB_03;BMS3;AliasName\n", 26, fhdlOut);    /* alias frame handle for BMS_HYB_03 */
            filePutString ("BMS_HYB_04;767\n", 15, fhdlOut);
            filePutString ("BMS_HYB_04;BMS4;AliasName\n", 26, fhdlOut);    /* alias frame handle for BMS_HYB_04 */
            filePutString ("BMS_HYB_06;1023\n", 16, fhdlOut);
            filePutString ("BMS_HYB_06;BMS6;AliasName\n", 26, fhdlOut);    /* alias frame handle for BMS_HYB_06 */
            filePutString ("CCU_HYB_01;1279\n", 16, fhdlOut);
            filePutString ("CCU_HYB_01;CCU1;AliasName\n", 26, fhdlOut);    /* alias frame handle for CCU_HYB_01 */
            filePutString ("CCU_HYB_02;1535\n", 16, fhdlOut);
            filePutString ("CCU_HYB_02;CCU2;AliasName\n", 26, fhdlOut);    /* alias frame handle for CCU_HYB_02 */
            filePutString ("DC_HYB_01;1791\n", 15, fhdlOut);
            filePutString ("DC_HYB_01;DC1;AliasName\n", 24, fhdlOut);    /* alias frame handle for DC_HYB_01 */
            filePutString ("DC_HYB_02;2047\n", 15, fhdlOut);
            filePutString ("DC_HYB_02;DC2;AliasName\n", 24, fhdlOut);    /* alias frame handle for DC_HYB_02 */
            filePutString ("EM_HYB_02;2303\n", 15, fhdlOut);
            filePutString ("EM_HYB_02;EM2;AliasName\n", 24, fhdlOut);    /* alias frame handle for EM_HYB_02 */
            filePutString ("EM_HYB_03;2559\n", 15, fhdlOut);
            filePutString ("EM_HYB_03;EM3;AliasName\n", 24, fhdlOut);    /* alias frame handle for EM_HYB_03 */
            filePutString ("EM_HYB_04;2815\n", 15, fhdlOut);
            filePutString ("EM_HYB_04;EM4;AliasName\n", 24, fhdlOut);    /* alias frame handle for EM_HYB_04 */
            filePutString ("EM_HYB_05;3071\n", 15, fhdlOut);
            filePutString ("EM_HYB_05;EM5;AliasName\n", 24, fhdlOut);    /* alias frame handle for EM_HYB_05 */
            filePutString ("EM_HYB_06;3327\n", 15, fhdlOut);
            filePutString ("EM_HYB_06;EM6;AliasName\n", 24, fhdlOut);    /* alias frame handle for EM_HYB_06 */
            filePutString ("FIS_1;3583\n", 11, fhdlOut);
            filePutString ("FIS_1;FIS1;AliasName\n", 21, fhdlOut);    /* alias frame handle for FIS_1 */

            filePutString ("BY02_Checksumme;0\n", 18, fhdlOut);
            filePutString ("BY02_Checksumme/BMS_HYB_02;0\n", 29, fhdlOut);
            filePutString ("BY02_Checksumme/BMS2;0\n", 23, fhdlOut);
            filePutString ("BY02_ErrContactorOpen;1\n", 24, fhdlOut);
            filePutString ("BY02_ErrContactorOpen/BMS_HYB_02;1\n", 35, fhdlOut);
            filePutString ("BY02_ErrContactorOpen/BMS2;1\n", 29, fhdlOut);
            filePutString ("BY02_ErrContactorWelding;2\n", 27, fhdlOut);
            filePutString ("BY02_ErrContactorWelding/BMS_HYB_02;2\n", 38, fhdlOut);
            filePutString ("BY02_ErrContactorWelding/BMS2;2\n", 32, fhdlOut);
            filePutString ("BY02_ErrEmrgcyShtOffCrash;3\n", 28, fhdlOut);
            filePutString ("BY02_ErrEmrgcyShtOffCrash/BMS_HYB_02;3\n", 39, fhdlOut);
            filePutString ("BY02_ErrEmrgcyShtOffCrash/BMS2;3\n", 33, fhdlOut);
            filePutString ("BY02_ErrEmrgcyShtOffPilotLine;4\n", 32, fhdlOut);
            filePutString ("BY02_ErrEmrgcyShtOffPilotLine/BMS_HYB_02;4\n", 43, fhdlOut);
            filePutString ("BY02_ErrEmrgcyShtOffPilotLine/BMS2;4\n", 37, fhdlOut);
            filePutString ("BY02_ErrInsulation;5\n", 21, fhdlOut);
            filePutString ("BY02_ErrInsulation/BMS_HYB_02;5\n", 32, fhdlOut);
            filePutString ("BY02_ErrInsulation/BMS2;5\n", 26, fhdlOut);
            filePutString ("BY02_ErrLimitedPerformance;6\n", 29, fhdlOut);
            filePutString ("BY02_ErrLimitedPerformance/BMS_HYB_02;6\n", 40, fhdlOut);
            filePutString ("BY02_ErrLimitedPerformance/BMS2;6\n", 34, fhdlOut);
            filePutString ("BY02_ErrShtOff;7\n", 17, fhdlOut);
            filePutString ("BY02_ErrShtOff/BMS_HYB_02;7\n", 28, fhdlOut);
            filePutString ("BY02_ErrShtOff/BMS2;7\n", 22, fhdlOut);
            filePutString ("BY02_ErrShtOffReq;8\n", 20, fhdlOut);
            filePutString ("BY02_ErrShtOffReq/BMS_HYB_02;8\n", 31, fhdlOut);
            filePutString ("BY02_ErrShtOffReq/BMS2;8\n", 25, fhdlOut);
            filePutString ("BY02_IsoTestActv;9\n", 19, fhdlOut);
            filePutString ("BY02_IsoTestActv/BMS_HYB_02;9\n", 30, fhdlOut);
            filePutString ("BY02_IsoTestActv/BMS2;9\n", 24, fhdlOut);
            filePutString ("BY02_ReadyInit;10\n", 18, fhdlOut);
            filePutString ("BY02_ReadyInit/BMS_HYB_02;10\n", 29, fhdlOut);
            filePutString ("BY02_ReadyInit/BMS2;10\n", 23, fhdlOut);
            filePutString ("BY02_SleepInd;11\n", 17, fhdlOut);
            filePutString ("BY02_SleepInd/BMS_HYB_02;11\n", 28, fhdlOut);
            filePutString ("BY02_SleepInd/BMS2;11\n", 22, fhdlOut);
            filePutString ("BY02_Zaehler;12\n", 16, fhdlOut);
            filePutString ("BY02_Zaehler/BMS_HYB_02;12\n", 27, fhdlOut);
            filePutString ("BY02_Zaehler/BMS2;12\n", 21, fhdlOut);
            filePutString ("BY02_iCurr;13\n", 14, fhdlOut);
            filePutString ("BY02_iCurr/BMS_HYB_02;13\n", 25, fhdlOut);
            filePutString ("BY02_iCurr/BMS2;13\n", 19, fhdlOut);
            filePutString ("BY02_res_42;14\n", 15, fhdlOut);
            filePutString ("BY02_res_42/BMS_HYB_02;14\n", 26, fhdlOut);
            filePutString ("BY02_res_42/BMS2;14\n", 20, fhdlOut);
            filePutString ("BY02_res_43;15\n", 15, fhdlOut);
            filePutString ("BY02_res_43/BMS_HYB_02;15\n", 26, fhdlOut);
            filePutString ("BY02_res_43/BMS2;15\n", 20, fhdlOut);
            filePutString ("BY02_res_44;16\n", 15, fhdlOut);
            filePutString ("BY02_res_44/BMS_HYB_02;16\n", 26, fhdlOut);
            filePutString ("BY02_res_44/BMS2;16\n", 20, fhdlOut);
            filePutString ("BY02_res_45;17\n", 15, fhdlOut);
            filePutString ("BY02_res_45/BMS_HYB_02;17\n", 26, fhdlOut);
            filePutString ("BY02_res_45/BMS2;17\n", 20, fhdlOut);
            filePutString ("BY02_res_46;18\n", 15, fhdlOut);
            filePutString ("BY02_res_46/BMS_HYB_02;18\n", 26, fhdlOut);
            filePutString ("BY02_res_46/BMS2;18\n", 20, fhdlOut);
            filePutString ("BY02_res_47;19\n", 15, fhdlOut);
            filePutString ("BY02_res_47/BMS_HYB_02;19\n", 26, fhdlOut);
            filePutString ("BY02_res_47/BMS2;19\n", 20, fhdlOut);
            filePutString ("BY02_res_48;20\n", 15, fhdlOut);
            filePutString ("BY02_res_48/BMS_HYB_02;20\n", 26, fhdlOut);
            filePutString ("BY02_res_48/BMS2;20\n", 20, fhdlOut);
            filePutString ("BY02_res_57;21\n", 15, fhdlOut);
            filePutString ("BY02_res_57/BMS_HYB_02;21\n", 26, fhdlOut);
            filePutString ("BY02_res_57/BMS2;21\n", 20, fhdlOut);
            filePutString ("BY02_res_58;22\n", 15, fhdlOut);
            filePutString ("BY02_res_58/BMS_HYB_02;22\n", 26, fhdlOut);
            filePutString ("BY02_res_58/BMS2;22\n", 20, fhdlOut);
            filePutString ("BY02_res_59;23\n", 15, fhdlOut);
            filePutString ("BY02_res_59/BMS_HYB_02;23\n", 26, fhdlOut);
            filePutString ("BY02_res_59/BMS2;23\n", 20, fhdlOut);
            filePutString ("BY02_res_60;24\n", 15, fhdlOut);
            filePutString ("BY02_res_60/BMS_HYB_02;24\n", 26, fhdlOut);
            filePutString ("BY02_res_60/BMS2;24\n", 20, fhdlOut);
            filePutString ("BY02_res_61;25\n", 15, fhdlOut);
            filePutString ("BY02_res_61/BMS_HYB_02;25\n", 26, fhdlOut);
            filePutString ("BY02_res_61/BMS2;25\n", 20, fhdlOut);
            filePutString ("BY02_res_62;26\n", 15, fhdlOut);
            filePutString ("BY02_res_62/BMS_HYB_02;26\n", 26, fhdlOut);
            filePutString ("BY02_res_62/BMS2;26\n", 20, fhdlOut);
            filePutString ("BY02_res_63;27\n", 15, fhdlOut);
            filePutString ("BY02_res_63/BMS_HYB_02;27\n", 26, fhdlOut);
            filePutString ("BY02_res_63/BMS2;27\n", 20, fhdlOut);
            filePutString ("BY02_stMode;28\n", 15, fhdlOut);
            filePutString ("BY02_stMode/BMS_HYB_02;28\n", 26, fhdlOut);
            filePutString ("BY02_stMode/BMS2;28\n", 20, fhdlOut);
            filePutString ("BY02_uCurr;29\n", 14, fhdlOut);
            filePutString ("BY02_uCurr/BMS_HYB_02;29\n", 25, fhdlOut);
            filePutString ("BY02_uCurr/BMS2;29\n", 19, fhdlOut);
            filePutString ("BY03_BattFanSpd;256\n", 20, fhdlOut);
            filePutString ("BY03_BattFanSpd/BMS_HYB_03;256\n", 31, fhdlOut);
            filePutString ("BY03_BattFanSpd/BMS3;256\n", 25, fhdlOut);
            filePutString ("BY03_Checksumme;257\n", 20, fhdlOut);
            filePutString ("BY03_Checksumme/BMS_HYB_03;257\n", 31, fhdlOut);
            filePutString ("BY03_Checksumme/BMS3;257\n", 25, fhdlOut);
            filePutString ("BY03_Zaehler;258\n", 17, fhdlOut);
            filePutString ("BY03_Zaehler/BMS_HYB_03;258\n", 28, fhdlOut);
            filePutString ("BY03_Zaehler/BMS3;258\n", 22, fhdlOut);
            filePutString ("BY03_iChPredMax;259\n", 20, fhdlOut);
            filePutString ("BY03_iChPredMax/BMS_HYB_03;259\n", 31, fhdlOut);
            filePutString ("BY03_iChPredMax/BMS3;259\n", 25, fhdlOut);
            filePutString ("BY03_iDisChPredMax;260\n", 23, fhdlOut);
            filePutString ("BY03_iDisChPredMax/BMS_HYB_03;260\n", 34, fhdlOut);
            filePutString ("BY03_iDisChPredMax/BMS3;260\n", 28, fhdlOut);
            filePutString ("BY03_rSOC;261\n", 14, fhdlOut);
            filePutString ("BY03_rSOC/BMS_HYB_03;261\n", 25, fhdlOut);
            filePutString ("BY03_rSOC/BMS3;261\n", 19, fhdlOut);
            filePutString ("BY03_uChPredMin;262\n", 20, fhdlOut);
            filePutString ("BY03_uChPredMin/BMS_HYB_03;262\n", 31, fhdlOut);
            filePutString ("BY03_uChPredMin/BMS3;262\n", 25, fhdlOut);
            filePutString ("BY03_uDisChPredMin;263\n", 23, fhdlOut);
            filePutString ("BY03_uDisChPredMin/BMS_HYB_03;263\n", 34, fhdlOut);
            filePutString ("BY03_uDisChPredMin/BMS3;263\n", 28, fhdlOut);
            filePutString ("BY04_Checksumme;512\n", 20, fhdlOut);
            filePutString ("BY04_Checksumme/BMS_HYB_04;512\n", 31, fhdlOut);
            filePutString ("BY04_Checksumme/BMS4;512\n", 25, fhdlOut);
            filePutString ("BY04_ExtRngActv;513\n", 20, fhdlOut);
            filePutString ("BY04_ExtRngActv/BMS_HYB_04;513\n", 31, fhdlOut);
            filePutString ("BY04_ExtRngActv/BMS4;513\n", 25, fhdlOut);
            filePutString ("BY04_Zaehler;514\n", 17, fhdlOut);
            filePutString ("BY04_Zaehler/BMS_HYB_04;514\n", 28, fhdlOut);
            filePutString ("BY04_Zaehler/BMS4;514\n", 22, fhdlOut);
            filePutString ("BY04_iChMax;515\n", 16, fhdlOut);
            filePutString ("BY04_iChMax/BMS_HYB_04;515\n", 27, fhdlOut);
            filePutString ("BY04_iChMax/BMS4;515\n", 21, fhdlOut);
            filePutString ("BY04_iDisChMax;516\n", 19, fhdlOut);
            filePutString ("BY04_iDisChMax/BMS_HYB_04;516\n", 30, fhdlOut);
            filePutString ("BY04_iDisChMax/BMS4;516\n", 24, fhdlOut);
            filePutString ("BY04_res_53;517\n", 16, fhdlOut);
            filePutString ("BY04_res_53/BMS_HYB_04;517\n", 27, fhdlOut);
            filePutString ("BY04_res_53/BMS4;517\n", 21, fhdlOut);
            filePutString ("BY04_res_54;518\n", 16, fhdlOut);
            filePutString ("BY04_res_54/BMS_HYB_04;518\n", 27, fhdlOut);
            filePutString ("BY04_res_54/BMS4;518\n", 21, fhdlOut);
            filePutString ("BY04_res_55;519\n", 16, fhdlOut);
            filePutString ("BY04_res_55/BMS_HYB_04;519\n", 27, fhdlOut);
            filePutString ("BY04_res_55/BMS4;519\n", 21, fhdlOut);
            filePutString ("BY04_res_56;520\n", 16, fhdlOut);
            filePutString ("BY04_res_56/BMS_HYB_04;520\n", 27, fhdlOut);
            filePutString ("BY04_res_56/BMS4;520\n", 21, fhdlOut);
            filePutString ("BY04_res_57;521\n", 16, fhdlOut);
            filePutString ("BY04_res_57/BMS_HYB_04;521\n", 27, fhdlOut);
            filePutString ("BY04_res_57/BMS4;521\n", 21, fhdlOut);
            filePutString ("BY04_res_58;522\n", 16, fhdlOut);
            filePutString ("BY04_res_58/BMS_HYB_04;522\n", 27, fhdlOut);
            filePutString ("BY04_res_58/BMS4;522\n", 21, fhdlOut);
            filePutString ("BY04_res_59;523\n", 16, fhdlOut);
            filePutString ("BY04_res_59/BMS_HYB_04;523\n", 27, fhdlOut);
            filePutString ("BY04_res_59/BMS4;523\n", 21, fhdlOut);
            filePutString ("BY04_res_60;524\n", 16, fhdlOut);
            filePutString ("BY04_res_60/BMS_HYB_04;524\n", 27, fhdlOut);
            filePutString ("BY04_res_60/BMS4;524\n", 21, fhdlOut);
            filePutString ("BY04_res_61;525\n", 16, fhdlOut);
            filePutString ("BY04_res_61/BMS_HYB_04;525\n", 27, fhdlOut);
            filePutString ("BY04_res_61/BMS4;525\n", 21, fhdlOut);
            filePutString ("BY04_res_62;526\n", 16, fhdlOut);
            filePutString ("BY04_res_62/BMS_HYB_04;526\n", 27, fhdlOut);
            filePutString ("BY04_res_62/BMS4;526\n", 21, fhdlOut);
            filePutString ("BY04_res_63;527\n", 16, fhdlOut);
            filePutString ("BY04_res_63/BMS_HYB_04;527\n", 27, fhdlOut);
            filePutString ("BY04_res_63/BMS4;527\n", 21, fhdlOut);
            filePutString ("BY04_uChDynMin;528\n", 19, fhdlOut);
            filePutString ("BY04_uChDynMin/BMS_HYB_04;528\n", 30, fhdlOut);
            filePutString ("BY04_uChDynMin/BMS4;528\n", 24, fhdlOut);
            filePutString ("BY04_uDisChDynMin;529\n", 22, fhdlOut);
            filePutString ("BY04_uDisChDynMin/BMS_HYB_04;529\n", 33, fhdlOut);
            filePutString ("BY04_uDisChDynMin/BMS4;529\n", 27, fhdlOut);
            filePutString ("BY06_BalancingReq;768\n", 22, fhdlOut);
            filePutString ("BY06_BalancingReq/BMS_HYB_06;768\n", 33, fhdlOut);
            filePutString ("BY06_BalancingReq/BMS6;768\n", 27, fhdlOut);
            filePutString ("BY06_Checksumme;769\n", 20, fhdlOut);
            filePutString ("BY06_Checksumme/BMS_HYB_06;769\n", 31, fhdlOut);
            filePutString ("BY06_Checksumme/BMS6;769\n", 25, fhdlOut);
            filePutString ("BY06_LftSOH;770\n", 16, fhdlOut);
            filePutString ("BY06_LftSOH/BMS_HYB_06;770\n", 27, fhdlOut);
            filePutString ("BY06_LftSOH/BMS6;770\n", 21, fhdlOut);
            filePutString ("BY06_MILReq;771\n", 16, fhdlOut);
            filePutString ("BY06_MILReq/BMS_HYB_06;771\n", 27, fhdlOut);
            filePutString ("BY06_MILReq/BMS6;771\n", 21, fhdlOut);
            filePutString ("BY06_RedLEDReq;772\n", 19, fhdlOut);
            filePutString ("BY06_RedLEDReq/BMS_HYB_06;772\n", 30, fhdlOut);
            filePutString ("BY06_RedLEDReq/BMS6;772\n", 24, fhdlOut);
            filePutString ("BY06_VentilationReq;773\n", 24, fhdlOut);
            filePutString ("BY06_VentilationReq/BMS_HYB_06;773\n", 35, fhdlOut);
            filePutString ("BY06_VentilationReq/BMS6;773\n", 29, fhdlOut);
            filePutString ("BY06_YellowLEDReq;774\n", 22, fhdlOut);
            filePutString ("BY06_YellowLEDReq/BMS_HYB_06;774\n", 33, fhdlOut);
            filePutString ("BY06_YellowLEDReq/BMS6;774\n", 27, fhdlOut);
            filePutString ("BY06_Zaehler;775\n", 17, fhdlOut);
            filePutString ("BY06_Zaehler/BMS_HYB_06;775\n", 28, fhdlOut);
            filePutString ("BY06_Zaehler/BMS6;775\n", 22, fhdlOut);
            filePutString ("BY06_res_61;776\n", 16, fhdlOut);
            filePutString ("BY06_res_61/BMS_HYB_06;776\n", 27, fhdlOut);
            filePutString ("BY06_res_61/BMS6;776\n", 21, fhdlOut);
            filePutString ("BY06_res_62;777\n", 16, fhdlOut);
            filePutString ("BY06_res_62/BMS_HYB_06;777\n", 27, fhdlOut);
            filePutString ("BY06_res_62/BMS6;777\n", 21, fhdlOut);
            filePutString ("BY06_res_63;778\n", 16, fhdlOut);
            filePutString ("BY06_res_63/BMS_HYB_06;778\n", 27, fhdlOut);
            filePutString ("BY06_res_63/BMS6;778\n", 21, fhdlOut);
            filePutString ("BY06_tAirIn;779\n", 16, fhdlOut);
            filePutString ("BY06_tAirIn/BMS_HYB_06;779\n", 27, fhdlOut);
            filePutString ("BY06_tAirIn/BMS6;779\n", 21, fhdlOut);
            filePutString ("BY06_tCurr;780\n", 15, fhdlOut);
            filePutString ("BY06_tCurr/BMS_HYB_06;780\n", 26, fhdlOut);
            filePutString ("BY06_tCurr/BMS6;780\n", 20, fhdlOut);
            filePutString ("BY06_uChMax;781\n", 16, fhdlOut);
            filePutString ("BY06_uChMax/BMS_HYB_06;781\n", 27, fhdlOut);
            filePutString ("BY06_uChMax/BMS6;781\n", 21, fhdlOut);
            filePutString ("BY06_uDisChMin;782\n", 19, fhdlOut);
            filePutString ("BY06_uDisChMin/BMS_HYB_06;782\n", 30, fhdlOut);
            filePutString ("BY06_uDisChMin/BMS6;782\n", 24, fhdlOut);
            filePutString ("CY01_AngSpdCurr;1024\n", 21, fhdlOut);
            filePutString ("CY01_AngSpdCurr/CCU_HYB_01;1024\n", 32, fhdlOut);
            filePutString ("CY01_AngSpdCurr/CCU1;1024\n", 26, fhdlOut);
            filePutString ("CY01_Checksumme;1025\n", 21, fhdlOut);
            filePutString ("CY01_Checksumme/CCU_HYB_01;1025\n", 32, fhdlOut);
            filePutString ("CY01_Checksumme/CCU1;1025\n", 26, fhdlOut);
            filePutString ("CY01_ErrCAN;1026\n", 17, fhdlOut);
            filePutString ("CY01_ErrCAN/CCU_HYB_01;1026\n", 28, fhdlOut);
            filePutString ("CY01_ErrCAN/CCU1;1026\n", 22, fhdlOut);
            filePutString ("CY01_ErrHW;1027\n", 16, fhdlOut);
            filePutString ("CY01_ErrHW/CCU_HYB_01;1027\n", 27, fhdlOut);
            filePutString ("CY01_ErrHW/CCU1;1027\n", 21, fhdlOut);
            filePutString ("CY01_ErrMech;1028\n", 18, fhdlOut);
            filePutString ("CY01_ErrMech/CCU_HYB_01;1028\n", 29, fhdlOut);
            filePutString ("CY01_ErrMech/CCU1;1028\n", 23, fhdlOut);
            filePutString ("CY01_ErrTempHigh;1029\n", 22, fhdlOut);
            filePutString ("CY01_ErrTempHigh/CCU_HYB_01;1029\n", 33, fhdlOut);
            filePutString ("CY01_ErrTempHigh/CCU1;1029\n", 27, fhdlOut);
            filePutString ("CY01_ErrTempWarn;1030\n", 22, fhdlOut);
            filePutString ("CY01_ErrTempWarn/CCU_HYB_01;1030\n", 33, fhdlOut);
            filePutString ("CY01_ErrTempWarn/CCU1;1030\n", 27, fhdlOut);
            filePutString ("CY01_ErrUBattLow;1031\n", 22, fhdlOut);
            filePutString ("CY01_ErrUBattLow/CCU_HYB_01;1031\n", 33, fhdlOut);
            filePutString ("CY01_ErrUBattLow/CCU1;1031\n", 27, fhdlOut);
            filePutString ("CY01_SleepInd;1032\n", 19, fhdlOut);
            filePutString ("CY01_SleepInd/CCU_HYB_01;1032\n", 30, fhdlOut);
            filePutString ("CY01_SleepInd/CCU1;1032\n", 24, fhdlOut);
            filePutString ("CY01_Zaehler;1033\n", 18, fhdlOut);
            filePutString ("CY01_Zaehler/CCU_HYB_01;1033\n", 29, fhdlOut);
            filePutString ("CY01_Zaehler/CCU1;1033\n", 23, fhdlOut);
            filePutString ("CY01_i2trqCurr;1034\n", 20, fhdlOut);
            filePutString ("CY01_i2trqCurr/CCU_HYB_01;1034\n", 31, fhdlOut);
            filePutString ("CY01_i2trqCurr/CCU1;1034\n", 25, fhdlOut);
            filePutString ("CY01_pCurr;1035\n", 16, fhdlOut);
            filePutString ("CY01_pCurr/CCU_HYB_01;1035\n", 27, fhdlOut);
            filePutString ("CY01_pCurr/CCU1;1035\n", 21, fhdlOut);
            filePutString ("CY01_posCurr;1036\n", 18, fhdlOut);
            filePutString ("CY01_posCurr/CCU_HYB_01;1036\n", 29, fhdlOut);
            filePutString ("CY01_posCurr/CCU1;1036\n", 23, fhdlOut);
            filePutString ("CY01_stMode;1037\n", 17, fhdlOut);
            filePutString ("CY01_stMode/CCU_HYB_01;1037\n", 28, fhdlOut);
            filePutString ("CY01_stMode/CCU1;1037\n", 22, fhdlOut);
            filePutString ("CY02_Checksumme;1280\n", 21, fhdlOut);
            filePutString ("CY02_Checksumme/CCU_HYB_02;1280\n", 32, fhdlOut);
            filePutString ("CY02_Checksumme/CCU2;1280\n", 26, fhdlOut);
            filePutString ("CY02_HW_Version;1281\n", 21, fhdlOut);
            filePutString ("CY02_HW_Version/CCU_HYB_02;1281\n", 32, fhdlOut);
            filePutString ("CY02_HW_Version/CCU2;1281\n", 26, fhdlOut);
            filePutString ("CY02_Medium;1282\n", 17, fhdlOut);
            filePutString ("CY02_Medium/CCU_HYB_02;1282\n", 28, fhdlOut);
            filePutString ("CY02_Medium/CCU2;1282\n", 22, fhdlOut);
            filePutString ("CY02_SPart_Number;1283\n", 23, fhdlOut);
            filePutString ("CY02_SPart_Number/CCU_HYB_02;1283\n", 34, fhdlOut);
            filePutString ("CY02_SPart_Number/CCU2;1283\n", 28, fhdlOut);
            filePutString ("CY02_SW_Version;1284\n", 21, fhdlOut);
            filePutString ("CY02_SW_Version/CCU_HYB_02;1284\n", 32, fhdlOut);
            filePutString ("CY02_SW_Version/CCU2;1284\n", 26, fhdlOut);
            filePutString ("CY02_Serial_Number;1285\n", 24, fhdlOut);
            filePutString ("CY02_Serial_Number/CCU_HYB_02;1285\n", 35, fhdlOut);
            filePutString ("CY02_Serial_Number/CCU2;1285\n", 29, fhdlOut);
            filePutString ("CY02_Zaehler;1286\n", 18, fhdlOut);
            filePutString ("CY02_Zaehler/CCU_HYB_02;1286\n", 29, fhdlOut);
            filePutString ("CY02_Zaehler/CCU2;1286\n", 23, fhdlOut);
            filePutString ("DY01_Checksumme;1536\n", 21, fhdlOut);
            filePutString ("DY01_Checksumme/DC_HYB_01;1536\n", 31, fhdlOut);
            filePutString ("DY01_Checksumme/DC1;1536\n", 25, fhdlOut);
            filePutString ("DY01_ErrLimitedPerformance;1537\n", 32, fhdlOut);
            filePutString ("DY01_ErrLimitedPerformance/DC_HYB_01;1537\n", 42, fhdlOut);
            filePutString ("DY01_ErrLimitedPerformance/DC1;1537\n", 36, fhdlOut);
            filePutString ("DY01_ErrShtOff;1538\n", 20, fhdlOut);
            filePutString ("DY01_ErrShtOff/DC_HYB_01;1538\n", 30, fhdlOut);
            filePutString ("DY01_ErrShtOff/DC1;1538\n", 24, fhdlOut);
            filePutString ("DY01_ErrVltg;1539\n", 18, fhdlOut);
            filePutString ("DY01_ErrVltg/DC_HYB_01;1539\n", 28, fhdlOut);
            filePutString ("DY01_ErrVltg/DC1;1539\n", 22, fhdlOut);
            filePutString ("DY01_SleepIndication;1540\n", 26, fhdlOut);
            filePutString ("DY01_SleepIndication/DC_HYB_01;1540\n", 36, fhdlOut);
            filePutString ("DY01_SleepIndication/DC1;1540\n", 30, fhdlOut);
            filePutString ("DY01_SlowControlActv;1541\n", 26, fhdlOut);
            filePutString ("DY01_SlowControlActv/DC_HYB_01;1541\n", 36, fhdlOut);
            filePutString ("DY01_SlowControlActv/DC1;1541\n", 30, fhdlOut);
            filePutString ("DY01_Zaehler;1542\n", 18, fhdlOut);
            filePutString ("DY01_Zaehler/DC_HYB_01;1542\n", 28, fhdlOut);
            filePutString ("DY01_Zaehler/DC1;1542\n", 22, fhdlOut);
            filePutString ("DY01_iCurrHV;1543\n", 18, fhdlOut);
            filePutString ("DY01_iCurrHV/DC_HYB_01;1543\n", 28, fhdlOut);
            filePutString ("DY01_iCurrHV/DC1;1543\n", 22, fhdlOut);
            filePutString ("DY01_res_42;1544\n", 17, fhdlOut);
            filePutString ("DY01_res_42/DC_HYB_01;1544\n", 27, fhdlOut);
            filePutString ("DY01_res_42/DC1;1544\n", 21, fhdlOut);
            filePutString ("DY01_res_43;1545\n", 17, fhdlOut);
            filePutString ("DY01_res_43/DC_HYB_01;1545\n", 27, fhdlOut);
            filePutString ("DY01_res_43/DC1;1545\n", 21, fhdlOut);
            filePutString ("DY01_res_44;1546\n", 17, fhdlOut);
            filePutString ("DY01_res_44/DC_HYB_01;1546\n", 27, fhdlOut);
            filePutString ("DY01_res_44/DC1;1546\n", 21, fhdlOut);
            filePutString ("DY01_res_45;1547\n", 17, fhdlOut);
            filePutString ("DY01_res_45/DC_HYB_01;1547\n", 27, fhdlOut);
            filePutString ("DY01_res_45/DC1;1547\n", 21, fhdlOut);
            filePutString ("DY01_res_46;1548\n", 17, fhdlOut);
            filePutString ("DY01_res_46/DC_HYB_01;1548\n", 27, fhdlOut);
            filePutString ("DY01_res_46/DC1;1548\n", 21, fhdlOut);
            filePutString ("DY01_res_47;1549\n", 17, fhdlOut);
            filePutString ("DY01_res_47/DC_HYB_01;1549\n", 27, fhdlOut);
            filePutString ("DY01_res_47/DC1;1549\n", 21, fhdlOut);
            filePutString ("DY01_res_48;1550\n", 17, fhdlOut);
            filePutString ("DY01_res_48/DC_HYB_01;1550\n", 27, fhdlOut);
            filePutString ("DY01_res_48/DC1;1550\n", 21, fhdlOut);
            filePutString ("DY01_res_49;1551\n", 17, fhdlOut);
            filePutString ("DY01_res_49/DC_HYB_01;1551\n", 27, fhdlOut);
            filePutString ("DY01_res_49/DC1;1551\n", 21, fhdlOut);
            filePutString ("DY01_res_50;1552\n", 17, fhdlOut);
            filePutString ("DY01_res_50/DC_HYB_01;1552\n", 27, fhdlOut);
            filePutString ("DY01_res_50/DC1;1552\n", 21, fhdlOut);
            filePutString ("DY01_res_51;1553\n", 17, fhdlOut);
            filePutString ("DY01_res_51/DC_HYB_01;1553\n", 27, fhdlOut);
            filePutString ("DY01_res_51/DC1;1553\n", 21, fhdlOut);
            filePutString ("DY01_res_52;1554\n", 17, fhdlOut);
            filePutString ("DY01_res_52/DC_HYB_01;1554\n", 27, fhdlOut);
            filePutString ("DY01_res_52/DC1;1554\n", 21, fhdlOut);
            filePutString ("DY01_res_53;1555\n", 17, fhdlOut);
            filePutString ("DY01_res_53/DC_HYB_01;1555\n", 27, fhdlOut);
            filePutString ("DY01_res_53/DC1;1555\n", 21, fhdlOut);
            filePutString ("DY01_res_54;1556\n", 17, fhdlOut);
            filePutString ("DY01_res_54/DC_HYB_01;1556\n", 27, fhdlOut);
            filePutString ("DY01_res_54/DC1;1556\n", 21, fhdlOut);
            filePutString ("DY01_res_55;1557\n", 17, fhdlOut);
            filePutString ("DY01_res_55/DC_HYB_01;1557\n", 27, fhdlOut);
            filePutString ("DY01_res_55/DC1;1557\n", 21, fhdlOut);
            filePutString ("DY01_res_56;1558\n", 17, fhdlOut);
            filePutString ("DY01_res_56/DC_HYB_01;1558\n", 27, fhdlOut);
            filePutString ("DY01_res_56/DC1;1558\n", 21, fhdlOut);
            filePutString ("DY01_res_57;1559\n", 17, fhdlOut);
            filePutString ("DY01_res_57/DC_HYB_01;1559\n", 27, fhdlOut);
            filePutString ("DY01_res_57/DC1;1559\n", 21, fhdlOut);
            filePutString ("DY01_res_58;1560\n", 17, fhdlOut);
            filePutString ("DY01_res_58/DC_HYB_01;1560\n", 27, fhdlOut);
            filePutString ("DY01_res_58/DC1;1560\n", 21, fhdlOut);
            filePutString ("DY01_res_59;1561\n", 17, fhdlOut);
            filePutString ("DY01_res_59/DC_HYB_01;1561\n", 27, fhdlOut);
            filePutString ("DY01_res_59/DC1;1561\n", 21, fhdlOut);
            filePutString ("DY01_res_60;1562\n", 17, fhdlOut);
            filePutString ("DY01_res_60/DC_HYB_01;1562\n", 27, fhdlOut);
            filePutString ("DY01_res_60/DC1;1562\n", 21, fhdlOut);
            filePutString ("DY01_res_61;1563\n", 17, fhdlOut);
            filePutString ("DY01_res_61/DC_HYB_01;1563\n", 27, fhdlOut);
            filePutString ("DY01_res_61/DC1;1563\n", 21, fhdlOut);
            filePutString ("DY01_res_62;1564\n", 17, fhdlOut);
            filePutString ("DY01_res_62/DC_HYB_01;1564\n", 27, fhdlOut);
            filePutString ("DY01_res_62/DC1;1564\n", 21, fhdlOut);
            filePutString ("DY01_res_63;1565\n", 17, fhdlOut);
            filePutString ("DY01_res_63/DC_HYB_01;1565\n", 27, fhdlOut);
            filePutString ("DY01_res_63/DC1;1565\n", 21, fhdlOut);
            filePutString ("DY01_stMode;1566\n", 17, fhdlOut);
            filePutString ("DY01_stMode/DC_HYB_01;1566\n", 27, fhdlOut);
            filePutString ("DY01_stMode/DC1;1566\n", 21, fhdlOut);
            filePutString ("DY01_uCurrHV;1567\n", 18, fhdlOut);
            filePutString ("DY01_uCurrHV/DC_HYB_01;1567\n", 28, fhdlOut);
            filePutString ("DY01_uCurrHV/DC1;1567\n", 22, fhdlOut);
            filePutString ("DY02_Checksumme;1792\n", 21, fhdlOut);
            filePutString ("DY02_Checksumme/DC_HYB_02;1792\n", 31, fhdlOut);
            filePutString ("DY02_Checksumme/DC2;1792\n", 25, fhdlOut);
            filePutString ("DY02_Derating_CrntLim_HV;1793\n", 30, fhdlOut);
            filePutString ("DY02_Derating_CrntLim_HV/DC_HYB_02;1793\n", 40, fhdlOut);
            filePutString ("DY02_Derating_CrntLim_HV/DC2;1793\n", 34, fhdlOut);
            filePutString ("DY02_Derating_CrntLim_LV;1794\n", 30, fhdlOut);
            filePutString ("DY02_Derating_CrntLim_LV/DC_HYB_02;1794\n", 40, fhdlOut);
            filePutString ("DY02_Derating_CrntLim_LV/DC2;1794\n", 34, fhdlOut);
            filePutString ("DY02_Derating_Temp;1795\n", 24, fhdlOut);
            filePutString ("DY02_Derating_Temp/DC_HYB_02;1795\n", 34, fhdlOut);
            filePutString ("DY02_Derating_Temp/DC2;1795\n", 28, fhdlOut);
            filePutString ("DY02_Derating_VltgLim_HV;1796\n", 30, fhdlOut);
            filePutString ("DY02_Derating_VltgLim_HV/DC_HYB_02;1796\n", 40, fhdlOut);
            filePutString ("DY02_Derating_VltgLim_HV/DC2;1796\n", 34, fhdlOut);
            filePutString ("DY02_Derating_VltgLim_LV;1797\n", 30, fhdlOut);
            filePutString ("DY02_Derating_VltgLim_LV/DC_HYB_02;1797\n", 40, fhdlOut);
            filePutString ("DY02_Derating_VltgLim_LV/DC2;1797\n", 34, fhdlOut);
            filePutString ("DY02_IdentCode;1798\n", 20, fhdlOut);
            filePutString ("DY02_IdentCode/DC_HYB_02;1798\n", 30, fhdlOut);
            filePutString ("DY02_IdentCode/DC2;1798\n", 24, fhdlOut);
            filePutString ("DY02_Zaehler;1799\n", 18, fhdlOut);
            filePutString ("DY02_Zaehler/DC_HYB_02;1799\n", 28, fhdlOut);
            filePutString ("DY02_Zaehler/DC2;1799\n", 22, fhdlOut);
            filePutString ("DY02_iCurrLV;1800\n", 18, fhdlOut);
            filePutString ("DY02_iCurrLV/DC_HYB_02;1800\n", 28, fhdlOut);
            filePutString ("DY02_iCurrLV/DC2;1800\n", 22, fhdlOut);
            filePutString ("DY02_rUtilRateDFM;1801\n", 23, fhdlOut);
            filePutString ("DY02_rUtilRateDFM/DC_HYB_02;1801\n", 33, fhdlOut);
            filePutString ("DY02_rUtilRateDFM/DC2;1801\n", 27, fhdlOut);
            filePutString ("DY02_res_56;1802\n", 17, fhdlOut);
            filePutString ("DY02_res_56/DC_HYB_02;1802\n", 27, fhdlOut);
            filePutString ("DY02_res_56/DC2;1802\n", 21, fhdlOut);
            filePutString ("DY02_res_57;1803\n", 17, fhdlOut);
            filePutString ("DY02_res_57/DC_HYB_02;1803\n", 27, fhdlOut);
            filePutString ("DY02_res_57/DC2;1803\n", 21, fhdlOut);
            filePutString ("DY02_res_58;1804\n", 17, fhdlOut);
            filePutString ("DY02_res_58/DC_HYB_02;1804\n", 27, fhdlOut);
            filePutString ("DY02_res_58/DC2;1804\n", 21, fhdlOut);
            filePutString ("DY02_res_59;1805\n", 17, fhdlOut);
            filePutString ("DY02_res_59/DC_HYB_02;1805\n", 27, fhdlOut);
            filePutString ("DY02_res_59/DC2;1805\n", 21, fhdlOut);
            filePutString ("DY02_res_60;1806\n", 17, fhdlOut);
            filePutString ("DY02_res_60/DC_HYB_02;1806\n", 27, fhdlOut);
            filePutString ("DY02_res_60/DC2;1806\n", 21, fhdlOut);
            filePutString ("DY02_res_61;1807\n", 17, fhdlOut);
            filePutString ("DY02_res_61/DC_HYB_02;1807\n", 27, fhdlOut);
            filePutString ("DY02_res_61/DC2;1807\n", 21, fhdlOut);
            filePutString ("DY02_res_62;1808\n", 17, fhdlOut);
            filePutString ("DY02_res_62/DC_HYB_02;1808\n", 27, fhdlOut);
            filePutString ("DY02_res_62/DC2;1808\n", 21, fhdlOut);
            filePutString ("DY02_res_63;1809\n", 17, fhdlOut);
            filePutString ("DY02_res_63/DC_HYB_02;1809\n", 27, fhdlOut);
            filePutString ("DY02_res_63/DC2;1809\n", 21, fhdlOut);
            filePutString ("DY02_tCurr;1810\n", 16, fhdlOut);
            filePutString ("DY02_tCurr/DC_HYB_02;1810\n", 26, fhdlOut);
            filePutString ("DY02_tCurr/DC2;1810\n", 20, fhdlOut);
            filePutString ("DY02_uCurrLV;1811\n", 18, fhdlOut);
            filePutString ("DY02_uCurrLV/DC_HYB_02;1811\n", 28, fhdlOut);
            filePutString ("DY02_uCurrLV/DC2;1811\n", 22, fhdlOut);
            filePutString ("EY02_Checksumme;2048\n", 21, fhdlOut);
            filePutString ("EY02_Checksumme/EM_HYB_02;2048\n", 31, fhdlOut);
            filePutString ("EY02_Checksumme/EM2;2048\n", 25, fhdlOut);
            filePutString ("EY02_DstCActv;2049\n", 19, fhdlOut);
            filePutString ("EY02_DstCActv/EM_HYB_02;2049\n", 29, fhdlOut);
            filePutString ("EY02_DstCActv/EM2;2049\n", 23, fhdlOut);
            filePutString ("EY02_Zaehler;2050\n", 18, fhdlOut);
            filePutString ("EY02_Zaehler/EM_HYB_02;2050\n", 28, fhdlOut);
            filePutString ("EY02_Zaehler/EM2;2050\n", 22, fhdlOut);
            filePutString ("EY02_nCurr;2051\n", 16, fhdlOut);
            filePutString ("EY02_nCurr/EM_HYB_02;2051\n", 26, fhdlOut);
            filePutString ("EY02_nCurr/EM2;2051\n", 20, fhdlOut);
            filePutString ("EY02_res_52;2052\n", 17, fhdlOut);
            filePutString ("EY02_res_52/EM_HYB_02;2052\n", 27, fhdlOut);
            filePutString ("EY02_res_52/EM2;2052\n", 21, fhdlOut);
            filePutString ("EY02_res_53;2053\n", 17, fhdlOut);
            filePutString ("EY02_res_53/EM_HYB_02;2053\n", 27, fhdlOut);
            filePutString ("EY02_res_53/EM2;2053\n", 21, fhdlOut);
            filePutString ("EY02_res_54;2054\n", 17, fhdlOut);
            filePutString ("EY02_res_54/EM_HYB_02;2054\n", 27, fhdlOut);
            filePutString ("EY02_res_54/EM2;2054\n", 21, fhdlOut);
            filePutString ("EY02_res_56;2055\n", 17, fhdlOut);
            filePutString ("EY02_res_56/EM_HYB_02;2055\n", 27, fhdlOut);
            filePutString ("EY02_res_56/EM2;2055\n", 21, fhdlOut);
            filePutString ("EY02_res_57;2056\n", 17, fhdlOut);
            filePutString ("EY02_res_57/EM_HYB_02;2056\n", 27, fhdlOut);
            filePutString ("EY02_res_57/EM2;2056\n", 21, fhdlOut);
            filePutString ("EY02_res_58;2057\n", 17, fhdlOut);
            filePutString ("EY02_res_58/EM_HYB_02;2057\n", 27, fhdlOut);
            filePutString ("EY02_res_58/EM2;2057\n", 21, fhdlOut);
            filePutString ("EY02_res_59;2058\n", 17, fhdlOut);
            filePutString ("EY02_res_59/EM_HYB_02;2058\n", 27, fhdlOut);
            filePutString ("EY02_res_59/EM2;2058\n", 21, fhdlOut);
            filePutString ("EY02_res_60;2059\n", 17, fhdlOut);
            filePutString ("EY02_res_60/EM_HYB_02;2059\n", 27, fhdlOut);
            filePutString ("EY02_res_60/EM2;2059\n", 21, fhdlOut);
            filePutString ("EY02_res_61;2060\n", 17, fhdlOut);
            filePutString ("EY02_res_61/EM_HYB_02;2060\n", 27, fhdlOut);
            filePutString ("EY02_res_61/EM2;2060\n", 21, fhdlOut);
            filePutString ("EY02_res_62;2061\n", 17, fhdlOut);
            filePutString ("EY02_res_62/EM_HYB_02;2061\n", 27, fhdlOut);
            filePutString ("EY02_res_62/EM2;2061\n", 21, fhdlOut);
            filePutString ("EY02_res_63;2062\n", 17, fhdlOut);
            filePutString ("EY02_res_63/EM_HYB_02;2062\n", 27, fhdlOut);
            filePutString ("EY02_res_63/EM2;2062\n", 21, fhdlOut);
            filePutString ("EY02_trqCurr;2063\n", 18, fhdlOut);
            filePutString ("EY02_trqCurr/EM_HYB_02;2063\n", 28, fhdlOut);
            filePutString ("EY02_trqCurr/EM2;2063\n", 22, fhdlOut);
            filePutString ("EY02_trqCurrWoDstC;2064\n", 24, fhdlOut);
            filePutString ("EY02_trqCurrWoDstC/EM_HYB_02;2064\n", 34, fhdlOut);
            filePutString ("EY02_trqCurrWoDstC/EM2;2064\n", 28, fhdlOut);
            filePutString ("EY03_Checksumme;2304\n", 21, fhdlOut);
            filePutString ("EY03_Checksumme/EM_HYB_03;2304\n", 31, fhdlOut);
            filePutString ("EY03_Checksumme/EM3;2304\n", 25, fhdlOut);
            filePutString ("EY03_Derating_Temp;2305\n", 24, fhdlOut);
            filePutString ("EY03_Derating_Temp/EM_HYB_03;2305\n", 34, fhdlOut);
            filePutString ("EY03_Derating_Temp/EM3;2305\n", 28, fhdlOut);
            filePutString ("EY03_DiagReq;2306\n", 18, fhdlOut);
            filePutString ("EY03_DiagReq/EM_HYB_03;2306\n", 28, fhdlOut);
            filePutString ("EY03_DiagReq/EM3;2306\n", 22, fhdlOut);
            filePutString ("EY03_Lim_CrntMax;2307\n", 22, fhdlOut);
            filePutString ("EY03_Lim_CrntMax/EM_HYB_03;2307\n", 32, fhdlOut);
            filePutString ("EY03_Lim_CrntMax/EM3;2307\n", 26, fhdlOut);
            filePutString ("EY03_Lim_CrntMin;2308\n", 22, fhdlOut);
            filePutString ("EY03_Lim_CrntMin/EM_HYB_03;2308\n", 32, fhdlOut);
            filePutString ("EY03_Lim_CrntMin/EM3;2308\n", 26, fhdlOut);
            filePutString ("EY03_Lim_TrqMax;2309\n", 21, fhdlOut);
            filePutString ("EY03_Lim_TrqMax/EM_HYB_03;2309\n", 31, fhdlOut);
            filePutString ("EY03_Lim_TrqMax/EM3;2309\n", 25, fhdlOut);
            filePutString ("EY03_Lim_TrqMin;2310\n", 21, fhdlOut);
            filePutString ("EY03_Lim_TrqMin/EM_HYB_03;2310\n", 31, fhdlOut);
            filePutString ("EY03_Lim_TrqMin/EM3;2310\n", 25, fhdlOut);
            filePutString ("EY03_Lim_VltgMax;2311\n", 22, fhdlOut);
            filePutString ("EY03_Lim_VltgMax/EM_HYB_03;2311\n", 32, fhdlOut);
            filePutString ("EY03_Lim_VltgMax/EM3;2311\n", 26, fhdlOut);
            filePutString ("EY03_Lim_VltgMin;2312\n", 22, fhdlOut);
            filePutString ("EY03_Lim_VltgMin/EM_HYB_03;2312\n", 32, fhdlOut);
            filePutString ("EY03_Lim_VltgMin/EM3;2312\n", 26, fhdlOut);
            filePutString ("EY03_Zaehler;2313\n", 18, fhdlOut);
            filePutString ("EY03_Zaehler/EM_HYB_03;2313\n", 28, fhdlOut);
            filePutString ("EY03_Zaehler/EM3;2313\n", 22, fhdlOut);
            filePutString ("EY03_iCurr;2314\n", 16, fhdlOut);
            filePutString ("EY03_iCurr/EM_HYB_03;2314\n", 26, fhdlOut);
            filePutString ("EY03_iCurr/EM3;2314\n", 20, fhdlOut);
            filePutString ("EY03_res_44;2315\n", 17, fhdlOut);
            filePutString ("EY03_res_44/EM_HYB_03;2315\n", 27, fhdlOut);
            filePutString ("EY03_res_44/EM3;2315\n", 21, fhdlOut);
            filePutString ("EY03_res_45;2316\n", 17, fhdlOut);
            filePutString ("EY03_res_45/EM_HYB_03;2316\n", 27, fhdlOut);
            filePutString ("EY03_res_45/EM3;2316\n", 21, fhdlOut);
            filePutString ("EY03_res_46;2317\n", 17, fhdlOut);
            filePutString ("EY03_res_46/EM_HYB_03;2317\n", 27, fhdlOut);
            filePutString ("EY03_res_46/EM3;2317\n", 21, fhdlOut);
            filePutString ("EY03_res_47;2318\n", 17, fhdlOut);
            filePutString ("EY03_res_47/EM_HYB_03;2318\n", 27, fhdlOut);
            filePutString ("EY03_res_47/EM3;2318\n", 21, fhdlOut);
            filePutString ("EY03_res_48;2319\n", 17, fhdlOut);
            filePutString ("EY03_res_48/EM_HYB_03;2319\n", 27, fhdlOut);
            filePutString ("EY03_res_48/EM3;2319\n", 21, fhdlOut);
            filePutString ("EY03_res_49;2320\n", 17, fhdlOut);
            filePutString ("EY03_res_49/EM_HYB_03;2320\n", 27, fhdlOut);
            filePutString ("EY03_res_49/EM3;2320\n", 21, fhdlOut);
            filePutString ("EY03_res_50;2321\n", 17, fhdlOut);
            filePutString ("EY03_res_50/EM_HYB_03;2321\n", 27, fhdlOut);
            filePutString ("EY03_res_50/EM3;2321\n", 21, fhdlOut);
            filePutString ("EY03_res_51;2322\n", 17, fhdlOut);
            filePutString ("EY03_res_51/EM_HYB_03;2322\n", 27, fhdlOut);
            filePutString ("EY03_res_51/EM3;2322\n", 21, fhdlOut);
            filePutString ("EY03_res_52;2323\n", 17, fhdlOut);
            filePutString ("EY03_res_52/EM_HYB_03;2323\n", 27, fhdlOut);
            filePutString ("EY03_res_52/EM3;2323\n", 21, fhdlOut);
            filePutString ("EY03_res_53;2324\n", 17, fhdlOut);
            filePutString ("EY03_res_53/EM_HYB_03;2324\n", 27, fhdlOut);
            filePutString ("EY03_res_53/EM3;2324\n", 21, fhdlOut);
            filePutString ("EY03_res_54;2325\n", 17, fhdlOut);
            filePutString ("EY03_res_54/EM_HYB_03;2325\n", 27, fhdlOut);
            filePutString ("EY03_res_54/EM3;2325\n", 21, fhdlOut);
            filePutString ("EY03_res_55;2326\n", 17, fhdlOut);
            filePutString ("EY03_res_55/EM_HYB_03;2326\n", 27, fhdlOut);
            filePutString ("EY03_res_55/EM3;2326\n", 21, fhdlOut);
            filePutString ("EY03_res_56;2327\n", 17, fhdlOut);
            filePutString ("EY03_res_56/EM_HYB_03;2327\n", 27, fhdlOut);
            filePutString ("EY03_res_56/EM3;2327\n", 21, fhdlOut);
            filePutString ("EY03_res_57;2328\n", 17, fhdlOut);
            filePutString ("EY03_res_57/EM_HYB_03;2328\n", 27, fhdlOut);
            filePutString ("EY03_res_57/EM3;2328\n", 21, fhdlOut);
            filePutString ("EY03_res_58;2329\n", 17, fhdlOut);
            filePutString ("EY03_res_58/EM_HYB_03;2329\n", 27, fhdlOut);
            filePutString ("EY03_res_58/EM3;2329\n", 21, fhdlOut);
            filePutString ("EY03_res_59;2330\n", 17, fhdlOut);
            filePutString ("EY03_res_59/EM_HYB_03;2330\n", 27, fhdlOut);
            filePutString ("EY03_res_59/EM3;2330\n", 21, fhdlOut);
            filePutString ("EY03_res_60;2331\n", 17, fhdlOut);
            filePutString ("EY03_res_60/EM_HYB_03;2331\n", 27, fhdlOut);
            filePutString ("EY03_res_60/EM3;2331\n", 21, fhdlOut);
            filePutString ("EY03_res_61;2332\n", 17, fhdlOut);
            filePutString ("EY03_res_61/EM_HYB_03;2332\n", 27, fhdlOut);
            filePutString ("EY03_res_61/EM3;2332\n", 21, fhdlOut);
            filePutString ("EY03_res_62;2333\n", 17, fhdlOut);
            filePutString ("EY03_res_62/EM_HYB_03;2333\n", 27, fhdlOut);
            filePutString ("EY03_res_62/EM3;2333\n", 21, fhdlOut);
            filePutString ("EY03_res_63;2334\n", 17, fhdlOut);
            filePutString ("EY03_res_63/EM_HYB_03;2334\n", 27, fhdlOut);
            filePutString ("EY03_res_63/EM3;2334\n", 21, fhdlOut);
            filePutString ("EY03_uCurr;2335\n", 16, fhdlOut);
            filePutString ("EY03_uCurr/EM_HYB_03;2335\n", 26, fhdlOut);
            filePutString ("EY03_uCurr/EM3;2335\n", 20, fhdlOut);
            filePutString ("EY04_Checksumme;2560\n", 21, fhdlOut);
            filePutString ("EY04_Checksumme/EM_HYB_04;2560\n", 31, fhdlOut);
            filePutString ("EY04_Checksumme/EM4;2560\n", 25, fhdlOut);
            filePutString ("EY04_Zaehler;2561\n", 18, fhdlOut);
            filePutString ("EY04_Zaehler/EM_HYB_04;2561\n", 28, fhdlOut);
            filePutString ("EY04_Zaehler/EM4;2561\n", 22, fhdlOut);
            filePutString ("EY04_nCalcPredMax;2562\n", 23, fhdlOut);
            filePutString ("EY04_nCalcPredMax/EM_HYB_04;2562\n", 33, fhdlOut);
            filePutString ("EY04_nCalcPredMax/EM4;2562\n", 27, fhdlOut);
            filePutString ("EY04_nCalcPredMin;2563\n", 23, fhdlOut);
            filePutString ("EY04_nCalcPredMin/EM_HYB_04;2563\n", 33, fhdlOut);
            filePutString ("EY04_nCalcPredMin/EM4;2563\n", 27, fhdlOut);
            filePutString ("EY04_res_58;2564\n", 17, fhdlOut);
            filePutString ("EY04_res_58/EM_HYB_04;2564\n", 27, fhdlOut);
            filePutString ("EY04_res_58/EM4;2564\n", 21, fhdlOut);
            filePutString ("EY04_res_59;2565\n", 17, fhdlOut);
            filePutString ("EY04_res_59/EM_HYB_04;2565\n", 27, fhdlOut);
            filePutString ("EY04_res_59/EM4;2565\n", 21, fhdlOut);
            filePutString ("EY04_res_60;2566\n", 17, fhdlOut);
            filePutString ("EY04_res_60/EM_HYB_04;2566\n", 27, fhdlOut);
            filePutString ("EY04_res_60/EM4;2566\n", 21, fhdlOut);
            filePutString ("EY04_res_61;2567\n", 17, fhdlOut);
            filePutString ("EY04_res_61/EM_HYB_04;2567\n", 27, fhdlOut);
            filePutString ("EY04_res_61/EM4;2567\n", 21, fhdlOut);
            filePutString ("EY04_res_62;2568\n", 17, fhdlOut);
            filePutString ("EY04_res_62/EM_HYB_04;2568\n", 27, fhdlOut);
            filePutString ("EY04_res_62/EM4;2568\n", 21, fhdlOut);
            filePutString ("EY04_res_63;2569\n", 17, fhdlOut);
            filePutString ("EY04_res_63/EM_HYB_04;2569\n", 27, fhdlOut);
            filePutString ("EY04_res_63/EM4;2569\n", 21, fhdlOut);
            filePutString ("EY04_trqCalcElPwr;2570\n", 23, fhdlOut);
            filePutString ("EY04_trqCalcElPwr/EM_HYB_04;2570\n", 33, fhdlOut);
            filePutString ("EY04_trqCalcElPwr/EM4;2570\n", 27, fhdlOut);
            filePutString ("EY04_trqCalcPredMax;2571\n", 25, fhdlOut);
            filePutString ("EY04_trqCalcPredMax/EM_HYB_04;2571\n", 35, fhdlOut);
            filePutString ("EY04_trqCalcPredMax/EM4;2571\n", 29, fhdlOut);
            filePutString ("EY04_trqCalcPredMin;2572\n", 25, fhdlOut);
            filePutString ("EY04_trqCalcPredMin/EM_HYB_04;2572\n", 35, fhdlOut);
            filePutString ("EY04_trqCalcPredMin/EM4;2572\n", 29, fhdlOut);
            filePutString ("EY05_Checksumme;2816\n", 21, fhdlOut);
            filePutString ("EY05_Checksumme/EM_HYB_05;2816\n", 31, fhdlOut);
            filePutString ("EY05_Checksumme/EM5;2816\n", 25, fhdlOut);
            filePutString ("EY05_MILReq;2817\n", 17, fhdlOut);
            filePutString ("EY05_MILReq/EM_HYB_05;2817\n", 27, fhdlOut);
            filePutString ("EY05_MILReq/EM5;2817\n", 21, fhdlOut);
            filePutString ("EY05_RedLEDReq;2818\n", 20, fhdlOut);
            filePutString ("EY05_RedLEDReq/EM_HYB_05;2818\n", 30, fhdlOut);
            filePutString ("EY05_RedLEDReq/EM5;2818\n", 24, fhdlOut);
            filePutString ("EY05_YellowLEDReq;2819\n", 23, fhdlOut);
            filePutString ("EY05_YellowLEDReq/EM_HYB_05;2819\n", 33, fhdlOut);
            filePutString ("EY05_YellowLEDReq/EM5;2819\n", 27, fhdlOut);
            filePutString ("EY05_Zaehler;2820\n", 18, fhdlOut);
            filePutString ("EY05_Zaehler/EM_HYB_05;2820\n", 28, fhdlOut);
            filePutString ("EY05_Zaehler/EM5;2820\n", 22, fhdlOut);
            filePutString ("EY05_res_15;2821\n", 17, fhdlOut);
            filePutString ("EY05_res_15/EM_HYB_05;2821\n", 27, fhdlOut);
            filePutString ("EY05_res_15/EM5;2821\n", 21, fhdlOut);
            filePutString ("EY05_res_40;2822\n", 17, fhdlOut);
            filePutString ("EY05_res_40/EM_HYB_05;2822\n", 27, fhdlOut);
            filePutString ("EY05_res_40/EM5;2822\n", 21, fhdlOut);
            filePutString ("EY05_res_41;2823\n", 17, fhdlOut);
            filePutString ("EY05_res_41/EM_HYB_05;2823\n", 27, fhdlOut);
            filePutString ("EY05_res_41/EM5;2823\n", 21, fhdlOut);
            filePutString ("EY05_res_42;2824\n", 17, fhdlOut);
            filePutString ("EY05_res_42/EM_HYB_05;2824\n", 27, fhdlOut);
            filePutString ("EY05_res_42/EM5;2824\n", 21, fhdlOut);
            filePutString ("EY05_res_43;2825\n", 17, fhdlOut);
            filePutString ("EY05_res_43/EM_HYB_05;2825\n", 27, fhdlOut);
            filePutString ("EY05_res_43/EM5;2825\n", 21, fhdlOut);
            filePutString ("EY05_res_44;2826\n", 17, fhdlOut);
            filePutString ("EY05_res_44/EM_HYB_05;2826\n", 27, fhdlOut);
            filePutString ("EY05_res_44/EM5;2826\n", 21, fhdlOut);
            filePutString ("EY05_res_45;2827\n", 17, fhdlOut);
            filePutString ("EY05_res_45/EM_HYB_05;2827\n", 27, fhdlOut);
            filePutString ("EY05_res_45/EM5;2827\n", 21, fhdlOut);
            filePutString ("EY05_res_46;2828\n", 17, fhdlOut);
            filePutString ("EY05_res_46/EM_HYB_05;2828\n", 27, fhdlOut);
            filePutString ("EY05_res_46/EM5;2828\n", 21, fhdlOut);
            filePutString ("EY05_res_47;2829\n", 17, fhdlOut);
            filePutString ("EY05_res_47/EM_HYB_05;2829\n", 27, fhdlOut);
            filePutString ("EY05_res_47/EM5;2829\n", 21, fhdlOut);
            filePutString ("EY05_res_48;2830\n", 17, fhdlOut);
            filePutString ("EY05_res_48/EM_HYB_05;2830\n", 27, fhdlOut);
            filePutString ("EY05_res_48/EM5;2830\n", 21, fhdlOut);
            filePutString ("EY05_res_49;2831\n", 17, fhdlOut);
            filePutString ("EY05_res_49/EM_HYB_05;2831\n", 27, fhdlOut);
            filePutString ("EY05_res_49/EM5;2831\n", 21, fhdlOut);
            filePutString ("EY05_res_50;2832\n", 17, fhdlOut);
            filePutString ("EY05_res_50/EM_HYB_05;2832\n", 27, fhdlOut);
            filePutString ("EY05_res_50/EM5;2832\n", 21, fhdlOut);
            filePutString ("EY05_res_51;2833\n", 17, fhdlOut);
            filePutString ("EY05_res_51/EM_HYB_05;2833\n", 27, fhdlOut);
            filePutString ("EY05_res_51/EM5;2833\n", 21, fhdlOut);
            filePutString ("EY05_res_52;2834\n", 17, fhdlOut);
            filePutString ("EY05_res_52/EM_HYB_05;2834\n", 27, fhdlOut);
            filePutString ("EY05_res_52/EM5;2834\n", 21, fhdlOut);
            filePutString ("EY05_res_53;2835\n", 17, fhdlOut);
            filePutString ("EY05_res_53/EM_HYB_05;2835\n", 27, fhdlOut);
            filePutString ("EY05_res_53/EM5;2835\n", 21, fhdlOut);
            filePutString ("EY05_res_54;2836\n", 17, fhdlOut);
            filePutString ("EY05_res_54/EM_HYB_05;2836\n", 27, fhdlOut);
            filePutString ("EY05_res_54/EM5;2836\n", 21, fhdlOut);
            filePutString ("EY05_res_55;2837\n", 17, fhdlOut);
            filePutString ("EY05_res_55/EM_HYB_05;2837\n", 27, fhdlOut);
            filePutString ("EY05_res_55/EM5;2837\n", 21, fhdlOut);
            filePutString ("EY05_res_56;2838\n", 17, fhdlOut);
            filePutString ("EY05_res_56/EM_HYB_05;2838\n", 27, fhdlOut);
            filePutString ("EY05_res_56/EM5;2838\n", 21, fhdlOut);
            filePutString ("EY05_res_57;2839\n", 17, fhdlOut);
            filePutString ("EY05_res_57/EM_HYB_05;2839\n", 27, fhdlOut);
            filePutString ("EY05_res_57/EM5;2839\n", 21, fhdlOut);
            filePutString ("EY05_res_58;2840\n", 17, fhdlOut);
            filePutString ("EY05_res_58/EM_HYB_05;2840\n", 27, fhdlOut);
            filePutString ("EY05_res_58/EM5;2840\n", 21, fhdlOut);
            filePutString ("EY05_res_59;2841\n", 17, fhdlOut);
            filePutString ("EY05_res_59/EM_HYB_05;2841\n", 27, fhdlOut);
            filePutString ("EY05_res_59/EM5;2841\n", 21, fhdlOut);
            filePutString ("EY05_res_60;2842\n", 17, fhdlOut);
            filePutString ("EY05_res_60/EM_HYB_05;2842\n", 27, fhdlOut);
            filePutString ("EY05_res_60/EM5;2842\n", 21, fhdlOut);
            filePutString ("EY05_res_61;2843\n", 17, fhdlOut);
            filePutString ("EY05_res_61/EM_HYB_05;2843\n", 27, fhdlOut);
            filePutString ("EY05_res_61/EM5;2843\n", 21, fhdlOut);
            filePutString ("EY05_res_62;2844\n", 17, fhdlOut);
            filePutString ("EY05_res_62/EM_HYB_05;2844\n", 27, fhdlOut);
            filePutString ("EY05_res_62/EM5;2844\n", 21, fhdlOut);
            filePutString ("EY05_res_63;2845\n", 17, fhdlOut);
            filePutString ("EY05_res_63/EM_HYB_05;2845\n", 27, fhdlOut);
            filePutString ("EY05_res_63/EM5;2845\n", 21, fhdlOut);
            filePutString ("EY05_tCurrMot;2846\n", 19, fhdlOut);
            filePutString ("EY05_tCurrMot/EM_HYB_05;2846\n", 29, fhdlOut);
            filePutString ("EY05_tCurrMot/EM5;2846\n", 23, fhdlOut);
            filePutString ("EY05_tCurrPWR;2847\n", 19, fhdlOut);
            filePutString ("EY05_tCurrPWR/EM_HYB_05;2847\n", 29, fhdlOut);
            filePutString ("EY05_tCurrPWR/EM5;2847\n", 23, fhdlOut);
            filePutString ("EY05_tCurrRotor;2848\n", 21, fhdlOut);
            filePutString ("EY05_tCurrRotor/EM_HYB_05;2848\n", 31, fhdlOut);
            filePutString ("EY05_tCurrRotor/EM5;2848\n", 25, fhdlOut);
            filePutString ("EY06_Checksumme;3072\n", 21, fhdlOut);
            filePutString ("EY06_Checksumme/EM_HYB_06;3072\n", 31, fhdlOut);
            filePutString ("EY06_Checksumme/EM6;3072\n", 25, fhdlOut);
            filePutString ("EY06_ErrEmrgcyShtOff;3073\n", 26, fhdlOut);
            filePutString ("EY06_ErrEmrgcyShtOff/EM_HYB_06;3073\n", 36, fhdlOut);
            filePutString ("EY06_ErrEmrgcyShtOff/EM6;3073\n", 30, fhdlOut);
            filePutString ("EY06_ErrFreeWheeling;3074\n", 26, fhdlOut);
            filePutString ("EY06_ErrFreeWheeling/EM_HYB_06;3074\n", 36, fhdlOut);
            filePutString ("EY06_ErrFreeWheeling/EM6;3074\n", 30, fhdlOut);
            filePutString ("EY06_ErrLimitedPerformance;3075\n", 32, fhdlOut);
            filePutString ("EY06_ErrLimitedPerformance/EM_HYB_06;3075\n", 42, fhdlOut);
            filePutString ("EY06_ErrLimitedPerformance/EM6;3075\n", 36, fhdlOut);
            filePutString ("EY06_ErrShtOff;3076\n", 20, fhdlOut);
            filePutString ("EY06_ErrShtOff/EM_HYB_06;3076\n", 30, fhdlOut);
            filePutString ("EY06_ErrShtOff/EM6;3076\n", 24, fhdlOut);
            filePutString ("EY06_ExtRngActv;3077\n", 21, fhdlOut);
            filePutString ("EY06_ExtRngActv/EM_HYB_06;3077\n", 31, fhdlOut);
            filePutString ("EY06_ExtRngActv/EM6;3077\n", 25, fhdlOut);
            filePutString ("EY06_ReadyHV;3078\n", 18, fhdlOut);
            filePutString ("EY06_ReadyHV/EM_HYB_06;3078\n", 28, fhdlOut);
            filePutString ("EY06_ReadyHV/EM6;3078\n", 22, fhdlOut);
            filePutString ("EY06_ReadyInit;3079\n", 20, fhdlOut);
            filePutString ("EY06_ReadyInit/EM_HYB_06;3079\n", 30, fhdlOut);
            filePutString ("EY06_ReadyInit/EM6;3079\n", 24, fhdlOut);
            filePutString ("EY06_SleepInd;3080\n", 19, fhdlOut);
            filePutString ("EY06_SleepInd/EM_HYB_06;3080\n", 29, fhdlOut);
            filePutString ("EY06_SleepInd/EM6;3080\n", 23, fhdlOut);
            filePutString ("EY06_Zaehler;3081\n", 18, fhdlOut);
            filePutString ("EY06_Zaehler/EM_HYB_06;3081\n", 28, fhdlOut);
            filePutString ("EY06_Zaehler/EM6;3081\n", 22, fhdlOut);
            filePutString ("EY06_stMode;3082\n", 17, fhdlOut);
            filePutString ("EY06_stMode/EM_HYB_06;3082\n", 27, fhdlOut);
            filePutString ("EY06_stMode/EM6;3082\n", 21, fhdlOut);
            filePutString ("EY06_trqAbsMax;3083\n", 20, fhdlOut);
            filePutString ("EY06_trqAbsMax/EM_HYB_06;3083\n", 30, fhdlOut);
            filePutString ("EY06_trqAbsMax/EM6;3083\n", 24, fhdlOut);
            filePutString ("EY06_trqAbsMin;3084\n", 20, fhdlOut);
            filePutString ("EY06_trqAbsMin/EM_HYB_06;3084\n", 30, fhdlOut);
            filePutString ("EY06_trqAbsMin/EM6;3084\n", 24, fhdlOut);
            filePutString ("EY06_trqCalcDynMax;3085\n", 24, fhdlOut);
            filePutString ("EY06_trqCalcDynMax/EM_HYB_06;3085\n", 34, fhdlOut);
            filePutString ("EY06_trqCalcDynMax/EM6;3085\n", 28, fhdlOut);
            filePutString ("EY06_trqCalcDynMin;3086\n", 24, fhdlOut);
            filePutString ("EY06_trqCalcDynMin/EM_HYB_06;3086\n", 34, fhdlOut);
            filePutString ("EY06_trqCalcDynMin/EM6;3086\n", 28, fhdlOut);
            filePutString ("FIS1_Operand1;3328\n", 19, fhdlOut);
            filePutString ("FIS1_Operand1/FIS_1;3328\n", 25, fhdlOut);
            filePutString ("FIS1_Operand1/FIS1;3328\n", 24, fhdlOut);
            filePutString ("FIS1_Operand2;3329\n", 19, fhdlOut);
            filePutString ("FIS1_Operand2/FIS_1;3329\n", 25, fhdlOut);
            filePutString ("FIS1_Operand2/FIS1;3329\n", 24, fhdlOut);
            filePutString ("FIS1_Operand3;3330\n", 19, fhdlOut);
            filePutString ("FIS1_Operand3/FIS_1;3330\n", 25, fhdlOut);
            filePutString ("FIS1_Operand3/FIS1;3330\n", 24, fhdlOut);

            fileClose(fhdlOut);
        }
    }

    /* ------------------------------------------------------------------------------------------ */
    /*  END frame and signal handle export for remote control of CAPL by Perl script              */
    /* ------------------------------------------------------------------------------------------ */
}
/*@@end*/

/*@@startStart:Start:*/
on start
{
    int FrmIdx;
    int LoopCnt;

    /* start 10ms timer */
    setTimer(Timer_10ms,TIMER_DURATION_10MS);

    for (FrmIdx = 0; FrmIdx < FRM_NUM_MAX; FrmIdx++)
    {
        /* init frame schedule timer */
        FrmSched_SchedTmr[FrmIdx] = 0;
        
        /* enable scheduler for all frames */
        FrmSched_FrmEna[FrmIdx] = 1;

        /* init message counter values */
        Frm_MsgCounter[FrmIdx] = 0;

        /* enable message counter increment */
        Frm_MsgCounterEna[FrmIdx] = 1;

        /* enable checksum calculation */
        Frm_MsgChksmEna[FrmIdx] = 1;

        /* init DLC error status to OK */
        Frm_DLCOk[FrmIdx] = 1;
    }

    
    /* init CAPL control related variables */
    for (LoopCnt = 0; LoopCnt < CAPLCTRL_INPUTBUF_LEN; LoopCnt ++)
    {
        CaplCtrl_InputBuf[LoopCnt] = 0;
    }

    /* ------------------------------------------------------------------------------------------ */
    /*  BEGIN variable initialization                                                             */
    /* ------------------------------------------------------------------------------------------ */

    FrmSched_CycleTime[FRM_HANDLE_BMS_HYB_02] = 10;
    FrmSched_CycleTime[FRM_HANDLE_BMS_HYB_03] = 100;
    FrmSched_CycleTime[FRM_HANDLE_BMS_HYB_04] = 20;
    FrmSched_CycleTime[FRM_HANDLE_BMS_HYB_06] = 500;
    FrmSched_CycleTime[FRM_HANDLE_CCU_HYB_01] = 5;
    FrmSched_CycleTime[FRM_HANDLE_CCU_HYB_02] = 1000;
    FrmSched_CycleTime[FRM_HANDLE_DC_HYB_01] = 10;
    FrmSched_CycleTime[FRM_HANDLE_DC_HYB_02] = 100;
    FrmSched_CycleTime[FRM_HANDLE_EM_HYB_02] = 10;
    FrmSched_CycleTime[FRM_HANDLE_EM_HYB_03] = 100;
    FrmSched_CycleTime[FRM_HANDLE_EM_HYB_04] = 100;
    FrmSched_CycleTime[FRM_HANDLE_EM_HYB_05] = 500;
    FrmSched_CycleTime[FRM_HANDLE_EM_HYB_06] = 10;
    FrmSched_CycleTime[FRM_HANDLE_FIS_1] = 100;

    Frm_DLC[FRM_HANDLE_BMS_HYB_02] = 8;
    Frm_DLC[FRM_HANDLE_BMS_HYB_03] = 8;
    Frm_DLC[FRM_HANDLE_BMS_HYB_04] = 8;
    Frm_DLC[FRM_HANDLE_BMS_HYB_06] = 8;
    Frm_DLC[FRM_HANDLE_CCU_HYB_01] = 8;
    Frm_DLC[FRM_HANDLE_CCU_HYB_02] = 8;
    Frm_DLC[FRM_HANDLE_DC_HYB_01] = 8;
    Frm_DLC[FRM_HANDLE_DC_HYB_02] = 8;
    Frm_DLC[FRM_HANDLE_EM_HYB_02] = 8;
    Frm_DLC[FRM_HANDLE_EM_HYB_03] = 8;
    Frm_DLC[FRM_HANDLE_EM_HYB_04] = 8;
    Frm_DLC[FRM_HANDLE_EM_HYB_05] = 8;
    Frm_DLC[FRM_HANDLE_EM_HYB_06] = 8;
    Frm_DLC[FRM_HANDLE_FIS_1] = 3;


    /* ------------------------------------------------------------------------------------------ */
    /*  END variable initialization                                                               */
    /* ------------------------------------------------------------------------------------------ */


    /* ------------------------------------------------------------------------------------------ */
    /*  BEGIN OnStart                                                                             */
    /* ------------------------------------------------------------------------------------------ */

    write("");
    write("#===================================================================");
    write("# CAPL program hcan_v1x.can");
    write("# Generated by:  dbc2capl.pl v1.4.5 (dbcparser.pm 1.3.0)");
    write("# CAPL template: dbc2capl_template.can v1.0.2");
    write("# Generated on:  17.03.2010 09:48:16");
    write("# DBC file:      hcan_v1x.dbc");
    write("#===================================================================");
    write("");


    /* ------------------------------------------------------------------------------------------ */
    /*  END OnStart                                                                               */
    /* ------------------------------------------------------------------------------------------ */

    /* HelpFrameList(); */

    write("Hit '?' to get list of all available frames ...");
    ShowPrompt();
}
/*@@end*/

/*@@key:*:*/
on key *
{
    int InputVal = 0;
    int LevelActvOld;
    char CharBufTmp[CAPLCTRL_CHARBUF_LEN];
    
    /* store current input level to be able to check for level change */
    LevelActvOld = CaplCtrl_LevelActv;

    /* empty string */
    CharBufTmp[0] = 0;


    switch (this)
    {
        /* --- numeric input -------------------------------------------------------------------- */
        case '0':
        case '1':
        case '2':
        case '3':
        case '4':
        case '5':
        case '6':
        case '7':
        case '8':
        case '9':
        {
            /* copy input to input buffer */
            CaplCtrl_InputBuf[CaplCtrl_InputIdx] = this;
            
            /* increment to next buffer value */
            CaplCtrl_InputIdx ++;

            /* limit input to buffer length */
            if (CaplCtrl_InputIdx >= CAPLCTRL_INPUTBUF_LEN)
            {
                CaplCtrl_InputIdx = CAPLCTRL_INPUTBUF_LEN - 1;
            }

            /* make sure that string is terminated properly */
            CaplCtrl_InputBuf[CaplCtrl_InputIdx] = 0;
        }
        break;

        /* --- numeric input -------------------------------------------------------------------- */
        case KEY_ENTER:
        {
            if (CaplCtrl_InputIdx > 0)
            {
                InputVal = atol(CaplCtrl_InputBuf);
            
                /* reset input variables */
                CaplCtrl_InputIdx = 0;
                CaplCtrl_InputBuf[0] = 0;

                switch (CaplCtrl_LevelActv)
                {
                    /* currently no level selected */
                    case CAPLCTRL_LEVEL_NOSEL:
                    {
                        /* select frame only if selection was valid */
                        if (InputVal < FRM_NUM_MAX)
                        {
                            /* switch to next level */
                            CaplCtrl_LevelActv = CAPLCTRL_LEVEL_FRAME;

                            /* select frame */
                            CaplCtrl_FrameActv = InputVal;
                        }
                        break;
                    }

                    case CAPLCTRL_LEVEL_FRAME:
                    {
                        /* switch to next level */
                        CaplCtrl_LevelActv = CAPLCTRL_LEVEL_SIGNAL;
                
                        /* select signal */
                        CaplCtrl_SignalActv = InputVal;
                        break;
                    }
            
                    case CAPLCTRL_LEVEL_SIGNAL:
                    {
                        /* set signal to input value */
                        CaplCtrl_InputValue = InputVal;
                        Frm_SetSignal(CaplCtrl_FrameActv, CaplCtrl_SignalActv, CaplCtrl_InputValue);
                        break;
                    }
                }
            }
        }
        break;

        case KEY_LEVEL_DOWN:
        {
            switch (CaplCtrl_LevelActv)
            {
                /* currently no level selected */
                case CAPLCTRL_LEVEL_NOSEL:
                {
                    /* keep level, do nothing */
                    break;
                }

                case CAPLCTRL_LEVEL_FRAME:
                {
                    /* switch back to above level */
                    CaplCtrl_LevelActv = CAPLCTRL_LEVEL_NOSEL;
                    break;
                }
        
                case CAPLCTRL_LEVEL_SIGNAL:
                {
                    /* switch back to above level */
                    CaplCtrl_LevelActv = CAPLCTRL_LEVEL_FRAME;
                    break;
                }
            }
        }
        break;

        case KEY_BACKSPACE:
        {
            /* update index */
            if (CaplCtrl_InputIdx > 0)
            {
                CaplCtrl_InputIdx --;
            }
            else
            {
                CaplCtrl_InputIdx = 0;
            }

            /* remove last character */
            CaplCtrl_InputBuf[CaplCtrl_InputIdx] = 0;
        }
        break;

        case KEY_TIMEOUT:
        {
            switch (CaplCtrl_LevelActv)
            {
                /* currently no level selected */
                case CAPLCTRL_LEVEL_NOSEL:
                {
                    /* enable/disable all frames */
                    if (FrmSched_FrmEna[0] != 0)
                    {
                        FrmSch_DisableAllFrames();
                        snprintf(CaplCtrl_CharBuf,
                                 CAPLCTRL_CHARBUF_LEN,
                                 "all frames disabled!");
                    }
                    else
                    {
                        FrmSch_EnableAllFrames();
                        snprintf(CaplCtrl_CharBuf,
                                 CAPLCTRL_CHARBUF_LEN,
                                 "all frames enabled!");
                    }
                    CaplCtrl_PromptMode = CAPLCTRL_PROMPTMODE_CHAR;
                    break;
                }

                case CAPLCTRL_LEVEL_FRAME:
                case CAPLCTRL_LEVEL_SIGNAL:
                {
                    /* toggle timeout status for selected frame */
                    FrmSched_FrmEna[CaplCtrl_FrameActv] ^= 1;
                    
                    /* get current frame status */
                    snprintf(CharBufTmp,
                             CAPLCTRL_CHARBUF_LEN,
                             "[tx=%d dlc=%d cs=%d cnt=%d]",
                             FrmSched_FrmEna[CaplCtrl_FrameActv],
                             Frm_DLCOk[CaplCtrl_FrameActv],
                             Frm_MsgChksmEna[CaplCtrl_FrameActv],
                             Frm_MsgCounterEna[CaplCtrl_FrameActv]);

                    if (FrmSched_FrmEna[CaplCtrl_FrameActv] != 0)
                    {
                        snprintf(CaplCtrl_CharBuf,
                                 CAPLCTRL_CHARBUF_LEN,
                                 "%s TX enabled!",
                                 CharBufTmp);
                    }
                    else
                    {
                        snprintf(CaplCtrl_CharBuf,
                                 CAPLCTRL_CHARBUF_LEN,
                                 "%s TX disabled!",
                                 CharBufTmp);
                    }

                    CaplCtrl_PromptMode = CAPLCTRL_PROMPTMODE_CHAR;
                    break;
                }
            }
            break;
        }

        case KEY_MSGCNT:
        {
            switch (CaplCtrl_LevelActv)
            {
                /* currently no level selected */
                case CAPLCTRL_LEVEL_NOSEL:
                {
                    /* keep level, do nothing */
                    break;
                }

                case CAPLCTRL_LEVEL_FRAME:
                case CAPLCTRL_LEVEL_SIGNAL:
                {
                    /* toggle message counter enable status */
                    Frm_MsgCounterEna[CaplCtrl_FrameActv] ^= 1;

                    /* get current frame status */
                    snprintf(CharBufTmp,
                             CAPLCTRL_CHARBUF_LEN,
                             "[tx=%d dlc=%d cs=%d cnt=%d]",
                             FrmSched_FrmEna[CaplCtrl_FrameActv],
                             Frm_DLCOk[CaplCtrl_FrameActv],
                             Frm_MsgChksmEna[CaplCtrl_FrameActv],
                             Frm_MsgCounterEna[CaplCtrl_FrameActv]);

                    if (Frm_MsgCounterEna[CaplCtrl_FrameActv] != 0)
                    {
                        snprintf(CaplCtrl_CharBuf,
                                 CAPLCTRL_CHARBUF_LEN,
                                 "%s Message counter running!",
                                 CharBufTmp);
                    }
                    else
                    {
                        snprintf(CaplCtrl_CharBuf,
                                 CAPLCTRL_CHARBUF_LEN,
                                 "%s Message counter stopped!",
                                 CharBufTmp);
                    }

                    CaplCtrl_PromptMode = CAPLCTRL_PROMPTMODE_CHAR;
                    break;
                }
            }
            break;
        }

        case KEY_CHKSM:
        {
            switch (CaplCtrl_LevelActv)
            {
                /* currently no level selected */
                case CAPLCTRL_LEVEL_NOSEL:
                {
                    /* keep level, do nothing */
                    break;
                }

                case CAPLCTRL_LEVEL_FRAME:
                case CAPLCTRL_LEVEL_SIGNAL:
                {
                    /* toggle checksum enable status */
                    Frm_MsgChksmEna[CaplCtrl_FrameActv] ^= 1;

                    /* get current frame status */
                    snprintf(CharBufTmp,
                             CAPLCTRL_CHARBUF_LEN,
                             "[tx=%d dlc=%d cs=%d cnt=%d]",
                             FrmSched_FrmEna[CaplCtrl_FrameActv],
                             Frm_DLCOk[CaplCtrl_FrameActv],
                             Frm_MsgChksmEna[CaplCtrl_FrameActv],
                             Frm_MsgCounterEna[CaplCtrl_FrameActv]);

                    if (Frm_MsgChksmEna[CaplCtrl_FrameActv] != 0)
                    {
                        snprintf(CaplCtrl_CharBuf,
                                 CAPLCTRL_CHARBUF_LEN,
                                 "%s Checksum calculation enabled!",
                                 CharBufTmp);
                    }
                    else
                    {
                        snprintf(CaplCtrl_CharBuf,
                                 CAPLCTRL_CHARBUF_LEN,
                                 "%s Checksum calculation disabled!",
                                 CharBufTmp);
                    }

                    CaplCtrl_PromptMode = CAPLCTRL_PROMPTMODE_CHAR;
                    break;
                }
            }
            break;
        }

        case KEY_DLC:
        {
            switch (CaplCtrl_LevelActv)
            {
                /* currently no level selected */
                case CAPLCTRL_LEVEL_NOSEL:
                {
                    /* keep level, do nothing */
                    break;
                }

                case CAPLCTRL_LEVEL_FRAME:
                case CAPLCTRL_LEVEL_SIGNAL:
                {
                    /* toggle DLC ok status */
                    Frm_DLCOk[CaplCtrl_FrameActv] ^= 1;

                    /* get current frame status */
                    snprintf(CharBufTmp,
                             CAPLCTRL_CHARBUF_LEN,
                             "[tx=%d dlc=%d cs=%d cnt=%d]",
                             FrmSched_FrmEna[CaplCtrl_FrameActv],
                             Frm_DLCOk[CaplCtrl_FrameActv],
                             Frm_MsgChksmEna[CaplCtrl_FrameActv],
                             Frm_MsgCounterEna[CaplCtrl_FrameActv]);

                    if (Frm_DLCOk[CaplCtrl_FrameActv] != 0)
                    {
                        snprintf(CaplCtrl_CharBuf,
                                 CAPLCTRL_CHARBUF_LEN,
                                 "%s correct DLC!",
                                 CharBufTmp);

                        Frm_SetDLC (CaplCtrl_FrameActv, Frm_DLC[CaplCtrl_FrameActv]);
                    }
                    else
                    {
                        snprintf(CaplCtrl_CharBuf,
                                 CAPLCTRL_CHARBUF_LEN,
                                 "%s incorrect DLC!",
                                 CharBufTmp);

                        Frm_SetDLC (CaplCtrl_FrameActv, 0);
                    }


                    CaplCtrl_PromptMode = CAPLCTRL_PROMPTMODE_CHAR;
                    break;
                }
            }
            break;
        }
        
        case KEY_HELP:
        {
            CaplCtrl_LevelChanged();
            break;
        }

        default:
        {
            break;
        }
    }

    if (LevelActvOld != CaplCtrl_LevelActv)
    {
        //CaplCtrl_LevelChanged();
    }

    ShowPrompt();
    CaplCtrl_PromptMode = CAPLCTRL_PROMPTMODE_NUM;
}
/*@@end*/

/*@@caplFunc:CaplCtrl_LevelChanged():*/
CaplCtrl_LevelChanged ()
{
    switch(CaplCtrl_LevelActv)
    {
        case CAPLCTRL_LEVEL_NOSEL:
        {
           HelpFrameList();
        }
        break;

        case CAPLCTRL_LEVEL_FRAME:
        {
            HelpSignalList();
        }
        break;

        case CAPLCTRL_LEVEL_SIGNAL:
        {
           
        }
        break;
    }
}
/*@@end*/

/*@@msg:*:*/
on message *
{
   output(this);
}
/*@@end*/

/*@@caplFunc:FrmSched_SendFrame(int):*/
FrmSched_SendFrame (int FrmIdx)
{
    switch (FrmIdx)
    {
        case FRM_HANDLE_BMS_HYB_02:
            MsgObj_BMS_HYB_02.BY02_Zaehler = Frm_CalcMsgCounter(FRM_HANDLE_BMS_HYB_02);
            MsgObj_BMS_HYB_02.BY02_Checksumme = Frm_CalcChecksumXOR(FRM_HANDLE_BMS_HYB_02, MsgObj_BMS_HYB_02, 0);
            output(MsgObj_BMS_HYB_02);
            break;
        case FRM_HANDLE_BMS_HYB_03:
            MsgObj_BMS_HYB_03.BY03_Zaehler = Frm_CalcMsgCounter(FRM_HANDLE_BMS_HYB_03);
            MsgObj_BMS_HYB_03.BY03_Checksumme = Frm_CalcChecksumXOR(FRM_HANDLE_BMS_HYB_03, MsgObj_BMS_HYB_03, 0);
            output(MsgObj_BMS_HYB_03);
            break;
        case FRM_HANDLE_BMS_HYB_04:
            MsgObj_BMS_HYB_04.BY04_Zaehler = Frm_CalcMsgCounter(FRM_HANDLE_BMS_HYB_04);
            MsgObj_BMS_HYB_04.BY04_Checksumme = Frm_CalcChecksumXOR(FRM_HANDLE_BMS_HYB_04, MsgObj_BMS_HYB_04, 0);
            output(MsgObj_BMS_HYB_04);
            break;
        case FRM_HANDLE_BMS_HYB_06:
            MsgObj_BMS_HYB_06.BY06_Zaehler = Frm_CalcMsgCounter(FRM_HANDLE_BMS_HYB_06);
            MsgObj_BMS_HYB_06.BY06_Checksumme = Frm_CalcChecksumXOR(FRM_HANDLE_BMS_HYB_06, MsgObj_BMS_HYB_06, 0);
            output(MsgObj_BMS_HYB_06);
            break;
        case FRM_HANDLE_CCU_HYB_01:
            MsgObj_CCU_HYB_01.CY01_Zaehler = Frm_CalcMsgCounter(FRM_HANDLE_CCU_HYB_01);
            MsgObj_CCU_HYB_01.CY01_Checksumme = Frm_CalcChecksumXOR(FRM_HANDLE_CCU_HYB_01, MsgObj_CCU_HYB_01, 0);
            output(MsgObj_CCU_HYB_01);
            break;
        case FRM_HANDLE_CCU_HYB_02:
            MsgObj_CCU_HYB_02.CY02_Zaehler = Frm_CalcMsgCounter(FRM_HANDLE_CCU_HYB_02);
            MsgObj_CCU_HYB_02.CY02_Checksumme = Frm_CalcChecksumXOR(FRM_HANDLE_CCU_HYB_02, MsgObj_CCU_HYB_02, 0);
            output(MsgObj_CCU_HYB_02);
            break;
        case FRM_HANDLE_DC_HYB_01:
            MsgObj_DC_HYB_01.DY01_Zaehler = Frm_CalcMsgCounter(FRM_HANDLE_DC_HYB_01);
            MsgObj_DC_HYB_01.DY01_Checksumme = Frm_CalcChecksumXOR(FRM_HANDLE_DC_HYB_01, MsgObj_DC_HYB_01, 0);
            output(MsgObj_DC_HYB_01);
            break;
        case FRM_HANDLE_DC_HYB_02:
            MsgObj_DC_HYB_02.DY02_Zaehler = Frm_CalcMsgCounter(FRM_HANDLE_DC_HYB_02);
            MsgObj_DC_HYB_02.DY02_Checksumme = Frm_CalcChecksumXOR(FRM_HANDLE_DC_HYB_02, MsgObj_DC_HYB_02, 0);
            output(MsgObj_DC_HYB_02);
            break;
        case FRM_HANDLE_EM_HYB_02:
            MsgObj_EM_HYB_02.EY02_Zaehler = Frm_CalcMsgCounter(FRM_HANDLE_EM_HYB_02);
            MsgObj_EM_HYB_02.EY02_Checksumme = Frm_CalcChecksumXOR(FRM_HANDLE_EM_HYB_02, MsgObj_EM_HYB_02, 0);
            output(MsgObj_EM_HYB_02);
            break;
        case FRM_HANDLE_EM_HYB_03:
            MsgObj_EM_HYB_03.EY03_Zaehler = Frm_CalcMsgCounter(FRM_HANDLE_EM_HYB_03);
            MsgObj_EM_HYB_03.EY03_Checksumme = Frm_CalcChecksumXOR(FRM_HANDLE_EM_HYB_03, MsgObj_EM_HYB_03, 0);
            output(MsgObj_EM_HYB_03);
            break;
        case FRM_HANDLE_EM_HYB_04:
            MsgObj_EM_HYB_04.EY04_Zaehler = Frm_CalcMsgCounter(FRM_HANDLE_EM_HYB_04);
            MsgObj_EM_HYB_04.EY04_Checksumme = Frm_CalcChecksumXOR(FRM_HANDLE_EM_HYB_04, MsgObj_EM_HYB_04, 0);
            output(MsgObj_EM_HYB_04);
            break;
        case FRM_HANDLE_EM_HYB_05:
            MsgObj_EM_HYB_05.EY05_Zaehler = Frm_CalcMsgCounter(FRM_HANDLE_EM_HYB_05);
            MsgObj_EM_HYB_05.EY05_Checksumme = Frm_CalcChecksumXOR(FRM_HANDLE_EM_HYB_05, MsgObj_EM_HYB_05, 0);
            output(MsgObj_EM_HYB_05);
            break;
        case FRM_HANDLE_EM_HYB_06:
            MsgObj_EM_HYB_06.EY06_Zaehler = Frm_CalcMsgCounter(FRM_HANDLE_EM_HYB_06);
            MsgObj_EM_HYB_06.EY06_Checksumme = Frm_CalcChecksumXOR(FRM_HANDLE_EM_HYB_06, MsgObj_EM_HYB_06, 0);
            output(MsgObj_EM_HYB_06);
            break;
        case FRM_HANDLE_FIS_1:
            output(MsgObj_FIS_1);
            break;
    }
}
/*@@end*/

/*@@caplFunc:Frm_SetDLC(long, long):*/
Frm_SetDLC (long FrmIdx, long FrmDLC)
{
    switch (FrmIdx)
    {
        case FRM_HANDLE_BMS_HYB_02:
            MsgObj_BMS_HYB_02.DLC = FrmDLC;
            break;
        case FRM_HANDLE_BMS_HYB_03:
            MsgObj_BMS_HYB_03.DLC = FrmDLC;
            break;
        case FRM_HANDLE_BMS_HYB_04:
            MsgObj_BMS_HYB_04.DLC = FrmDLC;
            break;
        case FRM_HANDLE_BMS_HYB_06:
            MsgObj_BMS_HYB_06.DLC = FrmDLC;
            break;
        case FRM_HANDLE_CCU_HYB_01:
            MsgObj_CCU_HYB_01.DLC = FrmDLC;
            break;
        case FRM_HANDLE_CCU_HYB_02:
            MsgObj_CCU_HYB_02.DLC = FrmDLC;
            break;
        case FRM_HANDLE_DC_HYB_01:
            MsgObj_DC_HYB_01.DLC = FrmDLC;
            break;
        case FRM_HANDLE_DC_HYB_02:
            MsgObj_DC_HYB_02.DLC = FrmDLC;
            break;
        case FRM_HANDLE_EM_HYB_02:
            MsgObj_EM_HYB_02.DLC = FrmDLC;
            break;
        case FRM_HANDLE_EM_HYB_03:
            MsgObj_EM_HYB_03.DLC = FrmDLC;
            break;
        case FRM_HANDLE_EM_HYB_04:
            MsgObj_EM_HYB_04.DLC = FrmDLC;
            break;
        case FRM_HANDLE_EM_HYB_05:
            MsgObj_EM_HYB_05.DLC = FrmDLC;
            break;
        case FRM_HANDLE_EM_HYB_06:
            MsgObj_EM_HYB_06.DLC = FrmDLC;
            break;
        case FRM_HANDLE_FIS_1:
            MsgObj_FIS_1.DLC = FrmDLC;
            break;
    }
}
/*@@end*/

/*@@busOff:BusOff:*/
on busOff
{
    resetCan();
}
/*@@end*/

/*@@caplFunc:HelpCommands():*/
HelpCommands ()
{
    write("-------------------------------------------");
    write("Supported commands:");
    write("[a] ... toggle timeout error status");
    write("[b] ... toggle message counter error status");
    write("[c] ... toggle checksumm error status");
    write("[d] ... toggle DLC error status");
    write("[.] ... one level up in command prompt");
    write("-------------------------------------------");
}

/*@@caplFunc:HelpFrameList():*/
HelpFrameList ()
{
    HelpCommands();

    write("[0] ... BMS_HYB_02");
    write("[1] ... BMS_HYB_03");
    write("[2] ... BMS_HYB_04");
    write("[3] ... BMS_HYB_06");
    write("[4] ... CCU_HYB_01");
    write("[5] ... CCU_HYB_02");
    write("[6] ... DC_HYB_01");
    write("[7] ... DC_HYB_02");
    write("[8] ... EM_HYB_02");
    write("[9] ... EM_HYB_03");
    write("[10] ... EM_HYB_04");
    write("[11] ... EM_HYB_05");
    write("[12] ... EM_HYB_06");
    write("[13] ... FIS_1");

}

/*@@caplFunc:HelpSignalList():*/
HelpSignalList ()
{
    HelpCommands();

    switch(CaplCtrl_FrameActv)
    {
        case FRM_HANDLE_BMS_HYB_02:
        {
            write("[0] ... BY02_Checksumme");
            write("[1] ... BY02_ErrContactorOpen");
            write("[2] ... BY02_ErrContactorWelding");
            write("[3] ... BY02_ErrEmrgcyShtOffCrash");
            write("[4] ... BY02_ErrEmrgcyShtOffPilotLine");
            write("[5] ... BY02_ErrInsulation");
            write("[6] ... BY02_ErrLimitedPerformance");
            write("[7] ... BY02_ErrShtOff");
            write("[8] ... BY02_ErrShtOffReq");
            write("[9] ... BY02_IsoTestActv");
            write("[10] ... BY02_ReadyInit");
            write("[11] ... BY02_SleepInd");
            write("[12] ... BY02_Zaehler");
            write("[13] ... BY02_iCurr");
            write("[14] ... BY02_res_42");
            write("[15] ... BY02_res_43");
            write("[16] ... BY02_res_44");
            write("[17] ... BY02_res_45");
            write("[18] ... BY02_res_46");
            write("[19] ... BY02_res_47");
            write("[20] ... BY02_res_48");
            write("[21] ... BY02_res_57");
            write("[22] ... BY02_res_58");
            write("[23] ... BY02_res_59");
            write("[24] ... BY02_res_60");
            write("[25] ... BY02_res_61");
            write("[26] ... BY02_res_62");
            write("[27] ... BY02_res_63");
            write("[28] ... BY02_stMode");
            write("[29] ... BY02_uCurr");
        }
        break;
        case FRM_HANDLE_BMS_HYB_03:
        {
            write("[0] ... BY03_BattFanSpd");
            write("[1] ... BY03_Checksumme");
            write("[2] ... BY03_Zaehler");
            write("[3] ... BY03_iChPredMax");
            write("[4] ... BY03_iDisChPredMax");
            write("[5] ... BY03_rSOC");
            write("[6] ... BY03_uChPredMin");
            write("[7] ... BY03_uDisChPredMin");
        }
        break;
        case FRM_HANDLE_BMS_HYB_04:
        {
            write("[0] ... BY04_Checksumme");
            write("[1] ... BY04_ExtRngActv");
            write("[2] ... BY04_Zaehler");
            write("[3] ... BY04_iChMax");
            write("[4] ... BY04_iDisChMax");
            write("[5] ... BY04_res_53");
            write("[6] ... BY04_res_54");
            write("[7] ... BY04_res_55");
            write("[8] ... BY04_res_56");
            write("[9] ... BY04_res_57");
            write("[10] ... BY04_res_58");
            write("[11] ... BY04_res_59");
            write("[12] ... BY04_res_60");
            write("[13] ... BY04_res_61");
            write("[14] ... BY04_res_62");
            write("[15] ... BY04_res_63");
            write("[16] ... BY04_uChDynMin");
            write("[17] ... BY04_uDisChDynMin");
        }
        break;
        case FRM_HANDLE_BMS_HYB_06:
        {
            write("[0] ... BY06_BalancingReq");
            write("[1] ... BY06_Checksumme");
            write("[2] ... BY06_LftSOH");
            write("[3] ... BY06_MILReq");
            write("[4] ... BY06_RedLEDReq");
            write("[5] ... BY06_VentilationReq");
            write("[6] ... BY06_YellowLEDReq");
            write("[7] ... BY06_Zaehler");
            write("[8] ... BY06_res_61");
            write("[9] ... BY06_res_62");
            write("[10] ... BY06_res_63");
            write("[11] ... BY06_tAirIn");
            write("[12] ... BY06_tCurr");
            write("[13] ... BY06_uChMax");
            write("[14] ... BY06_uDisChMin");
        }
        break;
        case FRM_HANDLE_CCU_HYB_01:
        {
            write("[0] ... CY01_AngSpdCurr");
            write("[1] ... CY01_Checksumme");
            write("[2] ... CY01_ErrCAN");
            write("[3] ... CY01_ErrHW");
            write("[4] ... CY01_ErrMech");
            write("[5] ... CY01_ErrTempHigh");
            write("[6] ... CY01_ErrTempWarn");
            write("[7] ... CY01_ErrUBattLow");
            write("[8] ... CY01_SleepInd");
            write("[9] ... CY01_Zaehler");
            write("[10] ... CY01_i2trqCurr");
            write("[11] ... CY01_pCurr");
            write("[12] ... CY01_posCurr");
            write("[13] ... CY01_stMode");
        }
        break;
        case FRM_HANDLE_CCU_HYB_02:
        {
            write("[0] ... CY02_Checksumme");
            write("[1] ... CY02_HW_Version");
            write("[2] ... CY02_Medium");
            write("[3] ... CY02_SPart_Number");
            write("[4] ... CY02_SW_Version");
            write("[5] ... CY02_Serial_Number");
            write("[6] ... CY02_Zaehler");
        }
        break;
        case FRM_HANDLE_DC_HYB_01:
        {
            write("[0] ... DY01_Checksumme");
            write("[1] ... DY01_ErrLimitedPerformance");
            write("[2] ... DY01_ErrShtOff");
            write("[3] ... DY01_ErrVltg");
            write("[4] ... DY01_SleepIndication");
            write("[5] ... DY01_SlowControlActv");
            write("[6] ... DY01_Zaehler");
            write("[7] ... DY01_iCurrHV");
            write("[8] ... DY01_res_42");
            write("[9] ... DY01_res_43");
            write("[10] ... DY01_res_44");
            write("[11] ... DY01_res_45");
            write("[12] ... DY01_res_46");
            write("[13] ... DY01_res_47");
            write("[14] ... DY01_res_48");
            write("[15] ... DY01_res_49");
            write("[16] ... DY01_res_50");
            write("[17] ... DY01_res_51");
            write("[18] ... DY01_res_52");
            write("[19] ... DY01_res_53");
            write("[20] ... DY01_res_54");
            write("[21] ... DY01_res_55");
            write("[22] ... DY01_res_56");
            write("[23] ... DY01_res_57");
            write("[24] ... DY01_res_58");
            write("[25] ... DY01_res_59");
            write("[26] ... DY01_res_60");
            write("[27] ... DY01_res_61");
            write("[28] ... DY01_res_62");
            write("[29] ... DY01_res_63");
            write("[30] ... DY01_stMode");
            write("[31] ... DY01_uCurrHV");
        }
        break;
        case FRM_HANDLE_DC_HYB_02:
        {
            write("[0] ... DY02_Checksumme");
            write("[1] ... DY02_Derating_CrntLim_HV");
            write("[2] ... DY02_Derating_CrntLim_LV");
            write("[3] ... DY02_Derating_Temp");
            write("[4] ... DY02_Derating_VltgLim_HV");
            write("[5] ... DY02_Derating_VltgLim_LV");
            write("[6] ... DY02_IdentCode");
            write("[7] ... DY02_Zaehler");
            write("[8] ... DY02_iCurrLV");
            write("[9] ... DY02_rUtilRateDFM");
            write("[10] ... DY02_res_56");
            write("[11] ... DY02_res_57");
            write("[12] ... DY02_res_58");
            write("[13] ... DY02_res_59");
            write("[14] ... DY02_res_60");
            write("[15] ... DY02_res_61");
            write("[16] ... DY02_res_62");
            write("[17] ... DY02_res_63");
            write("[18] ... DY02_tCurr");
            write("[19] ... DY02_uCurrLV");
        }
        break;
        case FRM_HANDLE_EM_HYB_02:
        {
            write("[0] ... EY02_Checksumme");
            write("[1] ... EY02_DstCActv");
            write("[2] ... EY02_Zaehler");
            write("[3] ... EY02_nCurr");
            write("[4] ... EY02_res_52");
            write("[5] ... EY02_res_53");
            write("[6] ... EY02_res_54");
            write("[7] ... EY02_res_56");
            write("[8] ... EY02_res_57");
            write("[9] ... EY02_res_58");
            write("[10] ... EY02_res_59");
            write("[11] ... EY02_res_60");
            write("[12] ... EY02_res_61");
            write("[13] ... EY02_res_62");
            write("[14] ... EY02_res_63");
            write("[15] ... EY02_trqCurr");
            write("[16] ... EY02_trqCurrWoDstC");
        }
        break;
        case FRM_HANDLE_EM_HYB_03:
        {
            write("[0] ... EY03_Checksumme");
            write("[1] ... EY03_Derating_Temp");
            write("[2] ... EY03_DiagReq");
            write("[3] ... EY03_Lim_CrntMax");
            write("[4] ... EY03_Lim_CrntMin");
            write("[5] ... EY03_Lim_TrqMax");
            write("[6] ... EY03_Lim_TrqMin");
            write("[7] ... EY03_Lim_VltgMax");
            write("[8] ... EY03_Lim_VltgMin");
            write("[9] ... EY03_Zaehler");
            write("[10] ... EY03_iCurr");
            write("[11] ... EY03_res_44");
            write("[12] ... EY03_res_45");
            write("[13] ... EY03_res_46");
            write("[14] ... EY03_res_47");
            write("[15] ... EY03_res_48");
            write("[16] ... EY03_res_49");
            write("[17] ... EY03_res_50");
            write("[18] ... EY03_res_51");
            write("[19] ... EY03_res_52");
            write("[20] ... EY03_res_53");
            write("[21] ... EY03_res_54");
            write("[22] ... EY03_res_55");
            write("[23] ... EY03_res_56");
            write("[24] ... EY03_res_57");
            write("[25] ... EY03_res_58");
            write("[26] ... EY03_res_59");
            write("[27] ... EY03_res_60");
            write("[28] ... EY03_res_61");
            write("[29] ... EY03_res_62");
            write("[30] ... EY03_res_63");
            write("[31] ... EY03_uCurr");
        }
        break;
        case FRM_HANDLE_EM_HYB_04:
        {
            write("[0] ... EY04_Checksumme");
            write("[1] ... EY04_Zaehler");
            write("[2] ... EY04_nCalcPredMax");
            write("[3] ... EY04_nCalcPredMin");
            write("[4] ... EY04_res_58");
            write("[5] ... EY04_res_59");
            write("[6] ... EY04_res_60");
            write("[7] ... EY04_res_61");
            write("[8] ... EY04_res_62");
            write("[9] ... EY04_res_63");
            write("[10] ... EY04_trqCalcElPwr");
            write("[11] ... EY04_trqCalcPredMax");
            write("[12] ... EY04_trqCalcPredMin");
        }
        break;
        case FRM_HANDLE_EM_HYB_05:
        {
            write("[0] ... EY05_Checksumme");
            write("[1] ... EY05_MILReq");
            write("[2] ... EY05_RedLEDReq");
            write("[3] ... EY05_YellowLEDReq");
            write("[4] ... EY05_Zaehler");
            write("[5] ... EY05_res_15");
            write("[6] ... EY05_res_40");
            write("[7] ... EY05_res_41");
            write("[8] ... EY05_res_42");
            write("[9] ... EY05_res_43");
            write("[10] ... EY05_res_44");
            write("[11] ... EY05_res_45");
            write("[12] ... EY05_res_46");
            write("[13] ... EY05_res_47");
            write("[14] ... EY05_res_48");
            write("[15] ... EY05_res_49");
            write("[16] ... EY05_res_50");
            write("[17] ... EY05_res_51");
            write("[18] ... EY05_res_52");
            write("[19] ... EY05_res_53");
            write("[20] ... EY05_res_54");
            write("[21] ... EY05_res_55");
            write("[22] ... EY05_res_56");
            write("[23] ... EY05_res_57");
            write("[24] ... EY05_res_58");
            write("[25] ... EY05_res_59");
            write("[26] ... EY05_res_60");
            write("[27] ... EY05_res_61");
            write("[28] ... EY05_res_62");
            write("[29] ... EY05_res_63");
            write("[30] ... EY05_tCurrMot");
            write("[31] ... EY05_tCurrPWR");
            write("[32] ... EY05_tCurrRotor");
        }
        break;
        case FRM_HANDLE_EM_HYB_06:
        {
            write("[0] ... EY06_Checksumme");
            write("[1] ... EY06_ErrEmrgcyShtOff");
            write("[2] ... EY06_ErrFreeWheeling");
            write("[3] ... EY06_ErrLimitedPerformance");
            write("[4] ... EY06_ErrShtOff");
            write("[5] ... EY06_ExtRngActv");
            write("[6] ... EY06_ReadyHV");
            write("[7] ... EY06_ReadyInit");
            write("[8] ... EY06_SleepInd");
            write("[9] ... EY06_Zaehler");
            write("[10] ... EY06_stMode");
            write("[11] ... EY06_trqAbsMax");
            write("[12] ... EY06_trqAbsMin");
            write("[13] ... EY06_trqCalcDynMax");
            write("[14] ... EY06_trqCalcDynMin");
        }
        break;
        case FRM_HANDLE_FIS_1:
        {
            write("[0] ... FIS1_Operand1");
            write("[1] ... FIS1_Operand2");
            write("[2] ... FIS1_Operand3");
        }
        break;

    }
}

/*@@caplFunc:HelpSignal():*/
HelpSignal ()
{
    //REPLACE_HELP_SIGNAL
}
/*@@end*/

/*@@caplFunc:GetFrameName(int):*/
GetFrameName (int FrmIdx)
{
    switch (FrmIdx)
    {
        case FRM_HANDLE_BMS_HYB_02:
            strncpy(CaplCtrl_FrameName, "BMS_HYB_02", 11);
            break;
        case FRM_HANDLE_BMS_HYB_03:
            strncpy(CaplCtrl_FrameName, "BMS_HYB_03", 11);
            break;
        case FRM_HANDLE_BMS_HYB_04:
            strncpy(CaplCtrl_FrameName, "BMS_HYB_04", 11);
            break;
        case FRM_HANDLE_BMS_HYB_06:
            strncpy(CaplCtrl_FrameName, "BMS_HYB_06", 11);
            break;
        case FRM_HANDLE_CCU_HYB_01:
            strncpy(CaplCtrl_FrameName, "CCU_HYB_01", 11);
            break;
        case FRM_HANDLE_CCU_HYB_02:
            strncpy(CaplCtrl_FrameName, "CCU_HYB_02", 11);
            break;
        case FRM_HANDLE_DC_HYB_01:
            strncpy(CaplCtrl_FrameName, "DC_HYB_01", 10);
            break;
        case FRM_HANDLE_DC_HYB_02:
            strncpy(CaplCtrl_FrameName, "DC_HYB_02", 10);
            break;
        case FRM_HANDLE_EM_HYB_02:
            strncpy(CaplCtrl_FrameName, "EM_HYB_02", 10);
            break;
        case FRM_HANDLE_EM_HYB_03:
            strncpy(CaplCtrl_FrameName, "EM_HYB_03", 10);
            break;
        case FRM_HANDLE_EM_HYB_04:
            strncpy(CaplCtrl_FrameName, "EM_HYB_04", 10);
            break;
        case FRM_HANDLE_EM_HYB_05:
            strncpy(CaplCtrl_FrameName, "EM_HYB_05", 10);
            break;
        case FRM_HANDLE_EM_HYB_06:
            strncpy(CaplCtrl_FrameName, "EM_HYB_06", 10);
            break;
        case FRM_HANDLE_FIS_1:
            strncpy(CaplCtrl_FrameName, "FIS_1", 6);
            break;
    }
}
/*@@end*/

/*@@caplFunc:GetSignalName(int,int):*/
GetSignalName (int FrmIdx, int SigIdx)
{
    switch (FrmIdx)
    {
        case FRM_HANDLE_BMS_HYB_02:
        {
            switch (SigIdx)
            {
                case 0:
                    strncpy(CaplCtrl_SignalName, "BY02_Checksumme", 16);
                    break;
                case 1:
                    strncpy(CaplCtrl_SignalName, "BY02_ErrContactorOpen", 22);
                    break;
                case 2:
                    strncpy(CaplCtrl_SignalName, "BY02_ErrContactorWelding", 25);
                    break;
                case 3:
                    strncpy(CaplCtrl_SignalName, "BY02_ErrEmrgcyShtOffCrash", 26);
                    break;
                case 4:
                    strncpy(CaplCtrl_SignalName, "BY02_ErrEmrgcyShtOffPilotLine", 30);
                    break;
                case 5:
                    strncpy(CaplCtrl_SignalName, "BY02_ErrInsulation", 19);
                    break;
                case 6:
                    strncpy(CaplCtrl_SignalName, "BY02_ErrLimitedPerformance", 27);
                    break;
                case 7:
                    strncpy(CaplCtrl_SignalName, "BY02_ErrShtOff", 15);
                    break;
                case 8:
                    strncpy(CaplCtrl_SignalName, "BY02_ErrShtOffReq", 18);
                    break;
                case 9:
                    strncpy(CaplCtrl_SignalName, "BY02_IsoTestActv", 17);
                    break;
                case 10:
                    strncpy(CaplCtrl_SignalName, "BY02_ReadyInit", 15);
                    break;
                case 11:
                    strncpy(CaplCtrl_SignalName, "BY02_SleepInd", 14);
                    break;
                case 12:
                    strncpy(CaplCtrl_SignalName, "BY02_Zaehler", 13);
                    break;
                case 13:
                    strncpy(CaplCtrl_SignalName, "BY02_iCurr", 11);
                    break;
                case 14:
                    strncpy(CaplCtrl_SignalName, "BY02_res_42", 12);
                    break;
                case 15:
                    strncpy(CaplCtrl_SignalName, "BY02_res_43", 12);
                    break;
                case 16:
                    strncpy(CaplCtrl_SignalName, "BY02_res_44", 12);
                    break;
                case 17:
                    strncpy(CaplCtrl_SignalName, "BY02_res_45", 12);
                    break;
                case 18:
                    strncpy(CaplCtrl_SignalName, "BY02_res_46", 12);
                    break;
                case 19:
                    strncpy(CaplCtrl_SignalName, "BY02_res_47", 12);
                    break;
                case 20:
                    strncpy(CaplCtrl_SignalName, "BY02_res_48", 12);
                    break;
                case 21:
                    strncpy(CaplCtrl_SignalName, "BY02_res_57", 12);
                    break;
                case 22:
                    strncpy(CaplCtrl_SignalName, "BY02_res_58", 12);
                    break;
                case 23:
                    strncpy(CaplCtrl_SignalName, "BY02_res_59", 12);
                    break;
                case 24:
                    strncpy(CaplCtrl_SignalName, "BY02_res_60", 12);
                    break;
                case 25:
                    strncpy(CaplCtrl_SignalName, "BY02_res_61", 12);
                    break;
                case 26:
                    strncpy(CaplCtrl_SignalName, "BY02_res_62", 12);
                    break;
                case 27:
                    strncpy(CaplCtrl_SignalName, "BY02_res_63", 12);
                    break;
                case 28:
                    strncpy(CaplCtrl_SignalName, "BY02_stMode", 12);
                    break;
                case 29:
                    strncpy(CaplCtrl_SignalName, "BY02_uCurr", 11);
                    break;
            }
        }
        break;
        case FRM_HANDLE_BMS_HYB_03:
        {
            switch (SigIdx)
            {
                case 0:
                    strncpy(CaplCtrl_SignalName, "BY03_BattFanSpd", 16);
                    break;
                case 1:
                    strncpy(CaplCtrl_SignalName, "BY03_Checksumme", 16);
                    break;
                case 2:
                    strncpy(CaplCtrl_SignalName, "BY03_Zaehler", 13);
                    break;
                case 3:
                    strncpy(CaplCtrl_SignalName, "BY03_iChPredMax", 16);
                    break;
                case 4:
                    strncpy(CaplCtrl_SignalName, "BY03_iDisChPredMax", 19);
                    break;
                case 5:
                    strncpy(CaplCtrl_SignalName, "BY03_rSOC", 10);
                    break;
                case 6:
                    strncpy(CaplCtrl_SignalName, "BY03_uChPredMin", 16);
                    break;
                case 7:
                    strncpy(CaplCtrl_SignalName, "BY03_uDisChPredMin", 19);
                    break;
            }
        }
        break;
        case FRM_HANDLE_BMS_HYB_04:
        {
            switch (SigIdx)
            {
                case 0:
                    strncpy(CaplCtrl_SignalName, "BY04_Checksumme", 16);
                    break;
                case 1:
                    strncpy(CaplCtrl_SignalName, "BY04_ExtRngActv", 16);
                    break;
                case 2:
                    strncpy(CaplCtrl_SignalName, "BY04_Zaehler", 13);
                    break;
                case 3:
                    strncpy(CaplCtrl_SignalName, "BY04_iChMax", 12);
                    break;
                case 4:
                    strncpy(CaplCtrl_SignalName, "BY04_iDisChMax", 15);
                    break;
                case 5:
                    strncpy(CaplCtrl_SignalName, "BY04_res_53", 12);
                    break;
                case 6:
                    strncpy(CaplCtrl_SignalName, "BY04_res_54", 12);
                    break;
                case 7:
                    strncpy(CaplCtrl_SignalName, "BY04_res_55", 12);
                    break;
                case 8:
                    strncpy(CaplCtrl_SignalName, "BY04_res_56", 12);
                    break;
                case 9:
                    strncpy(CaplCtrl_SignalName, "BY04_res_57", 12);
                    break;
                case 10:
                    strncpy(CaplCtrl_SignalName, "BY04_res_58", 12);
                    break;
                case 11:
                    strncpy(CaplCtrl_SignalName, "BY04_res_59", 12);
                    break;
                case 12:
                    strncpy(CaplCtrl_SignalName, "BY04_res_60", 12);
                    break;
                case 13:
                    strncpy(CaplCtrl_SignalName, "BY04_res_61", 12);
                    break;
                case 14:
                    strncpy(CaplCtrl_SignalName, "BY04_res_62", 12);
                    break;
                case 15:
                    strncpy(CaplCtrl_SignalName, "BY04_res_63", 12);
                    break;
                case 16:
                    strncpy(CaplCtrl_SignalName, "BY04_uChDynMin", 15);
                    break;
                case 17:
                    strncpy(CaplCtrl_SignalName, "BY04_uDisChDynMin", 18);
                    break;
            }
        }
        break;
        case FRM_HANDLE_BMS_HYB_06:
        {
            switch (SigIdx)
            {
                case 0:
                    strncpy(CaplCtrl_SignalName, "BY06_BalancingReq", 18);
                    break;
                case 1:
                    strncpy(CaplCtrl_SignalName, "BY06_Checksumme", 16);
                    break;
                case 2:
                    strncpy(CaplCtrl_SignalName, "BY06_LftSOH", 12);
                    break;
                case 3:
                    strncpy(CaplCtrl_SignalName, "BY06_MILReq", 12);
                    break;
                case 4:
                    strncpy(CaplCtrl_SignalName, "BY06_RedLEDReq", 15);
                    break;
                case 5:
                    strncpy(CaplCtrl_SignalName, "BY06_VentilationReq", 20);
                    break;
                case 6:
                    strncpy(CaplCtrl_SignalName, "BY06_YellowLEDReq", 18);
                    break;
                case 7:
                    strncpy(CaplCtrl_SignalName, "BY06_Zaehler", 13);
                    break;
                case 8:
                    strncpy(CaplCtrl_SignalName, "BY06_res_61", 12);
                    break;
                case 9:
                    strncpy(CaplCtrl_SignalName, "BY06_res_62", 12);
                    break;
                case 10:
                    strncpy(CaplCtrl_SignalName, "BY06_res_63", 12);
                    break;
                case 11:
                    strncpy(CaplCtrl_SignalName, "BY06_tAirIn", 12);
                    break;
                case 12:
                    strncpy(CaplCtrl_SignalName, "BY06_tCurr", 11);
                    break;
                case 13:
                    strncpy(CaplCtrl_SignalName, "BY06_uChMax", 12);
                    break;
                case 14:
                    strncpy(CaplCtrl_SignalName, "BY06_uDisChMin", 15);
                    break;
            }
        }
        break;
        case FRM_HANDLE_CCU_HYB_01:
        {
            switch (SigIdx)
            {
                case 0:
                    strncpy(CaplCtrl_SignalName, "CY01_AngSpdCurr", 16);
                    break;
                case 1:
                    strncpy(CaplCtrl_SignalName, "CY01_Checksumme", 16);
                    break;
                case 2:
                    strncpy(CaplCtrl_SignalName, "CY01_ErrCAN", 12);
                    break;
                case 3:
                    strncpy(CaplCtrl_SignalName, "CY01_ErrHW", 11);
                    break;
                case 4:
                    strncpy(CaplCtrl_SignalName, "CY01_ErrMech", 13);
                    break;
                case 5:
                    strncpy(CaplCtrl_SignalName, "CY01_ErrTempHigh", 17);
                    break;
                case 6:
                    strncpy(CaplCtrl_SignalName, "CY01_ErrTempWarn", 17);
                    break;
                case 7:
                    strncpy(CaplCtrl_SignalName, "CY01_ErrUBattLow", 17);
                    break;
                case 8:
                    strncpy(CaplCtrl_SignalName, "CY01_SleepInd", 14);
                    break;
                case 9:
                    strncpy(CaplCtrl_SignalName, "CY01_Zaehler", 13);
                    break;
                case 10:
                    strncpy(CaplCtrl_SignalName, "CY01_i2trqCurr", 15);
                    break;
                case 11:
                    strncpy(CaplCtrl_SignalName, "CY01_pCurr", 11);
                    break;
                case 12:
                    strncpy(CaplCtrl_SignalName, "CY01_posCurr", 13);
                    break;
                case 13:
                    strncpy(CaplCtrl_SignalName, "CY01_stMode", 12);
                    break;
            }
        }
        break;
        case FRM_HANDLE_CCU_HYB_02:
        {
            switch (SigIdx)
            {
                case 0:
                    strncpy(CaplCtrl_SignalName, "CY02_Checksumme", 16);
                    break;
                case 1:
                    strncpy(CaplCtrl_SignalName, "CY02_HW_Version", 16);
                    break;
                case 2:
                    strncpy(CaplCtrl_SignalName, "CY02_Medium", 12);
                    break;
                case 3:
                    strncpy(CaplCtrl_SignalName, "CY02_SPart_Number", 18);
                    break;
                case 4:
                    strncpy(CaplCtrl_SignalName, "CY02_SW_Version", 16);
                    break;
                case 5:
                    strncpy(CaplCtrl_SignalName, "CY02_Serial_Number", 19);
                    break;
                case 6:
                    strncpy(CaplCtrl_SignalName, "CY02_Zaehler", 13);
                    break;
            }
        }
        break;
        case FRM_HANDLE_DC_HYB_01:
        {
            switch (SigIdx)
            {
                case 0:
                    strncpy(CaplCtrl_SignalName, "DY01_Checksumme", 16);
                    break;
                case 1:
                    strncpy(CaplCtrl_SignalName, "DY01_ErrLimitedPerformance", 27);
                    break;
                case 2:
                    strncpy(CaplCtrl_SignalName, "DY01_ErrShtOff", 15);
                    break;
                case 3:
                    strncpy(CaplCtrl_SignalName, "DY01_ErrVltg", 13);
                    break;
                case 4:
                    strncpy(CaplCtrl_SignalName, "DY01_SleepIndication", 21);
                    break;
                case 5:
                    strncpy(CaplCtrl_SignalName, "DY01_SlowControlActv", 21);
                    break;
                case 6:
                    strncpy(CaplCtrl_SignalName, "DY01_Zaehler", 13);
                    break;
                case 7:
                    strncpy(CaplCtrl_SignalName, "DY01_iCurrHV", 13);
                    break;
                case 8:
                    strncpy(CaplCtrl_SignalName, "DY01_res_42", 12);
                    break;
                case 9:
                    strncpy(CaplCtrl_SignalName, "DY01_res_43", 12);
                    break;
                case 10:
                    strncpy(CaplCtrl_SignalName, "DY01_res_44", 12);
                    break;
                case 11:
                    strncpy(CaplCtrl_SignalName, "DY01_res_45", 12);
                    break;
                case 12:
                    strncpy(CaplCtrl_SignalName, "DY01_res_46", 12);
                    break;
                case 13:
                    strncpy(CaplCtrl_SignalName, "DY01_res_47", 12);
                    break;
                case 14:
                    strncpy(CaplCtrl_SignalName, "DY01_res_48", 12);
                    break;
                case 15:
                    strncpy(CaplCtrl_SignalName, "DY01_res_49", 12);
                    break;
                case 16:
                    strncpy(CaplCtrl_SignalName, "DY01_res_50", 12);
                    break;
                case 17:
                    strncpy(CaplCtrl_SignalName, "DY01_res_51", 12);
                    break;
                case 18:
                    strncpy(CaplCtrl_SignalName, "DY01_res_52", 12);
                    break;
                case 19:
                    strncpy(CaplCtrl_SignalName, "DY01_res_53", 12);
                    break;
                case 20:
                    strncpy(CaplCtrl_SignalName, "DY01_res_54", 12);
                    break;
                case 21:
                    strncpy(CaplCtrl_SignalName, "DY01_res_55", 12);
                    break;
                case 22:
                    strncpy(CaplCtrl_SignalName, "DY01_res_56", 12);
                    break;
                case 23:
                    strncpy(CaplCtrl_SignalName, "DY01_res_57", 12);
                    break;
                case 24:
                    strncpy(CaplCtrl_SignalName, "DY01_res_58", 12);
                    break;
                case 25:
                    strncpy(CaplCtrl_SignalName, "DY01_res_59", 12);
                    break;
                case 26:
                    strncpy(CaplCtrl_SignalName, "DY01_res_60", 12);
                    break;
                case 27:
                    strncpy(CaplCtrl_SignalName, "DY01_res_61", 12);
                    break;
                case 28:
                    strncpy(CaplCtrl_SignalName, "DY01_res_62", 12);
                    break;
                case 29:
                    strncpy(CaplCtrl_SignalName, "DY01_res_63", 12);
                    break;
                case 30:
                    strncpy(CaplCtrl_SignalName, "DY01_stMode", 12);
                    break;
                case 31:
                    strncpy(CaplCtrl_SignalName, "DY01_uCurrHV", 13);
                    break;
            }
        }
        break;
        case FRM_HANDLE_DC_HYB_02:
        {
            switch (SigIdx)
            {
                case 0:
                    strncpy(CaplCtrl_SignalName, "DY02_Checksumme", 16);
                    break;
                case 1:
                    strncpy(CaplCtrl_SignalName, "DY02_Derating_CrntLim_HV", 25);
                    break;
                case 2:
                    strncpy(CaplCtrl_SignalName, "DY02_Derating_CrntLim_LV", 25);
                    break;
                case 3:
                    strncpy(CaplCtrl_SignalName, "DY02_Derating_Temp", 19);
                    break;
                case 4:
                    strncpy(CaplCtrl_SignalName, "DY02_Derating_VltgLim_HV", 25);
                    break;
                case 5:
                    strncpy(CaplCtrl_SignalName, "DY02_Derating_VltgLim_LV", 25);
                    break;
                case 6:
                    strncpy(CaplCtrl_SignalName, "DY02_IdentCode", 15);
                    break;
                case 7:
                    strncpy(CaplCtrl_SignalName, "DY02_Zaehler", 13);
                    break;
                case 8:
                    strncpy(CaplCtrl_SignalName, "DY02_iCurrLV", 13);
                    break;
                case 9:
                    strncpy(CaplCtrl_SignalName, "DY02_rUtilRateDFM", 18);
                    break;
                case 10:
                    strncpy(CaplCtrl_SignalName, "DY02_res_56", 12);
                    break;
                case 11:
                    strncpy(CaplCtrl_SignalName, "DY02_res_57", 12);
                    break;
                case 12:
                    strncpy(CaplCtrl_SignalName, "DY02_res_58", 12);
                    break;
                case 13:
                    strncpy(CaplCtrl_SignalName, "DY02_res_59", 12);
                    break;
                case 14:
                    strncpy(CaplCtrl_SignalName, "DY02_res_60", 12);
                    break;
                case 15:
                    strncpy(CaplCtrl_SignalName, "DY02_res_61", 12);
                    break;
                case 16:
                    strncpy(CaplCtrl_SignalName, "DY02_res_62", 12);
                    break;
                case 17:
                    strncpy(CaplCtrl_SignalName, "DY02_res_63", 12);
                    break;
                case 18:
                    strncpy(CaplCtrl_SignalName, "DY02_tCurr", 11);
                    break;
                case 19:
                    strncpy(CaplCtrl_SignalName, "DY02_uCurrLV", 13);
                    break;
            }
        }
        break;
        case FRM_HANDLE_EM_HYB_02:
        {
            switch (SigIdx)
            {
                case 0:
                    strncpy(CaplCtrl_SignalName, "EY02_Checksumme", 16);
                    break;
                case 1:
                    strncpy(CaplCtrl_SignalName, "EY02_DstCActv", 14);
                    break;
                case 2:
                    strncpy(CaplCtrl_SignalName, "EY02_Zaehler", 13);
                    break;
                case 3:
                    strncpy(CaplCtrl_SignalName, "EY02_nCurr", 11);
                    break;
                case 4:
                    strncpy(CaplCtrl_SignalName, "EY02_res_52", 12);
                    break;
                case 5:
                    strncpy(CaplCtrl_SignalName, "EY02_res_53", 12);
                    break;
                case 6:
                    strncpy(CaplCtrl_SignalName, "EY02_res_54", 12);
                    break;
                case 7:
                    strncpy(CaplCtrl_SignalName, "EY02_res_56", 12);
                    break;
                case 8:
                    strncpy(CaplCtrl_SignalName, "EY02_res_57", 12);
                    break;
                case 9:
                    strncpy(CaplCtrl_SignalName, "EY02_res_58", 12);
                    break;
                case 10:
                    strncpy(CaplCtrl_SignalName, "EY02_res_59", 12);
                    break;
                case 11:
                    strncpy(CaplCtrl_SignalName, "EY02_res_60", 12);
                    break;
                case 12:
                    strncpy(CaplCtrl_SignalName, "EY02_res_61", 12);
                    break;
                case 13:
                    strncpy(CaplCtrl_SignalName, "EY02_res_62", 12);
                    break;
                case 14:
                    strncpy(CaplCtrl_SignalName, "EY02_res_63", 12);
                    break;
                case 15:
                    strncpy(CaplCtrl_SignalName, "EY02_trqCurr", 13);
                    break;
                case 16:
                    strncpy(CaplCtrl_SignalName, "EY02_trqCurrWoDstC", 19);
                    break;
            }
        }
        break;
        case FRM_HANDLE_EM_HYB_03:
        {
            switch (SigIdx)
            {
                case 0:
                    strncpy(CaplCtrl_SignalName, "EY03_Checksumme", 16);
                    break;
                case 1:
                    strncpy(CaplCtrl_SignalName, "EY03_Derating_Temp", 19);
                    break;
                case 2:
                    strncpy(CaplCtrl_SignalName, "EY03_DiagReq", 13);
                    break;
                case 3:
                    strncpy(CaplCtrl_SignalName, "EY03_Lim_CrntMax", 17);
                    break;
                case 4:
                    strncpy(CaplCtrl_SignalName, "EY03_Lim_CrntMin", 17);
                    break;
                case 5:
                    strncpy(CaplCtrl_SignalName, "EY03_Lim_TrqMax", 16);
                    break;
                case 6:
                    strncpy(CaplCtrl_SignalName, "EY03_Lim_TrqMin", 16);
                    break;
                case 7:
                    strncpy(CaplCtrl_SignalName, "EY03_Lim_VltgMax", 17);
                    break;
                case 8:
                    strncpy(CaplCtrl_SignalName, "EY03_Lim_VltgMin", 17);
                    break;
                case 9:
                    strncpy(CaplCtrl_SignalName, "EY03_Zaehler", 13);
                    break;
                case 10:
                    strncpy(CaplCtrl_SignalName, "EY03_iCurr", 11);
                    break;
                case 11:
                    strncpy(CaplCtrl_SignalName, "EY03_res_44", 12);
                    break;
                case 12:
                    strncpy(CaplCtrl_SignalName, "EY03_res_45", 12);
                    break;
                case 13:
                    strncpy(CaplCtrl_SignalName, "EY03_res_46", 12);
                    break;
                case 14:
                    strncpy(CaplCtrl_SignalName, "EY03_res_47", 12);
                    break;
                case 15:
                    strncpy(CaplCtrl_SignalName, "EY03_res_48", 12);
                    break;
                case 16:
                    strncpy(CaplCtrl_SignalName, "EY03_res_49", 12);
                    break;
                case 17:
                    strncpy(CaplCtrl_SignalName, "EY03_res_50", 12);
                    break;
                case 18:
                    strncpy(CaplCtrl_SignalName, "EY03_res_51", 12);
                    break;
                case 19:
                    strncpy(CaplCtrl_SignalName, "EY03_res_52", 12);
                    break;
                case 20:
                    strncpy(CaplCtrl_SignalName, "EY03_res_53", 12);
                    break;
                case 21:
                    strncpy(CaplCtrl_SignalName, "EY03_res_54", 12);
                    break;
                case 22:
                    strncpy(CaplCtrl_SignalName, "EY03_res_55", 12);
                    break;
                case 23:
                    strncpy(CaplCtrl_SignalName, "EY03_res_56", 12);
                    break;
                case 24:
                    strncpy(CaplCtrl_SignalName, "EY03_res_57", 12);
                    break;
                case 25:
                    strncpy(CaplCtrl_SignalName, "EY03_res_58", 12);
                    break;
                case 26:
                    strncpy(CaplCtrl_SignalName, "EY03_res_59", 12);
                    break;
                case 27:
                    strncpy(CaplCtrl_SignalName, "EY03_res_60", 12);
                    break;
                case 28:
                    strncpy(CaplCtrl_SignalName, "EY03_res_61", 12);
                    break;
                case 29:
                    strncpy(CaplCtrl_SignalName, "EY03_res_62", 12);
                    break;
                case 30:
                    strncpy(CaplCtrl_SignalName, "EY03_res_63", 12);
                    break;
                case 31:
                    strncpy(CaplCtrl_SignalName, "EY03_uCurr", 11);
                    break;
            }
        }
        break;
        case FRM_HANDLE_EM_HYB_04:
        {
            switch (SigIdx)
            {
                case 0:
                    strncpy(CaplCtrl_SignalName, "EY04_Checksumme", 16);
                    break;
                case 1:
                    strncpy(CaplCtrl_SignalName, "EY04_Zaehler", 13);
                    break;
                case 2:
                    strncpy(CaplCtrl_SignalName, "EY04_nCalcPredMax", 18);
                    break;
                case 3:
                    strncpy(CaplCtrl_SignalName, "EY04_nCalcPredMin", 18);
                    break;
                case 4:
                    strncpy(CaplCtrl_SignalName, "EY04_res_58", 12);
                    break;
                case 5:
                    strncpy(CaplCtrl_SignalName, "EY04_res_59", 12);
                    break;
                case 6:
                    strncpy(CaplCtrl_SignalName, "EY04_res_60", 12);
                    break;
                case 7:
                    strncpy(CaplCtrl_SignalName, "EY04_res_61", 12);
                    break;
                case 8:
                    strncpy(CaplCtrl_SignalName, "EY04_res_62", 12);
                    break;
                case 9:
                    strncpy(CaplCtrl_SignalName, "EY04_res_63", 12);
                    break;
                case 10:
                    strncpy(CaplCtrl_SignalName, "EY04_trqCalcElPwr", 18);
                    break;
                case 11:
                    strncpy(CaplCtrl_SignalName, "EY04_trqCalcPredMax", 20);
                    break;
                case 12:
                    strncpy(CaplCtrl_SignalName, "EY04_trqCalcPredMin", 20);
                    break;
            }
        }
        break;
        case FRM_HANDLE_EM_HYB_05:
        {
            switch (SigIdx)
            {
                case 0:
                    strncpy(CaplCtrl_SignalName, "EY05_Checksumme", 16);
                    break;
                case 1:
                    strncpy(CaplCtrl_SignalName, "EY05_MILReq", 12);
                    break;
                case 2:
                    strncpy(CaplCtrl_SignalName, "EY05_RedLEDReq", 15);
                    break;
                case 3:
                    strncpy(CaplCtrl_SignalName, "EY05_YellowLEDReq", 18);
                    break;
                case 4:
                    strncpy(CaplCtrl_SignalName, "EY05_Zaehler", 13);
                    break;
                case 5:
                    strncpy(CaplCtrl_SignalName, "EY05_res_15", 12);
                    break;
                case 6:
                    strncpy(CaplCtrl_SignalName, "EY05_res_40", 12);
                    break;
                case 7:
                    strncpy(CaplCtrl_SignalName, "EY05_res_41", 12);
                    break;
                case 8:
                    strncpy(CaplCtrl_SignalName, "EY05_res_42", 12);
                    break;
                case 9:
                    strncpy(CaplCtrl_SignalName, "EY05_res_43", 12);
                    break;
                case 10:
                    strncpy(CaplCtrl_SignalName, "EY05_res_44", 12);
                    break;
                case 11:
                    strncpy(CaplCtrl_SignalName, "EY05_res_45", 12);
                    break;
                case 12:
                    strncpy(CaplCtrl_SignalName, "EY05_res_46", 12);
                    break;
                case 13:
                    strncpy(CaplCtrl_SignalName, "EY05_res_47", 12);
                    break;
                case 14:
                    strncpy(CaplCtrl_SignalName, "EY05_res_48", 12);
                    break;
                case 15:
                    strncpy(CaplCtrl_SignalName, "EY05_res_49", 12);
                    break;
                case 16:
                    strncpy(CaplCtrl_SignalName, "EY05_res_50", 12);
                    break;
                case 17:
                    strncpy(CaplCtrl_SignalName, "EY05_res_51", 12);
                    break;
                case 18:
                    strncpy(CaplCtrl_SignalName, "EY05_res_52", 12);
                    break;
                case 19:
                    strncpy(CaplCtrl_SignalName, "EY05_res_53", 12);
                    break;
                case 20:
                    strncpy(CaplCtrl_SignalName, "EY05_res_54", 12);
                    break;
                case 21:
                    strncpy(CaplCtrl_SignalName, "EY05_res_55", 12);
                    break;
                case 22:
                    strncpy(CaplCtrl_SignalName, "EY05_res_56", 12);
                    break;
                case 23:
                    strncpy(CaplCtrl_SignalName, "EY05_res_57", 12);
                    break;
                case 24:
                    strncpy(CaplCtrl_SignalName, "EY05_res_58", 12);
                    break;
                case 25:
                    strncpy(CaplCtrl_SignalName, "EY05_res_59", 12);
                    break;
                case 26:
                    strncpy(CaplCtrl_SignalName, "EY05_res_60", 12);
                    break;
                case 27:
                    strncpy(CaplCtrl_SignalName, "EY05_res_61", 12);
                    break;
                case 28:
                    strncpy(CaplCtrl_SignalName, "EY05_res_62", 12);
                    break;
                case 29:
                    strncpy(CaplCtrl_SignalName, "EY05_res_63", 12);
                    break;
                case 30:
                    strncpy(CaplCtrl_SignalName, "EY05_tCurrMot", 14);
                    break;
                case 31:
                    strncpy(CaplCtrl_SignalName, "EY05_tCurrPWR", 14);
                    break;
                case 32:
                    strncpy(CaplCtrl_SignalName, "EY05_tCurrRotor", 16);
                    break;
            }
        }
        break;
        case FRM_HANDLE_EM_HYB_06:
        {
            switch (SigIdx)
            {
                case 0:
                    strncpy(CaplCtrl_SignalName, "EY06_Checksumme", 16);
                    break;
                case 1:
                    strncpy(CaplCtrl_SignalName, "EY06_ErrEmrgcyShtOff", 21);
                    break;
                case 2:
                    strncpy(CaplCtrl_SignalName, "EY06_ErrFreeWheeling", 21);
                    break;
                case 3:
                    strncpy(CaplCtrl_SignalName, "EY06_ErrLimitedPerformance", 27);
                    break;
                case 4:
                    strncpy(CaplCtrl_SignalName, "EY06_ErrShtOff", 15);
                    break;
                case 5:
                    strncpy(CaplCtrl_SignalName, "EY06_ExtRngActv", 16);
                    break;
                case 6:
                    strncpy(CaplCtrl_SignalName, "EY06_ReadyHV", 13);
                    break;
                case 7:
                    strncpy(CaplCtrl_SignalName, "EY06_ReadyInit", 15);
                    break;
                case 8:
                    strncpy(CaplCtrl_SignalName, "EY06_SleepInd", 14);
                    break;
                case 9:
                    strncpy(CaplCtrl_SignalName, "EY06_Zaehler", 13);
                    break;
                case 10:
                    strncpy(CaplCtrl_SignalName, "EY06_stMode", 12);
                    break;
                case 11:
                    strncpy(CaplCtrl_SignalName, "EY06_trqAbsMax", 15);
                    break;
                case 12:
                    strncpy(CaplCtrl_SignalName, "EY06_trqAbsMin", 15);
                    break;
                case 13:
                    strncpy(CaplCtrl_SignalName, "EY06_trqCalcDynMax", 19);
                    break;
                case 14:
                    strncpy(CaplCtrl_SignalName, "EY06_trqCalcDynMin", 19);
                    break;
            }
        }
        break;
        case FRM_HANDLE_FIS_1:
        {
            switch (SigIdx)
            {
                case 0:
                    strncpy(CaplCtrl_SignalName, "FIS1_Operand1", 14);
                    break;
                case 1:
                    strncpy(CaplCtrl_SignalName, "FIS1_Operand2", 14);
                    break;
                case 2:
                    strncpy(CaplCtrl_SignalName, "FIS1_Operand3", 14);
                    break;
            }
        }
        break;
    }
}
/*@@end*/

/*@@caplFunc:Frm_SetSignal(long,long,long):*/
Frm_SetSignal (long FrmIdx, long SigIdx, long SigVal)
{
    switch (FrmIdx)
    {
        case FRM_HANDLE_BMS_HYB_02:
        {
            switch (SigIdx)
            {
                case 0:
                    MsgObj_BMS_HYB_02.BY02_Checksumme = SigVal;
                    break;
                case 1:
                    MsgObj_BMS_HYB_02.BY02_ErrContactorOpen = SigVal;
                    break;
                case 2:
                    MsgObj_BMS_HYB_02.BY02_ErrContactorWelding = SigVal;
                    break;
                case 3:
                    MsgObj_BMS_HYB_02.BY02_ErrEmrgcyShtOffCrash = SigVal;
                    break;
                case 4:
                    MsgObj_BMS_HYB_02.BY02_ErrEmrgcyShtOffPilotLine = SigVal;
                    break;
                case 5:
                    MsgObj_BMS_HYB_02.BY02_ErrInsulation = SigVal;
                    break;
                case 6:
                    MsgObj_BMS_HYB_02.BY02_ErrLimitedPerformance = SigVal;
                    break;
                case 7:
                    MsgObj_BMS_HYB_02.BY02_ErrShtOff = SigVal;
                    break;
                case 8:
                    MsgObj_BMS_HYB_02.BY02_ErrShtOffReq = SigVal;
                    break;
                case 9:
                    MsgObj_BMS_HYB_02.BY02_IsoTestActv = SigVal;
                    break;
                case 10:
                    MsgObj_BMS_HYB_02.BY02_ReadyInit = SigVal;
                    break;
                case 11:
                    MsgObj_BMS_HYB_02.BY02_SleepInd = SigVal;
                    break;
                case 12:
                    MsgObj_BMS_HYB_02.BY02_Zaehler = SigVal;
                    break;
                case 13:
                    MsgObj_BMS_HYB_02.BY02_iCurr = SigVal;
                    break;
                case 14:
                    MsgObj_BMS_HYB_02.BY02_res_42 = SigVal;
                    break;
                case 15:
                    MsgObj_BMS_HYB_02.BY02_res_43 = SigVal;
                    break;
                case 16:
                    MsgObj_BMS_HYB_02.BY02_res_44 = SigVal;
                    break;
                case 17:
                    MsgObj_BMS_HYB_02.BY02_res_45 = SigVal;
                    break;
                case 18:
                    MsgObj_BMS_HYB_02.BY02_res_46 = SigVal;
                    break;
                case 19:
                    MsgObj_BMS_HYB_02.BY02_res_47 = SigVal;
                    break;
                case 20:
                    MsgObj_BMS_HYB_02.BY02_res_48 = SigVal;
                    break;
                case 21:
                    MsgObj_BMS_HYB_02.BY02_res_57 = SigVal;
                    break;
                case 22:
                    MsgObj_BMS_HYB_02.BY02_res_58 = SigVal;
                    break;
                case 23:
                    MsgObj_BMS_HYB_02.BY02_res_59 = SigVal;
                    break;
                case 24:
                    MsgObj_BMS_HYB_02.BY02_res_60 = SigVal;
                    break;
                case 25:
                    MsgObj_BMS_HYB_02.BY02_res_61 = SigVal;
                    break;
                case 26:
                    MsgObj_BMS_HYB_02.BY02_res_62 = SigVal;
                    break;
                case 27:
                    MsgObj_BMS_HYB_02.BY02_res_63 = SigVal;
                    break;
                case 28:
                    MsgObj_BMS_HYB_02.BY02_stMode = SigVal;
                    break;
                case 29:
                    MsgObj_BMS_HYB_02.BY02_uCurr = SigVal;
                    break;
            }
        }
        break;
        case FRM_HANDLE_BMS_HYB_03:
        {
            switch (SigIdx)
            {
                case 0:
                    MsgObj_BMS_HYB_03.BY03_BattFanSpd = SigVal;
                    break;
                case 1:
                    MsgObj_BMS_HYB_03.BY03_Checksumme = SigVal;
                    break;
                case 2:
                    MsgObj_BMS_HYB_03.BY03_Zaehler = SigVal;
                    break;
                case 3:
                    MsgObj_BMS_HYB_03.BY03_iChPredMax = SigVal;
                    break;
                case 4:
                    MsgObj_BMS_HYB_03.BY03_iDisChPredMax = SigVal;
                    break;
                case 5:
                    MsgObj_BMS_HYB_03.BY03_rSOC = SigVal;
                    break;
                case 6:
                    MsgObj_BMS_HYB_03.BY03_uChPredMin = SigVal;
                    break;
                case 7:
                    MsgObj_BMS_HYB_03.BY03_uDisChPredMin = SigVal;
                    break;
            }
        }
        break;
        case FRM_HANDLE_BMS_HYB_04:
        {
            switch (SigIdx)
            {
                case 0:
                    MsgObj_BMS_HYB_04.BY04_Checksumme = SigVal;
                    break;
                case 1:
                    MsgObj_BMS_HYB_04.BY04_ExtRngActv = SigVal;
                    break;
                case 2:
                    MsgObj_BMS_HYB_04.BY04_Zaehler = SigVal;
                    break;
                case 3:
                    MsgObj_BMS_HYB_04.BY04_iChMax = SigVal;
                    break;
                case 4:
                    MsgObj_BMS_HYB_04.BY04_iDisChMax = SigVal;
                    break;
                case 5:
                    MsgObj_BMS_HYB_04.BY04_res_53 = SigVal;
                    break;
                case 6:
                    MsgObj_BMS_HYB_04.BY04_res_54 = SigVal;
                    break;
                case 7:
                    MsgObj_BMS_HYB_04.BY04_res_55 = SigVal;
                    break;
                case 8:
                    MsgObj_BMS_HYB_04.BY04_res_56 = SigVal;
                    break;
                case 9:
                    MsgObj_BMS_HYB_04.BY04_res_57 = SigVal;
                    break;
                case 10:
                    MsgObj_BMS_HYB_04.BY04_res_58 = SigVal;
                    break;
                case 11:
                    MsgObj_BMS_HYB_04.BY04_res_59 = SigVal;
                    break;
                case 12:
                    MsgObj_BMS_HYB_04.BY04_res_60 = SigVal;
                    break;
                case 13:
                    MsgObj_BMS_HYB_04.BY04_res_61 = SigVal;
                    break;
                case 14:
                    MsgObj_BMS_HYB_04.BY04_res_62 = SigVal;
                    break;
                case 15:
                    MsgObj_BMS_HYB_04.BY04_res_63 = SigVal;
                    break;
                case 16:
                    MsgObj_BMS_HYB_04.BY04_uChDynMin = SigVal;
                    break;
                case 17:
                    MsgObj_BMS_HYB_04.BY04_uDisChDynMin = SigVal;
                    break;
            }
        }
        break;
        case FRM_HANDLE_BMS_HYB_06:
        {
            switch (SigIdx)
            {
                case 0:
                    MsgObj_BMS_HYB_06.BY06_BalancingReq = SigVal;
                    break;
                case 1:
                    MsgObj_BMS_HYB_06.BY06_Checksumme = SigVal;
                    break;
                case 2:
                    MsgObj_BMS_HYB_06.BY06_LftSOH = SigVal;
                    break;
                case 3:
                    MsgObj_BMS_HYB_06.BY06_MILReq = SigVal;
                    break;
                case 4:
                    MsgObj_BMS_HYB_06.BY06_RedLEDReq = SigVal;
                    break;
                case 5:
                    MsgObj_BMS_HYB_06.BY06_VentilationReq = SigVal;
                    break;
                case 6:
                    MsgObj_BMS_HYB_06.BY06_YellowLEDReq = SigVal;
                    break;
                case 7:
                    MsgObj_BMS_HYB_06.BY06_Zaehler = SigVal;
                    break;
                case 8:
                    MsgObj_BMS_HYB_06.BY06_res_61 = SigVal;
                    break;
                case 9:
                    MsgObj_BMS_HYB_06.BY06_res_62 = SigVal;
                    break;
                case 10:
                    MsgObj_BMS_HYB_06.BY06_res_63 = SigVal;
                    break;
                case 11:
                    MsgObj_BMS_HYB_06.BY06_tAirIn = SigVal;
                    break;
                case 12:
                    MsgObj_BMS_HYB_06.BY06_tCurr = SigVal;
                    break;
                case 13:
                    MsgObj_BMS_HYB_06.BY06_uChMax = SigVal;
                    break;
                case 14:
                    MsgObj_BMS_HYB_06.BY06_uDisChMin = SigVal;
                    break;
            }
        }
        break;
        case FRM_HANDLE_CCU_HYB_01:
        {
            switch (SigIdx)
            {
                case 0:
                    MsgObj_CCU_HYB_01.CY01_AngSpdCurr = SigVal;
                    break;
                case 1:
                    MsgObj_CCU_HYB_01.CY01_Checksumme = SigVal;
                    break;
                case 2:
                    MsgObj_CCU_HYB_01.CY01_ErrCAN = SigVal;
                    break;
                case 3:
                    MsgObj_CCU_HYB_01.CY01_ErrHW = SigVal;
                    break;
                case 4:
                    MsgObj_CCU_HYB_01.CY01_ErrMech = SigVal;
                    break;
                case 5:
                    MsgObj_CCU_HYB_01.CY01_ErrTempHigh = SigVal;
                    break;
                case 6:
                    MsgObj_CCU_HYB_01.CY01_ErrTempWarn = SigVal;
                    break;
                case 7:
                    MsgObj_CCU_HYB_01.CY01_ErrUBattLow = SigVal;
                    break;
                case 8:
                    MsgObj_CCU_HYB_01.CY01_SleepInd = SigVal;
                    break;
                case 9:
                    MsgObj_CCU_HYB_01.CY01_Zaehler = SigVal;
                    break;
                case 10:
                    MsgObj_CCU_HYB_01.CY01_i2trqCurr = SigVal;
                    break;
                case 11:
                    MsgObj_CCU_HYB_01.CY01_pCurr = SigVal;
                    break;
                case 12:
                    MsgObj_CCU_HYB_01.CY01_posCurr = SigVal;
                    break;
                case 13:
                    MsgObj_CCU_HYB_01.CY01_stMode = SigVal;
                    break;
            }
        }
        break;
        case FRM_HANDLE_CCU_HYB_02:
        {
            switch (SigIdx)
            {
                case 0:
                    MsgObj_CCU_HYB_02.CY02_Checksumme = SigVal;
                    break;
                case 1:
                    MsgObj_CCU_HYB_02.CY02_HW_Version = SigVal;
                    break;
                case 2:
                    MsgObj_CCU_HYB_02.CY02_Medium = SigVal;
                    break;
                case 3:
                    MsgObj_CCU_HYB_02.CY02_SPart_Number = SigVal;
                    break;
                case 4:
                    MsgObj_CCU_HYB_02.CY02_SW_Version = SigVal;
                    break;
                case 5:
                    MsgObj_CCU_HYB_02.CY02_Serial_Number = SigVal;
                    break;
                case 6:
                    MsgObj_CCU_HYB_02.CY02_Zaehler = SigVal;
                    break;
            }
        }
        break;
        case FRM_HANDLE_DC_HYB_01:
        {
            switch (SigIdx)
            {
                case 0:
                    MsgObj_DC_HYB_01.DY01_Checksumme = SigVal;
                    break;
                case 1:
                    MsgObj_DC_HYB_01.DY01_ErrLimitedPerformance = SigVal;
                    break;
                case 2:
                    MsgObj_DC_HYB_01.DY01_ErrShtOff = SigVal;
                    break;
                case 3:
                    MsgObj_DC_HYB_01.DY01_ErrVltg = SigVal;
                    break;
                case 4:
                    MsgObj_DC_HYB_01.DY01_SleepIndication = SigVal;
                    break;
                case 5:
                    MsgObj_DC_HYB_01.DY01_SlowControlActv = SigVal;
                    break;
                case 6:
                    MsgObj_DC_HYB_01.DY01_Zaehler = SigVal;
                    break;
                case 7:
                    MsgObj_DC_HYB_01.DY01_iCurrHV = SigVal;
                    break;
                case 8:
                    MsgObj_DC_HYB_01.DY01_res_42 = SigVal;
                    break;
                case 9:
                    MsgObj_DC_HYB_01.DY01_res_43 = SigVal;
                    break;
                case 10:
                    MsgObj_DC_HYB_01.DY01_res_44 = SigVal;
                    break;
                case 11:
                    MsgObj_DC_HYB_01.DY01_res_45 = SigVal;
                    break;
                case 12:
                    MsgObj_DC_HYB_01.DY01_res_46 = SigVal;
                    break;
                case 13:
                    MsgObj_DC_HYB_01.DY01_res_47 = SigVal;
                    break;
                case 14:
                    MsgObj_DC_HYB_01.DY01_res_48 = SigVal;
                    break;
                case 15:
                    MsgObj_DC_HYB_01.DY01_res_49 = SigVal;
                    break;
                case 16:
                    MsgObj_DC_HYB_01.DY01_res_50 = SigVal;
                    break;
                case 17:
                    MsgObj_DC_HYB_01.DY01_res_51 = SigVal;
                    break;
                case 18:
                    MsgObj_DC_HYB_01.DY01_res_52 = SigVal;
                    break;
                case 19:
                    MsgObj_DC_HYB_01.DY01_res_53 = SigVal;
                    break;
                case 20:
                    MsgObj_DC_HYB_01.DY01_res_54 = SigVal;
                    break;
                case 21:
                    MsgObj_DC_HYB_01.DY01_res_55 = SigVal;
                    break;
                case 22:
                    MsgObj_DC_HYB_01.DY01_res_56 = SigVal;
                    break;
                case 23:
                    MsgObj_DC_HYB_01.DY01_res_57 = SigVal;
                    break;
                case 24:
                    MsgObj_DC_HYB_01.DY01_res_58 = SigVal;
                    break;
                case 25:
                    MsgObj_DC_HYB_01.DY01_res_59 = SigVal;
                    break;
                case 26:
                    MsgObj_DC_HYB_01.DY01_res_60 = SigVal;
                    break;
                case 27:
                    MsgObj_DC_HYB_01.DY01_res_61 = SigVal;
                    break;
                case 28:
                    MsgObj_DC_HYB_01.DY01_res_62 = SigVal;
                    break;
                case 29:
                    MsgObj_DC_HYB_01.DY01_res_63 = SigVal;
                    break;
                case 30:
                    MsgObj_DC_HYB_01.DY01_stMode = SigVal;
                    break;
                case 31:
                    MsgObj_DC_HYB_01.DY01_uCurrHV = SigVal;
                    break;
            }
        }
        break;
        case FRM_HANDLE_DC_HYB_02:
        {
            switch (SigIdx)
            {
                case 0:
                    MsgObj_DC_HYB_02.DY02_Checksumme = SigVal;
                    break;
                case 1:
                    MsgObj_DC_HYB_02.DY02_Derating_CrntLim_HV = SigVal;
                    break;
                case 2:
                    MsgObj_DC_HYB_02.DY02_Derating_CrntLim_LV = SigVal;
                    break;
                case 3:
                    MsgObj_DC_HYB_02.DY02_Derating_Temp = SigVal;
                    break;
                case 4:
                    MsgObj_DC_HYB_02.DY02_Derating_VltgLim_HV = SigVal;
                    break;
                case 5:
                    MsgObj_DC_HYB_02.DY02_Derating_VltgLim_LV = SigVal;
                    break;
                case 6:
                    MsgObj_DC_HYB_02.DY02_IdentCode = SigVal;
                    break;
                case 7:
                    MsgObj_DC_HYB_02.DY02_Zaehler = SigVal;
                    break;
                case 8:
                    MsgObj_DC_HYB_02.DY02_iCurrLV = SigVal;
                    break;
                case 9:
                    MsgObj_DC_HYB_02.DY02_rUtilRateDFM = SigVal;
                    break;
                case 10:
                    MsgObj_DC_HYB_02.DY02_res_56 = SigVal;
                    break;
                case 11:
                    MsgObj_DC_HYB_02.DY02_res_57 = SigVal;
                    break;
                case 12:
                    MsgObj_DC_HYB_02.DY02_res_58 = SigVal;
                    break;
                case 13:
                    MsgObj_DC_HYB_02.DY02_res_59 = SigVal;
                    break;
                case 14:
                    MsgObj_DC_HYB_02.DY02_res_60 = SigVal;
                    break;
                case 15:
                    MsgObj_DC_HYB_02.DY02_res_61 = SigVal;
                    break;
                case 16:
                    MsgObj_DC_HYB_02.DY02_res_62 = SigVal;
                    break;
                case 17:
                    MsgObj_DC_HYB_02.DY02_res_63 = SigVal;
                    break;
                case 18:
                    MsgObj_DC_HYB_02.DY02_tCurr = SigVal;
                    break;
                case 19:
                    MsgObj_DC_HYB_02.DY02_uCurrLV = SigVal;
                    break;
            }
        }
        break;
        case FRM_HANDLE_EM_HYB_02:
        {
            switch (SigIdx)
            {
                case 0:
                    MsgObj_EM_HYB_02.EY02_Checksumme = SigVal;
                    break;
                case 1:
                    MsgObj_EM_HYB_02.EY02_DstCActv = SigVal;
                    break;
                case 2:
                    MsgObj_EM_HYB_02.EY02_Zaehler = SigVal;
                    break;
                case 3:
                    MsgObj_EM_HYB_02.EY02_nCurr = SigVal;
                    break;
                case 4:
                    MsgObj_EM_HYB_02.EY02_res_52 = SigVal;
                    break;
                case 5:
                    MsgObj_EM_HYB_02.EY02_res_53 = SigVal;
                    break;
                case 6:
                    MsgObj_EM_HYB_02.EY02_res_54 = SigVal;
                    break;
                case 7:
                    MsgObj_EM_HYB_02.EY02_res_56 = SigVal;
                    break;
                case 8:
                    MsgObj_EM_HYB_02.EY02_res_57 = SigVal;
                    break;
                case 9:
                    MsgObj_EM_HYB_02.EY02_res_58 = SigVal;
                    break;
                case 10:
                    MsgObj_EM_HYB_02.EY02_res_59 = SigVal;
                    break;
                case 11:
                    MsgObj_EM_HYB_02.EY02_res_60 = SigVal;
                    break;
                case 12:
                    MsgObj_EM_HYB_02.EY02_res_61 = SigVal;
                    break;
                case 13:
                    MsgObj_EM_HYB_02.EY02_res_62 = SigVal;
                    break;
                case 14:
                    MsgObj_EM_HYB_02.EY02_res_63 = SigVal;
                    break;
                case 15:
                    MsgObj_EM_HYB_02.EY02_trqCurr = SigVal;
                    break;
                case 16:
                    MsgObj_EM_HYB_02.EY02_trqCurrWoDstC = SigVal;
                    break;
            }
        }
        break;
        case FRM_HANDLE_EM_HYB_03:
        {
            switch (SigIdx)
            {
                case 0:
                    MsgObj_EM_HYB_03.EY03_Checksumme = SigVal;
                    break;
                case 1:
                    MsgObj_EM_HYB_03.EY03_Derating_Temp = SigVal;
                    break;
                case 2:
                    MsgObj_EM_HYB_03.EY03_DiagReq = SigVal;
                    break;
                case 3:
                    MsgObj_EM_HYB_03.EY03_Lim_CrntMax = SigVal;
                    break;
                case 4:
                    MsgObj_EM_HYB_03.EY03_Lim_CrntMin = SigVal;
                    break;
                case 5:
                    MsgObj_EM_HYB_03.EY03_Lim_TrqMax = SigVal;
                    break;
                case 6:
                    MsgObj_EM_HYB_03.EY03_Lim_TrqMin = SigVal;
                    break;
                case 7:
                    MsgObj_EM_HYB_03.EY03_Lim_VltgMax = SigVal;
                    break;
                case 8:
                    MsgObj_EM_HYB_03.EY03_Lim_VltgMin = SigVal;
                    break;
                case 9:
                    MsgObj_EM_HYB_03.EY03_Zaehler = SigVal;
                    break;
                case 10:
                    MsgObj_EM_HYB_03.EY03_iCurr = SigVal;
                    break;
                case 11:
                    MsgObj_EM_HYB_03.EY03_res_44 = SigVal;
                    break;
                case 12:
                    MsgObj_EM_HYB_03.EY03_res_45 = SigVal;
                    break;
                case 13:
                    MsgObj_EM_HYB_03.EY03_res_46 = SigVal;
                    break;
                case 14:
                    MsgObj_EM_HYB_03.EY03_res_47 = SigVal;
                    break;
                case 15:
                    MsgObj_EM_HYB_03.EY03_res_48 = SigVal;
                    break;
                case 16:
                    MsgObj_EM_HYB_03.EY03_res_49 = SigVal;
                    break;
                case 17:
                    MsgObj_EM_HYB_03.EY03_res_50 = SigVal;
                    break;
                case 18:
                    MsgObj_EM_HYB_03.EY03_res_51 = SigVal;
                    break;
                case 19:
                    MsgObj_EM_HYB_03.EY03_res_52 = SigVal;
                    break;
                case 20:
                    MsgObj_EM_HYB_03.EY03_res_53 = SigVal;
                    break;
                case 21:
                    MsgObj_EM_HYB_03.EY03_res_54 = SigVal;
                    break;
                case 22:
                    MsgObj_EM_HYB_03.EY03_res_55 = SigVal;
                    break;
                case 23:
                    MsgObj_EM_HYB_03.EY03_res_56 = SigVal;
                    break;
                case 24:
                    MsgObj_EM_HYB_03.EY03_res_57 = SigVal;
                    break;
                case 25:
                    MsgObj_EM_HYB_03.EY03_res_58 = SigVal;
                    break;
                case 26:
                    MsgObj_EM_HYB_03.EY03_res_59 = SigVal;
                    break;
                case 27:
                    MsgObj_EM_HYB_03.EY03_res_60 = SigVal;
                    break;
                case 28:
                    MsgObj_EM_HYB_03.EY03_res_61 = SigVal;
                    break;
                case 29:
                    MsgObj_EM_HYB_03.EY03_res_62 = SigVal;
                    break;
                case 30:
                    MsgObj_EM_HYB_03.EY03_res_63 = SigVal;
                    break;
                case 31:
                    MsgObj_EM_HYB_03.EY03_uCurr = SigVal;
                    break;
            }
        }
        break;
        case FRM_HANDLE_EM_HYB_04:
        {
            switch (SigIdx)
            {
                case 0:
                    MsgObj_EM_HYB_04.EY04_Checksumme = SigVal;
                    break;
                case 1:
                    MsgObj_EM_HYB_04.EY04_Zaehler = SigVal;
                    break;
                case 2:
                    MsgObj_EM_HYB_04.EY04_nCalcPredMax = SigVal;
                    break;
                case 3:
                    MsgObj_EM_HYB_04.EY04_nCalcPredMin = SigVal;
                    break;
                case 4:
                    MsgObj_EM_HYB_04.EY04_res_58 = SigVal;
                    break;
                case 5:
                    MsgObj_EM_HYB_04.EY04_res_59 = SigVal;
                    break;
                case 6:
                    MsgObj_EM_HYB_04.EY04_res_60 = SigVal;
                    break;
                case 7:
                    MsgObj_EM_HYB_04.EY04_res_61 = SigVal;
                    break;
                case 8:
                    MsgObj_EM_HYB_04.EY04_res_62 = SigVal;
                    break;
                case 9:
                    MsgObj_EM_HYB_04.EY04_res_63 = SigVal;
                    break;
                case 10:
                    MsgObj_EM_HYB_04.EY04_trqCalcElPwr = SigVal;
                    break;
                case 11:
                    MsgObj_EM_HYB_04.EY04_trqCalcPredMax = SigVal;
                    break;
                case 12:
                    MsgObj_EM_HYB_04.EY04_trqCalcPredMin = SigVal;
                    break;
            }
        }
        break;
        case FRM_HANDLE_EM_HYB_05:
        {
            switch (SigIdx)
            {
                case 0:
                    MsgObj_EM_HYB_05.EY05_Checksumme = SigVal;
                    break;
                case 1:
                    MsgObj_EM_HYB_05.EY05_MILReq = SigVal;
                    break;
                case 2:
                    MsgObj_EM_HYB_05.EY05_RedLEDReq = SigVal;
                    break;
                case 3:
                    MsgObj_EM_HYB_05.EY05_YellowLEDReq = SigVal;
                    break;
                case 4:
                    MsgObj_EM_HYB_05.EY05_Zaehler = SigVal;
                    break;
                case 5:
                    MsgObj_EM_HYB_05.EY05_res_15 = SigVal;
                    break;
                case 6:
                    MsgObj_EM_HYB_05.EY05_res_40 = SigVal;
                    break;
                case 7:
                    MsgObj_EM_HYB_05.EY05_res_41 = SigVal;
                    break;
                case 8:
                    MsgObj_EM_HYB_05.EY05_res_42 = SigVal;
                    break;
                case 9:
                    MsgObj_EM_HYB_05.EY05_res_43 = SigVal;
                    break;
                case 10:
                    MsgObj_EM_HYB_05.EY05_res_44 = SigVal;
                    break;
                case 11:
                    MsgObj_EM_HYB_05.EY05_res_45 = SigVal;
                    break;
                case 12:
                    MsgObj_EM_HYB_05.EY05_res_46 = SigVal;
                    break;
                case 13:
                    MsgObj_EM_HYB_05.EY05_res_47 = SigVal;
                    break;
                case 14:
                    MsgObj_EM_HYB_05.EY05_res_48 = SigVal;
                    break;
                case 15:
                    MsgObj_EM_HYB_05.EY05_res_49 = SigVal;
                    break;
                case 16:
                    MsgObj_EM_HYB_05.EY05_res_50 = SigVal;
                    break;
                case 17:
                    MsgObj_EM_HYB_05.EY05_res_51 = SigVal;
                    break;
                case 18:
                    MsgObj_EM_HYB_05.EY05_res_52 = SigVal;
                    break;
                case 19:
                    MsgObj_EM_HYB_05.EY05_res_53 = SigVal;
                    break;
                case 20:
                    MsgObj_EM_HYB_05.EY05_res_54 = SigVal;
                    break;
                case 21:
                    MsgObj_EM_HYB_05.EY05_res_55 = SigVal;
                    break;
                case 22:
                    MsgObj_EM_HYB_05.EY05_res_56 = SigVal;
                    break;
                case 23:
                    MsgObj_EM_HYB_05.EY05_res_57 = SigVal;
                    break;
                case 24:
                    MsgObj_EM_HYB_05.EY05_res_58 = SigVal;
                    break;
                case 25:
                    MsgObj_EM_HYB_05.EY05_res_59 = SigVal;
                    break;
                case 26:
                    MsgObj_EM_HYB_05.EY05_res_60 = SigVal;
                    break;
                case 27:
                    MsgObj_EM_HYB_05.EY05_res_61 = SigVal;
                    break;
                case 28:
                    MsgObj_EM_HYB_05.EY05_res_62 = SigVal;
                    break;
                case 29:
                    MsgObj_EM_HYB_05.EY05_res_63 = SigVal;
                    break;
                case 30:
                    MsgObj_EM_HYB_05.EY05_tCurrMot = SigVal;
                    break;
                case 31:
                    MsgObj_EM_HYB_05.EY05_tCurrPWR = SigVal;
                    break;
                case 32:
                    MsgObj_EM_HYB_05.EY05_tCurrRotor = SigVal;
                    break;
            }
        }
        break;
        case FRM_HANDLE_EM_HYB_06:
        {
            switch (SigIdx)
            {
                case 0:
                    MsgObj_EM_HYB_06.EY06_Checksumme = SigVal;
                    break;
                case 1:
                    MsgObj_EM_HYB_06.EY06_ErrEmrgcyShtOff = SigVal;
                    break;
                case 2:
                    MsgObj_EM_HYB_06.EY06_ErrFreeWheeling = SigVal;
                    break;
                case 3:
                    MsgObj_EM_HYB_06.EY06_ErrLimitedPerformance = SigVal;
                    break;
                case 4:
                    MsgObj_EM_HYB_06.EY06_ErrShtOff = SigVal;
                    break;
                case 5:
                    MsgObj_EM_HYB_06.EY06_ExtRngActv = SigVal;
                    break;
                case 6:
                    MsgObj_EM_HYB_06.EY06_ReadyHV = SigVal;
                    break;
                case 7:
                    MsgObj_EM_HYB_06.EY06_ReadyInit = SigVal;
                    break;
                case 8:
                    MsgObj_EM_HYB_06.EY06_SleepInd = SigVal;
                    break;
                case 9:
                    MsgObj_EM_HYB_06.EY06_Zaehler = SigVal;
                    break;
                case 10:
                    MsgObj_EM_HYB_06.EY06_stMode = SigVal;
                    break;
                case 11:
                    MsgObj_EM_HYB_06.EY06_trqAbsMax = SigVal;
                    break;
                case 12:
                    MsgObj_EM_HYB_06.EY06_trqAbsMin = SigVal;
                    break;
                case 13:
                    MsgObj_EM_HYB_06.EY06_trqCalcDynMax = SigVal;
                    break;
                case 14:
                    MsgObj_EM_HYB_06.EY06_trqCalcDynMin = SigVal;
                    break;
            }
        }
        break;
        case FRM_HANDLE_FIS_1:
        {
            switch (SigIdx)
            {
                case 0:
                    MsgObj_FIS_1.FIS1_Operand1 = SigVal;
                    break;
                case 1:
                    MsgObj_FIS_1.FIS1_Operand2 = SigVal;
                    break;
                case 2:
                    MsgObj_FIS_1.FIS1_Operand3 = SigVal;
                    break;
            }
        }
        break;
    }
}
/*@@end*/

/*@@caplFunc:GetSignalVal(int,int):*/
int GetSignalVal (int FrmIdx, int SigIdx)
{
    int SigVal;

    switch (FrmIdx)
    {
        case FRM_HANDLE_BMS_HYB_02:
        {
            switch (SigIdx)
            {
                case 0:
                    SigVal = MsgObj_BMS_HYB_02.BY02_Checksumme;
                    break;
                case 1:
                    SigVal = MsgObj_BMS_HYB_02.BY02_ErrContactorOpen;
                    break;
                case 2:
                    SigVal = MsgObj_BMS_HYB_02.BY02_ErrContactorWelding;
                    break;
                case 3:
                    SigVal = MsgObj_BMS_HYB_02.BY02_ErrEmrgcyShtOffCrash;
                    break;
                case 4:
                    SigVal = MsgObj_BMS_HYB_02.BY02_ErrEmrgcyShtOffPilotLine;
                    break;
                case 5:
                    SigVal = MsgObj_BMS_HYB_02.BY02_ErrInsulation;
                    break;
                case 6:
                    SigVal = MsgObj_BMS_HYB_02.BY02_ErrLimitedPerformance;
                    break;
                case 7:
                    SigVal = MsgObj_BMS_HYB_02.BY02_ErrShtOff;
                    break;
                case 8:
                    SigVal = MsgObj_BMS_HYB_02.BY02_ErrShtOffReq;
                    break;
                case 9:
                    SigVal = MsgObj_BMS_HYB_02.BY02_IsoTestActv;
                    break;
                case 10:
                    SigVal = MsgObj_BMS_HYB_02.BY02_ReadyInit;
                    break;
                case 11:
                    SigVal = MsgObj_BMS_HYB_02.BY02_SleepInd;
                    break;
                case 12:
                    SigVal = MsgObj_BMS_HYB_02.BY02_Zaehler;
                    break;
                case 13:
                    SigVal = MsgObj_BMS_HYB_02.BY02_iCurr;
                    break;
                case 14:
                    SigVal = MsgObj_BMS_HYB_02.BY02_res_42;
                    break;
                case 15:
                    SigVal = MsgObj_BMS_HYB_02.BY02_res_43;
                    break;
                case 16:
                    SigVal = MsgObj_BMS_HYB_02.BY02_res_44;
                    break;
                case 17:
                    SigVal = MsgObj_BMS_HYB_02.BY02_res_45;
                    break;
                case 18:
                    SigVal = MsgObj_BMS_HYB_02.BY02_res_46;
                    break;
                case 19:
                    SigVal = MsgObj_BMS_HYB_02.BY02_res_47;
                    break;
                case 20:
                    SigVal = MsgObj_BMS_HYB_02.BY02_res_48;
                    break;
                case 21:
                    SigVal = MsgObj_BMS_HYB_02.BY02_res_57;
                    break;
                case 22:
                    SigVal = MsgObj_BMS_HYB_02.BY02_res_58;
                    break;
                case 23:
                    SigVal = MsgObj_BMS_HYB_02.BY02_res_59;
                    break;
                case 24:
                    SigVal = MsgObj_BMS_HYB_02.BY02_res_60;
                    break;
                case 25:
                    SigVal = MsgObj_BMS_HYB_02.BY02_res_61;
                    break;
                case 26:
                    SigVal = MsgObj_BMS_HYB_02.BY02_res_62;
                    break;
                case 27:
                    SigVal = MsgObj_BMS_HYB_02.BY02_res_63;
                    break;
                case 28:
                    SigVal = MsgObj_BMS_HYB_02.BY02_stMode;
                    break;
                case 29:
                    SigVal = MsgObj_BMS_HYB_02.BY02_uCurr;
                    break;
            }
        }
        break;
        case FRM_HANDLE_BMS_HYB_03:
        {
            switch (SigIdx)
            {
                case 0:
                    SigVal = MsgObj_BMS_HYB_03.BY03_BattFanSpd;
                    break;
                case 1:
                    SigVal = MsgObj_BMS_HYB_03.BY03_Checksumme;
                    break;
                case 2:
                    SigVal = MsgObj_BMS_HYB_03.BY03_Zaehler;
                    break;
                case 3:
                    SigVal = MsgObj_BMS_HYB_03.BY03_iChPredMax;
                    break;
                case 4:
                    SigVal = MsgObj_BMS_HYB_03.BY03_iDisChPredMax;
                    break;
                case 5:
                    SigVal = MsgObj_BMS_HYB_03.BY03_rSOC;
                    break;
                case 6:
                    SigVal = MsgObj_BMS_HYB_03.BY03_uChPredMin;
                    break;
                case 7:
                    SigVal = MsgObj_BMS_HYB_03.BY03_uDisChPredMin;
                    break;
            }
        }
        break;
        case FRM_HANDLE_BMS_HYB_04:
        {
            switch (SigIdx)
            {
                case 0:
                    SigVal = MsgObj_BMS_HYB_04.BY04_Checksumme;
                    break;
                case 1:
                    SigVal = MsgObj_BMS_HYB_04.BY04_ExtRngActv;
                    break;
                case 2:
                    SigVal = MsgObj_BMS_HYB_04.BY04_Zaehler;
                    break;
                case 3:
                    SigVal = MsgObj_BMS_HYB_04.BY04_iChMax;
                    break;
                case 4:
                    SigVal = MsgObj_BMS_HYB_04.BY04_iDisChMax;
                    break;
                case 5:
                    SigVal = MsgObj_BMS_HYB_04.BY04_res_53;
                    break;
                case 6:
                    SigVal = MsgObj_BMS_HYB_04.BY04_res_54;
                    break;
                case 7:
                    SigVal = MsgObj_BMS_HYB_04.BY04_res_55;
                    break;
                case 8:
                    SigVal = MsgObj_BMS_HYB_04.BY04_res_56;
                    break;
                case 9:
                    SigVal = MsgObj_BMS_HYB_04.BY04_res_57;
                    break;
                case 10:
                    SigVal = MsgObj_BMS_HYB_04.BY04_res_58;
                    break;
                case 11:
                    SigVal = MsgObj_BMS_HYB_04.BY04_res_59;
                    break;
                case 12:
                    SigVal = MsgObj_BMS_HYB_04.BY04_res_60;
                    break;
                case 13:
                    SigVal = MsgObj_BMS_HYB_04.BY04_res_61;
                    break;
                case 14:
                    SigVal = MsgObj_BMS_HYB_04.BY04_res_62;
                    break;
                case 15:
                    SigVal = MsgObj_BMS_HYB_04.BY04_res_63;
                    break;
                case 16:
                    SigVal = MsgObj_BMS_HYB_04.BY04_uChDynMin;
                    break;
                case 17:
                    SigVal = MsgObj_BMS_HYB_04.BY04_uDisChDynMin;
                    break;
            }
        }
        break;
        case FRM_HANDLE_BMS_HYB_06:
        {
            switch (SigIdx)
            {
                case 0:
                    SigVal = MsgObj_BMS_HYB_06.BY06_BalancingReq;
                    break;
                case 1:
                    SigVal = MsgObj_BMS_HYB_06.BY06_Checksumme;
                    break;
                case 2:
                    SigVal = MsgObj_BMS_HYB_06.BY06_LftSOH;
                    break;
                case 3:
                    SigVal = MsgObj_BMS_HYB_06.BY06_MILReq;
                    break;
                case 4:
                    SigVal = MsgObj_BMS_HYB_06.BY06_RedLEDReq;
                    break;
                case 5:
                    SigVal = MsgObj_BMS_HYB_06.BY06_VentilationReq;
                    break;
                case 6:
                    SigVal = MsgObj_BMS_HYB_06.BY06_YellowLEDReq;
                    break;
                case 7:
                    SigVal = MsgObj_BMS_HYB_06.BY06_Zaehler;
                    break;
                case 8:
                    SigVal = MsgObj_BMS_HYB_06.BY06_res_61;
                    break;
                case 9:
                    SigVal = MsgObj_BMS_HYB_06.BY06_res_62;
                    break;
                case 10:
                    SigVal = MsgObj_BMS_HYB_06.BY06_res_63;
                    break;
                case 11:
                    SigVal = MsgObj_BMS_HYB_06.BY06_tAirIn;
                    break;
                case 12:
                    SigVal = MsgObj_BMS_HYB_06.BY06_tCurr;
                    break;
                case 13:
                    SigVal = MsgObj_BMS_HYB_06.BY06_uChMax;
                    break;
                case 14:
                    SigVal = MsgObj_BMS_HYB_06.BY06_uDisChMin;
                    break;
            }
        }
        break;
        case FRM_HANDLE_CCU_HYB_01:
        {
            switch (SigIdx)
            {
                case 0:
                    SigVal = MsgObj_CCU_HYB_01.CY01_AngSpdCurr;
                    break;
                case 1:
                    SigVal = MsgObj_CCU_HYB_01.CY01_Checksumme;
                    break;
                case 2:
                    SigVal = MsgObj_CCU_HYB_01.CY01_ErrCAN;
                    break;
                case 3:
                    SigVal = MsgObj_CCU_HYB_01.CY01_ErrHW;
                    break;
                case 4:
                    SigVal = MsgObj_CCU_HYB_01.CY01_ErrMech;
                    break;
                case 5:
                    SigVal = MsgObj_CCU_HYB_01.CY01_ErrTempHigh;
                    break;
                case 6:
                    SigVal = MsgObj_CCU_HYB_01.CY01_ErrTempWarn;
                    break;
                case 7:
                    SigVal = MsgObj_CCU_HYB_01.CY01_ErrUBattLow;
                    break;
                case 8:
                    SigVal = MsgObj_CCU_HYB_01.CY01_SleepInd;
                    break;
                case 9:
                    SigVal = MsgObj_CCU_HYB_01.CY01_Zaehler;
                    break;
                case 10:
                    SigVal = MsgObj_CCU_HYB_01.CY01_i2trqCurr;
                    break;
                case 11:
                    SigVal = MsgObj_CCU_HYB_01.CY01_pCurr;
                    break;
                case 12:
                    SigVal = MsgObj_CCU_HYB_01.CY01_posCurr;
                    break;
                case 13:
                    SigVal = MsgObj_CCU_HYB_01.CY01_stMode;
                    break;
            }
        }
        break;
        case FRM_HANDLE_CCU_HYB_02:
        {
            switch (SigIdx)
            {
                case 0:
                    SigVal = MsgObj_CCU_HYB_02.CY02_Checksumme;
                    break;
                case 1:
                    SigVal = MsgObj_CCU_HYB_02.CY02_HW_Version;
                    break;
                case 2:
                    SigVal = MsgObj_CCU_HYB_02.CY02_Medium;
                    break;
                case 3:
                    SigVal = MsgObj_CCU_HYB_02.CY02_SPart_Number;
                    break;
                case 4:
                    SigVal = MsgObj_CCU_HYB_02.CY02_SW_Version;
                    break;
                case 5:
                    SigVal = MsgObj_CCU_HYB_02.CY02_Serial_Number;
                    break;
                case 6:
                    SigVal = MsgObj_CCU_HYB_02.CY02_Zaehler;
                    break;
            }
        }
        break;
        case FRM_HANDLE_DC_HYB_01:
        {
            switch (SigIdx)
            {
                case 0:
                    SigVal = MsgObj_DC_HYB_01.DY01_Checksumme;
                    break;
                case 1:
                    SigVal = MsgObj_DC_HYB_01.DY01_ErrLimitedPerformance;
                    break;
                case 2:
                    SigVal = MsgObj_DC_HYB_01.DY01_ErrShtOff;
                    break;
                case 3:
                    SigVal = MsgObj_DC_HYB_01.DY01_ErrVltg;
                    break;
                case 4:
                    SigVal = MsgObj_DC_HYB_01.DY01_SleepIndication;
                    break;
                case 5:
                    SigVal = MsgObj_DC_HYB_01.DY01_SlowControlActv;
                    break;
                case 6:
                    SigVal = MsgObj_DC_HYB_01.DY01_Zaehler;
                    break;
                case 7:
                    SigVal = MsgObj_DC_HYB_01.DY01_iCurrHV;
                    break;
                case 8:
                    SigVal = MsgObj_DC_HYB_01.DY01_res_42;
                    break;
                case 9:
                    SigVal = MsgObj_DC_HYB_01.DY01_res_43;
                    break;
                case 10:
                    SigVal = MsgObj_DC_HYB_01.DY01_res_44;
                    break;
                case 11:
                    SigVal = MsgObj_DC_HYB_01.DY01_res_45;
                    break;
                case 12:
                    SigVal = MsgObj_DC_HYB_01.DY01_res_46;
                    break;
                case 13:
                    SigVal = MsgObj_DC_HYB_01.DY01_res_47;
                    break;
                case 14:
                    SigVal = MsgObj_DC_HYB_01.DY01_res_48;
                    break;
                case 15:
                    SigVal = MsgObj_DC_HYB_01.DY01_res_49;
                    break;
                case 16:
                    SigVal = MsgObj_DC_HYB_01.DY01_res_50;
                    break;
                case 17:
                    SigVal = MsgObj_DC_HYB_01.DY01_res_51;
                    break;
                case 18:
                    SigVal = MsgObj_DC_HYB_01.DY01_res_52;
                    break;
                case 19:
                    SigVal = MsgObj_DC_HYB_01.DY01_res_53;
                    break;
                case 20:
                    SigVal = MsgObj_DC_HYB_01.DY01_res_54;
                    break;
                case 21:
                    SigVal = MsgObj_DC_HYB_01.DY01_res_55;
                    break;
                case 22:
                    SigVal = MsgObj_DC_HYB_01.DY01_res_56;
                    break;
                case 23:
                    SigVal = MsgObj_DC_HYB_01.DY01_res_57;
                    break;
                case 24:
                    SigVal = MsgObj_DC_HYB_01.DY01_res_58;
                    break;
                case 25:
                    SigVal = MsgObj_DC_HYB_01.DY01_res_59;
                    break;
                case 26:
                    SigVal = MsgObj_DC_HYB_01.DY01_res_60;
                    break;
                case 27:
                    SigVal = MsgObj_DC_HYB_01.DY01_res_61;
                    break;
                case 28:
                    SigVal = MsgObj_DC_HYB_01.DY01_res_62;
                    break;
                case 29:
                    SigVal = MsgObj_DC_HYB_01.DY01_res_63;
                    break;
                case 30:
                    SigVal = MsgObj_DC_HYB_01.DY01_stMode;
                    break;
                case 31:
                    SigVal = MsgObj_DC_HYB_01.DY01_uCurrHV;
                    break;
            }
        }
        break;
        case FRM_HANDLE_DC_HYB_02:
        {
            switch (SigIdx)
            {
                case 0:
                    SigVal = MsgObj_DC_HYB_02.DY02_Checksumme;
                    break;
                case 1:
                    SigVal = MsgObj_DC_HYB_02.DY02_Derating_CrntLim_HV;
                    break;
                case 2:
                    SigVal = MsgObj_DC_HYB_02.DY02_Derating_CrntLim_LV;
                    break;
                case 3:
                    SigVal = MsgObj_DC_HYB_02.DY02_Derating_Temp;
                    break;
                case 4:
                    SigVal = MsgObj_DC_HYB_02.DY02_Derating_VltgLim_HV;
                    break;
                case 5:
                    SigVal = MsgObj_DC_HYB_02.DY02_Derating_VltgLim_LV;
                    break;
                case 6:
                    SigVal = MsgObj_DC_HYB_02.DY02_IdentCode;
                    break;
                case 7:
                    SigVal = MsgObj_DC_HYB_02.DY02_Zaehler;
                    break;
                case 8:
                    SigVal = MsgObj_DC_HYB_02.DY02_iCurrLV;
                    break;
                case 9:
                    SigVal = MsgObj_DC_HYB_02.DY02_rUtilRateDFM;
                    break;
                case 10:
                    SigVal = MsgObj_DC_HYB_02.DY02_res_56;
                    break;
                case 11:
                    SigVal = MsgObj_DC_HYB_02.DY02_res_57;
                    break;
                case 12:
                    SigVal = MsgObj_DC_HYB_02.DY02_res_58;
                    break;
                case 13:
                    SigVal = MsgObj_DC_HYB_02.DY02_res_59;
                    break;
                case 14:
                    SigVal = MsgObj_DC_HYB_02.DY02_res_60;
                    break;
                case 15:
                    SigVal = MsgObj_DC_HYB_02.DY02_res_61;
                    break;
                case 16:
                    SigVal = MsgObj_DC_HYB_02.DY02_res_62;
                    break;
                case 17:
                    SigVal = MsgObj_DC_HYB_02.DY02_res_63;
                    break;
                case 18:
                    SigVal = MsgObj_DC_HYB_02.DY02_tCurr;
                    break;
                case 19:
                    SigVal = MsgObj_DC_HYB_02.DY02_uCurrLV;
                    break;
            }
        }
        break;
        case FRM_HANDLE_EM_HYB_02:
        {
            switch (SigIdx)
            {
                case 0:
                    SigVal = MsgObj_EM_HYB_02.EY02_Checksumme;
                    break;
                case 1:
                    SigVal = MsgObj_EM_HYB_02.EY02_DstCActv;
                    break;
                case 2:
                    SigVal = MsgObj_EM_HYB_02.EY02_Zaehler;
                    break;
                case 3:
                    SigVal = MsgObj_EM_HYB_02.EY02_nCurr;
                    break;
                case 4:
                    SigVal = MsgObj_EM_HYB_02.EY02_res_52;
                    break;
                case 5:
                    SigVal = MsgObj_EM_HYB_02.EY02_res_53;
                    break;
                case 6:
                    SigVal = MsgObj_EM_HYB_02.EY02_res_54;
                    break;
                case 7:
                    SigVal = MsgObj_EM_HYB_02.EY02_res_56;
                    break;
                case 8:
                    SigVal = MsgObj_EM_HYB_02.EY02_res_57;
                    break;
                case 9:
                    SigVal = MsgObj_EM_HYB_02.EY02_res_58;
                    break;
                case 10:
                    SigVal = MsgObj_EM_HYB_02.EY02_res_59;
                    break;
                case 11:
                    SigVal = MsgObj_EM_HYB_02.EY02_res_60;
                    break;
                case 12:
                    SigVal = MsgObj_EM_HYB_02.EY02_res_61;
                    break;
                case 13:
                    SigVal = MsgObj_EM_HYB_02.EY02_res_62;
                    break;
                case 14:
                    SigVal = MsgObj_EM_HYB_02.EY02_res_63;
                    break;
                case 15:
                    SigVal = MsgObj_EM_HYB_02.EY02_trqCurr;
                    break;
                case 16:
                    SigVal = MsgObj_EM_HYB_02.EY02_trqCurrWoDstC;
                    break;
            }
        }
        break;
        case FRM_HANDLE_EM_HYB_03:
        {
            switch (SigIdx)
            {
                case 0:
                    SigVal = MsgObj_EM_HYB_03.EY03_Checksumme;
                    break;
                case 1:
                    SigVal = MsgObj_EM_HYB_03.EY03_Derating_Temp;
                    break;
                case 2:
                    SigVal = MsgObj_EM_HYB_03.EY03_DiagReq;
                    break;
                case 3:
                    SigVal = MsgObj_EM_HYB_03.EY03_Lim_CrntMax;
                    break;
                case 4:
                    SigVal = MsgObj_EM_HYB_03.EY03_Lim_CrntMin;
                    break;
                case 5:
                    SigVal = MsgObj_EM_HYB_03.EY03_Lim_TrqMax;
                    break;
                case 6:
                    SigVal = MsgObj_EM_HYB_03.EY03_Lim_TrqMin;
                    break;
                case 7:
                    SigVal = MsgObj_EM_HYB_03.EY03_Lim_VltgMax;
                    break;
                case 8:
                    SigVal = MsgObj_EM_HYB_03.EY03_Lim_VltgMin;
                    break;
                case 9:
                    SigVal = MsgObj_EM_HYB_03.EY03_Zaehler;
                    break;
                case 10:
                    SigVal = MsgObj_EM_HYB_03.EY03_iCurr;
                    break;
                case 11:
                    SigVal = MsgObj_EM_HYB_03.EY03_res_44;
                    break;
                case 12:
                    SigVal = MsgObj_EM_HYB_03.EY03_res_45;
                    break;
                case 13:
                    SigVal = MsgObj_EM_HYB_03.EY03_res_46;
                    break;
                case 14:
                    SigVal = MsgObj_EM_HYB_03.EY03_res_47;
                    break;
                case 15:
                    SigVal = MsgObj_EM_HYB_03.EY03_res_48;
                    break;
                case 16:
                    SigVal = MsgObj_EM_HYB_03.EY03_res_49;
                    break;
                case 17:
                    SigVal = MsgObj_EM_HYB_03.EY03_res_50;
                    break;
                case 18:
                    SigVal = MsgObj_EM_HYB_03.EY03_res_51;
                    break;
                case 19:
                    SigVal = MsgObj_EM_HYB_03.EY03_res_52;
                    break;
                case 20:
                    SigVal = MsgObj_EM_HYB_03.EY03_res_53;
                    break;
                case 21:
                    SigVal = MsgObj_EM_HYB_03.EY03_res_54;
                    break;
                case 22:
                    SigVal = MsgObj_EM_HYB_03.EY03_res_55;
                    break;
                case 23:
                    SigVal = MsgObj_EM_HYB_03.EY03_res_56;
                    break;
                case 24:
                    SigVal = MsgObj_EM_HYB_03.EY03_res_57;
                    break;
                case 25:
                    SigVal = MsgObj_EM_HYB_03.EY03_res_58;
                    break;
                case 26:
                    SigVal = MsgObj_EM_HYB_03.EY03_res_59;
                    break;
                case 27:
                    SigVal = MsgObj_EM_HYB_03.EY03_res_60;
                    break;
                case 28:
                    SigVal = MsgObj_EM_HYB_03.EY03_res_61;
                    break;
                case 29:
                    SigVal = MsgObj_EM_HYB_03.EY03_res_62;
                    break;
                case 30:
                    SigVal = MsgObj_EM_HYB_03.EY03_res_63;
                    break;
                case 31:
                    SigVal = MsgObj_EM_HYB_03.EY03_uCurr;
                    break;
            }
        }
        break;
        case FRM_HANDLE_EM_HYB_04:
        {
            switch (SigIdx)
            {
                case 0:
                    SigVal = MsgObj_EM_HYB_04.EY04_Checksumme;
                    break;
                case 1:
                    SigVal = MsgObj_EM_HYB_04.EY04_Zaehler;
                    break;
                case 2:
                    SigVal = MsgObj_EM_HYB_04.EY04_nCalcPredMax;
                    break;
                case 3:
                    SigVal = MsgObj_EM_HYB_04.EY04_nCalcPredMin;
                    break;
                case 4:
                    SigVal = MsgObj_EM_HYB_04.EY04_res_58;
                    break;
                case 5:
                    SigVal = MsgObj_EM_HYB_04.EY04_res_59;
                    break;
                case 6:
                    SigVal = MsgObj_EM_HYB_04.EY04_res_60;
                    break;
                case 7:
                    SigVal = MsgObj_EM_HYB_04.EY04_res_61;
                    break;
                case 8:
                    SigVal = MsgObj_EM_HYB_04.EY04_res_62;
                    break;
                case 9:
                    SigVal = MsgObj_EM_HYB_04.EY04_res_63;
                    break;
                case 10:
                    SigVal = MsgObj_EM_HYB_04.EY04_trqCalcElPwr;
                    break;
                case 11:
                    SigVal = MsgObj_EM_HYB_04.EY04_trqCalcPredMax;
                    break;
                case 12:
                    SigVal = MsgObj_EM_HYB_04.EY04_trqCalcPredMin;
                    break;
            }
        }
        break;
        case FRM_HANDLE_EM_HYB_05:
        {
            switch (SigIdx)
            {
                case 0:
                    SigVal = MsgObj_EM_HYB_05.EY05_Checksumme;
                    break;
                case 1:
                    SigVal = MsgObj_EM_HYB_05.EY05_MILReq;
                    break;
                case 2:
                    SigVal = MsgObj_EM_HYB_05.EY05_RedLEDReq;
                    break;
                case 3:
                    SigVal = MsgObj_EM_HYB_05.EY05_YellowLEDReq;
                    break;
                case 4:
                    SigVal = MsgObj_EM_HYB_05.EY05_Zaehler;
                    break;
                case 5:
                    SigVal = MsgObj_EM_HYB_05.EY05_res_15;
                    break;
                case 6:
                    SigVal = MsgObj_EM_HYB_05.EY05_res_40;
                    break;
                case 7:
                    SigVal = MsgObj_EM_HYB_05.EY05_res_41;
                    break;
                case 8:
                    SigVal = MsgObj_EM_HYB_05.EY05_res_42;
                    break;
                case 9:
                    SigVal = MsgObj_EM_HYB_05.EY05_res_43;
                    break;
                case 10:
                    SigVal = MsgObj_EM_HYB_05.EY05_res_44;
                    break;
                case 11:
                    SigVal = MsgObj_EM_HYB_05.EY05_res_45;
                    break;
                case 12:
                    SigVal = MsgObj_EM_HYB_05.EY05_res_46;
                    break;
                case 13:
                    SigVal = MsgObj_EM_HYB_05.EY05_res_47;
                    break;
                case 14:
                    SigVal = MsgObj_EM_HYB_05.EY05_res_48;
                    break;
                case 15:
                    SigVal = MsgObj_EM_HYB_05.EY05_res_49;
                    break;
                case 16:
                    SigVal = MsgObj_EM_HYB_05.EY05_res_50;
                    break;
                case 17:
                    SigVal = MsgObj_EM_HYB_05.EY05_res_51;
                    break;
                case 18:
                    SigVal = MsgObj_EM_HYB_05.EY05_res_52;
                    break;
                case 19:
                    SigVal = MsgObj_EM_HYB_05.EY05_res_53;
                    break;
                case 20:
                    SigVal = MsgObj_EM_HYB_05.EY05_res_54;
                    break;
                case 21:
                    SigVal = MsgObj_EM_HYB_05.EY05_res_55;
                    break;
                case 22:
                    SigVal = MsgObj_EM_HYB_05.EY05_res_56;
                    break;
                case 23:
                    SigVal = MsgObj_EM_HYB_05.EY05_res_57;
                    break;
                case 24:
                    SigVal = MsgObj_EM_HYB_05.EY05_res_58;
                    break;
                case 25:
                    SigVal = MsgObj_EM_HYB_05.EY05_res_59;
                    break;
                case 26:
                    SigVal = MsgObj_EM_HYB_05.EY05_res_60;
                    break;
                case 27:
                    SigVal = MsgObj_EM_HYB_05.EY05_res_61;
                    break;
                case 28:
                    SigVal = MsgObj_EM_HYB_05.EY05_res_62;
                    break;
                case 29:
                    SigVal = MsgObj_EM_HYB_05.EY05_res_63;
                    break;
                case 30:
                    SigVal = MsgObj_EM_HYB_05.EY05_tCurrMot;
                    break;
                case 31:
                    SigVal = MsgObj_EM_HYB_05.EY05_tCurrPWR;
                    break;
                case 32:
                    SigVal = MsgObj_EM_HYB_05.EY05_tCurrRotor;
                    break;
            }
        }
        break;
        case FRM_HANDLE_EM_HYB_06:
        {
            switch (SigIdx)
            {
                case 0:
                    SigVal = MsgObj_EM_HYB_06.EY06_Checksumme;
                    break;
                case 1:
                    SigVal = MsgObj_EM_HYB_06.EY06_ErrEmrgcyShtOff;
                    break;
                case 2:
                    SigVal = MsgObj_EM_HYB_06.EY06_ErrFreeWheeling;
                    break;
                case 3:
                    SigVal = MsgObj_EM_HYB_06.EY06_ErrLimitedPerformance;
                    break;
                case 4:
                    SigVal = MsgObj_EM_HYB_06.EY06_ErrShtOff;
                    break;
                case 5:
                    SigVal = MsgObj_EM_HYB_06.EY06_ExtRngActv;
                    break;
                case 6:
                    SigVal = MsgObj_EM_HYB_06.EY06_ReadyHV;
                    break;
                case 7:
                    SigVal = MsgObj_EM_HYB_06.EY06_ReadyInit;
                    break;
                case 8:
                    SigVal = MsgObj_EM_HYB_06.EY06_SleepInd;
                    break;
                case 9:
                    SigVal = MsgObj_EM_HYB_06.EY06_Zaehler;
                    break;
                case 10:
                    SigVal = MsgObj_EM_HYB_06.EY06_stMode;
                    break;
                case 11:
                    SigVal = MsgObj_EM_HYB_06.EY06_trqAbsMax;
                    break;
                case 12:
                    SigVal = MsgObj_EM_HYB_06.EY06_trqAbsMin;
                    break;
                case 13:
                    SigVal = MsgObj_EM_HYB_06.EY06_trqCalcDynMax;
                    break;
                case 14:
                    SigVal = MsgObj_EM_HYB_06.EY06_trqCalcDynMin;
                    break;
            }
        }
        break;
        case FRM_HANDLE_FIS_1:
        {
            switch (SigIdx)
            {
                case 0:
                    SigVal = MsgObj_FIS_1.FIS1_Operand1;
                    break;
                case 1:
                    SigVal = MsgObj_FIS_1.FIS1_Operand2;
                    break;
                case 2:
                    SigVal = MsgObj_FIS_1.FIS1_Operand3;
                    break;
            }
        }
        break;
    }

    return (SigVal);
}
/*@@end*/

/*@@caplFunc:ShowPrompt():*/
ShowPrompt ()
{
    int SigVal = 0;

    switch (CaplCtrl_LevelActv)
    {
        /* currently no level selected */
        case CAPLCTRL_LEVEL_NOSEL:
        {
            if (CaplCtrl_PromptMode == CAPLCTRL_PROMPTMODE_NUM)
            {
                write("# > %s", CaplCtrl_InputBuf);
            }
            else
            {
                write("# > %s", CaplCtrl_CharBuf);
            }
        }
        break;

        case CAPLCTRL_LEVEL_FRAME:
        {
            GetFrameName(CaplCtrl_FrameActv);

            if (CaplCtrl_PromptMode == CAPLCTRL_PROMPTMODE_NUM)
            {
                write("# %s> %s", CaplCtrl_FrameName, CaplCtrl_InputBuf);
            }
            else
            {
                write("# %s> %s", CaplCtrl_FrameName, CaplCtrl_CharBuf);
            }
        }
        break;

        case CAPLCTRL_LEVEL_SIGNAL:
        {
            GetFrameName(CaplCtrl_FrameActv);
            GetSignalName(CaplCtrl_FrameActv, CaplCtrl_SignalActv);

            SigVal = GetSignalVal(CaplCtrl_FrameActv, CaplCtrl_SignalActv);

            if (CaplCtrl_PromptMode == CAPLCTRL_PROMPTMODE_NUM)
            {
                write("# %s.%s = %d> %s", CaplCtrl_FrameName, CaplCtrl_SignalName, SigVal, CaplCtrl_InputBuf);
            }
            else
            {
                write("# %s.%s = %d> %s", CaplCtrl_FrameName, CaplCtrl_SignalName, SigVal, CaplCtrl_CharBuf);
            }
        }
        break;
    }
}
/*@@end*/

/*@@caplFunc:Frm_CalcChecksumCRC8(int, message*, byte):*/
byte Frm_CalcChecksumCRC8(int FrmIdx, message *MsgObj, byte endval)
{
    int idx;
    byte crc;

    /* calculate CRC8 checksum */
    crc = 0xFF;
    /* IMPORTANT NOTE: assumes CRC8 is in byte 0 */
    for (idx = 1; idx < MsgObj.DLC; idx++)
    {
        crc = CRC8_tab_256[(MsgObj.BYTE(idx) ^ crc)];
    }
    crc = CRC8_tab_256[(endval ^ crc)];
    crc = ~crc;

    /* checksum calculation disabled, make sure checksum is wrong */
    if (Frm_MsgChksmEna[FrmIdx] == 0)
    {
        crc = ~crc;
    }

   	return (crc);
}
/*@@end*/

/*@@caplFunc:Frm_CalcChecksumCRC8Id(int, message*):*/
byte Frm_CalcChecksumCRC8Id(int FrmIdx, message *MsgObj)
{
    byte crcid;

    /* XOR high byte and low byte of CAN ID - used as checksum end value */
	crcid = MsgObj.ID;
    crcid = crcid ^ ((MsgObj.ID >> 8) & 0xFF);

    return Frm_CalcChecksumCRC8(FrmIdx, MsgObj, crcid);
}
/*@@end*/

/*@@caplFunc:Frm_CalcChecksumCRC8Dyn(int, message*, int):*/
byte Frm_CalcChecksumCRC8Dyn(int FrmIdx, message *MsgObj, int MsgCnt)
{
    byte crcid;
    byte ChksmEndVal[FRM_NUM_MAX][16] =
    {
        { 0x00,0x00,0x00,0x00,0x00,0x00,0x00,0x00,0x00,0x00,0x00,0x00,0x00,0x00,0x00,0x00 },
        { 0x00,0x00,0x00,0x00,0x00,0x00,0x00,0x00,0x00,0x00,0x00,0x00,0x00,0x00,0x00,0x00 },
        { 0x00,0x00,0x00,0x00,0x00,0x00,0x00,0x00,0x00,0x00,0x00,0x00,0x00,0x00,0x00,0x00 },
        { 0x00,0x00,0x00,0x00,0x00,0x00,0x00,0x00,0x00,0x00,0x00,0x00,0x00,0x00,0x00,0x00 },
        { 0x00,0x00,0x00,0x00,0x00,0x00,0x00,0x00,0x00,0x00,0x00,0x00,0x00,0x00,0x00,0x00 },
        { 0x00,0x00,0x00,0x00,0x00,0x00,0x00,0x00,0x00,0x00,0x00,0x00,0x00,0x00,0x00,0x00 },
        { 0x00,0x00,0x00,0x00,0x00,0x00,0x00,0x00,0x00,0x00,0x00,0x00,0x00,0x00,0x00,0x00 },
        { 0x00,0x00,0x00,0x00,0x00,0x00,0x00,0x00,0x00,0x00,0x00,0x00,0x00,0x00,0x00,0x00 },
        { 0x00,0x00,0x00,0x00,0x00,0x00,0x00,0x00,0x00,0x00,0x00,0x00,0x00,0x00,0x00,0x00 },
        { 0x00,0x00,0x00,0x00,0x00,0x00,0x00,0x00,0x00,0x00,0x00,0x00,0x00,0x00,0x00,0x00 },
        { 0x00,0x00,0x00,0x00,0x00,0x00,0x00,0x00,0x00,0x00,0x00,0x00,0x00,0x00,0x00,0x00 },
        { 0x00,0x00,0x00,0x00,0x00,0x00,0x00,0x00,0x00,0x00,0x00,0x00,0x00,0x00,0x00,0x00 },
        { 0x00,0x00,0x00,0x00,0x00,0x00,0x00,0x00,0x00,0x00,0x00,0x00,0x00,0x00,0x00,0x00 },
        { 0x00,0x00,0x00,0x00,0x00,0x00,0x00,0x00,0x00,0x00,0x00,0x00,0x00,0x00,0x00,0x00 }
    };

    /* checksum end value is based on message counter value */
    crcid = ChksmEndVal[FrmIdx][MsgCnt];

    return Frm_CalcChecksumCRC8(FrmIdx, MsgObj, crcid);
}
/*@@end*/

/*@@caplFunc:Frm_CalcChecksumXOR(int, message*, int):*/
byte Frm_CalcChecksumXOR(int FrmIdx, message *MsgObj, int dChksmIdx)
{
    int idx;
    byte chksm;

    /* reset checksum byte */
    MsgObj.BYTE(dChksmIdx) = 0;

    /* init checksum value */
    chksm = 0;

    /* calculate checksum */
    for (idx = 0; idx < MsgObj.DLC; idx++)
    {
        if (idx != dChksmIdx)
        {
            /* XOR all bytes */
            chksm = chksm ^ MsgObj.BYTE(idx);
        }
    }

    /* checksum calculation disabled, make sure checksum is wrong */
    if (Frm_MsgChksmEna[FrmIdx] == 0)
    {
        chksm = ~chksm;
    }

	return (chksm);
}
/*@@end*/

/*@@caplFunc:Frm_CalcChecksumXORID(int, message*, int):*/
byte Frm_CalcChecksumXORID(int FrmIdx, message *MsgObj, int dChksmIdx)
{
    int idx;
    byte chksm;

    /* reset checksum byte */
    MsgObj.BYTE(dChksmIdx) = 0;

    /* init checksum value */
    chksm = 0;

    /* calculate checksum */
    for (idx = 0; idx < MsgObj.DLC; idx++)
    {
        if (idx != dChksmIdx)
        {
            /* XOR all bytes */
            chksm = chksm ^ MsgObj.BYTE(idx);
        }
    }

    /* add high and low byte of CAN ID */
    chksm = chksm ^ (MsgObj.ID & 0xFF);
    chksm = chksm ^ ((MsgObj.ID >> 8) & 0xFF);

    /* checksum calculation disabled, make sure checksum is wrong */
    if (Frm_MsgChksmEna[FrmIdx] == 0)
    {
        chksm = ~chksm;
    }

	return (chksm);
}
/*@@end*/

/*@@caplFunc:Frm_CalcChecksumLW1(int, message*, int):*/
byte Frm_CalcChecksumLW1(int FrmIdx, message *MsgObj, int dChksmIdx)
{
    int idx;
    byte chksm;

    /* reset checksum byte */
    MsgObj.BYTE(dChksmIdx) = 0;

    /* init checksum value */
    chksm = 0;

    /* calculate checksum */
    chksm = ((MsgObj.BYTE(0) + MsgObj.BYTE(1) + MsgObj.BYTE(2) + MsgObj.BYTE(3) + MsgObj.BYTE(5)) & 0xFF);
    chksm = ~chksm;

    /* checksum calculation disabled, make sure checksum is wrong */
    if (Frm_MsgChksmEna[FrmIdx] == 0)
    {
        chksm = ~chksm;
    }

	return (chksm);
}
/*@@end*/

/*@@caplFunc:Frm_CalcMsgCounter(int):*/
int Frm_CalcMsgCounter(int FrmIdx)
{
    /* IMPORTANT NOTE: currently it is assumed that message counter is 4 bit long */
    if (Frm_MsgCounterEna[FrmIdx] != 0)
    {
        Frm_MsgCounter[FrmIdx] ++;
        Frm_MsgCounter[FrmIdx] &= 0x0F;
    }

    return (Frm_MsgCounter[FrmIdx]);
}
/*@@end*/

/*@@caplFunc:FrmSch_EnableFrame(long):*/
FrmSch_EnableFrame(long FrmIdx)
{
    /* enable TX of CAN frame */
    FrmSched_FrmEna[FrmIdx] = 1;
}
/*@@end*/

/*@@caplFunc:FrmSch_DisableFrame(long):*/
FrmSch_DisableFrame(long FrmIdx)
{
    /* enable TX of CAN frame */
    FrmSched_FrmEna[FrmIdx] = 0;
}
/*@@end*/

/*@@caplFunc:FrmSch_EnableAllFrames():*/
FrmSch_EnableAllFrames()
{
    int FrmIdx;

    for (FrmIdx = 0; FrmIdx < FRM_NUM_MAX; FrmIdx++)
    {
        /* enable scheduler for all frames */
        FrmSched_FrmEna[FrmIdx] = 1;
    }
}
/*@@end*/

/*@@caplFunc:FrmSch_DisableAllFrames():*/
FrmSch_DisableAllFrames()
{
    int FrmIdx;

    for (FrmIdx = 0; FrmIdx < FRM_NUM_MAX; FrmIdx++)
    {
        /* disable scheduler for all frames */
        FrmSched_FrmEna[FrmIdx] = 0;
    }
}
/*@@end*/

/*@@caplFunc:Frm_EnableMsgCounter(long):*/
Frm_EnableMsgCounter(long FrmIdx)
{
    /* enable message counter calculation */
    Frm_MsgCounterEna[FrmIdx] = 1;
}
/*@@end*/

/*@@caplFunc:Frm_DisableMsgCounter(long):*/
Frm_DisableMsgCounter(long FrmIdx)
{
    /* disable message counter calculation */
    Frm_MsgCounterEna[FrmIdx] = 0;
}
/*@@end*/

/*@@caplFunc:Frm_EnableChksm(long):*/
Frm_EnableChksm(long FrmIdx)
{
    /* enable checksum calculation */
    Frm_MsgChksmEna[FrmIdx] = 1;
}
/*@@end*/

/*@@caplFunc:Frm_DisableChksm(long):*/
Frm_DisableChksm(long FrmIdx)
{
    /* disable checksum calculation */
    Frm_MsgChksmEna[FrmIdx] = 0;
}
/*@@end*/
