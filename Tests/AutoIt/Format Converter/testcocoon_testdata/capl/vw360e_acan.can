/*@@var:*/
/* TemplateVersion: 1.0.2 */
variables 
{
    /**********************************************************************************************/
    /* BEGIN AUTO                                                                                 */
    /**********************************************************************************************/
    
    message ACC_System MsgObj_ACC_System;
    message Airbag_1 MsgObj_Airbag_1;
    message BSG_Last MsgObj_BSG_Last;
    message Bremse_1 MsgObj_Bremse_1;
    message Bremse_3 MsgObj_Bremse_3;
    message Charisma_01 MsgObj_Charisma_01;
    message Clima_1 MsgObj_Clima_1;
    message Diagnose_1 MsgObj_Diagnose_1;
    message EKompKlima_1 MsgObj_EKompKlima_1;
    message GRA_Neu MsgObj_GRA_Neu;
    message Gate_Komf_1 MsgObj_Gate_Komf_1;
    message Gate_Komf_4 MsgObj_Gate_Komf_4;
    message Klima_EV_1 MsgObj_Klima_EV_1;
    message Kombi_1 MsgObj_Kombi_1;
    message Kombi_2 MsgObj_Kombi_2;
    message NMH_Gateway MsgObj_NMH_Gateway;
    message Waehlhebel_1 MsgObj_Waehlhebel_1;

    const FRM_HANDLE_ACC_System = 0;
    const FRM_HANDLE_Airbag_1 = 1;
    const FRM_HANDLE_BSG_Last = 2;
    const FRM_HANDLE_Bremse_1 = 3;
    const FRM_HANDLE_Bremse_3 = 4;
    const FRM_HANDLE_Charisma_01 = 5;
    const FRM_HANDLE_Clima_1 = 6;
    const FRM_HANDLE_Diagnose_1 = 7;
    const FRM_HANDLE_EKompKlima_1 = 8;
    const FRM_HANDLE_GRA_Neu = 9;
    const FRM_HANDLE_Gate_Komf_1 = 10;
    const FRM_HANDLE_Gate_Komf_4 = 11;
    const FRM_HANDLE_Klima_EV_1 = 12;
    const FRM_HANDLE_Kombi_1 = 13;
    const FRM_HANDLE_Kombi_2 = 14;
    const FRM_HANDLE_NMH_Gateway = 15;
    const FRM_HANDLE_Waehlhebel_1 = 16;

    const FRM_NUM_MAX = 17;


    /**********************************************************************************************/
    /* END AUTO                                                                                   */
    /**********************************************************************************************/


    /* ------------------------------------------------------------------------------------------ */
    /*  timer                                                                                     */
    /* ------------------------------------------------------------------------------------------ */
    msTimer Timer_10ms;                   /* 10ms base timer */
    const TIMER_DURATION_10MS = 10;       /* timer duration for 10ms timer */
    

    /* ------------------------------------------------------------------------------------------ */
    /*  frame scheduler                                                                           */
    /* ------------------------------------------------------------------------------------------ */
    int FrmSched_SchedTmr[FRM_NUM_MAX];   /* schedule timer, incremented every 10ms, resolution [1ms] */
    int FrmSched_CycleTime[FRM_NUM_MAX];  /* cycle time of the CAN frame, resolution [1ms] */
    int FrmSched_FrmEna[FRM_NUM_MAX];     /* frame enable status */


    /* ------------------------------------------------------------------------------------------ */
    /*  frame manager                                                                             */
    /* ------------------------------------------------------------------------------------------ */
    int Frm_MsgCounter[FRM_NUM_MAX];      /* current message counter value */
    int Frm_MsgCounterEna[FRM_NUM_MAX];   /* message counter enable status */
    int Frm_MsgChksmEna[FRM_NUM_MAX];     /* checksum enable status */
    int Frm_DLC[FRM_NUM_MAX];             /* DLC */
    int Frm_DLCOk[FRM_NUM_MAX];           /* DLC status (0=DLC wrong, 1=DLC ok) */

    
    /* ------------------------------------------------------------------------------------------ */
    /*  CAPL control                                                                              */
    /* ------------------------------------------------------------------------------------------ */
    const CAPLCTRL_LEVEL_NOSEL = 0;
    const CAPLCTRL_LEVEL_FRAME = 1;
    const CAPLCTRL_LEVEL_SIGNAL = 2;

    const CAPLCTRL_NOVAL = -1;

    const CAPLCTRL_INPUTBUF_LEN = 32;
    const CAPLCTRL_CHARBUF_LEN = 64;

    const CAPLCTRL_PROMPTMODE_NUM = 0;
    const CAPLCTRL_PROMPTMODE_CHAR = 1;

    int  CaplCtrl_LevelActv = CAPLCTRL_LEVEL_NOSEL;  /* current active level */
    int  CaplCtrl_FrameActv = 0;                     /* current selected frame */
    int  CaplCtrl_SignalActv = 0;                    /* current selected signal */
    int  CaplCtrl_InputValue = 0;                    /* current input value */
    char CaplCtrl_InputBuf[CAPLCTRL_INPUTBUF_LEN];   /* user input buffer */
    int  CaplCtrl_InputIdx = 0;                      /* index into input buffer */
    char CaplCtrl_FrameName[32];                     /* buffer to store frame name */
    char CaplCtrl_SignalName[64];                    /* buffer to store signal name */
    int  CaplCtrl_PromptMode;                        /* prompt mode */
    char CaplCtrl_CharBuf[CAPLCTRL_CHARBUF_LEN];     /* buffer for char output in prompt */


    /* ------------------------------------------------------------------------------------------ */
    /*  key codes                                                                                 */
    /* ------------------------------------------------------------------------------------------ */
    const KEY_ENTER = 0x0D;
    const KEY_BACKSPACE = 0x08;
    const KEY_UP = 0x4800;
    const KEY_DOWN = 0x5000;
    const KEY_TAB = 0x09;
    const KEY_LEVEL_DOWN = '.';
    const KEY_TIMEOUT = 'a';
    const KEY_MSGCNT = 'b';
    const KEY_CHKSM = 'c';
    const KEY_DLC = 'd';
    const KEY_HELP = '?';


    /* ------------------------------------------------------------------------------------------ */
    /*  checksum related variables                                                                */
    /* ------------------------------------------------------------------------------------------ */
    byte CRC8_tab_256[256] =
    {
        0x00, 0x2f, 0x5e, 0x71, 0xbc, 0x93, 0xe2, 0xcd,
        0x57, 0x78, 0x09, 0x26, 0xeb, 0xc4, 0xb5, 0x9a,
        0xae, 0x81, 0xf0, 0xdf, 0x12, 0x3d, 0x4c, 0x63,
        0xf9, 0xd6, 0xa7, 0x88, 0x45, 0x6a, 0x1b, 0x34,
        0x73, 0x5c, 0x2d, 0x02, 0xcf, 0xe0, 0x91, 0xbe,
        0x24, 0x0b, 0x7a, 0x55, 0x98, 0xb7, 0xc6, 0xe9,
        0xdd, 0xf2, 0x83, 0xac, 0x61, 0x4e, 0x3f, 0x10,
        0x8a, 0xa5, 0xd4, 0xfb, 0x36, 0x19, 0x68, 0x47,
        0xe6, 0xc9, 0xb8, 0x97, 0x5a, 0x75, 0x04, 0x2b,
        0xb1, 0x9e, 0xef, 0xc0, 0x0d, 0x22, 0x53, 0x7c,
        0x48, 0x67, 0x16, 0x39, 0xf4, 0xdb, 0xaa, 0x85,
        0x1f, 0x30, 0x41, 0x6e, 0xa3, 0x8c, 0xfd, 0xd2,
        0x95, 0xba, 0xcb, 0xe4, 0x29, 0x06, 0x77, 0x58,
        0xc2, 0xed, 0x9c, 0xb3, 0x7e, 0x51, 0x20, 0x0f,
        0x3b, 0x14, 0x65, 0x4a, 0x87, 0xa8, 0xd9, 0xf6,
        0x6c, 0x43, 0x32, 0x1d, 0xd0, 0xff, 0x8e, 0xa1,
        0xe3, 0xcc, 0xbd, 0x92, 0x5f, 0x70, 0x01, 0x2e,
        0xb4, 0x9b, 0xea, 0xc5, 0x08, 0x27, 0x56, 0x79,
        0x4d, 0x62, 0x13, 0x3c, 0xf1, 0xde, 0xaf, 0x80,
        0x1a, 0x35, 0x44, 0x6b, 0xa6, 0x89, 0xf8, 0xd7,
        0x90, 0xbf, 0xce, 0xe1, 0x2c, 0x03, 0x72, 0x5d,
        0xc7, 0xe8, 0x99, 0xb6, 0x7b, 0x54, 0x25, 0x0a,
        0x3e, 0x11, 0x60, 0x4f, 0x82, 0xad, 0xdc, 0xf3,
        0x69, 0x46, 0x37, 0x18, 0xd5, 0xfa, 0x8b, 0xa4,
        0x05, 0x2a, 0x5b, 0x74, 0xb9, 0x96, 0xe7, 0xc8,
        0x52, 0x7d, 0x0c, 0x23, 0xee, 0xc1, 0xb0, 0x9f,
        0xab, 0x84, 0xf5, 0xda, 0x17, 0x38, 0x49, 0x66,
        0xfc, 0xd3, 0xa2, 0x8d, 0x40, 0x6f, 0x1e, 0x31,
        0x76, 0x59, 0x28, 0x07, 0xca, 0xe5, 0x94, 0xbb,
        0x21, 0x0e, 0x7f, 0x50, 0x9d, 0xb2, 0xc3, 0xec,
        0xd8, 0xf7, 0x86, 0xa9, 0x64, 0x4b, 0x3a, 0x15,
        0x8f, 0xa0, 0xd1, 0xfe, 0x33, 0x1c, 0x6d, 0x42
    };
}
/*@@end*/

/*@@timer:Timer_10ms:*/
on timer Timer_10ms
{
    int FrmIdx;

    /* restart the 10ms timer */
    setTimer(Timer_10ms,TIMER_DURATION_10MS);


    /* ------------------------------------------------------------------------------------------ */
    /*  BEGIN Frame Scheduler                                                                     */
    /* ------------------------------------------------------------------------------------------ */

    for (FrmIdx = 0; FrmIdx < FRM_NUM_MAX; FrmIdx++)
    {
        /* check if frame is enabled */
        if (FrmSched_FrmEna[FrmIdx] != 0)
        {
            /* increment schedule timer */
            FrmSched_SchedTmr[FrmIdx] += 10;
        }
        else
        {
            /* frame disabled, stop schedule timer */
            FrmSched_SchedTmr[FrmIdx] = 0;
        }

        /* if schedule timer reaches cycle time, trigger transfer of CAN frame */
        if (FrmSched_SchedTmr[FrmIdx] >= FrmSched_CycleTime[FrmIdx])
        {
            /* reset schedule timer */
            FrmSched_SchedTmr[FrmIdx] = 0;

            /* trigger transmission of frame */
            FrmSched_SendFrame(FrmIdx);
        }
    }

    /* ------------------------------------------------------------------------------------------ */
    /*  END Frame Scheduler                                                                       */
    /* ------------------------------------------------------------------------------------------ */
}
/*@@end*/

/*@@preStart:PreStart:*/
on preStart
{
    dword fhdlIn;
    dword fhdlOut;
    
    /* ------------------------------------------------------------------------------------------ */
    /*  BEGIN frame and signal handle export for remote control of CAPL by Perl script            */
    /* ------------------------------------------------------------------------------------------ */

    /* check if CAPL is remote controlled by CaplCtrl Perl script */
    /* NOTE: Communication between CAPL program and Perl scritp is done via file, since with */
    /*       CANalyzer Version v4 it is not possible to use environment variables, so this is */
    /*       just a workaround. */
    fhdlIn = openFileRead ("caplctrl_req.txt", 0);
    if (fhdlIn != 0)
    {
        /* close input file */
        fileClose(fhdlIn);

        /* export frame and signal handles to file for remote control scripts */
        fhdlOut = openFileWrite ("caplctrl.txt", 0);
        if (fhdlOut != 0)
        {
            /* NOTE:   handles are 2 bytes long. */
            /* LAYOUT: frame handle: lower byte = 0xFF, upper byte = frame handle for CAPL program */
            /*         signal handle: lower byte = signal index, upper byte = frame index */
            filePutString ("ACC_System;255\n", 15, fhdlOut);
            filePutString ("ACC_System;ACCA;AliasName\n", 26, fhdlOut);    /* alias frame handle for ACC_System */
            filePutString ("Airbag_1;511\n", 13, fhdlOut);
            filePutString ("Airbag_1;AIRBG1;AliasName\n", 26, fhdlOut);    /* alias frame handle for Airbag_1 */
            filePutString ("BSG_Last;767\n", 13, fhdlOut);
            filePutString ("BSG_Last;ESCU;AliasName\n", 24, fhdlOut);    /* alias frame handle for BSG_Last */
            filePutString ("Bremse_1;1023\n", 14, fhdlOut);
            filePutString ("Bremse_1;BRK1;AliasName\n", 24, fhdlOut);    /* alias frame handle for Bremse_1 */
            filePutString ("Bremse_3;1279\n", 14, fhdlOut);
            filePutString ("Bremse_3;BRK3;AliasName\n", 24, fhdlOut);    /* alias frame handle for Bremse_3 */
            filePutString ("Charisma_01;1535\n", 17, fhdlOut);
            filePutString ("Charisma_01;CHRMS01;AliasName\n", 30, fhdlOut);    /* alias frame handle for Charisma_01 */
            filePutString ("Clima_1;1791\n", 13, fhdlOut);
            filePutString ("Clima_1;Klima_1;AliasName\n", 26, fhdlOut);    /* alias frame handle for Clima_1 */
            filePutString ("Diagnose_1;2047\n", 16, fhdlOut);
            filePutString ("Diagnose_1;DIA1;AliasName\n", 26, fhdlOut);    /* alias frame handle for Diagnose_1 */
            filePutString ("EKompKlima_1;2303\n", 18, fhdlOut);
            filePutString ("EKompKlima_1;EAC1;AliasName\n", 28, fhdlOut);    /* alias frame handle for EKompKlima_1 */
            filePutString ("GRA_Neu;2559\n", 13, fhdlOut);
            filePutString ("GRA_Neu;GRA_neu;AliasName\n", 26, fhdlOut);    /* alias frame handle for GRA_Neu */
            filePutString ("Gate_Komf_1;2815\n", 17, fhdlOut);
            filePutString ("Gate_Komf_1;Gateway_Komfort_1;AliasName\n", 40, fhdlOut);    /* alias frame handle for Gate_Komf_1 */
            filePutString ("Gate_Komf_4;3071\n", 17, fhdlOut);
            filePutString ("Gate_Komf_4;Gateway_Komfort_4;AliasName\n", 40, fhdlOut);    /* alias frame handle for Gate_Komf_4 */
            filePutString ("Klima_EV_1;3327\n", 16, fhdlOut);
            filePutString ("Klima_EV_1;ACEV1;AliasName\n", 27, fhdlOut);    /* alias frame handle for Klima_EV_1 */
            filePutString ("Kombi_1;3583\n", 13, fhdlOut);
            filePutString ("Kombi_1;DSP1;AliasName\n", 23, fhdlOut);    /* alias frame handle for Kombi_1 */
            filePutString ("Kombi_2;3839\n", 13, fhdlOut);
            filePutString ("Kombi_2;DSP2;AliasName\n", 23, fhdlOut);    /* alias frame handle for Kombi_2 */
            filePutString ("NMH_Gateway;4095\n", 17, fhdlOut);
            filePutString ("NMH_Gateway;NMH_Gateway;AliasName\n", 34, fhdlOut);    /* alias frame handle for NMH_Gateway */
            filePutString ("Waehlhebel_1;4351\n", 18, fhdlOut);
            filePutString ("Waehlhebel_1;Waehlhebel_1;AliasName\n", 36, fhdlOut);    /* alias frame handle for Waehlhebel_1 */

            filePutString ("ACS_ADR_Schub;0\n", 16, fhdlOut);
            filePutString ("ACS_ADR_Schub/ACC_System;0\n", 27, fhdlOut);
            filePutString ("ACS_ADR_Schub/ACCA;0\n", 21, fhdlOut);
            filePutString ("ACS_Anhaltewunsch;1\n", 20, fhdlOut);
            filePutString ("ACS_Anhaltewunsch/ACC_System;1\n", 31, fhdlOut);
            filePutString ("ACS_Anhaltewunsch/ACCA;1\n", 25, fhdlOut);
            filePutString ("ACS_Checksum;2\n", 15, fhdlOut);
            filePutString ("ACS_Checksum/ACC_System;2\n", 26, fhdlOut);
            filePutString ("ACS_Checksum/ACCA;2\n", 20, fhdlOut);
            filePutString ("ACS_Fehler;3\n", 13, fhdlOut);
            filePutString ("ACS_Fehler/ACC_System;3\n", 24, fhdlOut);
            filePutString ("ACS_Fehler/ACCA;3\n", 18, fhdlOut);
            filePutString ("ACS_FreigSollB;4\n", 17, fhdlOut);
            filePutString ("ACS_FreigSollB/ACC_System;4\n", 28, fhdlOut);
            filePutString ("ACS_FreigSollB/ACCA;4\n", 22, fhdlOut);
            filePutString ("ACS_MomEingriff;5\n", 18, fhdlOut);
            filePutString ("ACS_MomEingriff/ACC_System;5\n", 29, fhdlOut);
            filePutString ("ACS_MomEingriff/ACCA;5\n", 23, fhdlOut);
            filePutString ("ACS_Schubabsch;6\n", 17, fhdlOut);
            filePutString ("ACS_Schubabsch/ACC_System;6\n", 28, fhdlOut);
            filePutString ("ACS_Schubabsch/ACCA;6\n", 22, fhdlOut);
            filePutString ("ACS_Sollbeschl;7\n", 17, fhdlOut);
            filePutString ("ACS_Sollbeschl/ACC_System;7\n", 28, fhdlOut);
            filePutString ("ACS_Sollbeschl/ACCA;7\n", 22, fhdlOut);
            filePutString ("ACS_StSt_Info;8\n", 16, fhdlOut);
            filePutString ("ACS_StSt_Info/ACC_System;8\n", 27, fhdlOut);
            filePutString ("ACS_StSt_Info/ACCA;8\n", 21, fhdlOut);
            filePutString ("ACS_Sta_ADR;9\n", 14, fhdlOut);
            filePutString ("ACS_Sta_ADR/ACC_System;9\n", 25, fhdlOut);
            filePutString ("ACS_Sta_ADR/ACCA;9\n", 19, fhdlOut);
            filePutString ("ACS_Typ_ACC;10\n", 15, fhdlOut);
            filePutString ("ACS_Typ_ACC/ACC_System;10\n", 26, fhdlOut);
            filePutString ("ACS_Typ_ACC/ACCA;10\n", 20, fhdlOut);
            filePutString ("ACS_Zaehler;11\n", 15, fhdlOut);
            filePutString ("ACS_Zaehler/ACC_System;11\n", 26, fhdlOut);
            filePutString ("ACS_Zaehler/ACCA;11\n", 20, fhdlOut);
            filePutString ("ACS_max_AendGrad;12\n", 20, fhdlOut);
            filePutString ("ACS_max_AendGrad/ACC_System;12\n", 31, fhdlOut);
            filePutString ("ACS_max_AendGrad/ACCA;12\n", 25, fhdlOut);
            filePutString ("ACS_zul_Regelabw;13\n", 20, fhdlOut);
            filePutString ("ACS_zul_Regelabw/ACC_System;13\n", 31, fhdlOut);
            filePutString ("ACS_zul_Regelabw/ACCA;13\n", 25, fhdlOut);
            filePutString ("AB1_BF_Warnung;256\n", 19, fhdlOut);
            filePutString ("AB1_BF_Warnung/Airbag_1;256\n", 28, fhdlOut);
            filePutString ("AB1_BF_Warnung/AIRBG1;256\n", 26, fhdlOut);
            filePutString ("AB1_Beifahrer;257\n", 18, fhdlOut);
            filePutString ("AB1_Beifahrer/Airbag_1;257\n", 27, fhdlOut);
            filePutString ("AB1_Beifahrer/AIRBG1;257\n", 25, fhdlOut);
            filePutString ("AB1_Bf_Seite;258\n", 17, fhdlOut);
            filePutString ("AB1_Bf_Seite/Airbag_1;258\n", 26, fhdlOut);
            filePutString ("AB1_Bf_Seite/AIRBG1;258\n", 24, fhdlOut);
            filePutString ("AB1_Checksumme;259\n", 19, fhdlOut);
            filePutString ("AB1_Checksumme/Airbag_1;259\n", 28, fhdlOut);
            filePutString ("AB1_Checksumme/AIRBG1;259\n", 26, fhdlOut);
            filePutString ("AB1_Diagnose;260\n", 17, fhdlOut);
            filePutString ("AB1_Diagnose/Airbag_1;260\n", 26, fhdlOut);
            filePutString ("AB1_Diagnose/AIRBG1;260\n", 24, fhdlOut);
            filePutString ("AB1_Fa_Seite;261\n", 17, fhdlOut);
            filePutString ("AB1_Fa_Seite/Airbag_1;261\n", 26, fhdlOut);
            filePutString ("AB1_Fa_Seite/AIRBG1;261\n", 24, fhdlOut);
            filePutString ("AB1_Fehlereintr;262\n", 20, fhdlOut);
            filePutString ("AB1_Fehlereintr/Airbag_1;262\n", 29, fhdlOut);
            filePutString ("AB1_Fehlereintr/AIRBG1;262\n", 27, fhdlOut);
            filePutString ("AB1_Front;263\n", 14, fhdlOut);
            filePutString ("AB1_Front/Airbag_1;263\n", 23, fhdlOut);
            filePutString ("AB1_Front/AIRBG1;263\n", 21, fhdlOut);
            filePutString ("AB1_Gurt_Bf;264\n", 16, fhdlOut);
            filePutString ("AB1_Gurt_Bf/Airbag_1;264\n", 25, fhdlOut);
            filePutString ("AB1_Gurt_Bf/AIRBG1;264\n", 23, fhdlOut);
            filePutString ("AB1_Gurt_Fa;265\n", 16, fhdlOut);
            filePutString ("AB1_Gurt_Fa/Airbag_1;265\n", 25, fhdlOut);
            filePutString ("AB1_Gurt_Fa/AIRBG1;265\n", 23, fhdlOut);
            filePutString ("AB1_Heck;266\n", 13, fhdlOut);
            filePutString ("AB1_Heck/Airbag_1;266\n", 22, fhdlOut);
            filePutString ("AB1_Heck/AIRBG1;266\n", 20, fhdlOut);
            filePutString ("AB1_Intens;267\n", 15, fhdlOut);
            filePutString ("AB1_Intens/Airbag_1;267\n", 24, fhdlOut);
            filePutString ("AB1_Intens/AIRBG1;267\n", 22, fhdlOut);
            filePutString ("AB1_Lampe;268\n", 14, fhdlOut);
            filePutString ("AB1_Lampe/Airbag_1;268\n", 23, fhdlOut);
            filePutString ("AB1_Lampe/AIRBG1;268\n", 21, fhdlOut);
            filePutString ("AB1_Rollover;269\n", 17, fhdlOut);
            filePutString ("AB1_Rollover/Airbag_1;269\n", 26, fhdlOut);
            filePutString ("AB1_Rollover/AIRBG1;269\n", 24, fhdlOut);
            filePutString ("AB1_Status;270\n", 15, fhdlOut);
            filePutString ("AB1_Status/Airbag_1;270\n", 24, fhdlOut);
            filePutString ("AB1_Status/AIRBG1;270\n", 22, fhdlOut);
            filePutString ("AB1_Stellglied;271\n", 19, fhdlOut);
            filePutString ("AB1_Stellglied/Airbag_1;271\n", 28, fhdlOut);
            filePutString ("AB1_Stellglied/AIRBG1;271\n", 26, fhdlOut);
            filePutString ("AB1_System;272\n", 15, fhdlOut);
            filePutString ("AB1_System/Airbag_1;272\n", 24, fhdlOut);
            filePutString ("AB1_System/AIRBG1;272\n", 22, fhdlOut);
            filePutString ("AB1_Zaehler;273\n", 16, fhdlOut);
            filePutString ("AB1_Zaehler/Airbag_1;273\n", 25, fhdlOut);
            filePutString ("AB1_Zaehler/AIRBG1;273\n", 23, fhdlOut);
            filePutString ("BSL_Ab_Batterie;512\n", 20, fhdlOut);
            filePutString ("BSL_Ab_Batterie/BSG_Last;512\n", 29, fhdlOut);
            filePutString ("BSL_Ab_Batterie/ESCU;512\n", 25, fhdlOut);
            filePutString ("BSL_Aussensp;513\n", 17, fhdlOut);
            filePutString ("BSL_Aussensp/BSG_Last;513\n", 26, fhdlOut);
            filePutString ("BSL_Aussensp/ESCU;513\n", 22, fhdlOut);
            filePutString ("BSL_BSG_2_alt;514\n", 18, fhdlOut);
            filePutString ("BSL_BSG_2_alt/BSG_Last;514\n", 27, fhdlOut);
            filePutString ("BSL_BSG_2_alt/ESCU;514\n", 23, fhdlOut);
            filePutString ("BSL_BSG_3_alt;515\n", 18, fhdlOut);
            filePutString ("BSL_BSG_3_alt/BSG_Last;515\n", 27, fhdlOut);
            filePutString ("BSL_BSG_3_alt/ESCU;515\n", 23, fhdlOut);
            filePutString ("BSL_Clima;516\n", 14, fhdlOut);
            filePutString ("BSL_Clima/BSG_Last;516\n", 23, fhdlOut);
            filePutString ("BSL_Clima/ESCU;516\n", 19, fhdlOut);
            filePutString ("BSL_Fehlereintr;517\n", 20, fhdlOut);
            filePutString ("BSL_Fehlereintr/BSG_Last;517\n", 29, fhdlOut);
            filePutString ("BSL_Fehlereintr/ESCU;517\n", 25, fhdlOut);
            filePutString ("BSL_Frontsch;518\n", 17, fhdlOut);
            filePutString ("BSL_Frontsch/BSG_Last;518\n", 26, fhdlOut);
            filePutString ("BSL_Frontsch/ESCU;518\n", 22, fhdlOut);
            filePutString ("BSL_Hecksch;519\n", 16, fhdlOut);
            filePutString ("BSL_Hecksch/BSG_Last;519\n", 25, fhdlOut);
            filePutString ("BSL_Hecksch/ESCU;519\n", 21, fhdlOut);
            filePutString ("BSL_Kl_15_Motor;520\n", 20, fhdlOut);
            filePutString ("BSL_Kl_15_Motor/BSG_Last;520\n", 29, fhdlOut);
            filePutString ("BSL_Kl_15_Motor/ESCU;520\n", 25, fhdlOut);
            filePutString ("BSL_Kl_L;521\n", 13, fhdlOut);
            filePutString ("BSL_Kl_L/BSG_Last;521\n", 22, fhdlOut);
            filePutString ("BSL_Kl_L/ESCU;521\n", 18, fhdlOut);
            filePutString ("BSL_Kuehlerlueft;522\n", 21, fhdlOut);
            filePutString ("BSL_Kuehlerlueft/BSG_Last;522\n", 30, fhdlOut);
            filePutString ("BSL_Kuehlerlueft/ESCU;522\n", 26, fhdlOut);
            filePutString ("BSL_LL_Anheb;523\n", 17, fhdlOut);
            filePutString ("BSL_LL_Anheb/BSG_Last;523\n", 26, fhdlOut);
            filePutString ("BSL_LL_Anheb/ESCU;523\n", 22, fhdlOut);
            filePutString ("BSL_LL_Anheb2;524\n", 18, fhdlOut);
            filePutString ("BSL_LL_Anheb2/BSG_Last;524\n", 27, fhdlOut);
            filePutString ("BSL_LL_Anheb2/ESCU;524\n", 23, fhdlOut);
            filePutString ("BSL_Lenkradheiz;525\n", 20, fhdlOut);
            filePutString ("BSL_Lenkradheiz/BSG_Last;525\n", 29, fhdlOut);
            filePutString ("BSL_Lenkradheiz/ESCU;525\n", 25, fhdlOut);
            filePutString ("BSL_Motor_Haube;526\n", 20, fhdlOut);
            filePutString ("BSL_Motor_Haube/BSG_Last;526\n", 29, fhdlOut);
            filePutString ("BSL_Motor_Haube/ESCU;526\n", 25, fhdlOut);
            filePutString ("BSL_Parklicht;527\n", 18, fhdlOut);
            filePutString ("BSL_Parklicht/BSG_Last;527\n", 27, fhdlOut);
            filePutString ("BSL_Parklicht/ESCU;527\n", 23, fhdlOut);
            filePutString ("BSL_Sitzbelueft;528\n", 20, fhdlOut);
            filePutString ("BSL_Sitzbelueft/BSG_Last;528\n", 29, fhdlOut);
            filePutString ("BSL_Sitzbelueft/ESCU;528\n", 25, fhdlOut);
            filePutString ("BSL_Sitzheiz;529\n", 17, fhdlOut);
            filePutString ("BSL_Sitzheiz/BSG_Last;529\n", 26, fhdlOut);
            filePutString ("BSL_Sitzheiz/ESCU;529\n", 22, fhdlOut);
            filePutString ("BSL_Sta_LWR;530\n", 16, fhdlOut);
            filePutString ("BSL_Sta_LWR/BSG_Last;530\n", 25, fhdlOut);
            filePutString ("BSL_Sta_LWR/ESCU;530\n", 21, fhdlOut);
            filePutString ("BSL_Sta_StBat;531\n", 18, fhdlOut);
            filePutString ("BSL_Sta_StBat/BSG_Last;531\n", 27, fhdlOut);
            filePutString ("BSL_Sta_StBat/ESCU;531\n", 23, fhdlOut);
            filePutString ("BSL_Sta_UBat;532\n", 17, fhdlOut);
            filePutString ("BSL_Sta_UBat/BSG_Last;532\n", 26, fhdlOut);
            filePutString ("BSL_Sta_UBat/ESCU;532\n", 22, fhdlOut);
            filePutString ("BSL_Starterlaubnis;533\n", 23, fhdlOut);
            filePutString ("BSL_Starterlaubnis/BSG_Last;533\n", 32, fhdlOut);
            filePutString ("BSL_Starterlaubnis/ESCU;533\n", 28, fhdlOut);
            filePutString ("BSL_UBat;534\n", 13, fhdlOut);
            filePutString ("BSL_UBat/BSG_Last;534\n", 22, fhdlOut);
            filePutString ("BSL_UBat/ESCU;534\n", 18, fhdlOut);
            filePutString ("BSL_Wake_Up_ACAN;535\n", 21, fhdlOut);
            filePutString ("BSL_Wake_Up_ACAN/BSG_Last;535\n", 30, fhdlOut);
            filePutString ("BSL_Wake_Up_ACAN/ESCU;535\n", 26, fhdlOut);
            filePutString ("BSL_Wasserheiz;536\n", 19, fhdlOut);
            filePutString ("BSL_Wasserheiz/BSG_Last;536\n", 28, fhdlOut);
            filePutString ("BSL_Wasserheiz/ESCU;536\n", 24, fhdlOut);
            filePutString ("BSL_Weckursache_ACAN;537\n", 25, fhdlOut);
            filePutString ("BSL_Weckursache_ACAN/BSG_Last;537\n", 34, fhdlOut);
            filePutString ("BSL_Weckursache_ACAN/ESCU;537\n", 30, fhdlOut);
            filePutString ("BSL_ZAS_Kl_15;538\n", 18, fhdlOut);
            filePutString ("BSL_ZAS_Kl_15/BSG_Last;538\n", 27, fhdlOut);
            filePutString ("BSL_ZAS_Kl_15/ESCU;538\n", 23, fhdlOut);
            filePutString ("BSL_ZAS_Kl_50;539\n", 18, fhdlOut);
            filePutString ("BSL_ZAS_Kl_50/BSG_Last;539\n", 27, fhdlOut);
            filePutString ("BSL_ZAS_Kl_50/ESCU;539\n", 23, fhdlOut);
            filePutString ("BSL_ZAS_Kl_S;540\n", 17, fhdlOut);
            filePutString ("BSL_ZAS_Kl_S/BSG_Last;540\n", 26, fhdlOut);
            filePutString ("BSL_ZAS_Kl_S/ESCU;540\n", 22, fhdlOut);
            filePutString ("BSL_ZAS_Kl_X;541\n", 17, fhdlOut);
            filePutString ("BSL_ZAS_Kl_X/BSG_Last;541\n", 26, fhdlOut);
            filePutString ("BSL_ZAS_Kl_X/ESCU;541\n", 22, fhdlOut);
            filePutString ("BR1_ABS_Brems;768\n", 18, fhdlOut);
            filePutString ("BR1_ABS_Brems/Bremse_1;768\n", 27, fhdlOut);
            filePutString ("BR1_ABS_Brems/BRK1;768\n", 23, fhdlOut);
            filePutString ("BR1_ASRMo_fa;769\n", 17, fhdlOut);
            filePutString ("BR1_ASRMo_fa/Bremse_1;769\n", 26, fhdlOut);
            filePutString ("BR1_ASRMo_fa/BRK1;769\n", 22, fhdlOut);
            filePutString ("BR1_ASRMo_sl;770\n", 17, fhdlOut);
            filePutString ("BR1_ASRMo_sl/Bremse_1;770\n", 26, fhdlOut);
            filePutString ("BR1_ASRMo_sl/BRK1;770\n", 22, fhdlOut);
            filePutString ("BR1_ASR_Anf;771\n", 16, fhdlOut);
            filePutString ("BR1_ASR_Anf/Bremse_1;771\n", 25, fhdlOut);
            filePutString ("BR1_ASR_Anf/BRK1;771\n", 21, fhdlOut);
            filePutString ("BR1_ASR_ESP;772\n", 16, fhdlOut);
            filePutString ("BR1_ASR_ESP/Bremse_1;772\n", 25, fhdlOut);
            filePutString ("BR1_ASR_ESP/BRK1;772\n", 21, fhdlOut);
            filePutString ("BR1_ASR_Eingr;773\n", 18, fhdlOut);
            filePutString ("BR1_ASR_Eingr/Bremse_1;773\n", 27, fhdlOut);
            filePutString ("BR1_ASR_Eingr/BRK1;773\n", 23, fhdlOut);
            filePutString ("BR1_BKV_aktiv;774\n", 18, fhdlOut);
            filePutString ("BR1_BKV_aktiv/Bremse_1;774\n", 27, fhdlOut);
            filePutString ("BR1_BKV_aktiv/BRK1;774\n", 23, fhdlOut);
            filePutString ("BR1_Diagnose;775\n", 17, fhdlOut);
            filePutString ("BR1_Diagnose/Bremse_1;775\n", 26, fhdlOut);
            filePutString ("BR1_Diagnose/BRK1;775\n", 22, fhdlOut);
            filePutString ("BR1_EBV_Eingr;776\n", 18, fhdlOut);
            filePutString ("BR1_EBV_Eingr/Bremse_1;776\n", 27, fhdlOut);
            filePutString ("BR1_EBV_Eingr/BRK1;776\n", 23, fhdlOut);
            filePutString ("BR1_EDS_Eingr;777\n", 18, fhdlOut);
            filePutString ("BR1_EDS_Eingr/Bremse_1;777\n", 27, fhdlOut);
            filePutString ("BR1_EDS_Eingr/BRK1;777\n", 23, fhdlOut);
            filePutString ("BR1_ESPASR_passiv;778\n", 22, fhdlOut);
            filePutString ("BR1_ESPASR_passiv/Bremse_1;778\n", 31, fhdlOut);
            filePutString ("BR1_ESPASR_passiv/BRK1;778\n", 27, fhdlOut);
            filePutString ("BR1_ESP_Eingr;779\n", 18, fhdlOut);
            filePutString ("BR1_ESP_Eingr/Bremse_1;779\n", 27, fhdlOut);
            filePutString ("BR1_ESP_Eingr/BRK1;779\n", 23, fhdlOut);
            filePutString ("BR1_Ersatz_Kmh;780\n", 19, fhdlOut);
            filePutString ("BR1_Ersatz_Kmh/Bremse_1;780\n", 28, fhdlOut);
            filePutString ("BR1_Ersatz_Kmh/BRK1;780\n", 24, fhdlOut);
            filePutString ("BR1_Lampe_ABS;781\n", 18, fhdlOut);
            filePutString ("BR1_Lampe_ABS/Bremse_1;781\n", 27, fhdlOut);
            filePutString ("BR1_Lampe_ABS/BRK1;781\n", 23, fhdlOut);
            filePutString ("BR1_Lampe_ASR;782\n", 18, fhdlOut);
            filePutString ("BR1_Lampe_ASR/Bremse_1;782\n", 27, fhdlOut);
            filePutString ("BR1_Lampe_ASR/BRK1;782\n", 23, fhdlOut);
            filePutString ("BR1_Lampe_BK;783\n", 17, fhdlOut);
            filePutString ("BR1_Lampe_BK/Bremse_1;783\n", 26, fhdlOut);
            filePutString ("BR1_Lampe_BK/BRK1;783\n", 22, fhdlOut);
            filePutString ("BR1_Lichtschalt;784\n", 20, fhdlOut);
            filePutString ("BR1_Lichtschalt/Bremse_1;784\n", 29, fhdlOut);
            filePutString ("BR1_Lichtschalt/BRK1;784\n", 25, fhdlOut);
            filePutString ("BR1_MAD;785\n", 12, fhdlOut);
            filePutString ("BR1_MAD/Bremse_1;785\n", 21, fhdlOut);
            filePutString ("BR1_MAD/BRK1;785\n", 17, fhdlOut);
            filePutString ("BR1_MSR_Anf;786\n", 16, fhdlOut);
            filePutString ("BR1_MSR_Anf/Bremse_1;786\n", 25, fhdlOut);
            filePutString ("BR1_MSR_Anf/BRK1;786\n", 21, fhdlOut);
            filePutString ("BR1_MSR_Mo;787\n", 15, fhdlOut);
            filePutString ("BR1_MSR_Mo/Bremse_1;787\n", 24, fhdlOut);
            filePutString ("BR1_MSR_Mo/BRK1;787\n", 20, fhdlOut);
            filePutString ("BR1_MSR_Mo_inv;788\n", 19, fhdlOut);
            filePutString ("BR1_MSR_Mo_inv/Bremse_1;788\n", 28, fhdlOut);
            filePutString ("BR1_MSR_Mo_inv/BRK1;788\n", 24, fhdlOut);
            filePutString ("BR1_Rad_kmh;789\n", 16, fhdlOut);
            filePutString ("BR1_Rad_kmh/Bremse_1;789\n", 25, fhdlOut);
            filePutString ("BR1_Rad_kmh/BRK1;789\n", 21, fhdlOut);
            filePutString ("BR1_StaDruckschw;790\n", 21, fhdlOut);
            filePutString ("BR1_StaDruckschw/Bremse_1;790\n", 30, fhdlOut);
            filePutString ("BR1_StaDruckschw/BRK1;790\n", 26, fhdlOut);
            filePutString ("BR1_Sta_ESP;791\n", 16, fhdlOut);
            filePutString ("BR1_Sta_ESP/Bremse_1;791\n", 25, fhdlOut);
            filePutString ("BR1_Sta_ESP/BRK1;791\n", 21, fhdlOut);
            filePutString ("BR1_Sta_MAD;792\n", 16, fhdlOut);
            filePutString ("BR1_Sta_MAD/Bremse_1;792\n", 25, fhdlOut);
            filePutString ("BR1_Sta_MAD/BRK1;792\n", 21, fhdlOut);
            filePutString ("BR1_Zaehler;793\n", 16, fhdlOut);
            filePutString ("BR1_Zaehler/Bremse_1;793\n", 25, fhdlOut);
            filePutString ("BR1_Zaehler/BRK1;793\n", 21, fhdlOut);
            filePutString ("BR3_Fahrtr_HL;1024\n", 19, fhdlOut);
            filePutString ("BR3_Fahrtr_HL/Bremse_3;1024\n", 28, fhdlOut);
            filePutString ("BR3_Fahrtr_HL/BRK3;1024\n", 24, fhdlOut);
            filePutString ("BR3_Fahrtr_HR;1025\n", 19, fhdlOut);
            filePutString ("BR3_Fahrtr_HR/Bremse_3;1025\n", 28, fhdlOut);
            filePutString ("BR3_Fahrtr_HR/BRK3;1025\n", 24, fhdlOut);
            filePutString ("BR3_Fahrtr_VL;1026\n", 19, fhdlOut);
            filePutString ("BR3_Fahrtr_VL/Bremse_3;1026\n", 28, fhdlOut);
            filePutString ("BR3_Fahrtr_VL/BRK3;1026\n", 24, fhdlOut);
            filePutString ("BR3_Fahrtr_VR;1027\n", 19, fhdlOut);
            filePutString ("BR3_Fahrtr_VR/Bremse_3;1027\n", 28, fhdlOut);
            filePutString ("BR3_Fahrtr_VR/BRK3;1027\n", 24, fhdlOut);
            filePutString ("BR3_Rad_kmh_HL;1028\n", 20, fhdlOut);
            filePutString ("BR3_Rad_kmh_HL/Bremse_3;1028\n", 29, fhdlOut);
            filePutString ("BR3_Rad_kmh_HL/BRK3;1028\n", 25, fhdlOut);
            filePutString ("BR3_Rad_kmh_HR;1029\n", 20, fhdlOut);
            filePutString ("BR3_Rad_kmh_HR/Bremse_3;1029\n", 29, fhdlOut);
            filePutString ("BR3_Rad_kmh_HR/BRK3;1029\n", 25, fhdlOut);
            filePutString ("BR3_Rad_kmh_VL;1030\n", 20, fhdlOut);
            filePutString ("BR3_Rad_kmh_VL/Bremse_3;1030\n", 29, fhdlOut);
            filePutString ("BR3_Rad_kmh_VL/BRK3;1030\n", 25, fhdlOut);
            filePutString ("BR3_Rad_kmh_VR;1031\n", 20, fhdlOut);
            filePutString ("BR3_Rad_kmh_VR/Bremse_3;1031\n", 29, fhdlOut);
            filePutString ("BR3_Rad_kmh_VR/BRK3;1031\n", 25, fhdlOut);
            filePutString ("CHA_Ziel_FahrPr_GE;1280\n", 24, fhdlOut);
            filePutString ("CHA_Ziel_FahrPr_GE/Charisma_01;1280\n", 36, fhdlOut);
            filePutString ("CHA_Ziel_FahrPr_GE/CHRMS01;1280\n", 32, fhdlOut);
            filePutString ("CHA_Ziel_FahrPr_MO;1281\n", 24, fhdlOut);
            filePutString ("CHA_Ziel_FahrPr_MO/Charisma_01;1281\n", 36, fhdlOut);
            filePutString ("CHA_Ziel_FahrPr_MO/CHRMS01;1281\n", 32, fhdlOut);
            filePutString ("CL1_AC_Schalter;1536\n", 21, fhdlOut);
            filePutString ("CL1_AC_Schalter/Clima_1;1536\n", 29, fhdlOut);
            filePutString ("CL1_AC_Schalter/Klima_1;1536\n", 29, fhdlOut);
            filePutString ("CL1_Aussentemp;1537\n", 20, fhdlOut);
            filePutString ("CL1_Aussentemp/Clima_1;1537\n", 28, fhdlOut);
            filePutString ("CL1_Aussentemp/Klima_1;1537\n", 28, fhdlOut);
            filePutString ("CL1_Druck;1538\n", 15, fhdlOut);
            filePutString ("CL1_Druck/Clima_1;1538\n", 23, fhdlOut);
            filePutString ("CL1_Druck/Klima_1;1538\n", 23, fhdlOut);
            filePutString ("CL1_Einheit_Temp;1539\n", 22, fhdlOut);
            filePutString ("CL1_Einheit_Temp/Clima_1;1539\n", 30, fhdlOut);
            filePutString ("CL1_Einheit_Temp/Klima_1;1539\n", 30, fhdlOut);
            filePutString ("CL1_Fa_Zuheiz;1540\n", 19, fhdlOut);
            filePutString ("CL1_Fa_Zuheiz/Clima_1;1540\n", 27, fhdlOut);
            filePutString ("CL1_Fa_Zuheiz/Klima_1;1540\n", 27, fhdlOut);
            filePutString ("CL1_Fehlereintr;1541\n", 21, fhdlOut);
            filePutString ("CL1_Fehlereintr/Clima_1;1541\n", 29, fhdlOut);
            filePutString ("CL1_Fehlereintr/Klima_1;1541\n", 29, fhdlOut);
            filePutString ("CL1_Frontsch;1542\n", 18, fhdlOut);
            filePutString ("CL1_Frontsch/Clima_1;1542\n", 26, fhdlOut);
            filePutString ("CL1_Frontsch/Klima_1;1542\n", 26, fhdlOut);
            filePutString ("CL1_Gebl_last;1543\n", 19, fhdlOut);
            filePutString ("CL1_Gebl_last/Clima_1;1543\n", 27, fhdlOut);
            filePutString ("CL1_Gebl_last/Klima_1;1543\n", 27, fhdlOut);
            filePutString ("CL1_Hecksch;1544\n", 17, fhdlOut);
            filePutString ("CL1_Hecksch/Clima_1;1544\n", 25, fhdlOut);
            filePutString ("CL1_Hecksch/Klima_1;1544\n", 25, fhdlOut);
            filePutString ("CL1_Heizleist;1545\n", 19, fhdlOut);
            filePutString ("CL1_Heizleist/Clima_1;1545\n", 27, fhdlOut);
            filePutString ("CL1_Heizleist/Klima_1;1545\n", 27, fhdlOut);
            filePutString ("CL1_Kompr_Last;1546\n", 20, fhdlOut);
            filePutString ("CL1_Kompr_Last/Clima_1;1546\n", 28, fhdlOut);
            filePutString ("CL1_Kompr_Last/Klima_1;1546\n", 28, fhdlOut);
            filePutString ("CL1_Kompressor;1547\n", 20, fhdlOut);
            filePutString ("CL1_Kompressor/Clima_1;1547\n", 28, fhdlOut);
            filePutString ("CL1_Kompressor/Klima_1;1547\n", 28, fhdlOut);
            filePutString ("CL1_LL_Dz;1548\n", 15, fhdlOut);
            filePutString ("CL1_LL_Dz/Clima_1;1548\n", 23, fhdlOut);
            filePutString ("CL1_LL_Dz/Klima_1;1548\n", 23, fhdlOut);
            filePutString ("CL1_Luefter;1549\n", 17, fhdlOut);
            filePutString ("CL1_Luefter/Clima_1;1549\n", 25, fhdlOut);
            filePutString ("CL1_Luefter/Klima_1;1549\n", 25, fhdlOut);
            filePutString ("CL1_PTC_Hzg;1550\n", 17, fhdlOut);
            filePutString ("CL1_PTC_Hzg/Clima_1;1550\n", 25, fhdlOut);
            filePutString ("CL1_PTC_Hzg/Klima_1;1550\n", 25, fhdlOut);
            filePutString ("CL1_Restwaerme;1551\n", 20, fhdlOut);
            filePutString ("CL1_Restwaerme/Clima_1;1551\n", 28, fhdlOut);
            filePutString ("CL1_Restwaerme/Klima_1;1551\n", 28, fhdlOut);
            filePutString ("CL1_Sta_Druck;1552\n", 19, fhdlOut);
            filePutString ("CL1_Sta_Druck/Clima_1;1552\n", 27, fhdlOut);
            filePutString ("CL1_Sta_Druck/Klima_1;1552\n", 27, fhdlOut);
            filePutString ("CL1_Sta_Moment;1553\n", 20, fhdlOut);
            filePutString ("CL1_Sta_Moment/Clima_1;1553\n", 28, fhdlOut);
            filePutString ("CL1_Sta_Moment/Klima_1;1553\n", 28, fhdlOut);
            filePutString ("CL1_WAPU_Zuschaltung;1554\n", 26, fhdlOut);
            filePutString ("CL1_WAPU_Zuschaltung/Clima_1;1554\n", 34, fhdlOut);
            filePutString ("CL1_WAPU_Zuschaltung/Klima_1;1554\n", 34, fhdlOut);
            filePutString ("KL_Thermomanagement;1555\n", 25, fhdlOut);
            filePutString ("KL_Thermomanagement/Clima_1;1555\n", 33, fhdlOut);
            filePutString ("KL_Thermomanagement/Klima_1;1555\n", 33, fhdlOut);
            filePutString ("DI1_Jahr;1792\n", 14, fhdlOut);
            filePutString ("DI1_Jahr/Diagnose_1;1792\n", 25, fhdlOut);
            filePutString ("DI1_Jahr/DIA1;1792\n", 19, fhdlOut);
            filePutString ("DI1_KM_Stand_alt;1793\n", 22, fhdlOut);
            filePutString ("DI1_KM_Stand_alt/Diagnose_1;1793\n", 33, fhdlOut);
            filePutString ("DI1_KM_Stand_alt/DIA1;1793\n", 27, fhdlOut);
            filePutString ("DI1_Minute;1794\n", 16, fhdlOut);
            filePutString ("DI1_Minute/Diagnose_1;1794\n", 27, fhdlOut);
            filePutString ("DI1_Minute/DIA1;1794\n", 21, fhdlOut);
            filePutString ("DI1_Monat;1795\n", 15, fhdlOut);
            filePutString ("DI1_Monat/Diagnose_1;1795\n", 26, fhdlOut);
            filePutString ("DI1_Monat/DIA1;1795\n", 20, fhdlOut);
            filePutString ("DI1_Sekunde;1796\n", 17, fhdlOut);
            filePutString ("DI1_Sekunde/Diagnose_1;1796\n", 28, fhdlOut);
            filePutString ("DI1_Sekunde/DIA1;1796\n", 22, fhdlOut);
            filePutString ("DI1_Stunde;1797\n", 16, fhdlOut);
            filePutString ("DI1_Stunde/Diagnose_1;1797\n", 27, fhdlOut);
            filePutString ("DI1_Stunde/DIA1;1797\n", 21, fhdlOut);
            filePutString ("DI1_Tag;1798\n", 13, fhdlOut);
            filePutString ("DI1_Tag/Diagnose_1;1798\n", 24, fhdlOut);
            filePutString ("DI1_Tag/DIA1;1798\n", 18, fhdlOut);
            filePutString ("DI1_VerlernZaehl;1799\n", 22, fhdlOut);
            filePutString ("DI1_VerlernZaehl/Diagnose_1;1799\n", 33, fhdlOut);
            filePutString ("DI1_VerlernZaehl/DIA1;1799\n", 27, fhdlOut);
            filePutString ("DI1_Zeit_alt;1800\n", 18, fhdlOut);
            filePutString ("DI1_Zeit_alt/Diagnose_1;1800\n", 29, fhdlOut);
            filePutString ("DI1_Zeit_alt/DIA1;1800\n", 23, fhdlOut);
            filePutString ("DI1_km_Stand;1801\n", 18, fhdlOut);
            filePutString ("DI1_km_Stand/Diagnose_1;1801\n", 29, fhdlOut);
            filePutString ("DI1_km_Stand/DIA1;1801\n", 23, fhdlOut);
            filePutString ("EK1_Comp_Inv_stat;2048\n", 23, fhdlOut);
            filePutString ("EK1_Comp_Inv_stat/EKompKlima_1;2048\n", 36, fhdlOut);
            filePutString ("EK1_Comp_Inv_stat/EAC1;2048\n", 28, fhdlOut);
            filePutString ("EK1_Comp_SCI_com_stat;2049\n", 27, fhdlOut);
            filePutString ("EK1_Comp_SCI_com_stat/EKompKlima_1;2049\n", 40, fhdlOut);
            filePutString ("EK1_Comp_SCI_com_stat/EAC1;2049\n", 32, fhdlOut);
            filePutString ("EK1_Comp_current;2050\n", 22, fhdlOut);
            filePutString ("EK1_Comp_current/EKompKlima_1;2050\n", 35, fhdlOut);
            filePutString ("EK1_Comp_current/EAC1;2050\n", 27, fhdlOut);
            filePutString ("EK1_Comp_main_stat;2051\n", 24, fhdlOut);
            filePutString ("EK1_Comp_main_stat/EKompKlima_1;2051\n", 37, fhdlOut);
            filePutString ("EK1_Comp_main_stat/EAC1;2051\n", 29, fhdlOut);
            filePutString ("EK1_Comp_output_stat;2052\n", 26, fhdlOut);
            filePutString ("EK1_Comp_output_stat/EKompKlima_1;2052\n", 39, fhdlOut);
            filePutString ("EK1_Comp_output_stat/EAC1;2052\n", 31, fhdlOut);
            filePutString ("EK1_Comp_ovld_stat;2053\n", 24, fhdlOut);
            filePutString ("EK1_Comp_ovld_stat/EKompKlima_1;2053\n", 37, fhdlOut);
            filePutString ("EK1_Comp_ovld_stat/EAC1;2053\n", 29, fhdlOut);
            filePutString ("EK1_Comp_photo_temp;2054\n", 25, fhdlOut);
            filePutString ("EK1_Comp_photo_temp/EKompKlima_1;2054\n", 38, fhdlOut);
            filePutString ("EK1_Comp_photo_temp/EAC1;2054\n", 30, fhdlOut);
            filePutString ("EK1_Comp_photo_temp_stat;2055\n", 30, fhdlOut);
            filePutString ("EK1_Comp_photo_temp_stat/EKompKlima_1;2055\n", 43, fhdlOut);
            filePutString ("EK1_Comp_photo_temp_stat/EAC1;2055\n", 35, fhdlOut);
            filePutString ("EK1_Comp_rev_stat;2056\n", 23, fhdlOut);
            filePutString ("EK1_Comp_rev_stat/EKompKlima_1;2056\n", 36, fhdlOut);
            filePutString ("EK1_Comp_rev_stat/EAC1;2056\n", 28, fhdlOut);
            filePutString ("EK1_KD_Fehler;2057\n", 19, fhdlOut);
            filePutString ("EK1_KD_Fehler/EKompKlima_1;2057\n", 32, fhdlOut);
            filePutString ("EK1_KD_Fehler/EAC1;2057\n", 24, fhdlOut);
            filePutString ("GRA_Abbrechen;2304\n", 19, fhdlOut);
            filePutString ("GRA_Abbrechen/GRA_Neu;2304\n", 27, fhdlOut);
            filePutString ("GRA_Abbrechen/GRA_neu;2304\n", 27, fhdlOut);
            filePutString ("GRA_Checksum;2305\n", 18, fhdlOut);
            filePutString ("GRA_Checksum/GRA_Neu;2305\n", 26, fhdlOut);
            filePutString ("GRA_Checksum/GRA_neu;2305\n", 26, fhdlOut);
            filePutString ("GRA_Down_kurz;2306\n", 19, fhdlOut);
            filePutString ("GRA_Down_kurz/GRA_Neu;2306\n", 27, fhdlOut);
            filePutString ("GRA_Down_kurz/GRA_neu;2306\n", 27, fhdlOut);
            filePutString ("GRA_Down_lang;2307\n", 19, fhdlOut);
            filePutString ("GRA_Down_lang/GRA_Neu;2307\n", 27, fhdlOut);
            filePutString ("GRA_Down_lang/GRA_neu;2307\n", 27, fhdlOut);
            filePutString ("GRA_Fehler_Bed;2308\n", 20, fhdlOut);
            filePutString ("GRA_Fehler_Bed/GRA_Neu;2308\n", 28, fhdlOut);
            filePutString ("GRA_Fehler_Bed/GRA_neu;2308\n", 28, fhdlOut);
            filePutString ("GRA_Fehler_Tip;2309\n", 20, fhdlOut);
            filePutString ("GRA_Fehler_Tip/GRA_Neu;2309\n", 28, fhdlOut);
            filePutString ("GRA_Fehler_Tip/GRA_neu;2309\n", 28, fhdlOut);
            filePutString ("GRA_Hauptschalt;2310\n", 21, fhdlOut);
            filePutString ("GRA_Hauptschalt/GRA_Neu;2310\n", 29, fhdlOut);
            filePutString ("GRA_Hauptschalt/GRA_neu;2310\n", 29, fhdlOut);
            filePutString ("GRA_Kodierinfo;2311\n", 20, fhdlOut);
            filePutString ("GRA_Kodierinfo/GRA_Neu;2311\n", 28, fhdlOut);
            filePutString ("GRA_Kodierinfo/GRA_neu;2311\n", 28, fhdlOut);
            filePutString ("GRA_Neu_Setzen;2312\n", 20, fhdlOut);
            filePutString ("GRA_Neu_Setzen/GRA_Neu;2312\n", 28, fhdlOut);
            filePutString ("GRA_Neu_Setzen/GRA_neu;2312\n", 28, fhdlOut);
            filePutString ("GRA_Neu_Zaehler;2313\n", 21, fhdlOut);
            filePutString ("GRA_Neu_Zaehler/GRA_Neu;2313\n", 29, fhdlOut);
            filePutString ("GRA_Neu_Zaehler/GRA_neu;2313\n", 29, fhdlOut);
            filePutString ("GRA_Recall;2314\n", 16, fhdlOut);
            filePutString ("GRA_Recall/GRA_Neu;2314\n", 24, fhdlOut);
            filePutString ("GRA_Recall/GRA_neu;2314\n", 24, fhdlOut);
            filePutString ("GRA_Sender;2315\n", 16, fhdlOut);
            filePutString ("GRA_Sender/GRA_Neu;2315\n", 24, fhdlOut);
            filePutString ("GRA_Sender/GRA_neu;2315\n", 24, fhdlOut);
            filePutString ("GRA_Sportschalter;2316\n", 23, fhdlOut);
            filePutString ("GRA_Sportschalter/GRA_Neu;2316\n", 31, fhdlOut);
            filePutString ("GRA_Sportschalter/GRA_neu;2316\n", 31, fhdlOut);
            filePutString ("GRA_Sta_Limiter;2317\n", 21, fhdlOut);
            filePutString ("GRA_Sta_Limiter/GRA_Neu;2317\n", 29, fhdlOut);
            filePutString ("GRA_Sta_Limiter/GRA_neu;2317\n", 29, fhdlOut);
            filePutString ("GRA_Tip_Down;2318\n", 18, fhdlOut);
            filePutString ("GRA_Tip_Down/GRA_Neu;2318\n", 26, fhdlOut);
            filePutString ("GRA_Tip_Down/GRA_neu;2318\n", 26, fhdlOut);
            filePutString ("GRA_Tip_Up;2319\n", 16, fhdlOut);
            filePutString ("GRA_Tip_Up/GRA_Neu;2319\n", 24, fhdlOut);
            filePutString ("GRA_Tip_Up/GRA_neu;2319\n", 24, fhdlOut);
            filePutString ("GRA_Typ_Hauptschalt;2320\n", 25, fhdlOut);
            filePutString ("GRA_Typ_Hauptschalt/GRA_Neu;2320\n", 33, fhdlOut);
            filePutString ("GRA_Typ_Hauptschalt/GRA_neu;2320\n", 33, fhdlOut);
            filePutString ("GRA_Up_kurz;2321\n", 17, fhdlOut);
            filePutString ("GRA_Up_kurz/GRA_Neu;2321\n", 25, fhdlOut);
            filePutString ("GRA_Up_kurz/GRA_neu;2321\n", 25, fhdlOut);
            filePutString ("GRA_Up_lang;2322\n", 17, fhdlOut);
            filePutString ("GRA_Up_lang/GRA_Neu;2322\n", 25, fhdlOut);
            filePutString ("GRA_Up_lang/GRA_neu;2322\n", 25, fhdlOut);
            filePutString ("GRA_Zeitluecke;2323\n", 20, fhdlOut);
            filePutString ("GRA_Zeitluecke/GRA_Neu;2323\n", 28, fhdlOut);
            filePutString ("GRA_Zeitluecke/GRA_neu;2323\n", 28, fhdlOut);
            filePutString ("BCM_CV_Taster;2560\n", 19, fhdlOut);
            filePutString ("BCM_CV_Taster/Gate_Komf_1;2560\n", 31, fhdlOut);
            filePutString ("BCM_CV_Taster/Gateway_Komfort_1;2560\n", 37, fhdlOut);
            filePutString ("BCM_Offroad_Taster;2561\n", 24, fhdlOut);
            filePutString ("BCM_Offroad_Taster/Gate_Komf_1;2561\n", 36, fhdlOut);
            filePutString ("BCM_Offroad_Taster/Gateway_Komfort_1;2561\n", 42, fhdlOut);
            filePutString ("BCM_Remotestart_Betrieb;2562\n", 29, fhdlOut);
            filePutString ("BCM_Remotestart_Betrieb/Gate_Komf_1;2562\n", 41, fhdlOut);
            filePutString ("BCM_Remotestart_Betrieb/Gateway_Komfort_1;2562\n", 47, fhdlOut);
            filePutString ("BSK_BT_geoeffnet;2563\n", 22, fhdlOut);
            filePutString ("BSK_BT_geoeffnet/Gate_Komf_1;2563\n", 34, fhdlOut);
            filePutString ("BSK_BT_geoeffnet/Gateway_Komfort_1;2563\n", 40, fhdlOut);
            filePutString ("BSK_HD_Hauptraste;2564\n", 23, fhdlOut);
            filePutString ("BSK_HD_Hauptraste/Gate_Komf_1;2564\n", 35, fhdlOut);
            filePutString ("BSK_HD_Hauptraste/Gateway_Komfort_1;2564\n", 41, fhdlOut);
            filePutString ("BSK_HL_geoeffnet;2565\n", 22, fhdlOut);
            filePutString ("BSK_HL_geoeffnet/Gate_Komf_1;2565\n", 34, fhdlOut);
            filePutString ("BSK_HL_geoeffnet/Gateway_Komfort_1;2565\n", 40, fhdlOut);
            filePutString ("BSK_HR_geoeffnet;2566\n", 22, fhdlOut);
            filePutString ("BSK_HR_geoeffnet/Gate_Komf_1;2566\n", 34, fhdlOut);
            filePutString ("BSK_HR_geoeffnet/Gateway_Komfort_1;2566\n", 40, fhdlOut);
            filePutString ("GK1_Abbl_VL_def;2567\n", 21, fhdlOut);
            filePutString ("GK1_Abbl_VL_def/Gate_Komf_1;2567\n", 33, fhdlOut);
            filePutString ("GK1_Abbl_VL_def/Gateway_Komfort_1;2567\n", 39, fhdlOut);
            filePutString ("GK1_Abbl_VR_def;2568\n", 21, fhdlOut);
            filePutString ("GK1_Abbl_VR_def/Gate_Komf_1;2568\n", 33, fhdlOut);
            filePutString ("GK1_Abbl_VR_def/Gateway_Komfort_1;2568\n", 39, fhdlOut);
            filePutString ("GK1_Abblendlicht;2569\n", 22, fhdlOut);
            filePutString ("GK1_Abblendlicht/Gate_Komf_1;2569\n", 34, fhdlOut);
            filePutString ("GK1_Abblendlicht/Gateway_Komfort_1;2569\n", 40, fhdlOut);
            filePutString ("GK1_AnhKonLamp;2570\n", 20, fhdlOut);
            filePutString ("GK1_AnhKonLamp/Gate_Komf_1;2570\n", 32, fhdlOut);
            filePutString ("GK1_AnhKonLamp/Gateway_Komfort_1;2570\n", 38, fhdlOut);
            filePutString ("GK1_Anh_abgesteckt;2571\n", 24, fhdlOut);
            filePutString ("GK1_Anh_abgesteckt/Gate_Komf_1;2571\n", 36, fhdlOut);
            filePutString ("GK1_Anh_abgesteckt/Gateway_Komfort_1;2571\n", 42, fhdlOut);
            filePutString ("GK1_Anhaenger;2572\n", 19, fhdlOut);
            filePutString ("GK1_Anhaenger/Gate_Komf_1;2572\n", 31, fhdlOut);
            filePutString ("GK1_Anhaenger/Gateway_Komfort_1;2572\n", 37, fhdlOut);
            filePutString ("GK1_BLS_ILM;2573\n", 17, fhdlOut);
            filePutString ("GK1_BLS_ILM/Gate_Komf_1;2573\n", 29, fhdlOut);
            filePutString ("GK1_BLS_ILM/Gateway_Komfort_1;2573\n", 35, fhdlOut);
            filePutString ("GK1_Blink_Autob;2574\n", 21, fhdlOut);
            filePutString ("GK1_Blink_Autob/Gate_Komf_1;2574\n", 33, fhdlOut);
            filePutString ("GK1_Blink_Autob/Gateway_Komfort_1;2574\n", 39, fhdlOut);
            filePutString ("GK1_Blinker_li;2575\n", 20, fhdlOut);
            filePutString ("GK1_Blinker_li/Gate_Komf_1;2575\n", 32, fhdlOut);
            filePutString ("GK1_Blinker_li/Gateway_Komfort_1;2575\n", 38, fhdlOut);
            filePutString ("GK1_Blinker_re;2576\n", 20, fhdlOut);
            filePutString ("GK1_Blinker_re/Gate_Komf_1;2576\n", 32, fhdlOut);
            filePutString ("GK1_Blinker_re/Gateway_Komfort_1;2576\n", 38, fhdlOut);
            filePutString ("GK1_BrLi_Anhaen;2577\n", 21, fhdlOut);
            filePutString ("GK1_BrLi_Anhaen/Gate_Komf_1;2577\n", 33, fhdlOut);
            filePutString ("GK1_BrLi_Anhaen/Gateway_Komfort_1;2577\n", 39, fhdlOut);
            filePutString ("GK1_BrLi_links;2578\n", 20, fhdlOut);
            filePutString ("GK1_BrLi_links/Gate_Komf_1;2578\n", 32, fhdlOut);
            filePutString ("GK1_BrLi_links/Gateway_Komfort_1;2578\n", 38, fhdlOut);
            filePutString ("GK1_BrLi_mitte;2579\n", 20, fhdlOut);
            filePutString ("GK1_BrLi_mitte/Gate_Komf_1;2579\n", 32, fhdlOut);
            filePutString ("GK1_BrLi_mitte/Gateway_Komfort_1;2579\n", 38, fhdlOut);
            filePutString ("GK1_BrLi_rechts;2580\n", 21, fhdlOut);
            filePutString ("GK1_BrLi_rechts/Gate_Komf_1;2580\n", 33, fhdlOut);
            filePutString ("GK1_BrLi_rechts/Gateway_Komfort_1;2580\n", 39, fhdlOut);
            filePutString ("GK1_Bremslicht;2581\n", 20, fhdlOut);
            filePutString ("GK1_Bremslicht/Gate_Komf_1;2581\n", 32, fhdlOut);
            filePutString ("GK1_Bremslicht/Gateway_Komfort_1;2581\n", 38, fhdlOut);
            filePutString ("GK1_CharismaModus;2582\n", 23, fhdlOut);
            filePutString ("GK1_CharismaModus/Gate_Komf_1;2582\n", 35, fhdlOut);
            filePutString ("GK1_CharismaModus/Gateway_Komfort_1;2582\n", 41, fhdlOut);
            filePutString ("GK1_DriveSelectModus_1;2583\n", 28, fhdlOut);
            filePutString ("GK1_DriveSelectModus_1/Gate_Komf_1;2583\n", 40, fhdlOut);
            filePutString ("GK1_DriveSelectModus_1/Gateway_Komfort_1;2583\n", 46, fhdlOut);
            filePutString ("GK1_DriveSelectModus_2;2584\n", 28, fhdlOut);
            filePutString ("GK1_DriveSelectModus_2/Gate_Komf_1;2584\n", 40, fhdlOut);
            filePutString ("GK1_DriveSelectModus_2/Gateway_Komfort_1;2584\n", 46, fhdlOut);
            filePutString ("GK1_EDC_ILM;2585\n", 17, fhdlOut);
            filePutString ("GK1_EDC_ILM/Gate_Komf_1;2585\n", 29, fhdlOut);
            filePutString ("GK1_EDC_ILM/Gateway_Komfort_1;2585\n", 35, fhdlOut);
            filePutString ("GK1_ELV_verrieg;2586\n", 21, fhdlOut);
            filePutString ("GK1_ELV_verrieg/Gate_Komf_1;2586\n", 33, fhdlOut);
            filePutString ("GK1_ELV_verrieg/Gateway_Komfort_1;2586\n", 39, fhdlOut);
            filePutString ("GK1_EfficiencyModus;2587\n", 25, fhdlOut);
            filePutString ("GK1_EfficiencyModus/Gate_Komf_1;2587\n", 37, fhdlOut);
            filePutString ("GK1_EfficiencyModus/Gateway_Komfort_1;2587\n", 43, fhdlOut);
            filePutString ("GK1_Fa_Tuerkont;2588\n", 21, fhdlOut);
            filePutString ("GK1_Fa_Tuerkont/Gate_Komf_1;2588\n", 33, fhdlOut);
            filePutString ("GK1_Fa_Tuerkont/Gateway_Komfort_1;2588\n", 39, fhdlOut);
            filePutString ("GK1_Fernlicht;2589\n", 19, fhdlOut);
            filePutString ("GK1_Fernlicht/Gate_Komf_1;2589\n", 31, fhdlOut);
            filePutString ("GK1_Fernlicht/Gateway_Komfort_1;2589\n", 37, fhdlOut);
            filePutString ("GK1_KW_Warm;2590\n", 17, fhdlOut);
            filePutString ("GK1_KW_Warm/Gate_Komf_1;2590\n", 29, fhdlOut);
            filePutString ("GK1_KW_Warm/Gateway_Komfort_1;2590\n", 35, fhdlOut);
            filePutString ("GK1_LS1_Fernlicht;2591\n", 23, fhdlOut);
            filePutString ("GK1_LS1_Fernlicht/Gate_Komf_1;2591\n", 35, fhdlOut);
            filePutString ("GK1_LS1_Fernlicht/Gateway_Komfort_1;2591\n", 41, fhdlOut);
            filePutString ("GK1_Nebel_ein;2592\n", 19, fhdlOut);
            filePutString ("GK1_Nebel_ein/Gate_Komf_1;2592\n", 31, fhdlOut);
            filePutString ("GK1_Nebel_ein/Gateway_Komfort_1;2592\n", 37, fhdlOut);
            filePutString ("GK1_ParkFrontWi;2593\n", 21, fhdlOut);
            filePutString ("GK1_ParkFrontWi/Gate_Komf_1;2593\n", 33, fhdlOut);
            filePutString ("GK1_ParkFrontWi/Gateway_Komfort_1;2593\n", 39, fhdlOut);
            filePutString ("GK1_Rueckfahr;2594\n", 19, fhdlOut);
            filePutString ("GK1_Rueckfahr/Gate_Komf_1;2594\n", 31, fhdlOut);
            filePutString ("GK1_Rueckfahr/Gateway_Komfort_1;2594\n", 37, fhdlOut);
            filePutString ("GK1_RueckfahrSch;2595\n", 22, fhdlOut);
            filePutString ("GK1_RueckfahrSch/Gate_Komf_1;2595\n", 34, fhdlOut);
            filePutString ("GK1_RueckfahrSch/Gateway_Komfort_1;2595\n", 40, fhdlOut);
            filePutString ("GK1_SH_Verbau;2596\n", 19, fhdlOut);
            filePutString ("GK1_SH_Verbau/Gate_Komf_1;2596\n", 31, fhdlOut);
            filePutString ("GK1_SH_Verbau/Gateway_Komfort_1;2596\n", 37, fhdlOut);
            filePutString ("GK1_SH_Zusatzfkt;2597\n", 22, fhdlOut);
            filePutString ("GK1_SH_Zusatzfkt/Gate_Komf_1;2597\n", 34, fhdlOut);
            filePutString ("GK1_SH_Zusatzfkt/Gateway_Komfort_1;2597\n", 40, fhdlOut);
            filePutString ("GK1_SH_laeuft;2598\n", 19, fhdlOut);
            filePutString ("GK1_SH_laeuft/Gate_Komf_1;2598\n", 31, fhdlOut);
            filePutString ("GK1_SH_laeuft/Gateway_Komfort_1;2598\n", 37, fhdlOut);
            filePutString ("GK1_SamFktNr;2599\n", 18, fhdlOut);
            filePutString ("GK1_SamFktNr/Gate_Komf_1;2599\n", 30, fhdlOut);
            filePutString ("GK1_SamFktNr/Gateway_Komfort_1;2599\n", 36, fhdlOut);
            filePutString ("GK1_SleepAckn;2600\n", 19, fhdlOut);
            filePutString ("GK1_SleepAckn/Gate_Komf_1;2600\n", 31, fhdlOut);
            filePutString ("GK1_SleepAckn/Gateway_Komfort_1;2600\n", 37, fhdlOut);
            filePutString ("GK1_SportModus;2601\n", 20, fhdlOut);
            filePutString ("GK1_SportModus/Gate_Komf_1;2601\n", 32, fhdlOut);
            filePutString ("GK1_SportModus/Gateway_Komfort_1;2601\n", 38, fhdlOut);
            filePutString ("GK1_Sta_Anhaen;2602\n", 20, fhdlOut);
            filePutString ("GK1_Sta_Anhaen/Gate_Komf_1;2602\n", 32, fhdlOut);
            filePutString ("GK1_Sta_Anhaen/Gateway_Komfort_1;2602\n", 38, fhdlOut);
            filePutString ("GK1_Sta_ILM_F_1;2603\n", 21, fhdlOut);
            filePutString ("GK1_Sta_ILM_F_1/Gate_Komf_1;2603\n", 33, fhdlOut);
            filePutString ("GK1_Sta_ILM_F_1/Gateway_Komfort_1;2603\n", 39, fhdlOut);
            filePutString ("GK1_Sta_Kessy_2;2604\n", 21, fhdlOut);
            filePutString ("GK1_Sta_Kessy_2/Gate_Komf_1;2604\n", 33, fhdlOut);
            filePutString ("GK1_Sta_Kessy_2/Gateway_Komfort_1;2604\n", 39, fhdlOut);
            filePutString ("GK1_Sta_LSM;2605\n", 17, fhdlOut);
            filePutString ("GK1_Sta_LSM/Gate_Komf_1;2605\n", 29, fhdlOut);
            filePutString ("GK1_Sta_LSM/Gateway_Komfort_1;2605\n", 35, fhdlOut);
            filePutString ("GK1_Sta_Li_vorn;2606\n", 21, fhdlOut);
            filePutString ("GK1_Sta_Li_vorn/Gate_Komf_1;2606\n", 33, fhdlOut);
            filePutString ("GK1_Sta_Li_vorn/Gateway_Komfort_1;2606\n", 39, fhdlOut);
            filePutString ("GK1_Sta_Licht1;2607\n", 20, fhdlOut);
            filePutString ("GK1_Sta_Licht1/Gate_Komf_1;2607\n", 32, fhdlOut);
            filePutString ("GK1_Sta_Licht1/Gateway_Komfort_1;2607\n", 38, fhdlOut);
            filePutString ("GK1_Sta_Licht2;2608\n", 20, fhdlOut);
            filePutString ("GK1_Sta_Licht2/Gate_Komf_1;2608\n", 32, fhdlOut);
            filePutString ("GK1_Sta_Licht2/Gateway_Komfort_1;2608\n", 38, fhdlOut);
            filePutString ("GK1_Sta_Licht3;2609\n", 20, fhdlOut);
            filePutString ("GK1_Sta_Licht3/Gate_Komf_1;2609\n", 32, fhdlOut);
            filePutString ("GK1_Sta_Licht3/Gateway_Komfort_1;2609\n", 38, fhdlOut);
            filePutString ("GK1_Sta_RDK_Warn;2610\n", 22, fhdlOut);
            filePutString ("GK1_Sta_RDK_Warn/Gate_Komf_1;2610\n", 34, fhdlOut);
            filePutString ("GK1_Sta_RDK_Warn/Gateway_Komfort_1;2610\n", 40, fhdlOut);
            filePutString ("GK1_Sta_Stdhzg;2611\n", 20, fhdlOut);
            filePutString ("GK1_Sta_Stdhzg/Gate_Komf_1;2611\n", 32, fhdlOut);
            filePutString ("GK1_Sta_Stdhzg/Gateway_Komfort_1;2611\n", 38, fhdlOut);
            filePutString ("GK1_Sta_Tuerkont;2612\n", 22, fhdlOut);
            filePutString ("GK1_Sta_Tuerkont/Gate_Komf_1;2612\n", 34, fhdlOut);
            filePutString ("GK1_Sta_Tuerkont/Gateway_Komfort_1;2612\n", 40, fhdlOut);
            filePutString ("GK1_Warnblk_Status;2613\n", 24, fhdlOut);
            filePutString ("GK1_Warnblk_Status/Gate_Komf_1;2613\n", 36, fhdlOut);
            filePutString ("GK1_Warnblk_Status/Gateway_Komfort_1;2613\n", 42, fhdlOut);
            filePutString ("GK1_Wischer_vorn;2614\n", 22, fhdlOut);
            filePutString ("GK1_Wischer_vorn/Gate_Komf_1;2614\n", 34, fhdlOut);
            filePutString ("GK1_Wischer_vorn/Gateway_Komfort_1;2614\n", 40, fhdlOut);
            filePutString ("GK1_def_P_verr;2615\n", 20, fhdlOut);
            filePutString ("GK1_def_P_verr/Gate_Komf_1;2615\n", 32, fhdlOut);
            filePutString ("GK1_def_P_verr/Gateway_Komfort_1;2615\n", 38, fhdlOut);
            filePutString ("LDS_Stellung_AFL;2616\n", 22, fhdlOut);
            filePutString ("LDS_Stellung_AFL/Gate_Komf_1;2616\n", 34, fhdlOut);
            filePutString ("LDS_Stellung_AFL/Gateway_Komfort_1;2616\n", 40, fhdlOut);
            filePutString ("SH1_ein_Wasserpumpe;2617\n", 25, fhdlOut);
            filePutString ("SH1_ein_Wasserpumpe/Gate_Komf_1;2617\n", 37, fhdlOut);
            filePutString ("SH1_ein_Wasserpumpe/Gateway_Komfort_1;2617\n", 43, fhdlOut);
            filePutString ("WI1_Front_Wasch;2618\n", 21, fhdlOut);
            filePutString ("WI1_Front_Wasch/Gate_Komf_1;2618\n", 33, fhdlOut);
            filePutString ("WI1_Front_Wasch/Gateway_Komfort_1;2618\n", 39, fhdlOut);
            filePutString ("GK1_Sta_LSM;2816\n", 17, fhdlOut);
            filePutString ("GK1_Sta_LSM/Gate_Komf_4;2816\n", 29, fhdlOut);
            filePutString ("GK1_Sta_LSM/Gateway_Komfort_4;2816\n", 35, fhdlOut);
            filePutString ("GK4_Ladesteckerentr_Anf;2817\n", 29, fhdlOut);
            filePutString ("GK4_Ladesteckerentr_Anf/Gate_Komf_4;2817\n", 41, fhdlOut);
            filePutString ("GK4_Ladesteckerentr_Anf/Gateway_Komfort_4;2817\n", 47, fhdlOut);
            filePutString ("GK4_Sta_MFA_6;2818\n", 19, fhdlOut);
            filePutString ("GK4_Sta_MFA_6/Gate_Komf_4;2818\n", 31, fhdlOut);
            filePutString ("GK4_Sta_MFA_6/Gateway_Komfort_4;2818\n", 37, fhdlOut);
            filePutString ("LS1_P_verriegelt;2819\n", 22, fhdlOut);
            filePutString ("LS1_P_verriegelt/Gate_Komf_4;2819\n", 34, fhdlOut);
            filePutString ("LS1_P_verriegelt/Gateway_Komfort_4;2819\n", 40, fhdlOut);
            filePutString ("MA6_Reichweite;2820\n", 20, fhdlOut);
            filePutString ("MA6_Reichweite/Gate_Komf_4;2820\n", 32, fhdlOut);
            filePutString ("MA6_Reichweite/Gateway_Komfort_4;2820\n", 38, fhdlOut);
            filePutString ("MA6_km_Reichweite;2821\n", 23, fhdlOut);
            filePutString ("MA6_km_Reichweite/Gate_Komf_4;2821\n", 35, fhdlOut);
            filePutString ("MA6_km_Reichweite/Gateway_Komfort_4;2821\n", 41, fhdlOut);
            filePutString ("MA6_mls_Reichweite;2822\n", 24, fhdlOut);
            filePutString ("MA6_mls_Reichweite/Gate_Komf_4;2822\n", 36, fhdlOut);
            filePutString ("MA6_mls_Reichweite/Gateway_Komfort_4;2822\n", 42, fhdlOut);
            filePutString ("EKK_Status;3072\n", 16, fhdlOut);
            filePutString ("EKK_Status/Klima_EV_1;3072\n", 27, fhdlOut);
            filePutString ("EKK_Status/ACEV1;3072\n", 22, fhdlOut);
            filePutString ("EKK_Status_Vorstrg;3073\n", 24, fhdlOut);
            filePutString ("EKK_Status_Vorstrg/Klima_EV_1;3073\n", 35, fhdlOut);
            filePutString ("EKK_Status_Vorstrg/ACEV1;3073\n", 30, fhdlOut);
            filePutString ("EKK_Strom;3074\n", 15, fhdlOut);
            filePutString ("EKK_Strom/Klima_EV_1;3074\n", 26, fhdlOut);
            filePutString ("EKK_Strom/ACEV1;3074\n", 21, fhdlOut);
            filePutString ("KL_Charisma_FahrPr;3075\n", 24, fhdlOut);
            filePutString ("KL_Charisma_FahrPr/Klima_EV_1;3075\n", 35, fhdlOut);
            filePutString ("KL_Charisma_FahrPr/ACEV1;3075\n", 30, fhdlOut);
            filePutString ("KL_Charisma_Status;3076\n", 24, fhdlOut);
            filePutString ("KL_Charisma_Status/Klima_EV_1;3076\n", 35, fhdlOut);
            filePutString ("KL_Charisma_Status/ACEV1;3076\n", 30, fhdlOut);
            filePutString ("KL_HV_Anf;3077\n", 15, fhdlOut);
            filePutString ("KL_HV_Anf/Klima_EV_1;3077\n", 26, fhdlOut);
            filePutString ("KL_HV_Anf/ACEV1;3077\n", 21, fhdlOut);
            filePutString ("KL_HV_ein;3078\n", 15, fhdlOut);
            filePutString ("KL_HV_ein/Klima_EV_1;3078\n", 26, fhdlOut);
            filePutString ("KL_HV_ein/ACEV1;3078\n", 21, fhdlOut);
            filePutString ("KL_Innengeblaese;3079\n", 22, fhdlOut);
            filePutString ("KL_Innengeblaese/Klima_EV_1;3079\n", 33, fhdlOut);
            filePutString ("KL_Innengeblaese/ACEV1;3079\n", 28, fhdlOut);
            filePutString ("KL_Kompr_Drehzahl_Soll;3080\n", 28, fhdlOut);
            filePutString ("KL_Kompr_Drehzahl_Soll/Klima_EV_1;3080\n", 39, fhdlOut);
            filePutString ("KL_Kompr_Drehzahl_Soll/ACEV1;3080\n", 34, fhdlOut);
            filePutString ("KL_PTC_Soll;3081\n", 17, fhdlOut);
            filePutString ("KL_PTC_Soll/Klima_EV_1;3081\n", 28, fhdlOut);
            filePutString ("KL_PTC_Soll/ACEV1;3081\n", 23, fhdlOut);
            filePutString ("KL_Standklima_Status;3082\n", 26, fhdlOut);
            filePutString ("KL_Standklima_Status/Klima_EV_1;3082\n", 37, fhdlOut);
            filePutString ("KL_Standklima_Status/ACEV1;3082\n", 32, fhdlOut);
            filePutString ("KL_Standklima_Strg_Kluefter;3083\n", 33, fhdlOut);
            filePutString ("KL_Standklima_Strg_Kluefter/Klima_EV_1;3083\n", 44, fhdlOut);
            filePutString ("KL_Standklima_Strg_Kluefter/ACEV1;3083\n", 39, fhdlOut);
            filePutString ("KL_Ventil_Batterie_Anf;3084\n", 28, fhdlOut);
            filePutString ("KL_Ventil_Batterie_Anf/Klima_EV_1;3084\n", 39, fhdlOut);
            filePutString ("KL_Ventil_Batterie_Anf/ACEV1;3084\n", 34, fhdlOut);
            filePutString ("KL_Ventil_vor_Motor_Anf;3085\n", 29, fhdlOut);
            filePutString ("KL_Ventil_vor_Motor_Anf/Klima_EV_1;3085\n", 40, fhdlOut);
            filePutString ("KL_Ventil_vor_Motor_Anf/ACEV1;3085\n", 35, fhdlOut);
            filePutString ("KL_Wake_Up_ACAN;3086\n", 21, fhdlOut);
            filePutString ("KL_Wake_Up_ACAN/Klima_EV_1;3086\n", 32, fhdlOut);
            filePutString ("KL_Wake_Up_ACAN/ACEV1;3086\n", 27, fhdlOut);
            filePutString ("PTC_Pumpe_Ist;3087\n", 19, fhdlOut);
            filePutString ("PTC_Pumpe_Ist/Klima_EV_1;3087\n", 30, fhdlOut);
            filePutString ("PTC_Pumpe_Ist/ACEV1;3087\n", 25, fhdlOut);
            filePutString ("PTC_Pumpe_Status;3088\n", 22, fhdlOut);
            filePutString ("PTC_Pumpe_Status/Klima_EV_1;3088\n", 33, fhdlOut);
            filePutString ("PTC_Pumpe_Status/ACEV1;3088\n", 28, fhdlOut);
            filePutString ("PTC_Strom;3089\n", 15, fhdlOut);
            filePutString ("PTC_Strom/Klima_EV_1;3089\n", 26, fhdlOut);
            filePutString ("PTC_Strom/ACEV1;3089\n", 21, fhdlOut);
            filePutString ("KO1_ABS_Lampe;3328\n", 19, fhdlOut);
            filePutString ("KO1_ABS_Lampe/Kombi_1;3328\n", 27, fhdlOut);
            filePutString ("KO1_ABS_Lampe/DSP1;3328\n", 24, fhdlOut);
            filePutString ("KO1_ACC_AnzFhl;3329\n", 20, fhdlOut);
            filePutString ("KO1_ACC_AnzFhl/Kombi_1;3329\n", 28, fhdlOut);
            filePutString ("KO1_ACC_AnzFhl/DSP1;3329\n", 25, fhdlOut);
            filePutString ("KO1_ACC_Inkons;3330\n", 20, fhdlOut);
            filePutString ("KO1_ACC_Inkons/Kombi_1;3330\n", 28, fhdlOut);
            filePutString ("KO1_ACC_Inkons/DSP1;3330\n", 25, fhdlOut);
            filePutString ("KO1_ASRESP_Lampe;3331\n", 22, fhdlOut);
            filePutString ("KO1_ASRESP_Lampe/Kombi_1;3331\n", 30, fhdlOut);
            filePutString ("KO1_ASRESP_Lampe/DSP1;3331\n", 27, fhdlOut);
            filePutString ("KO1_Airbag_Lampe;3332\n", 22, fhdlOut);
            filePutString ("KO1_Airbag_Lampe/Kombi_1;3332\n", 30, fhdlOut);
            filePutString ("KO1_Airbag_Lampe/DSP1;3332\n", 27, fhdlOut);
            filePutString ("KO1_Brems_Lampe;3333\n", 21, fhdlOut);
            filePutString ("KO1_Brems_Lampe/Kombi_1;3333\n", 29, fhdlOut);
            filePutString ("KO1_Brems_Lampe/DSP1;3333\n", 26, fhdlOut);
            filePutString ("KO1_Bremsinfo;3334\n", 19, fhdlOut);
            filePutString ("KO1_Bremsinfo/Kombi_1;3334\n", 27, fhdlOut);
            filePutString ("KO1_Bremsinfo/DSP1;3334\n", 24, fhdlOut);
            filePutString ("KO1_Handbremse;3335\n", 20, fhdlOut);
            filePutString ("KO1_Handbremse/Kombi_1;3335\n", 28, fhdlOut);
            filePutString ("KO1_Handbremse/DSP1;3335\n", 25, fhdlOut);
            filePutString ("KO1_Kuehlmittel;3336\n", 21, fhdlOut);
            filePutString ("KO1_Kuehlmittel/Kombi_1;3336\n", 29, fhdlOut);
            filePutString ("KO1_Kuehlmittel/DSP1;3336\n", 26, fhdlOut);
            filePutString ("KO1_LDW_AnzFeh;3337\n", 20, fhdlOut);
            filePutString ("KO1_LDW_AnzFeh/Kombi_1;3337\n", 28, fhdlOut);
            filePutString ("KO1_LDW_AnzFeh/DSP1;3337\n", 25, fhdlOut);
            filePutString ("KO1_La_Ladekon;3338\n", 20, fhdlOut);
            filePutString ("KO1_La_Ladekon/Kombi_1;3338\n", 28, fhdlOut);
            filePutString ("KO1_La_Ladekon/DSP1;3338\n", 25, fhdlOut);
            filePutString ("KO1_Lenkh_Lampe;3339\n", 21, fhdlOut);
            filePutString ("KO1_Lenkh_Lampe/Kombi_1;3339\n", 29, fhdlOut);
            filePutString ("KO1_Lenkh_Lampe/DSP1;3339\n", 26, fhdlOut);
            filePutString ("KO1_OBD_Tank;3340\n", 18, fhdlOut);
            filePutString ("KO1_OBD_Tank/Kombi_1;3340\n", 26, fhdlOut);
            filePutString ("KO1_OBD_Tank/DSP1;3340\n", 23, fhdlOut);
            filePutString ("KO1_Oeldruck;3341\n", 18, fhdlOut);
            filePutString ("KO1_Oeldruck/Kombi_1;3341\n", 26, fhdlOut);
            filePutString ("KO1_Oeldruck/DSP1;3341\n", 23, fhdlOut);
            filePutString ("KO1_Quelle_kmh;3342\n", 20, fhdlOut);
            filePutString ("KO1_Quelle_kmh/Kombi_1;3342\n", 28, fhdlOut);
            filePutString ("KO1_Quelle_kmh/DSP1;3342\n", 25, fhdlOut);
            filePutString ("KO1_SILA_gueltig;3343\n", 22, fhdlOut);
            filePutString ("KO1_SILA_gueltig/Kombi_1;3343\n", 30, fhdlOut);
            filePutString ("KO1_SILA_gueltig/DSP1;3343\n", 27, fhdlOut);
            filePutString ("KO1_SleepInd;3344\n", 18, fhdlOut);
            filePutString ("KO1_SleepInd/Kombi_1;3344\n", 26, fhdlOut);
            filePutString ("KO1_SleepInd/DSP1;3344\n", 23, fhdlOut);
            filePutString ("KO1_Sta_Oeldr;3345\n", 19, fhdlOut);
            filePutString ("KO1_Sta_Oeldr/Kombi_1;3345\n", 27, fhdlOut);
            filePutString ("KO1_Sta_Oeldr/DSP1;3345\n", 24, fhdlOut);
            filePutString ("KO1_Sta_Tank;3346\n", 18, fhdlOut);
            filePutString ("KO1_Sta_Tank/Kombi_1;3346\n", 26, fhdlOut);
            filePutString ("KO1_Sta_Tank/DSP1;3346\n", 23, fhdlOut);
            filePutString ("KO1_Stellglieder;3347\n", 22, fhdlOut);
            filePutString ("KO1_Stellglieder/Kombi_1;3347\n", 30, fhdlOut);
            filePutString ("KO1_Stellglieder/DSP1;3347\n", 27, fhdlOut);
            filePutString ("KO1_Tankinhalt;3348\n", 20, fhdlOut);
            filePutString ("KO1_Tankinhalt/Kombi_1;3348\n", 28, fhdlOut);
            filePutString ("KO1_Tankinhalt/DSP1;3348\n", 25, fhdlOut);
            filePutString ("KO1_Tankstop;3349\n", 18, fhdlOut);
            filePutString ("KO1_Tankstop/Kombi_1;3349\n", 26, fhdlOut);
            filePutString ("KO1_Tankstop/DSP1;3349\n", 23, fhdlOut);
            filePutString ("KO1_Vorgluehen;3350\n", 20, fhdlOut);
            filePutString ("KO1_Vorgluehen/Kombi_1;3350\n", 28, fhdlOut);
            filePutString ("KO1_Vorgluehen/DSP1;3350\n", 25, fhdlOut);
            filePutString ("KO1_Wakeup_Komfort;3351\n", 24, fhdlOut);
            filePutString ("KO1_Wakeup_Komfort/Kombi_1;3351\n", 32, fhdlOut);
            filePutString ("KO1_Wakeup_Komfort/DSP1;3351\n", 29, fhdlOut);
            filePutString ("KO1_Warn_Tank;3352\n", 19, fhdlOut);
            filePutString ("KO1_Warn_Tank/Kombi_1;3352\n", 27, fhdlOut);
            filePutString ("KO1_Warn_Tank/DSP1;3352\n", 24, fhdlOut);
            filePutString ("KO1_Zaehler;3353\n", 17, fhdlOut);
            filePutString ("KO1_Zaehler/Kombi_1;3353\n", 25, fhdlOut);
            filePutString ("KO1_Zaehler/DSP1;3353\n", 22, fhdlOut);
            filePutString ("KO1_Zeitluecke;3354\n", 20, fhdlOut);
            filePutString ("KO1_Zeitluecke/Kombi_1;3354\n", 28, fhdlOut);
            filePutString ("KO1_Zeitluecke/DSP1;3354\n", 25, fhdlOut);
            filePutString ("KO1_angez_kmh;3355\n", 19, fhdlOut);
            filePutString ("KO1_angez_kmh/Kombi_1;3355\n", 27, fhdlOut);
            filePutString ("KO1_angez_kmh/DSP1;3355\n", 24, fhdlOut);
            filePutString ("KO1_kmh;3356\n", 13, fhdlOut);
            filePutString ("KO1_kmh/Kombi_1;3356\n", 21, fhdlOut);
            filePutString ("KO1_kmh/DSP1;3356\n", 18, fhdlOut);
            filePutString ("KO1_kmh_mph;3357\n", 17, fhdlOut);
            filePutString ("KO1_kmh_mph/Kombi_1;3357\n", 25, fhdlOut);
            filePutString ("KO1_kmh_mph/DSP1;3357\n", 22, fhdlOut);
            filePutString ("KB2_Auto_eKiSi;3584\n", 20, fhdlOut);
            filePutString ("KB2_Auto_eKiSi/Kombi_2;3584\n", 28, fhdlOut);
            filePutString ("KB2_Auto_eKiSi/DSP2;3584\n", 25, fhdlOut);
            filePutString ("KB2_EasyEntry;3585\n", 19, fhdlOut);
            filePutString ("KB2_EasyEntry/Kombi_2;3585\n", 27, fhdlOut);
            filePutString ("KB2_EasyEntry/DSP2;3585\n", 24, fhdlOut);
            filePutString ("KB2_MFA_Strecke_Einheit;3586\n", 29, fhdlOut);
            filePutString ("KB2_MFA_Strecke_Einheit/Kombi_2;3586\n", 37, fhdlOut);
            filePutString ("KB2_MFA_Strecke_Einheit/DSP2;3586\n", 34, fhdlOut);
            filePutString ("KB2_Req_IstZu_Solldruecke;3587\n", 31, fhdlOut);
            filePutString ("KB2_Req_IstZu_Solldruecke/Kombi_2;3587\n", 39, fhdlOut);
            filePutString ("KB2_Req_IstZu_Solldruecke/DSP2;3587\n", 36, fhdlOut);
            filePutString ("KBI_rotes_P_verbaut;3588\n", 25, fhdlOut);
            filePutString ("KBI_rotes_P_verbaut/Kombi_2;3588\n", 33, fhdlOut);
            filePutString ("KBI_rotes_P_verbaut/DSP2;3588\n", 30, fhdlOut);
            filePutString ("KO2_Aussen_T;3589\n", 18, fhdlOut);
            filePutString ("KO2_Aussen_T/Kombi_2;3589\n", 26, fhdlOut);
            filePutString ("KO2_Aussen_T/DSP2;3589\n", 23, fhdlOut);
            filePutString ("KO2_Bel_Displ;3590\n", 19, fhdlOut);
            filePutString ("KO2_Bel_Displ/Kombi_2;3590\n", 27, fhdlOut);
            filePutString ("KO2_Bel_Displ/DSP2;3590\n", 24, fhdlOut);
            filePutString ("KO2_Bel_Schalt;3591\n", 20, fhdlOut);
            filePutString ("KO2_Bel_Schalt/Kombi_2;3591\n", 28, fhdlOut);
            filePutString ("KO2_Bel_Schalt/DSP2;3591\n", 25, fhdlOut);
            filePutString ("KO2_Fehlereintr;3592\n", 21, fhdlOut);
            filePutString ("KO2_Fehlereintr/Kombi_2;3592\n", 29, fhdlOut);
            filePutString ("KO2_Fehlereintr/DSP2;3592\n", 26, fhdlOut);
            filePutString ("KO2_GRA_High;3593\n", 18, fhdlOut);
            filePutString ("KO2_GRA_High/Kombi_2;3593\n", 26, fhdlOut);
            filePutString ("KO2_GRA_High/DSP2;3593\n", 23, fhdlOut);
            filePutString ("KO2_MFA_v_Einheit;3594\n", 23, fhdlOut);
            filePutString ("KO2_MFA_v_Einheit/Kombi_2;3594\n", 31, fhdlOut);
            filePutString ("KO2_MFA_v_Einheit/DSP2;3594\n", 28, fhdlOut);
            filePutString ("KO2_OBD_Nib_Temp;3595\n", 22, fhdlOut);
            filePutString ("KO2_OBD_Nib_Temp/Kombi_2;3595\n", 30, fhdlOut);
            filePutString ("KO2_OBD_Nib_Temp/DSP2;3595\n", 27, fhdlOut);
            filePutString ("KO2_Oelwarn;3596\n", 17, fhdlOut);
            filePutString ("KO2_Oelwarn/Kombi_2;3596\n", 25, fhdlOut);
            filePutString ("KO2_Oelwarn/DSP2;3596\n", 22, fhdlOut);
            filePutString ("KO2_PLA_Displaystatus;3597\n", 27, fhdlOut);
            filePutString ("KO2_PLA_Displaystatus/Kombi_2;3597\n", 35, fhdlOut);
            filePutString ("KO2_PLA_Displaystatus/DSP2;3597\n", 32, fhdlOut);
            filePutString ("KO2_Passiv_Autolock;3598\n", 25, fhdlOut);
            filePutString ("KO2_Passiv_Autolock/Kombi_2;3598\n", 33, fhdlOut);
            filePutString ("KO2_Passiv_Autolock/DSP2;3598\n", 30, fhdlOut);
            filePutString ("KO2_Sta_Auss_T;3599\n", 20, fhdlOut);
            filePutString ("KO2_Sta_Auss_T/Kombi_2;3599\n", 28, fhdlOut);
            filePutString ("KO2_Sta_Auss_T/DSP2;3599\n", 25, fhdlOut);
            filePutString ("KO2_Sta_Displ;3600\n", 19, fhdlOut);
            filePutString ("KO2_Sta_Displ/Kombi_2;3600\n", 27, fhdlOut);
            filePutString ("KO2_Sta_Displ/DSP2;3600\n", 24, fhdlOut);
            filePutString ("KO2_Sta_Schalt;3601\n", 20, fhdlOut);
            filePutString ("KO2_Sta_Schalt/Kombi_2;3601\n", 28, fhdlOut);
            filePutString ("KO2_Sta_Schalt/DSP2;3601\n", 25, fhdlOut);
            filePutString ("KO2_Temp_Einheit;3602\n", 22, fhdlOut);
            filePutString ("KO2_Temp_Einheit/Kombi_2;3602\n", 30, fhdlOut);
            filePutString ("KO2_Temp_Einheit/DSP2;3602\n", 27, fhdlOut);
            filePutString ("KO2_Verb_TOG;3603\n", 18, fhdlOut);
            filePutString ("KO2_Verb_TOG/Kombi_2;3603\n", 26, fhdlOut);
            filePutString ("KO2_Verb_TOG/DSP2;3603\n", 23, fhdlOut);
            filePutString ("KO2_WFS_Schl_Ort;3604\n", 22, fhdlOut);
            filePutString ("KO2_WFS_Schl_Ort/Kombi_2;3604\n", 30, fhdlOut);
            filePutString ("KO2_WFS_Schl_Ort/DSP2;3604\n", 27, fhdlOut);
            filePutString ("KO2_Wischwasser;3605\n", 21, fhdlOut);
            filePutString ("KO2_Wischwasser/Kombi_2;3605\n", 29, fhdlOut);
            filePutString ("KO2_Wischwasser/DSP2;3605\n", 26, fhdlOut);
            filePutString ("KO2_gef_Auss_T;3606\n", 20, fhdlOut);
            filePutString ("KO2_gef_Auss_T/Kombi_2;3606\n", 28, fhdlOut);
            filePutString ("KO2_gef_Auss_T/DSP2;3606\n", 25, fhdlOut);
            filePutString ("KO_Segeln_Menuestatus;3607\n", 27, fhdlOut);
            filePutString ("KO_Segeln_Menuestatus/Kombi_2;3607\n", 35, fhdlOut);
            filePutString ("KO_Segeln_Menuestatus/DSP2;3607\n", 32, fhdlOut);
            filePutString ("KO_Segeln_Zustandswechsel;3608\n", 31, fhdlOut);
            filePutString ("KO_Segeln_Zustandswechsel/Kombi_2;3608\n", 39, fhdlOut);
            filePutString ("KO_Segeln_Zustandswechsel/DSP2;3608\n", 36, fhdlOut);
            filePutString ("NMH_GW_Abschaltstufe_aktiv;3840\n", 32, fhdlOut);
            filePutString ("NMH_GW_Abschaltstufe_aktiv/NMH_Gateway;3840\n", 44, fhdlOut);
            filePutString ("NMH_GW_Abschaltstufe_aktiv/NMH_Gateway;3840\n", 44, fhdlOut);
            filePutString ("NMH_GW_CAN_Diag_deaktiv;3841\n", 29, fhdlOut);
            filePutString ("NMH_GW_CAN_Diag_deaktiv/NMH_Gateway;3841\n", 41, fhdlOut);
            filePutString ("NMH_GW_CAN_Diag_deaktiv/NMH_Gateway;3841\n", 41, fhdlOut);
            filePutString ("NMH_GW_Car_WakeUp;3842\n", 23, fhdlOut);
            filePutString ("NMH_GW_Car_WakeUp/NMH_Gateway;3842\n", 35, fhdlOut);
            filePutString ("NMH_GW_Car_WakeUp/NMH_Gateway;3842\n", 35, fhdlOut);
            filePutString ("NMH_GW_Eindraht_Fehler;3843\n", 28, fhdlOut);
            filePutString ("NMH_GW_Eindraht_Fehler/NMH_Gateway;3843\n", 40, fhdlOut);
            filePutString ("NMH_GW_Eindraht_Fehler/NMH_Gateway;3843\n", 40, fhdlOut);
            filePutString ("NMH_GW_Fkt_WakeUp;3844\n", 23, fhdlOut);
            filePutString ("NMH_GW_Fkt_WakeUp/NMH_Gateway;3844\n", 35, fhdlOut);
            filePutString ("NMH_GW_Fkt_WakeUp/NMH_Gateway;3844\n", 35, fhdlOut);
            filePutString ("NMH_GW_KompSchutz;3845\n", 23, fhdlOut);
            filePutString ("NMH_GW_KompSchutz/NMH_Gateway;3845\n", 35, fhdlOut);
            filePutString ("NMH_GW_KompSchutz/NMH_Gateway;3845\n", 35, fhdlOut);
            filePutString ("NMH_GW_Mute_Mode;3846\n", 22, fhdlOut);
            filePutString ("NMH_GW_Mute_Mode/NMH_Gateway;3846\n", 34, fhdlOut);
            filePutString ("NMH_GW_Mute_Mode/NMH_Gateway;3846\n", 34, fhdlOut);
            filePutString ("NMH_GW_NL_0;3847\n", 17, fhdlOut);
            filePutString ("NMH_GW_NL_0/NMH_Gateway;3847\n", 29, fhdlOut);
            filePutString ("NMH_GW_NL_0/NMH_Gateway;3847\n", 29, fhdlOut);
            filePutString ("NMH_GW_NL_1;3848\n", 17, fhdlOut);
            filePutString ("NMH_GW_NL_1/NMH_Gateway;3848\n", 29, fhdlOut);
            filePutString ("NMH_GW_NL_1/NMH_Gateway;3848\n", 29, fhdlOut);
            filePutString ("NMH_GW_NL_2;3849\n", 17, fhdlOut);
            filePutString ("NMH_GW_NL_2/NMH_Gateway;3849\n", 29, fhdlOut);
            filePutString ("NMH_GW_NL_2/NMH_Gateway;3849\n", 29, fhdlOut);
            filePutString ("NMH_GW_NL_3;3850\n", 17, fhdlOut);
            filePutString ("NMH_GW_NL_3/NMH_Gateway;3850\n", 29, fhdlOut);
            filePutString ("NMH_GW_NL_3/NMH_Gateway;3850\n", 29, fhdlOut);
            filePutString ("NMH_GW_NL_4;3851\n", 17, fhdlOut);
            filePutString ("NMH_GW_NL_4/NMH_Gateway;3851\n", 29, fhdlOut);
            filePutString ("NMH_GW_NL_4/NMH_Gateway;3851\n", 29, fhdlOut);
            filePutString ("NMH_GW_NL_5;3852\n", 17, fhdlOut);
            filePutString ("NMH_GW_NL_5/NMH_Gateway;3852\n", 29, fhdlOut);
            filePutString ("NMH_GW_NL_5/NMH_Gateway;3852\n", 29, fhdlOut);
            filePutString ("NMH_GW_NL_6;3853\n", 17, fhdlOut);
            filePutString ("NMH_GW_NL_6/NMH_Gateway;3853\n", 29, fhdlOut);
            filePutString ("NMH_GW_NL_6/NMH_Gateway;3853\n", 29, fhdlOut);
            filePutString ("NMH_GW_NL_7;3854\n", 17, fhdlOut);
            filePutString ("NMH_GW_NL_7/NMH_Gateway;3854\n", 29, fhdlOut);
            filePutString ("NMH_GW_NL_7/NMH_Gateway;3854\n", 29, fhdlOut);
            filePutString ("NMH_GW_NL_aktiv_4;3855\n", 23, fhdlOut);
            filePutString ("NMH_GW_NL_aktiv_4/NMH_Gateway;3855\n", 35, fhdlOut);
            filePutString ("NMH_GW_NL_aktiv_4/NMH_Gateway;3855\n", 35, fhdlOut);
            filePutString ("NMH_GW_NL_aktiv_5;3856\n", 23, fhdlOut);
            filePutString ("NMH_GW_NL_aktiv_5/NMH_Gateway;3856\n", 35, fhdlOut);
            filePutString ("NMH_GW_NL_aktiv_5/NMH_Gateway;3856\n", 35, fhdlOut);
            filePutString ("NMH_GW_NL_aktiv_6;3857\n", 23, fhdlOut);
            filePutString ("NMH_GW_NL_aktiv_6/NMH_Gateway;3857\n", 35, fhdlOut);
            filePutString ("NMH_GW_NL_aktiv_6/NMH_Gateway;3857\n", 35, fhdlOut);
            filePutString ("NMH_GW_NL_aktiv_7;3858\n", 23, fhdlOut);
            filePutString ("NMH_GW_NL_aktiv_7/NMH_Gateway;3858\n", 35, fhdlOut);
            filePutString ("NMH_GW_NL_aktiv_7/NMH_Gateway;3858\n", 35, fhdlOut);
            filePutString ("NMH_GW_NL_aktiv_8;3859\n", 23, fhdlOut);
            filePutString ("NMH_GW_NL_aktiv_8/NMH_Gateway;3859\n", 35, fhdlOut);
            filePutString ("NMH_GW_NL_aktiv_8/NMH_Gateway;3859\n", 35, fhdlOut);
            filePutString ("NMH_GW_NM_aktiv_Diagnose;3860\n", 30, fhdlOut);
            filePutString ("NMH_GW_NM_aktiv_Diagnose/NMH_Gateway;3860\n", 42, fhdlOut);
            filePutString ("NMH_GW_NM_aktiv_Diagnose/NMH_Gateway;3860\n", 42, fhdlOut);
            filePutString ("NMH_GW_NM_aktiv_Klemme_15;3861\n", 31, fhdlOut);
            filePutString ("NMH_GW_NM_aktiv_Klemme_15/NMH_Gateway;3861\n", 43, fhdlOut);
            filePutString ("NMH_GW_NM_aktiv_Klemme_15/NMH_Gateway;3861\n", 43, fhdlOut);
            filePutString ("NMH_GW_NM_aktiv_Start;3862\n", 27, fhdlOut);
            filePutString ("NMH_GW_NM_aktiv_Start/NMH_Gateway;3862\n", 39, fhdlOut);
            filePutString ("NMH_GW_NM_aktiv_Start/NMH_Gateway;3862\n", 39, fhdlOut);
            filePutString ("NMH_GW_Normal_Mode_1;3863\n", 26, fhdlOut);
            filePutString ("NMH_GW_Normal_Mode_1/NMH_Gateway;3863\n", 38, fhdlOut);
            filePutString ("NMH_GW_Normal_Mode_1/NMH_Gateway;3863\n", 38, fhdlOut);
            filePutString ("NMH_GW_Normal_Mode_2;3864\n", 26, fhdlOut);
            filePutString ("NMH_GW_Normal_Mode_2/NMH_Gateway;3864\n", 38, fhdlOut);
            filePutString ("NMH_GW_Normal_Mode_2/NMH_Gateway;3864\n", 38, fhdlOut);
            filePutString ("NMH_GW_Per_WakeUp;3865\n", 23, fhdlOut);
            filePutString ("NMH_GW_Per_WakeUp/NMH_Gateway;3865\n", 35, fhdlOut);
            filePutString ("NMH_GW_Per_WakeUp/NMH_Gateway;3865\n", 35, fhdlOut);
            filePutString ("NMH_GW_Start_1;3866\n", 20, fhdlOut);
            filePutString ("NMH_GW_Start_1/NMH_Gateway;3866\n", 32, fhdlOut);
            filePutString ("NMH_GW_Start_1/NMH_Gateway;3866\n", 32, fhdlOut);
            filePutString ("NMH_GW_Start_2;3867\n", 20, fhdlOut);
            filePutString ("NMH_GW_Start_2/NMH_Gateway;3867\n", 32, fhdlOut);
            filePutString ("NMH_GW_Start_2/NMH_Gateway;3867\n", 32, fhdlOut);
            filePutString ("NMH_GW_TimeOut_Fehler;3868\n", 27, fhdlOut);
            filePutString ("NMH_GW_TimeOut_Fehler/NMH_Gateway;3868\n", 39, fhdlOut);
            filePutString ("NMH_GW_TimeOut_Fehler/NMH_Gateway;3868\n", 39, fhdlOut);
            filePutString ("NMH_GW_Transport_Mode;3869\n", 27, fhdlOut);
            filePutString ("NMH_GW_Transport_Mode/NMH_Gateway;3869\n", 39, fhdlOut);
            filePutString ("NMH_GW_Transport_Mode/NMH_Gateway;3869\n", 39, fhdlOut);
            filePutString ("WH1_Init;4096\n", 14, fhdlOut);
            filePutString ("WH1_Init/Waehlhebel_1;4096\n", 27, fhdlOut);
            filePutString ("WH1_Init/Waehlhebel_1;4096\n", 27, fhdlOut);
            filePutString ("WH1_Position;4097\n", 18, fhdlOut);
            filePutString ("WH1_Position/Waehlhebel_1;4097\n", 31, fhdlOut);
            filePutString ("WH1_Position/Waehlhebel_1;4097\n", 31, fhdlOut);
            filePutString ("WH1_Position_inv;4098\n", 22, fhdlOut);
            filePutString ("WH1_Position_inv/Waehlhebel_1;4098\n", 35, fhdlOut);
            filePutString ("WH1_Position_inv/Waehlhebel_1;4098\n", 35, fhdlOut);
            filePutString ("WH1_StaShiftlock;4099\n", 22, fhdlOut);
            filePutString ("WH1_StaShiftlock/Waehlhebel_1;4099\n", 35, fhdlOut);
            filePutString ("WH1_StaShiftlock/Waehlhebel_1;4099\n", 35, fhdlOut);
            filePutString ("WH1_Status;4100\n", 16, fhdlOut);
            filePutString ("WH1_Status/Waehlhebel_1;4100\n", 29, fhdlOut);
            filePutString ("WH1_Status/Waehlhebel_1;4100\n", 29, fhdlOut);
            filePutString ("WH1_Taster_betaetigt;4101\n", 26, fhdlOut);
            filePutString ("WH1_Taster_betaetigt/Waehlhebel_1;4101\n", 39, fhdlOut);
            filePutString ("WH1_Taster_betaetigt/Waehlhebel_1;4101\n", 39, fhdlOut);
            filePutString ("WH1_Test_Flag;4102\n", 19, fhdlOut);
            filePutString ("WH1_Test_Flag/Waehlhebel_1;4102\n", 32, fhdlOut);
            filePutString ("WH1_Test_Flag/Waehlhebel_1;4102\n", 32, fhdlOut);
            filePutString ("WH1_Testergebnis;4103\n", 22, fhdlOut);
            filePutString ("WH1_Testergebnis/Waehlhebel_1;4103\n", 35, fhdlOut);
            filePutString ("WH1_Testergebnis/Waehlhebel_1;4103\n", 35, fhdlOut);
            filePutString ("WH1_Zaehler;4104\n", 17, fhdlOut);
            filePutString ("WH1_Zaehler/Waehlhebel_1;4104\n", 30, fhdlOut);
            filePutString ("WH1_Zaehler/Waehlhebel_1;4104\n", 30, fhdlOut);

            fileClose(fhdlOut);
        }
    }

    /* ------------------------------------------------------------------------------------------ */
    /*  END frame and signal handle export for remote control of CAPL by Perl script              */
    /* ------------------------------------------------------------------------------------------ */
}
/*@@end*/

/*@@startStart:Start:*/
on start
{
    int FrmIdx;
    int LoopCnt;

    /* start 10ms timer */
    setTimer(Timer_10ms,TIMER_DURATION_10MS);

    for (FrmIdx = 0; FrmIdx < FRM_NUM_MAX; FrmIdx++)
    {
        /* init frame schedule timer */
        FrmSched_SchedTmr[FrmIdx] = 0;
        
        /* enable scheduler for all frames */
        FrmSched_FrmEna[FrmIdx] = 1;

        /* init message counter values */
        Frm_MsgCounter[FrmIdx] = 0;

        /* enable message counter increment */
        Frm_MsgCounterEna[FrmIdx] = 1;

        /* enable checksum calculation */
        Frm_MsgChksmEna[FrmIdx] = 1;

        /* init DLC error status to OK */
        Frm_DLCOk[FrmIdx] = 1;
    }

    
    /* init CAPL control related variables */
    for (LoopCnt = 0; LoopCnt < CAPLCTRL_INPUTBUF_LEN; LoopCnt ++)
    {
        CaplCtrl_InputBuf[LoopCnt] = 0;
    }

    /* ------------------------------------------------------------------------------------------ */
    /*  BEGIN variable initialization                                                             */
    /* ------------------------------------------------------------------------------------------ */

    FrmSched_CycleTime[FRM_HANDLE_ACC_System] = 20;
    FrmSched_CycleTime[FRM_HANDLE_Airbag_1] = 20;
    FrmSched_CycleTime[FRM_HANDLE_BSG_Last] = 100;
    FrmSched_CycleTime[FRM_HANDLE_Bremse_1] = 20;
    FrmSched_CycleTime[FRM_HANDLE_Bremse_3] = 20;
    FrmSched_CycleTime[FRM_HANDLE_Charisma_01] = 1000;
    FrmSched_CycleTime[FRM_HANDLE_Clima_1] = 100;
    FrmSched_CycleTime[FRM_HANDLE_Diagnose_1] = 1000;
    FrmSched_CycleTime[FRM_HANDLE_EKompKlima_1] = 500;
    FrmSched_CycleTime[FRM_HANDLE_GRA_Neu] = 20;
    FrmSched_CycleTime[FRM_HANDLE_Gate_Komf_1] = 100;
    FrmSched_CycleTime[FRM_HANDLE_Gate_Komf_4] = 200;
    FrmSched_CycleTime[FRM_HANDLE_Klima_EV_1] = 500;
    FrmSched_CycleTime[FRM_HANDLE_Kombi_1] = 20;
    FrmSched_CycleTime[FRM_HANDLE_Kombi_2] = 200;
    FrmSched_CycleTime[FRM_HANDLE_NMH_Gateway] = 200;
    FrmSched_CycleTime[FRM_HANDLE_Waehlhebel_1] = 10;

    Frm_DLC[FRM_HANDLE_ACC_System] = 8;
    Frm_DLC[FRM_HANDLE_Airbag_1] = 4;
    Frm_DLC[FRM_HANDLE_BSG_Last] = 5;
    Frm_DLC[FRM_HANDLE_Bremse_1] = 8;
    Frm_DLC[FRM_HANDLE_Bremse_3] = 8;
    Frm_DLC[FRM_HANDLE_Charisma_01] = 8;
    Frm_DLC[FRM_HANDLE_Clima_1] = 8;
    Frm_DLC[FRM_HANDLE_Diagnose_1] = 8;
    Frm_DLC[FRM_HANDLE_EKompKlima_1] = 6;
    Frm_DLC[FRM_HANDLE_GRA_Neu] = 4;
    Frm_DLC[FRM_HANDLE_Gate_Komf_1] = 8;
    Frm_DLC[FRM_HANDLE_Gate_Komf_4] = 8;
    Frm_DLC[FRM_HANDLE_Klima_EV_1] = 8;
    Frm_DLC[FRM_HANDLE_Kombi_1] = 8;
    Frm_DLC[FRM_HANDLE_Kombi_2] = 8;
    Frm_DLC[FRM_HANDLE_NMH_Gateway] = 7;
    Frm_DLC[FRM_HANDLE_Waehlhebel_1] = 5;


    /* ------------------------------------------------------------------------------------------ */
    /*  END variable initialization                                                               */
    /* ------------------------------------------------------------------------------------------ */


    /* ------------------------------------------------------------------------------------------ */
    /*  BEGIN OnStart                                                                             */
    /* ------------------------------------------------------------------------------------------ */

    write("");
    write("#===================================================================");
    write("# CAPL program vw360e_acan.can");
    write("# Generated by:  dbc2capl.pl v1.4.5 (dbcparser.pm 1.3.0)");
    write("# CAPL template: dbc2capl_template.can v1.0.2");
    write("# Generated on:  19.05.2010 10:32:56");
    write("# DBC file:      vw360e_acan.dbc");
    write("#===================================================================");
    write("");


    /* ------------------------------------------------------------------------------------------ */
    /*  END OnStart                                                                               */
    /* ------------------------------------------------------------------------------------------ */

    /* HelpFrameList(); */

    write("Hit '?' to get list of all available frames ...");
    ShowPrompt();
}
/*@@end*/

/*@@key:*:*/
on key *
{
    int InputVal = 0;
    int LevelActvOld;
    char CharBufTmp[CAPLCTRL_CHARBUF_LEN];
    
    /* store current input level to be able to check for level change */
    LevelActvOld = CaplCtrl_LevelActv;

    /* empty string */
    CharBufTmp[0] = 0;


    switch (this)
    {
        /* --- numeric input -------------------------------------------------------------------- */
        case '0':
        case '1':
        case '2':
        case '3':
        case '4':
        case '5':
        case '6':
        case '7':
        case '8':
        case '9':
        {
            /* copy input to input buffer */
            CaplCtrl_InputBuf[CaplCtrl_InputIdx] = this;
            
            /* increment to next buffer value */
            CaplCtrl_InputIdx ++;

            /* limit input to buffer length */
            if (CaplCtrl_InputIdx >= CAPLCTRL_INPUTBUF_LEN)
            {
                CaplCtrl_InputIdx = CAPLCTRL_INPUTBUF_LEN - 1;
            }

            /* make sure that string is terminated properly */
            CaplCtrl_InputBuf[CaplCtrl_InputIdx] = 0;
        }
        break;

        /* --- numeric input -------------------------------------------------------------------- */
        case KEY_ENTER:
        {
            if (CaplCtrl_InputIdx > 0)
            {
                InputVal = atol(CaplCtrl_InputBuf);
            
                /* reset input variables */
                CaplCtrl_InputIdx = 0;
                CaplCtrl_InputBuf[0] = 0;

                switch (CaplCtrl_LevelActv)
                {
                    /* currently no level selected */
                    case CAPLCTRL_LEVEL_NOSEL:
                    {
                        /* select frame only if selection was valid */
                        if (InputVal < FRM_NUM_MAX)
                        {
                            /* switch to next level */
                            CaplCtrl_LevelActv = CAPLCTRL_LEVEL_FRAME;

                            /* select frame */
                            CaplCtrl_FrameActv = InputVal;
                        }
                        break;
                    }

                    case CAPLCTRL_LEVEL_FRAME:
                    {
                        /* switch to next level */
                        CaplCtrl_LevelActv = CAPLCTRL_LEVEL_SIGNAL;
                
                        /* select signal */
                        CaplCtrl_SignalActv = InputVal;
                        break;
                    }
            
                    case CAPLCTRL_LEVEL_SIGNAL:
                    {
                        /* set signal to input value */
                        CaplCtrl_InputValue = InputVal;
                        Frm_SetSignal(CaplCtrl_FrameActv, CaplCtrl_SignalActv, CaplCtrl_InputValue);
                        break;
                    }
                }
            }
        }
        break;

        case KEY_LEVEL_DOWN:
        {
            switch (CaplCtrl_LevelActv)
            {
                /* currently no level selected */
                case CAPLCTRL_LEVEL_NOSEL:
                {
                    /* keep level, do nothing */
                    break;
                }

                case CAPLCTRL_LEVEL_FRAME:
                {
                    /* switch back to above level */
                    CaplCtrl_LevelActv = CAPLCTRL_LEVEL_NOSEL;
                    break;
                }
        
                case CAPLCTRL_LEVEL_SIGNAL:
                {
                    /* switch back to above level */
                    CaplCtrl_LevelActv = CAPLCTRL_LEVEL_FRAME;
                    break;
                }
            }
        }
        break;

        case KEY_BACKSPACE:
        {
            /* update index */
            if (CaplCtrl_InputIdx > 0)
            {
                CaplCtrl_InputIdx --;
            }
            else
            {
                CaplCtrl_InputIdx = 0;
            }

            /* remove last character */
            CaplCtrl_InputBuf[CaplCtrl_InputIdx] = 0;
        }
        break;

        case KEY_TIMEOUT:
        {
            switch (CaplCtrl_LevelActv)
            {
                /* currently no level selected */
                case CAPLCTRL_LEVEL_NOSEL:
                {
                    /* enable/disable all frames */
                    if (FrmSched_FrmEna[0] != 0)
                    {
                        FrmSch_DisableAllFrames();
                        snprintf(CaplCtrl_CharBuf,
                                 CAPLCTRL_CHARBUF_LEN,
                                 "all frames disabled!");
                    }
                    else
                    {
                        FrmSch_EnableAllFrames();
                        snprintf(CaplCtrl_CharBuf,
                                 CAPLCTRL_CHARBUF_LEN,
                                 "all frames enabled!");
                    }
                    CaplCtrl_PromptMode = CAPLCTRL_PROMPTMODE_CHAR;
                    break;
                }

                case CAPLCTRL_LEVEL_FRAME:
                case CAPLCTRL_LEVEL_SIGNAL:
                {
                    /* toggle timeout status for selected frame */
                    FrmSched_FrmEna[CaplCtrl_FrameActv] ^= 1;
                    
                    /* get current frame status */
                    snprintf(CharBufTmp,
                             CAPLCTRL_CHARBUF_LEN,
                             "[tx=%d dlc=%d cs=%d cnt=%d]",
                             FrmSched_FrmEna[CaplCtrl_FrameActv],
                             Frm_DLCOk[CaplCtrl_FrameActv],
                             Frm_MsgChksmEna[CaplCtrl_FrameActv],
                             Frm_MsgCounterEna[CaplCtrl_FrameActv]);

                    if (FrmSched_FrmEna[CaplCtrl_FrameActv] != 0)
                    {
                        snprintf(CaplCtrl_CharBuf,
                                 CAPLCTRL_CHARBUF_LEN,
                                 "%s TX enabled!",
                                 CharBufTmp);
                    }
                    else
                    {
                        snprintf(CaplCtrl_CharBuf,
                                 CAPLCTRL_CHARBUF_LEN,
                                 "%s TX disabled!",
                                 CharBufTmp);
                    }

                    CaplCtrl_PromptMode = CAPLCTRL_PROMPTMODE_CHAR;
                    break;
                }
            }
            break;
        }

        case KEY_MSGCNT:
        {
            switch (CaplCtrl_LevelActv)
            {
                /* currently no level selected */
                case CAPLCTRL_LEVEL_NOSEL:
                {
                    /* keep level, do nothing */
                    break;
                }

                case CAPLCTRL_LEVEL_FRAME:
                case CAPLCTRL_LEVEL_SIGNAL:
                {
                    /* toggle message counter enable status */
                    Frm_MsgCounterEna[CaplCtrl_FrameActv] ^= 1;

                    /* get current frame status */
                    snprintf(CharBufTmp,
                             CAPLCTRL_CHARBUF_LEN,
                             "[tx=%d dlc=%d cs=%d cnt=%d]",
                             FrmSched_FrmEna[CaplCtrl_FrameActv],
                             Frm_DLCOk[CaplCtrl_FrameActv],
                             Frm_MsgChksmEna[CaplCtrl_FrameActv],
                             Frm_MsgCounterEna[CaplCtrl_FrameActv]);

                    if (Frm_MsgCounterEna[CaplCtrl_FrameActv] != 0)
                    {
                        snprintf(CaplCtrl_CharBuf,
                                 CAPLCTRL_CHARBUF_LEN,
                                 "%s Message counter running!",
                                 CharBufTmp);
                    }
                    else
                    {
                        snprintf(CaplCtrl_CharBuf,
                                 CAPLCTRL_CHARBUF_LEN,
                                 "%s Message counter stopped!",
                                 CharBufTmp);
                    }

                    CaplCtrl_PromptMode = CAPLCTRL_PROMPTMODE_CHAR;
                    break;
                }
            }
            break;
        }

        case KEY_CHKSM:
        {
            switch (CaplCtrl_LevelActv)
            {
                /* currently no level selected */
                case CAPLCTRL_LEVEL_NOSEL:
                {
                    /* keep level, do nothing */
                    break;
                }

                case CAPLCTRL_LEVEL_FRAME:
                case CAPLCTRL_LEVEL_SIGNAL:
                {
                    /* toggle checksum enable status */
                    Frm_MsgChksmEna[CaplCtrl_FrameActv] ^= 1;

                    /* get current frame status */
                    snprintf(CharBufTmp,
                             CAPLCTRL_CHARBUF_LEN,
                             "[tx=%d dlc=%d cs=%d cnt=%d]",
                             FrmSched_FrmEna[CaplCtrl_FrameActv],
                             Frm_DLCOk[CaplCtrl_FrameActv],
                             Frm_MsgChksmEna[CaplCtrl_FrameActv],
                             Frm_MsgCounterEna[CaplCtrl_FrameActv]);

                    if (Frm_MsgChksmEna[CaplCtrl_FrameActv] != 0)
                    {
                        snprintf(CaplCtrl_CharBuf,
                                 CAPLCTRL_CHARBUF_LEN,
                                 "%s Checksum calculation enabled!",
                                 CharBufTmp);
                    }
                    else
                    {
                        snprintf(CaplCtrl_CharBuf,
                                 CAPLCTRL_CHARBUF_LEN,
                                 "%s Checksum calculation disabled!",
                                 CharBufTmp);
                    }

                    CaplCtrl_PromptMode = CAPLCTRL_PROMPTMODE_CHAR;
                    break;
                }
            }
            break;
        }

        case KEY_DLC:
        {
            switch (CaplCtrl_LevelActv)
            {
                /* currently no level selected */
                case CAPLCTRL_LEVEL_NOSEL:
                {
                    /* keep level, do nothing */
                    break;
                }

                case CAPLCTRL_LEVEL_FRAME:
                case CAPLCTRL_LEVEL_SIGNAL:
                {
                    /* toggle DLC ok status */
                    Frm_DLCOk[CaplCtrl_FrameActv] ^= 1;

                    /* get current frame status */
                    snprintf(CharBufTmp,
                             CAPLCTRL_CHARBUF_LEN,
                             "[tx=%d dlc=%d cs=%d cnt=%d]",
                             FrmSched_FrmEna[CaplCtrl_FrameActv],
                             Frm_DLCOk[CaplCtrl_FrameActv],
                             Frm_MsgChksmEna[CaplCtrl_FrameActv],
                             Frm_MsgCounterEna[CaplCtrl_FrameActv]);

                    if (Frm_DLCOk[CaplCtrl_FrameActv] != 0)
                    {
                        snprintf(CaplCtrl_CharBuf,
                                 CAPLCTRL_CHARBUF_LEN,
                                 "%s correct DLC!",
                                 CharBufTmp);

                        Frm_SetDLC (CaplCtrl_FrameActv, Frm_DLC[CaplCtrl_FrameActv]);
                    }
                    else
                    {
                        snprintf(CaplCtrl_CharBuf,
                                 CAPLCTRL_CHARBUF_LEN,
                                 "%s incorrect DLC!",
                                 CharBufTmp);

                        Frm_SetDLC (CaplCtrl_FrameActv, 0);
                    }


                    CaplCtrl_PromptMode = CAPLCTRL_PROMPTMODE_CHAR;
                    break;
                }
            }
            break;
        }
        
        case KEY_HELP:
        {
            CaplCtrl_LevelChanged();
            break;
        }

        default:
        {
            break;
        }
    }

    if (LevelActvOld != CaplCtrl_LevelActv)
    {
        //CaplCtrl_LevelChanged();
    }

    ShowPrompt();
    CaplCtrl_PromptMode = CAPLCTRL_PROMPTMODE_NUM;
}
/*@@end*/

/*@@caplFunc:CaplCtrl_LevelChanged():*/
CaplCtrl_LevelChanged ()
{
    switch(CaplCtrl_LevelActv)
    {
        case CAPLCTRL_LEVEL_NOSEL:
        {
           HelpFrameList();
        }
        break;

        case CAPLCTRL_LEVEL_FRAME:
        {
            HelpSignalList();
        }
        break;

        case CAPLCTRL_LEVEL_SIGNAL:
        {
           
        }
        break;
    }
}
/*@@end*/

/*@@msg:*:*/
on message *
{
   output(this);
}
/*@@end*/

/*@@caplFunc:FrmSched_SendFrame(int):*/
FrmSched_SendFrame (int FrmIdx)
{
    switch (FrmIdx)
    {
        case FRM_HANDLE_ACC_System:
            MsgObj_ACC_System.ACS_Zaehler = Frm_CalcMsgCounter(FRM_HANDLE_ACC_System);
            MsgObj_ACC_System.ACS_Checksum = Frm_CalcChecksumXOR(FRM_HANDLE_ACC_System, MsgObj_ACC_System, 0);
            output(MsgObj_ACC_System);
            break;
        case FRM_HANDLE_Airbag_1:
            MsgObj_Airbag_1.AB1_Zaehler = Frm_CalcMsgCounter(FRM_HANDLE_Airbag_1);
            MsgObj_Airbag_1.AB1_Checksumme = Frm_CalcChecksumXOR(FRM_HANDLE_Airbag_1, MsgObj_Airbag_1, 3);
            output(MsgObj_Airbag_1);
            break;
        case FRM_HANDLE_BSG_Last:
            output(MsgObj_BSG_Last);
            break;
        case FRM_HANDLE_Bremse_1:
            MsgObj_Bremse_1.BR1_Zaehler = Frm_CalcMsgCounter(FRM_HANDLE_Bremse_1);
            output(MsgObj_Bremse_1);
            break;
        case FRM_HANDLE_Bremse_3:
            output(MsgObj_Bremse_3);
            break;
        case FRM_HANDLE_Charisma_01:
            output(MsgObj_Charisma_01);
            break;
        case FRM_HANDLE_Clima_1:
            output(MsgObj_Clima_1);
            break;
        case FRM_HANDLE_Diagnose_1:
            output(MsgObj_Diagnose_1);
            break;
        case FRM_HANDLE_EKompKlima_1:
            output(MsgObj_EKompKlima_1);
            break;
        case FRM_HANDLE_GRA_Neu:
            MsgObj_GRA_Neu.GRA_Neu_Zaehler = Frm_CalcMsgCounter(FRM_HANDLE_GRA_Neu);
            MsgObj_GRA_Neu.GRA_Checksum = Frm_CalcChecksumXOR(FRM_HANDLE_GRA_Neu, MsgObj_GRA_Neu, 0);
            output(MsgObj_GRA_Neu);
            break;
        case FRM_HANDLE_Gate_Komf_1:
            output(MsgObj_Gate_Komf_1);
            break;
        case FRM_HANDLE_Gate_Komf_4:
            output(MsgObj_Gate_Komf_4);
            break;
        case FRM_HANDLE_Klima_EV_1:
            output(MsgObj_Klima_EV_1);
            break;
        case FRM_HANDLE_Kombi_1:
            MsgObj_Kombi_1.KO1_Zaehler = Frm_CalcMsgCounter(FRM_HANDLE_Kombi_1);
            output(MsgObj_Kombi_1);
            break;
        case FRM_HANDLE_Kombi_2:
            output(MsgObj_Kombi_2);
            break;
        case FRM_HANDLE_NMH_Gateway:
            output(MsgObj_NMH_Gateway);
            break;
        case FRM_HANDLE_Waehlhebel_1:
            MsgObj_Waehlhebel_1.WH1_Zaehler = Frm_CalcMsgCounter(FRM_HANDLE_Waehlhebel_1);
            output(MsgObj_Waehlhebel_1);
            break;
    }
}
/*@@end*/

/*@@caplFunc:Frm_SetDLC(long, long):*/
Frm_SetDLC (long FrmIdx, long FrmDLC)
{
    switch (FrmIdx)
    {
        case FRM_HANDLE_ACC_System:
            MsgObj_ACC_System.DLC = FrmDLC;
            break;
        case FRM_HANDLE_Airbag_1:
            MsgObj_Airbag_1.DLC = FrmDLC;
            break;
        case FRM_HANDLE_BSG_Last:
            MsgObj_BSG_Last.DLC = FrmDLC;
            break;
        case FRM_HANDLE_Bremse_1:
            MsgObj_Bremse_1.DLC = FrmDLC;
            break;
        case FRM_HANDLE_Bremse_3:
            MsgObj_Bremse_3.DLC = FrmDLC;
            break;
        case FRM_HANDLE_Charisma_01:
            MsgObj_Charisma_01.DLC = FrmDLC;
            break;
        case FRM_HANDLE_Clima_1:
            MsgObj_Clima_1.DLC = FrmDLC;
            break;
        case FRM_HANDLE_Diagnose_1:
            MsgObj_Diagnose_1.DLC = FrmDLC;
            break;
        case FRM_HANDLE_EKompKlima_1:
            MsgObj_EKompKlima_1.DLC = FrmDLC;
            break;
        case FRM_HANDLE_GRA_Neu:
            MsgObj_GRA_Neu.DLC = FrmDLC;
            break;
        case FRM_HANDLE_Gate_Komf_1:
            MsgObj_Gate_Komf_1.DLC = FrmDLC;
            break;
        case FRM_HANDLE_Gate_Komf_4:
            MsgObj_Gate_Komf_4.DLC = FrmDLC;
            break;
        case FRM_HANDLE_Klima_EV_1:
            MsgObj_Klima_EV_1.DLC = FrmDLC;
            break;
        case FRM_HANDLE_Kombi_1:
            MsgObj_Kombi_1.DLC = FrmDLC;
            break;
        case FRM_HANDLE_Kombi_2:
            MsgObj_Kombi_2.DLC = FrmDLC;
            break;
        case FRM_HANDLE_NMH_Gateway:
            MsgObj_NMH_Gateway.DLC = FrmDLC;
            break;
        case FRM_HANDLE_Waehlhebel_1:
            MsgObj_Waehlhebel_1.DLC = FrmDLC;
            break;
    }
}
/*@@end*/

/*@@busOff:BusOff:*/
on busOff
{
    resetCan();
}
/*@@end*/

/*@@caplFunc:HelpCommands():*/
HelpCommands ()
{
    write("-------------------------------------------");
    write("Supported commands:");
    write("[a] ... toggle timeout error status");
    write("[b] ... toggle message counter error status");
    write("[c] ... toggle checksumm error status");
    write("[d] ... toggle DLC error status");
    write("[.] ... one level up in command prompt");
    write("-------------------------------------------");
}

/*@@caplFunc:HelpFrameList():*/
HelpFrameList ()
{
    HelpCommands();

    write("[0] ... ACC_System");
    write("[1] ... Airbag_1");
    write("[2] ... BSG_Last");
    write("[3] ... Bremse_1");
    write("[4] ... Bremse_3");
    write("[5] ... Charisma_01");
    write("[6] ... Clima_1");
    write("[7] ... Diagnose_1");
    write("[8] ... EKompKlima_1");
    write("[9] ... GRA_Neu");
    write("[10] ... Gate_Komf_1");
    write("[11] ... Gate_Komf_4");
    write("[12] ... Klima_EV_1");
    write("[13] ... Kombi_1");
    write("[14] ... Kombi_2");
    write("[15] ... NMH_Gateway");
    write("[16] ... Waehlhebel_1");

}

/*@@caplFunc:HelpSignalList():*/
HelpSignalList ()
{
    HelpCommands();

    switch(CaplCtrl_FrameActv)
    {
        case FRM_HANDLE_ACC_System:
        {
            write("[0] ... ACS_ADR_Schub");
            write("[1] ... ACS_Anhaltewunsch");
            write("[2] ... ACS_Checksum");
            write("[3] ... ACS_Fehler");
            write("[4] ... ACS_FreigSollB");
            write("[5] ... ACS_MomEingriff");
            write("[6] ... ACS_Schubabsch");
            write("[7] ... ACS_Sollbeschl");
            write("[8] ... ACS_StSt_Info");
            write("[9] ... ACS_Sta_ADR");
            write("[10] ... ACS_Typ_ACC");
            write("[11] ... ACS_Zaehler");
            write("[12] ... ACS_max_AendGrad");
            write("[13] ... ACS_zul_Regelabw");
        }
        break;
        case FRM_HANDLE_Airbag_1:
        {
            write("[0] ... AB1_BF_Warnung");
            write("[1] ... AB1_Beifahrer");
            write("[2] ... AB1_Bf_Seite");
            write("[3] ... AB1_Checksumme");
            write("[4] ... AB1_Diagnose");
            write("[5] ... AB1_Fa_Seite");
            write("[6] ... AB1_Fehlereintr");
            write("[7] ... AB1_Front");
            write("[8] ... AB1_Gurt_Bf");
            write("[9] ... AB1_Gurt_Fa");
            write("[10] ... AB1_Heck");
            write("[11] ... AB1_Intens");
            write("[12] ... AB1_Lampe");
            write("[13] ... AB1_Rollover");
            write("[14] ... AB1_Status");
            write("[15] ... AB1_Stellglied");
            write("[16] ... AB1_System");
            write("[17] ... AB1_Zaehler");
        }
        break;
        case FRM_HANDLE_BSG_Last:
        {
            write("[0] ... BSL_Ab_Batterie");
            write("[1] ... BSL_Aussensp");
            write("[2] ... BSL_BSG_2_alt");
            write("[3] ... BSL_BSG_3_alt");
            write("[4] ... BSL_Clima");
            write("[5] ... BSL_Fehlereintr");
            write("[6] ... BSL_Frontsch");
            write("[7] ... BSL_Hecksch");
            write("[8] ... BSL_Kl_15_Motor");
            write("[9] ... BSL_Kl_L");
            write("[10] ... BSL_Kuehlerlueft");
            write("[11] ... BSL_LL_Anheb");
            write("[12] ... BSL_LL_Anheb2");
            write("[13] ... BSL_Lenkradheiz");
            write("[14] ... BSL_Motor_Haube");
            write("[15] ... BSL_Parklicht");
            write("[16] ... BSL_Sitzbelueft");
            write("[17] ... BSL_Sitzheiz");
            write("[18] ... BSL_Sta_LWR");
            write("[19] ... BSL_Sta_StBat");
            write("[20] ... BSL_Sta_UBat");
            write("[21] ... BSL_Starterlaubnis");
            write("[22] ... BSL_UBat");
            write("[23] ... BSL_Wake_Up_ACAN");
            write("[24] ... BSL_Wasserheiz");
            write("[25] ... BSL_Weckursache_ACAN");
            write("[26] ... BSL_ZAS_Kl_15");
            write("[27] ... BSL_ZAS_Kl_50");
            write("[28] ... BSL_ZAS_Kl_S");
            write("[29] ... BSL_ZAS_Kl_X");
        }
        break;
        case FRM_HANDLE_Bremse_1:
        {
            write("[0] ... BR1_ABS_Brems");
            write("[1] ... BR1_ASRMo_fa");
            write("[2] ... BR1_ASRMo_sl");
            write("[3] ... BR1_ASR_Anf");
            write("[4] ... BR1_ASR_ESP");
            write("[5] ... BR1_ASR_Eingr");
            write("[6] ... BR1_BKV_aktiv");
            write("[7] ... BR1_Diagnose");
            write("[8] ... BR1_EBV_Eingr");
            write("[9] ... BR1_EDS_Eingr");
            write("[10] ... BR1_ESPASR_passiv");
            write("[11] ... BR1_ESP_Eingr");
            write("[12] ... BR1_Ersatz_Kmh");
            write("[13] ... BR1_Lampe_ABS");
            write("[14] ... BR1_Lampe_ASR");
            write("[15] ... BR1_Lampe_BK");
            write("[16] ... BR1_Lichtschalt");
            write("[17] ... BR1_MAD");
            write("[18] ... BR1_MSR_Anf");
            write("[19] ... BR1_MSR_Mo");
            write("[20] ... BR1_MSR_Mo_inv");
            write("[21] ... BR1_Rad_kmh");
            write("[22] ... BR1_StaDruckschw");
            write("[23] ... BR1_Sta_ESP");
            write("[24] ... BR1_Sta_MAD");
            write("[25] ... BR1_Zaehler");
        }
        break;
        case FRM_HANDLE_Bremse_3:
        {
            write("[0] ... BR3_Fahrtr_HL");
            write("[1] ... BR3_Fahrtr_HR");
            write("[2] ... BR3_Fahrtr_VL");
            write("[3] ... BR3_Fahrtr_VR");
            write("[4] ... BR3_Rad_kmh_HL");
            write("[5] ... BR3_Rad_kmh_HR");
            write("[6] ... BR3_Rad_kmh_VL");
            write("[7] ... BR3_Rad_kmh_VR");
        }
        break;
        case FRM_HANDLE_Charisma_01:
        {
            write("[0] ... CHA_Ziel_FahrPr_GE");
            write("[1] ... CHA_Ziel_FahrPr_MO");
        }
        break;
        case FRM_HANDLE_Clima_1:
        {
            write("[0] ... CL1_AC_Schalter");
            write("[1] ... CL1_Aussentemp");
            write("[2] ... CL1_Druck");
            write("[3] ... CL1_Einheit_Temp");
            write("[4] ... CL1_Fa_Zuheiz");
            write("[5] ... CL1_Fehlereintr");
            write("[6] ... CL1_Frontsch");
            write("[7] ... CL1_Gebl_last");
            write("[8] ... CL1_Hecksch");
            write("[9] ... CL1_Heizleist");
            write("[10] ... CL1_Kompr_Last");
            write("[11] ... CL1_Kompressor");
            write("[12] ... CL1_LL_Dz");
            write("[13] ... CL1_Luefter");
            write("[14] ... CL1_PTC_Hzg");
            write("[15] ... CL1_Restwaerme");
            write("[16] ... CL1_Sta_Druck");
            write("[17] ... CL1_Sta_Moment");
            write("[18] ... CL1_WAPU_Zuschaltung");
            write("[19] ... KL_Thermomanagement");
        }
        break;
        case FRM_HANDLE_Diagnose_1:
        {
            write("[0] ... DI1_Jahr");
            write("[1] ... DI1_KM_Stand_alt");
            write("[2] ... DI1_Minute");
            write("[3] ... DI1_Monat");
            write("[4] ... DI1_Sekunde");
            write("[5] ... DI1_Stunde");
            write("[6] ... DI1_Tag");
            write("[7] ... DI1_VerlernZaehl");
            write("[8] ... DI1_Zeit_alt");
            write("[9] ... DI1_km_Stand");
        }
        break;
        case FRM_HANDLE_EKompKlima_1:
        {
            write("[0] ... EK1_Comp_Inv_stat");
            write("[1] ... EK1_Comp_SCI_com_stat");
            write("[2] ... EK1_Comp_current");
            write("[3] ... EK1_Comp_main_stat");
            write("[4] ... EK1_Comp_output_stat");
            write("[5] ... EK1_Comp_ovld_stat");
            write("[6] ... EK1_Comp_photo_temp");
            write("[7] ... EK1_Comp_photo_temp_stat");
            write("[8] ... EK1_Comp_rev_stat");
            write("[9] ... EK1_KD_Fehler");
        }
        break;
        case FRM_HANDLE_GRA_Neu:
        {
            write("[0] ... GRA_Abbrechen");
            write("[1] ... GRA_Checksum");
            write("[2] ... GRA_Down_kurz");
            write("[3] ... GRA_Down_lang");
            write("[4] ... GRA_Fehler_Bed");
            write("[5] ... GRA_Fehler_Tip");
            write("[6] ... GRA_Hauptschalt");
            write("[7] ... GRA_Kodierinfo");
            write("[8] ... GRA_Neu_Setzen");
            write("[9] ... GRA_Neu_Zaehler");
            write("[10] ... GRA_Recall");
            write("[11] ... GRA_Sender");
            write("[12] ... GRA_Sportschalter");
            write("[13] ... GRA_Sta_Limiter");
            write("[14] ... GRA_Tip_Down");
            write("[15] ... GRA_Tip_Up");
            write("[16] ... GRA_Typ_Hauptschalt");
            write("[17] ... GRA_Up_kurz");
            write("[18] ... GRA_Up_lang");
            write("[19] ... GRA_Zeitluecke");
        }
        break;
        case FRM_HANDLE_Gate_Komf_1:
        {
            write("[0] ... BCM_CV_Taster");
            write("[1] ... BCM_Offroad_Taster");
            write("[2] ... BCM_Remotestart_Betrieb");
            write("[3] ... BSK_BT_geoeffnet");
            write("[4] ... BSK_HD_Hauptraste");
            write("[5] ... BSK_HL_geoeffnet");
            write("[6] ... BSK_HR_geoeffnet");
            write("[7] ... GK1_Abbl_VL_def");
            write("[8] ... GK1_Abbl_VR_def");
            write("[9] ... GK1_Abblendlicht");
            write("[10] ... GK1_AnhKonLamp");
            write("[11] ... GK1_Anh_abgesteckt");
            write("[12] ... GK1_Anhaenger");
            write("[13] ... GK1_BLS_ILM");
            write("[14] ... GK1_Blink_Autob");
            write("[15] ... GK1_Blinker_li");
            write("[16] ... GK1_Blinker_re");
            write("[17] ... GK1_BrLi_Anhaen");
            write("[18] ... GK1_BrLi_links");
            write("[19] ... GK1_BrLi_mitte");
            write("[20] ... GK1_BrLi_rechts");
            write("[21] ... GK1_Bremslicht");
            write("[22] ... GK1_CharismaModus");
            write("[23] ... GK1_DriveSelectModus_1");
            write("[24] ... GK1_DriveSelectModus_2");
            write("[25] ... GK1_EDC_ILM");
            write("[26] ... GK1_ELV_verrieg");
            write("[27] ... GK1_EfficiencyModus");
            write("[28] ... GK1_Fa_Tuerkont");
            write("[29] ... GK1_Fernlicht");
            write("[30] ... GK1_KW_Warm");
            write("[31] ... GK1_LS1_Fernlicht");
            write("[32] ... GK1_Nebel_ein");
            write("[33] ... GK1_ParkFrontWi");
            write("[34] ... GK1_Rueckfahr");
            write("[35] ... GK1_RueckfahrSch");
            write("[36] ... GK1_SH_Verbau");
            write("[37] ... GK1_SH_Zusatzfkt");
            write("[38] ... GK1_SH_laeuft");
            write("[39] ... GK1_SamFktNr");
            write("[40] ... GK1_SleepAckn");
            write("[41] ... GK1_SportModus");
            write("[42] ... GK1_Sta_Anhaen");
            write("[43] ... GK1_Sta_ILM_F_1");
            write("[44] ... GK1_Sta_Kessy_2");
            write("[45] ... GK1_Sta_LSM");
            write("[46] ... GK1_Sta_Li_vorn");
            write("[47] ... GK1_Sta_Licht1");
            write("[48] ... GK1_Sta_Licht2");
            write("[49] ... GK1_Sta_Licht3");
            write("[50] ... GK1_Sta_RDK_Warn");
            write("[51] ... GK1_Sta_Stdhzg");
            write("[52] ... GK1_Sta_Tuerkont");
            write("[53] ... GK1_Warnblk_Status");
            write("[54] ... GK1_Wischer_vorn");
            write("[55] ... GK1_def_P_verr");
            write("[56] ... LDS_Stellung_AFL");
            write("[57] ... SH1_ein_Wasserpumpe");
            write("[58] ... WI1_Front_Wasch");
        }
        break;
        case FRM_HANDLE_Gate_Komf_4:
        {
            write("[0] ... GK1_Sta_LSM");
            write("[1] ... GK4_Ladesteckerentr_Anf");
            write("[2] ... GK4_Sta_MFA_6");
            write("[3] ... LS1_P_verriegelt");
            write("[4] ... MA6_Reichweite");
            write("[5] ... MA6_km_Reichweite");
            write("[6] ... MA6_mls_Reichweite");
        }
        break;
        case FRM_HANDLE_Klima_EV_1:
        {
            write("[0] ... EKK_Status");
            write("[1] ... EKK_Status_Vorstrg");
            write("[2] ... EKK_Strom");
            write("[3] ... KL_Charisma_FahrPr");
            write("[4] ... KL_Charisma_Status");
            write("[5] ... KL_HV_Anf");
            write("[6] ... KL_HV_ein");
            write("[7] ... KL_Innengeblaese");
            write("[8] ... KL_Kompr_Drehzahl_Soll");
            write("[9] ... KL_PTC_Soll");
            write("[10] ... KL_Standklima_Status");
            write("[11] ... KL_Standklima_Strg_Kluefter");
            write("[12] ... KL_Ventil_Batterie_Anf");
            write("[13] ... KL_Ventil_vor_Motor_Anf");
            write("[14] ... KL_Wake_Up_ACAN");
            write("[15] ... PTC_Pumpe_Ist");
            write("[16] ... PTC_Pumpe_Status");
            write("[17] ... PTC_Strom");
        }
        break;
        case FRM_HANDLE_Kombi_1:
        {
            write("[0] ... KO1_ABS_Lampe");
            write("[1] ... KO1_ACC_AnzFhl");
            write("[2] ... KO1_ACC_Inkons");
            write("[3] ... KO1_ASRESP_Lampe");
            write("[4] ... KO1_Airbag_Lampe");
            write("[5] ... KO1_Brems_Lampe");
            write("[6] ... KO1_Bremsinfo");
            write("[7] ... KO1_Handbremse");
            write("[8] ... KO1_Kuehlmittel");
            write("[9] ... KO1_LDW_AnzFeh");
            write("[10] ... KO1_La_Ladekon");
            write("[11] ... KO1_Lenkh_Lampe");
            write("[12] ... KO1_OBD_Tank");
            write("[13] ... KO1_Oeldruck");
            write("[14] ... KO1_Quelle_kmh");
            write("[15] ... KO1_SILA_gueltig");
            write("[16] ... KO1_SleepInd");
            write("[17] ... KO1_Sta_Oeldr");
            write("[18] ... KO1_Sta_Tank");
            write("[19] ... KO1_Stellglieder");
            write("[20] ... KO1_Tankinhalt");
            write("[21] ... KO1_Tankstop");
            write("[22] ... KO1_Vorgluehen");
            write("[23] ... KO1_Wakeup_Komfort");
            write("[24] ... KO1_Warn_Tank");
            write("[25] ... KO1_Zaehler");
            write("[26] ... KO1_Zeitluecke");
            write("[27] ... KO1_angez_kmh");
            write("[28] ... KO1_kmh");
            write("[29] ... KO1_kmh_mph");
        }
        break;
        case FRM_HANDLE_Kombi_2:
        {
            write("[0] ... KB2_Auto_eKiSi");
            write("[1] ... KB2_EasyEntry");
            write("[2] ... KB2_MFA_Strecke_Einheit");
            write("[3] ... KB2_Req_IstZu_Solldruecke");
            write("[4] ... KBI_rotes_P_verbaut");
            write("[5] ... KO2_Aussen_T");
            write("[6] ... KO2_Bel_Displ");
            write("[7] ... KO2_Bel_Schalt");
            write("[8] ... KO2_Fehlereintr");
            write("[9] ... KO2_GRA_High");
            write("[10] ... KO2_MFA_v_Einheit");
            write("[11] ... KO2_OBD_Nib_Temp");
            write("[12] ... KO2_Oelwarn");
            write("[13] ... KO2_PLA_Displaystatus");
            write("[14] ... KO2_Passiv_Autolock");
            write("[15] ... KO2_Sta_Auss_T");
            write("[16] ... KO2_Sta_Displ");
            write("[17] ... KO2_Sta_Schalt");
            write("[18] ... KO2_Temp_Einheit");
            write("[19] ... KO2_Verb_TOG");
            write("[20] ... KO2_WFS_Schl_Ort");
            write("[21] ... KO2_Wischwasser");
            write("[22] ... KO2_gef_Auss_T");
            write("[23] ... KO_Segeln_Menuestatus");
            write("[24] ... KO_Segeln_Zustandswechsel");
        }
        break;
        case FRM_HANDLE_NMH_Gateway:
        {
            write("[0] ... NMH_GW_Abschaltstufe_aktiv");
            write("[1] ... NMH_GW_CAN_Diag_deaktiv");
            write("[2] ... NMH_GW_Car_WakeUp");
            write("[3] ... NMH_GW_Eindraht_Fehler");
            write("[4] ... NMH_GW_Fkt_WakeUp");
            write("[5] ... NMH_GW_KompSchutz");
            write("[6] ... NMH_GW_Mute_Mode");
            write("[7] ... NMH_GW_NL_0");
            write("[8] ... NMH_GW_NL_1");
            write("[9] ... NMH_GW_NL_2");
            write("[10] ... NMH_GW_NL_3");
            write("[11] ... NMH_GW_NL_4");
            write("[12] ... NMH_GW_NL_5");
            write("[13] ... NMH_GW_NL_6");
            write("[14] ... NMH_GW_NL_7");
            write("[15] ... NMH_GW_NL_aktiv_4");
            write("[16] ... NMH_GW_NL_aktiv_5");
            write("[17] ... NMH_GW_NL_aktiv_6");
            write("[18] ... NMH_GW_NL_aktiv_7");
            write("[19] ... NMH_GW_NL_aktiv_8");
            write("[20] ... NMH_GW_NM_aktiv_Diagnose");
            write("[21] ... NMH_GW_NM_aktiv_Klemme_15");
            write("[22] ... NMH_GW_NM_aktiv_Start");
            write("[23] ... NMH_GW_Normal_Mode_1");
            write("[24] ... NMH_GW_Normal_Mode_2");
            write("[25] ... NMH_GW_Per_WakeUp");
            write("[26] ... NMH_GW_Start_1");
            write("[27] ... NMH_GW_Start_2");
            write("[28] ... NMH_GW_TimeOut_Fehler");
            write("[29] ... NMH_GW_Transport_Mode");
        }
        break;
        case FRM_HANDLE_Waehlhebel_1:
        {
            write("[0] ... WH1_Init");
            write("[1] ... WH1_Position");
            write("[2] ... WH1_Position_inv");
            write("[3] ... WH1_StaShiftlock");
            write("[4] ... WH1_Status");
            write("[5] ... WH1_Taster_betaetigt");
            write("[6] ... WH1_Test_Flag");
            write("[7] ... WH1_Testergebnis");
            write("[8] ... WH1_Zaehler");
        }
        break;

    }
}

/*@@caplFunc:HelpSignal():*/
HelpSignal ()
{
    //REPLACE_HELP_SIGNAL
}
/*@@end*/

/*@@caplFunc:GetFrameName(int):*/
GetFrameName (int FrmIdx)
{
    switch (FrmIdx)
    {
        case FRM_HANDLE_ACC_System:
            strncpy(CaplCtrl_FrameName, "ACC_System", 11);
            break;
        case FRM_HANDLE_Airbag_1:
            strncpy(CaplCtrl_FrameName, "Airbag_1", 9);
            break;
        case FRM_HANDLE_BSG_Last:
            strncpy(CaplCtrl_FrameName, "BSG_Last", 9);
            break;
        case FRM_HANDLE_Bremse_1:
            strncpy(CaplCtrl_FrameName, "Bremse_1", 9);
            break;
        case FRM_HANDLE_Bremse_3:
            strncpy(CaplCtrl_FrameName, "Bremse_3", 9);
            break;
        case FRM_HANDLE_Charisma_01:
            strncpy(CaplCtrl_FrameName, "Charisma_01", 12);
            break;
        case FRM_HANDLE_Clima_1:
            strncpy(CaplCtrl_FrameName, "Clima_1", 8);
            break;
        case FRM_HANDLE_Diagnose_1:
            strncpy(CaplCtrl_FrameName, "Diagnose_1", 11);
            break;
        case FRM_HANDLE_EKompKlima_1:
            strncpy(CaplCtrl_FrameName, "EKompKlima_1", 13);
            break;
        case FRM_HANDLE_GRA_Neu:
            strncpy(CaplCtrl_FrameName, "GRA_Neu", 8);
            break;
        case FRM_HANDLE_Gate_Komf_1:
            strncpy(CaplCtrl_FrameName, "Gate_Komf_1", 12);
            break;
        case FRM_HANDLE_Gate_Komf_4:
            strncpy(CaplCtrl_FrameName, "Gate_Komf_4", 12);
            break;
        case FRM_HANDLE_Klima_EV_1:
            strncpy(CaplCtrl_FrameName, "Klima_EV_1", 11);
            break;
        case FRM_HANDLE_Kombi_1:
            strncpy(CaplCtrl_FrameName, "Kombi_1", 8);
            break;
        case FRM_HANDLE_Kombi_2:
            strncpy(CaplCtrl_FrameName, "Kombi_2", 8);
            break;
        case FRM_HANDLE_NMH_Gateway:
            strncpy(CaplCtrl_FrameName, "NMH_Gateway", 12);
            break;
        case FRM_HANDLE_Waehlhebel_1:
            strncpy(CaplCtrl_FrameName, "Waehlhebel_1", 13);
            break;
    }
}
/*@@end*/

/*@@caplFunc:GetSignalName(int,int):*/
GetSignalName (int FrmIdx, int SigIdx)
{
    switch (FrmIdx)
    {
        case FRM_HANDLE_ACC_System:
        {
            switch (SigIdx)
            {
                case 0:
                    strncpy(CaplCtrl_SignalName, "ACS_ADR_Schub", 14);
                    break;
                case 1:
                    strncpy(CaplCtrl_SignalName, "ACS_Anhaltewunsch", 18);
                    break;
                case 2:
                    strncpy(CaplCtrl_SignalName, "ACS_Checksum", 13);
                    break;
                case 3:
                    strncpy(CaplCtrl_SignalName, "ACS_Fehler", 11);
                    break;
                case 4:
                    strncpy(CaplCtrl_SignalName, "ACS_FreigSollB", 15);
                    break;
                case 5:
                    strncpy(CaplCtrl_SignalName, "ACS_MomEingriff", 16);
                    break;
                case 6:
                    strncpy(CaplCtrl_SignalName, "ACS_Schubabsch", 15);
                    break;
                case 7:
                    strncpy(CaplCtrl_SignalName, "ACS_Sollbeschl", 15);
                    break;
                case 8:
                    strncpy(CaplCtrl_SignalName, "ACS_StSt_Info", 14);
                    break;
                case 9:
                    strncpy(CaplCtrl_SignalName, "ACS_Sta_ADR", 12);
                    break;
                case 10:
                    strncpy(CaplCtrl_SignalName, "ACS_Typ_ACC", 12);
                    break;
                case 11:
                    strncpy(CaplCtrl_SignalName, "ACS_Zaehler", 12);
                    break;
                case 12:
                    strncpy(CaplCtrl_SignalName, "ACS_max_AendGrad", 17);
                    break;
                case 13:
                    strncpy(CaplCtrl_SignalName, "ACS_zul_Regelabw", 17);
                    break;
            }
        }
        break;
        case FRM_HANDLE_Airbag_1:
        {
            switch (SigIdx)
            {
                case 0:
                    strncpy(CaplCtrl_SignalName, "AB1_BF_Warnung", 15);
                    break;
                case 1:
                    strncpy(CaplCtrl_SignalName, "AB1_Beifahrer", 14);
                    break;
                case 2:
                    strncpy(CaplCtrl_SignalName, "AB1_Bf_Seite", 13);
                    break;
                case 3:
                    strncpy(CaplCtrl_SignalName, "AB1_Checksumme", 15);
                    break;
                case 4:
                    strncpy(CaplCtrl_SignalName, "AB1_Diagnose", 13);
                    break;
                case 5:
                    strncpy(CaplCtrl_SignalName, "AB1_Fa_Seite", 13);
                    break;
                case 6:
                    strncpy(CaplCtrl_SignalName, "AB1_Fehlereintr", 16);
                    break;
                case 7:
                    strncpy(CaplCtrl_SignalName, "AB1_Front", 10);
                    break;
                case 8:
                    strncpy(CaplCtrl_SignalName, "AB1_Gurt_Bf", 12);
                    break;
                case 9:
                    strncpy(CaplCtrl_SignalName, "AB1_Gurt_Fa", 12);
                    break;
                case 10:
                    strncpy(CaplCtrl_SignalName, "AB1_Heck", 9);
                    break;
                case 11:
                    strncpy(CaplCtrl_SignalName, "AB1_Intens", 11);
                    break;
                case 12:
                    strncpy(CaplCtrl_SignalName, "AB1_Lampe", 10);
                    break;
                case 13:
                    strncpy(CaplCtrl_SignalName, "AB1_Rollover", 13);
                    break;
                case 14:
                    strncpy(CaplCtrl_SignalName, "AB1_Status", 11);
                    break;
                case 15:
                    strncpy(CaplCtrl_SignalName, "AB1_Stellglied", 15);
                    break;
                case 16:
                    strncpy(CaplCtrl_SignalName, "AB1_System", 11);
                    break;
                case 17:
                    strncpy(CaplCtrl_SignalName, "AB1_Zaehler", 12);
                    break;
            }
        }
        break;
        case FRM_HANDLE_BSG_Last:
        {
            switch (SigIdx)
            {
                case 0:
                    strncpy(CaplCtrl_SignalName, "BSL_Ab_Batterie", 16);
                    break;
                case 1:
                    strncpy(CaplCtrl_SignalName, "BSL_Aussensp", 13);
                    break;
                case 2:
                    strncpy(CaplCtrl_SignalName, "BSL_BSG_2_alt", 14);
                    break;
                case 3:
                    strncpy(CaplCtrl_SignalName, "BSL_BSG_3_alt", 14);
                    break;
                case 4:
                    strncpy(CaplCtrl_SignalName, "BSL_Clima", 10);
                    break;
                case 5:
                    strncpy(CaplCtrl_SignalName, "BSL_Fehlereintr", 16);
                    break;
                case 6:
                    strncpy(CaplCtrl_SignalName, "BSL_Frontsch", 13);
                    break;
                case 7:
                    strncpy(CaplCtrl_SignalName, "BSL_Hecksch", 12);
                    break;
                case 8:
                    strncpy(CaplCtrl_SignalName, "BSL_Kl_15_Motor", 16);
                    break;
                case 9:
                    strncpy(CaplCtrl_SignalName, "BSL_Kl_L", 9);
                    break;
                case 10:
                    strncpy(CaplCtrl_SignalName, "BSL_Kuehlerlueft", 17);
                    break;
                case 11:
                    strncpy(CaplCtrl_SignalName, "BSL_LL_Anheb", 13);
                    break;
                case 12:
                    strncpy(CaplCtrl_SignalName, "BSL_LL_Anheb2", 14);
                    break;
                case 13:
                    strncpy(CaplCtrl_SignalName, "BSL_Lenkradheiz", 16);
                    break;
                case 14:
                    strncpy(CaplCtrl_SignalName, "BSL_Motor_Haube", 16);
                    break;
                case 15:
                    strncpy(CaplCtrl_SignalName, "BSL_Parklicht", 14);
                    break;
                case 16:
                    strncpy(CaplCtrl_SignalName, "BSL_Sitzbelueft", 16);
                    break;
                case 17:
                    strncpy(CaplCtrl_SignalName, "BSL_Sitzheiz", 13);
                    break;
                case 18:
                    strncpy(CaplCtrl_SignalName, "BSL_Sta_LWR", 12);
                    break;
                case 19:
                    strncpy(CaplCtrl_SignalName, "BSL_Sta_StBat", 14);
                    break;
                case 20:
                    strncpy(CaplCtrl_SignalName, "BSL_Sta_UBat", 13);
                    break;
                case 21:
                    strncpy(CaplCtrl_SignalName, "BSL_Starterlaubnis", 19);
                    break;
                case 22:
                    strncpy(CaplCtrl_SignalName, "BSL_UBat", 9);
                    break;
                case 23:
                    strncpy(CaplCtrl_SignalName, "BSL_Wake_Up_ACAN", 17);
                    break;
                case 24:
                    strncpy(CaplCtrl_SignalName, "BSL_Wasserheiz", 15);
                    break;
                case 25:
                    strncpy(CaplCtrl_SignalName, "BSL_Weckursache_ACAN", 21);
                    break;
                case 26:
                    strncpy(CaplCtrl_SignalName, "BSL_ZAS_Kl_15", 14);
                    break;
                case 27:
                    strncpy(CaplCtrl_SignalName, "BSL_ZAS_Kl_50", 14);
                    break;
                case 28:
                    strncpy(CaplCtrl_SignalName, "BSL_ZAS_Kl_S", 13);
                    break;
                case 29:
                    strncpy(CaplCtrl_SignalName, "BSL_ZAS_Kl_X", 13);
                    break;
            }
        }
        break;
        case FRM_HANDLE_Bremse_1:
        {
            switch (SigIdx)
            {
                case 0:
                    strncpy(CaplCtrl_SignalName, "BR1_ABS_Brems", 14);
                    break;
                case 1:
                    strncpy(CaplCtrl_SignalName, "BR1_ASRMo_fa", 13);
                    break;
                case 2:
                    strncpy(CaplCtrl_SignalName, "BR1_ASRMo_sl", 13);
                    break;
                case 3:
                    strncpy(CaplCtrl_SignalName, "BR1_ASR_Anf", 12);
                    break;
                case 4:
                    strncpy(CaplCtrl_SignalName, "BR1_ASR_ESP", 12);
                    break;
                case 5:
                    strncpy(CaplCtrl_SignalName, "BR1_ASR_Eingr", 14);
                    break;
                case 6:
                    strncpy(CaplCtrl_SignalName, "BR1_BKV_aktiv", 14);
                    break;
                case 7:
                    strncpy(CaplCtrl_SignalName, "BR1_Diagnose", 13);
                    break;
                case 8:
                    strncpy(CaplCtrl_SignalName, "BR1_EBV_Eingr", 14);
                    break;
                case 9:
                    strncpy(CaplCtrl_SignalName, "BR1_EDS_Eingr", 14);
                    break;
                case 10:
                    strncpy(CaplCtrl_SignalName, "BR1_ESPASR_passiv", 18);
                    break;
                case 11:
                    strncpy(CaplCtrl_SignalName, "BR1_ESP_Eingr", 14);
                    break;
                case 12:
                    strncpy(CaplCtrl_SignalName, "BR1_Ersatz_Kmh", 15);
                    break;
                case 13:
                    strncpy(CaplCtrl_SignalName, "BR1_Lampe_ABS", 14);
                    break;
                case 14:
                    strncpy(CaplCtrl_SignalName, "BR1_Lampe_ASR", 14);
                    break;
                case 15:
                    strncpy(CaplCtrl_SignalName, "BR1_Lampe_BK", 13);
                    break;
                case 16:
                    strncpy(CaplCtrl_SignalName, "BR1_Lichtschalt", 16);
                    break;
                case 17:
                    strncpy(CaplCtrl_SignalName, "BR1_MAD", 8);
                    break;
                case 18:
                    strncpy(CaplCtrl_SignalName, "BR1_MSR_Anf", 12);
                    break;
                case 19:
                    strncpy(CaplCtrl_SignalName, "BR1_MSR_Mo", 11);
                    break;
                case 20:
                    strncpy(CaplCtrl_SignalName, "BR1_MSR_Mo_inv", 15);
                    break;
                case 21:
                    strncpy(CaplCtrl_SignalName, "BR1_Rad_kmh", 12);
                    break;
                case 22:
                    strncpy(CaplCtrl_SignalName, "BR1_StaDruckschw", 17);
                    break;
                case 23:
                    strncpy(CaplCtrl_SignalName, "BR1_Sta_ESP", 12);
                    break;
                case 24:
                    strncpy(CaplCtrl_SignalName, "BR1_Sta_MAD", 12);
                    break;
                case 25:
                    strncpy(CaplCtrl_SignalName, "BR1_Zaehler", 12);
                    break;
            }
        }
        break;
        case FRM_HANDLE_Bremse_3:
        {
            switch (SigIdx)
            {
                case 0:
                    strncpy(CaplCtrl_SignalName, "BR3_Fahrtr_HL", 14);
                    break;
                case 1:
                    strncpy(CaplCtrl_SignalName, "BR3_Fahrtr_HR", 14);
                    break;
                case 2:
                    strncpy(CaplCtrl_SignalName, "BR3_Fahrtr_VL", 14);
                    break;
                case 3:
                    strncpy(CaplCtrl_SignalName, "BR3_Fahrtr_VR", 14);
                    break;
                case 4:
                    strncpy(CaplCtrl_SignalName, "BR3_Rad_kmh_HL", 15);
                    break;
                case 5:
                    strncpy(CaplCtrl_SignalName, "BR3_Rad_kmh_HR", 15);
                    break;
                case 6:
                    strncpy(CaplCtrl_SignalName, "BR3_Rad_kmh_VL", 15);
                    break;
                case 7:
                    strncpy(CaplCtrl_SignalName, "BR3_Rad_kmh_VR", 15);
                    break;
            }
        }
        break;
        case FRM_HANDLE_Charisma_01:
        {
            switch (SigIdx)
            {
                case 0:
                    strncpy(CaplCtrl_SignalName, "CHA_Ziel_FahrPr_GE", 19);
                    break;
                case 1:
                    strncpy(CaplCtrl_SignalName, "CHA_Ziel_FahrPr_MO", 19);
                    break;
            }
        }
        break;
        case FRM_HANDLE_Clima_1:
        {
            switch (SigIdx)
            {
                case 0:
                    strncpy(CaplCtrl_SignalName, "CL1_AC_Schalter", 16);
                    break;
                case 1:
                    strncpy(CaplCtrl_SignalName, "CL1_Aussentemp", 15);
                    break;
                case 2:
                    strncpy(CaplCtrl_SignalName, "CL1_Druck", 10);
                    break;
                case 3:
                    strncpy(CaplCtrl_SignalName, "CL1_Einheit_Temp", 17);
                    break;
                case 4:
                    strncpy(CaplCtrl_SignalName, "CL1_Fa_Zuheiz", 14);
                    break;
                case 5:
                    strncpy(CaplCtrl_SignalName, "CL1_Fehlereintr", 16);
                    break;
                case 6:
                    strncpy(CaplCtrl_SignalName, "CL1_Frontsch", 13);
                    break;
                case 7:
                    strncpy(CaplCtrl_SignalName, "CL1_Gebl_last", 14);
                    break;
                case 8:
                    strncpy(CaplCtrl_SignalName, "CL1_Hecksch", 12);
                    break;
                case 9:
                    strncpy(CaplCtrl_SignalName, "CL1_Heizleist", 14);
                    break;
                case 10:
                    strncpy(CaplCtrl_SignalName, "CL1_Kompr_Last", 15);
                    break;
                case 11:
                    strncpy(CaplCtrl_SignalName, "CL1_Kompressor", 15);
                    break;
                case 12:
                    strncpy(CaplCtrl_SignalName, "CL1_LL_Dz", 10);
                    break;
                case 13:
                    strncpy(CaplCtrl_SignalName, "CL1_Luefter", 12);
                    break;
                case 14:
                    strncpy(CaplCtrl_SignalName, "CL1_PTC_Hzg", 12);
                    break;
                case 15:
                    strncpy(CaplCtrl_SignalName, "CL1_Restwaerme", 15);
                    break;
                case 16:
                    strncpy(CaplCtrl_SignalName, "CL1_Sta_Druck", 14);
                    break;
                case 17:
                    strncpy(CaplCtrl_SignalName, "CL1_Sta_Moment", 15);
                    break;
                case 18:
                    strncpy(CaplCtrl_SignalName, "CL1_WAPU_Zuschaltung", 21);
                    break;
                case 19:
                    strncpy(CaplCtrl_SignalName, "KL_Thermomanagement", 20);
                    break;
            }
        }
        break;
        case FRM_HANDLE_Diagnose_1:
        {
            switch (SigIdx)
            {
                case 0:
                    strncpy(CaplCtrl_SignalName, "DI1_Jahr", 9);
                    break;
                case 1:
                    strncpy(CaplCtrl_SignalName, "DI1_KM_Stand_alt", 17);
                    break;
                case 2:
                    strncpy(CaplCtrl_SignalName, "DI1_Minute", 11);
                    break;
                case 3:
                    strncpy(CaplCtrl_SignalName, "DI1_Monat", 10);
                    break;
                case 4:
                    strncpy(CaplCtrl_SignalName, "DI1_Sekunde", 12);
                    break;
                case 5:
                    strncpy(CaplCtrl_SignalName, "DI1_Stunde", 11);
                    break;
                case 6:
                    strncpy(CaplCtrl_SignalName, "DI1_Tag", 8);
                    break;
                case 7:
                    strncpy(CaplCtrl_SignalName, "DI1_VerlernZaehl", 17);
                    break;
                case 8:
                    strncpy(CaplCtrl_SignalName, "DI1_Zeit_alt", 13);
                    break;
                case 9:
                    strncpy(CaplCtrl_SignalName, "DI1_km_Stand", 13);
                    break;
            }
        }
        break;
        case FRM_HANDLE_EKompKlima_1:
        {
            switch (SigIdx)
            {
                case 0:
                    strncpy(CaplCtrl_SignalName, "EK1_Comp_Inv_stat", 18);
                    break;
                case 1:
                    strncpy(CaplCtrl_SignalName, "EK1_Comp_SCI_com_stat", 22);
                    break;
                case 2:
                    strncpy(CaplCtrl_SignalName, "EK1_Comp_current", 17);
                    break;
                case 3:
                    strncpy(CaplCtrl_SignalName, "EK1_Comp_main_stat", 19);
                    break;
                case 4:
                    strncpy(CaplCtrl_SignalName, "EK1_Comp_output_stat", 21);
                    break;
                case 5:
                    strncpy(CaplCtrl_SignalName, "EK1_Comp_ovld_stat", 19);
                    break;
                case 6:
                    strncpy(CaplCtrl_SignalName, "EK1_Comp_photo_temp", 20);
                    break;
                case 7:
                    strncpy(CaplCtrl_SignalName, "EK1_Comp_photo_temp_stat", 25);
                    break;
                case 8:
                    strncpy(CaplCtrl_SignalName, "EK1_Comp_rev_stat", 18);
                    break;
                case 9:
                    strncpy(CaplCtrl_SignalName, "EK1_KD_Fehler", 14);
                    break;
            }
        }
        break;
        case FRM_HANDLE_GRA_Neu:
        {
            switch (SigIdx)
            {
                case 0:
                    strncpy(CaplCtrl_SignalName, "GRA_Abbrechen", 14);
                    break;
                case 1:
                    strncpy(CaplCtrl_SignalName, "GRA_Checksum", 13);
                    break;
                case 2:
                    strncpy(CaplCtrl_SignalName, "GRA_Down_kurz", 14);
                    break;
                case 3:
                    strncpy(CaplCtrl_SignalName, "GRA_Down_lang", 14);
                    break;
                case 4:
                    strncpy(CaplCtrl_SignalName, "GRA_Fehler_Bed", 15);
                    break;
                case 5:
                    strncpy(CaplCtrl_SignalName, "GRA_Fehler_Tip", 15);
                    break;
                case 6:
                    strncpy(CaplCtrl_SignalName, "GRA_Hauptschalt", 16);
                    break;
                case 7:
                    strncpy(CaplCtrl_SignalName, "GRA_Kodierinfo", 15);
                    break;
                case 8:
                    strncpy(CaplCtrl_SignalName, "GRA_Neu_Setzen", 15);
                    break;
                case 9:
                    strncpy(CaplCtrl_SignalName, "GRA_Neu_Zaehler", 16);
                    break;
                case 10:
                    strncpy(CaplCtrl_SignalName, "GRA_Recall", 11);
                    break;
                case 11:
                    strncpy(CaplCtrl_SignalName, "GRA_Sender", 11);
                    break;
                case 12:
                    strncpy(CaplCtrl_SignalName, "GRA_Sportschalter", 18);
                    break;
                case 13:
                    strncpy(CaplCtrl_SignalName, "GRA_Sta_Limiter", 16);
                    break;
                case 14:
                    strncpy(CaplCtrl_SignalName, "GRA_Tip_Down", 13);
                    break;
                case 15:
                    strncpy(CaplCtrl_SignalName, "GRA_Tip_Up", 11);
                    break;
                case 16:
                    strncpy(CaplCtrl_SignalName, "GRA_Typ_Hauptschalt", 20);
                    break;
                case 17:
                    strncpy(CaplCtrl_SignalName, "GRA_Up_kurz", 12);
                    break;
                case 18:
                    strncpy(CaplCtrl_SignalName, "GRA_Up_lang", 12);
                    break;
                case 19:
                    strncpy(CaplCtrl_SignalName, "GRA_Zeitluecke", 15);
                    break;
            }
        }
        break;
        case FRM_HANDLE_Gate_Komf_1:
        {
            switch (SigIdx)
            {
                case 0:
                    strncpy(CaplCtrl_SignalName, "BCM_CV_Taster", 14);
                    break;
                case 1:
                    strncpy(CaplCtrl_SignalName, "BCM_Offroad_Taster", 19);
                    break;
                case 2:
                    strncpy(CaplCtrl_SignalName, "BCM_Remotestart_Betrieb", 24);
                    break;
                case 3:
                    strncpy(CaplCtrl_SignalName, "BSK_BT_geoeffnet", 17);
                    break;
                case 4:
                    strncpy(CaplCtrl_SignalName, "BSK_HD_Hauptraste", 18);
                    break;
                case 5:
                    strncpy(CaplCtrl_SignalName, "BSK_HL_geoeffnet", 17);
                    break;
                case 6:
                    strncpy(CaplCtrl_SignalName, "BSK_HR_geoeffnet", 17);
                    break;
                case 7:
                    strncpy(CaplCtrl_SignalName, "GK1_Abbl_VL_def", 16);
                    break;
                case 8:
                    strncpy(CaplCtrl_SignalName, "GK1_Abbl_VR_def", 16);
                    break;
                case 9:
                    strncpy(CaplCtrl_SignalName, "GK1_Abblendlicht", 17);
                    break;
                case 10:
                    strncpy(CaplCtrl_SignalName, "GK1_AnhKonLamp", 15);
                    break;
                case 11:
                    strncpy(CaplCtrl_SignalName, "GK1_Anh_abgesteckt", 19);
                    break;
                case 12:
                    strncpy(CaplCtrl_SignalName, "GK1_Anhaenger", 14);
                    break;
                case 13:
                    strncpy(CaplCtrl_SignalName, "GK1_BLS_ILM", 12);
                    break;
                case 14:
                    strncpy(CaplCtrl_SignalName, "GK1_Blink_Autob", 16);
                    break;
                case 15:
                    strncpy(CaplCtrl_SignalName, "GK1_Blinker_li", 15);
                    break;
                case 16:
                    strncpy(CaplCtrl_SignalName, "GK1_Blinker_re", 15);
                    break;
                case 17:
                    strncpy(CaplCtrl_SignalName, "GK1_BrLi_Anhaen", 16);
                    break;
                case 18:
                    strncpy(CaplCtrl_SignalName, "GK1_BrLi_links", 15);
                    break;
                case 19:
                    strncpy(CaplCtrl_SignalName, "GK1_BrLi_mitte", 15);
                    break;
                case 20:
                    strncpy(CaplCtrl_SignalName, "GK1_BrLi_rechts", 16);
                    break;
                case 21:
                    strncpy(CaplCtrl_SignalName, "GK1_Bremslicht", 15);
                    break;
                case 22:
                    strncpy(CaplCtrl_SignalName, "GK1_CharismaModus", 18);
                    break;
                case 23:
                    strncpy(CaplCtrl_SignalName, "GK1_DriveSelectModus_1", 23);
                    break;
                case 24:
                    strncpy(CaplCtrl_SignalName, "GK1_DriveSelectModus_2", 23);
                    break;
                case 25:
                    strncpy(CaplCtrl_SignalName, "GK1_EDC_ILM", 12);
                    break;
                case 26:
                    strncpy(CaplCtrl_SignalName, "GK1_ELV_verrieg", 16);
                    break;
                case 27:
                    strncpy(CaplCtrl_SignalName, "GK1_EfficiencyModus", 20);
                    break;
                case 28:
                    strncpy(CaplCtrl_SignalName, "GK1_Fa_Tuerkont", 16);
                    break;
                case 29:
                    strncpy(CaplCtrl_SignalName, "GK1_Fernlicht", 14);
                    break;
                case 30:
                    strncpy(CaplCtrl_SignalName, "GK1_KW_Warm", 12);
                    break;
                case 31:
                    strncpy(CaplCtrl_SignalName, "GK1_LS1_Fernlicht", 18);
                    break;
                case 32:
                    strncpy(CaplCtrl_SignalName, "GK1_Nebel_ein", 14);
                    break;
                case 33:
                    strncpy(CaplCtrl_SignalName, "GK1_ParkFrontWi", 16);
                    break;
                case 34:
                    strncpy(CaplCtrl_SignalName, "GK1_Rueckfahr", 14);
                    break;
                case 35:
                    strncpy(CaplCtrl_SignalName, "GK1_RueckfahrSch", 17);
                    break;
                case 36:
                    strncpy(CaplCtrl_SignalName, "GK1_SH_Verbau", 14);
                    break;
                case 37:
                    strncpy(CaplCtrl_SignalName, "GK1_SH_Zusatzfkt", 17);
                    break;
                case 38:
                    strncpy(CaplCtrl_SignalName, "GK1_SH_laeuft", 14);
                    break;
                case 39:
                    strncpy(CaplCtrl_SignalName, "GK1_SamFktNr", 13);
                    break;
                case 40:
                    strncpy(CaplCtrl_SignalName, "GK1_SleepAckn", 14);
                    break;
                case 41:
                    strncpy(CaplCtrl_SignalName, "GK1_SportModus", 15);
                    break;
                case 42:
                    strncpy(CaplCtrl_SignalName, "GK1_Sta_Anhaen", 15);
                    break;
                case 43:
                    strncpy(CaplCtrl_SignalName, "GK1_Sta_ILM_F_1", 16);
                    break;
                case 44:
                    strncpy(CaplCtrl_SignalName, "GK1_Sta_Kessy_2", 16);
                    break;
                case 45:
                    strncpy(CaplCtrl_SignalName, "GK1_Sta_LSM", 12);
                    break;
                case 46:
                    strncpy(CaplCtrl_SignalName, "GK1_Sta_Li_vorn", 16);
                    break;
                case 47:
                    strncpy(CaplCtrl_SignalName, "GK1_Sta_Licht1", 15);
                    break;
                case 48:
                    strncpy(CaplCtrl_SignalName, "GK1_Sta_Licht2", 15);
                    break;
                case 49:
                    strncpy(CaplCtrl_SignalName, "GK1_Sta_Licht3", 15);
                    break;
            }

            switch (SigIdx)
            {
                case 50:
                    strncpy(CaplCtrl_SignalName, "GK1_Sta_RDK_Warn", 17);
                    break;
                case 51:
                    strncpy(CaplCtrl_SignalName, "GK1_Sta_Stdhzg", 15);
                    break;
                case 52:
                    strncpy(CaplCtrl_SignalName, "GK1_Sta_Tuerkont", 17);
                    break;
                case 53:
                    strncpy(CaplCtrl_SignalName, "GK1_Warnblk_Status", 19);
                    break;
                case 54:
                    strncpy(CaplCtrl_SignalName, "GK1_Wischer_vorn", 17);
                    break;
                case 55:
                    strncpy(CaplCtrl_SignalName, "GK1_def_P_verr", 15);
                    break;
                case 56:
                    strncpy(CaplCtrl_SignalName, "LDS_Stellung_AFL", 17);
                    break;
                case 57:
                    strncpy(CaplCtrl_SignalName, "SH1_ein_Wasserpumpe", 20);
                    break;
                case 58:
                    strncpy(CaplCtrl_SignalName, "WI1_Front_Wasch", 16);
                    break;
            }
        }
        break;
        case FRM_HANDLE_Gate_Komf_4:
        {
            switch (SigIdx)
            {
                case 0:
                    strncpy(CaplCtrl_SignalName, "GK1_Sta_LSM", 12);
                    break;
                case 1:
                    strncpy(CaplCtrl_SignalName, "GK4_Ladesteckerentr_Anf", 24);
                    break;
                case 2:
                    strncpy(CaplCtrl_SignalName, "GK4_Sta_MFA_6", 14);
                    break;
                case 3:
                    strncpy(CaplCtrl_SignalName, "LS1_P_verriegelt", 17);
                    break;
                case 4:
                    strncpy(CaplCtrl_SignalName, "MA6_Reichweite", 15);
                    break;
                case 5:
                    strncpy(CaplCtrl_SignalName, "MA6_km_Reichweite", 18);
                    break;
                case 6:
                    strncpy(CaplCtrl_SignalName, "MA6_mls_Reichweite", 19);
                    break;
            }
        }
        break;
        case FRM_HANDLE_Klima_EV_1:
        {
            switch (SigIdx)
            {
                case 0:
                    strncpy(CaplCtrl_SignalName, "EKK_Status", 11);
                    break;
                case 1:
                    strncpy(CaplCtrl_SignalName, "EKK_Status_Vorstrg", 19);
                    break;
                case 2:
                    strncpy(CaplCtrl_SignalName, "EKK_Strom", 10);
                    break;
                case 3:
                    strncpy(CaplCtrl_SignalName, "KL_Charisma_FahrPr", 19);
                    break;
                case 4:
                    strncpy(CaplCtrl_SignalName, "KL_Charisma_Status", 19);
                    break;
                case 5:
                    strncpy(CaplCtrl_SignalName, "KL_HV_Anf", 10);
                    break;
                case 6:
                    strncpy(CaplCtrl_SignalName, "KL_HV_ein", 10);
                    break;
                case 7:
                    strncpy(CaplCtrl_SignalName, "KL_Innengeblaese", 17);
                    break;
                case 8:
                    strncpy(CaplCtrl_SignalName, "KL_Kompr_Drehzahl_Soll", 23);
                    break;
                case 9:
                    strncpy(CaplCtrl_SignalName, "KL_PTC_Soll", 12);
                    break;
                case 10:
                    strncpy(CaplCtrl_SignalName, "KL_Standklima_Status", 21);
                    break;
                case 11:
                    strncpy(CaplCtrl_SignalName, "KL_Standklima_Strg_Kluefter", 28);
                    break;
                case 12:
                    strncpy(CaplCtrl_SignalName, "KL_Ventil_Batterie_Anf", 23);
                    break;
                case 13:
                    strncpy(CaplCtrl_SignalName, "KL_Ventil_vor_Motor_Anf", 24);
                    break;
                case 14:
                    strncpy(CaplCtrl_SignalName, "KL_Wake_Up_ACAN", 16);
                    break;
                case 15:
                    strncpy(CaplCtrl_SignalName, "PTC_Pumpe_Ist", 14);
                    break;
                case 16:
                    strncpy(CaplCtrl_SignalName, "PTC_Pumpe_Status", 17);
                    break;
                case 17:
                    strncpy(CaplCtrl_SignalName, "PTC_Strom", 10);
                    break;
            }
        }
        break;
        case FRM_HANDLE_Kombi_1:
        {
            switch (SigIdx)
            {
                case 0:
                    strncpy(CaplCtrl_SignalName, "KO1_ABS_Lampe", 14);
                    break;
                case 1:
                    strncpy(CaplCtrl_SignalName, "KO1_ACC_AnzFhl", 15);
                    break;
                case 2:
                    strncpy(CaplCtrl_SignalName, "KO1_ACC_Inkons", 15);
                    break;
                case 3:
                    strncpy(CaplCtrl_SignalName, "KO1_ASRESP_Lampe", 17);
                    break;
                case 4:
                    strncpy(CaplCtrl_SignalName, "KO1_Airbag_Lampe", 17);
                    break;
                case 5:
                    strncpy(CaplCtrl_SignalName, "KO1_Brems_Lampe", 16);
                    break;
                case 6:
                    strncpy(CaplCtrl_SignalName, "KO1_Bremsinfo", 14);
                    break;
                case 7:
                    strncpy(CaplCtrl_SignalName, "KO1_Handbremse", 15);
                    break;
                case 8:
                    strncpy(CaplCtrl_SignalName, "KO1_Kuehlmittel", 16);
                    break;
                case 9:
                    strncpy(CaplCtrl_SignalName, "KO1_LDW_AnzFeh", 15);
                    break;
                case 10:
                    strncpy(CaplCtrl_SignalName, "KO1_La_Ladekon", 15);
                    break;
                case 11:
                    strncpy(CaplCtrl_SignalName, "KO1_Lenkh_Lampe", 16);
                    break;
                case 12:
                    strncpy(CaplCtrl_SignalName, "KO1_OBD_Tank", 13);
                    break;
                case 13:
                    strncpy(CaplCtrl_SignalName, "KO1_Oeldruck", 13);
                    break;
                case 14:
                    strncpy(CaplCtrl_SignalName, "KO1_Quelle_kmh", 15);
                    break;
                case 15:
                    strncpy(CaplCtrl_SignalName, "KO1_SILA_gueltig", 17);
                    break;
                case 16:
                    strncpy(CaplCtrl_SignalName, "KO1_SleepInd", 13);
                    break;
                case 17:
                    strncpy(CaplCtrl_SignalName, "KO1_Sta_Oeldr", 14);
                    break;
                case 18:
                    strncpy(CaplCtrl_SignalName, "KO1_Sta_Tank", 13);
                    break;
                case 19:
                    strncpy(CaplCtrl_SignalName, "KO1_Stellglieder", 17);
                    break;
                case 20:
                    strncpy(CaplCtrl_SignalName, "KO1_Tankinhalt", 15);
                    break;
                case 21:
                    strncpy(CaplCtrl_SignalName, "KO1_Tankstop", 13);
                    break;
                case 22:
                    strncpy(CaplCtrl_SignalName, "KO1_Vorgluehen", 15);
                    break;
                case 23:
                    strncpy(CaplCtrl_SignalName, "KO1_Wakeup_Komfort", 19);
                    break;
                case 24:
                    strncpy(CaplCtrl_SignalName, "KO1_Warn_Tank", 14);
                    break;
                case 25:
                    strncpy(CaplCtrl_SignalName, "KO1_Zaehler", 12);
                    break;
                case 26:
                    strncpy(CaplCtrl_SignalName, "KO1_Zeitluecke", 15);
                    break;
                case 27:
                    strncpy(CaplCtrl_SignalName, "KO1_angez_kmh", 14);
                    break;
                case 28:
                    strncpy(CaplCtrl_SignalName, "KO1_kmh", 8);
                    break;
                case 29:
                    strncpy(CaplCtrl_SignalName, "KO1_kmh_mph", 12);
                    break;
            }
        }
        break;
        case FRM_HANDLE_Kombi_2:
        {
            switch (SigIdx)
            {
                case 0:
                    strncpy(CaplCtrl_SignalName, "KB2_Auto_eKiSi", 15);
                    break;
                case 1:
                    strncpy(CaplCtrl_SignalName, "KB2_EasyEntry", 14);
                    break;
                case 2:
                    strncpy(CaplCtrl_SignalName, "KB2_MFA_Strecke_Einheit", 24);
                    break;
                case 3:
                    strncpy(CaplCtrl_SignalName, "KB2_Req_IstZu_Solldruecke", 26);
                    break;
                case 4:
                    strncpy(CaplCtrl_SignalName, "KBI_rotes_P_verbaut", 20);
                    break;
                case 5:
                    strncpy(CaplCtrl_SignalName, "KO2_Aussen_T", 13);
                    break;
                case 6:
                    strncpy(CaplCtrl_SignalName, "KO2_Bel_Displ", 14);
                    break;
                case 7:
                    strncpy(CaplCtrl_SignalName, "KO2_Bel_Schalt", 15);
                    break;
                case 8:
                    strncpy(CaplCtrl_SignalName, "KO2_Fehlereintr", 16);
                    break;
                case 9:
                    strncpy(CaplCtrl_SignalName, "KO2_GRA_High", 13);
                    break;
                case 10:
                    strncpy(CaplCtrl_SignalName, "KO2_MFA_v_Einheit", 18);
                    break;
                case 11:
                    strncpy(CaplCtrl_SignalName, "KO2_OBD_Nib_Temp", 17);
                    break;
                case 12:
                    strncpy(CaplCtrl_SignalName, "KO2_Oelwarn", 12);
                    break;
                case 13:
                    strncpy(CaplCtrl_SignalName, "KO2_PLA_Displaystatus", 22);
                    break;
                case 14:
                    strncpy(CaplCtrl_SignalName, "KO2_Passiv_Autolock", 20);
                    break;
                case 15:
                    strncpy(CaplCtrl_SignalName, "KO2_Sta_Auss_T", 15);
                    break;
                case 16:
                    strncpy(CaplCtrl_SignalName, "KO2_Sta_Displ", 14);
                    break;
                case 17:
                    strncpy(CaplCtrl_SignalName, "KO2_Sta_Schalt", 15);
                    break;
                case 18:
                    strncpy(CaplCtrl_SignalName, "KO2_Temp_Einheit", 17);
                    break;
                case 19:
                    strncpy(CaplCtrl_SignalName, "KO2_Verb_TOG", 13);
                    break;
                case 20:
                    strncpy(CaplCtrl_SignalName, "KO2_WFS_Schl_Ort", 17);
                    break;
                case 21:
                    strncpy(CaplCtrl_SignalName, "KO2_Wischwasser", 16);
                    break;
                case 22:
                    strncpy(CaplCtrl_SignalName, "KO2_gef_Auss_T", 15);
                    break;
                case 23:
                    strncpy(CaplCtrl_SignalName, "KO_Segeln_Menuestatus", 22);
                    break;
                case 24:
                    strncpy(CaplCtrl_SignalName, "KO_Segeln_Zustandswechsel", 26);
                    break;
            }
        }
        break;
        case FRM_HANDLE_NMH_Gateway:
        {
            switch (SigIdx)
            {
                case 0:
                    strncpy(CaplCtrl_SignalName, "NMH_GW_Abschaltstufe_aktiv", 27);
                    break;
                case 1:
                    strncpy(CaplCtrl_SignalName, "NMH_GW_CAN_Diag_deaktiv", 24);
                    break;
                case 2:
                    strncpy(CaplCtrl_SignalName, "NMH_GW_Car_WakeUp", 18);
                    break;
                case 3:
                    strncpy(CaplCtrl_SignalName, "NMH_GW_Eindraht_Fehler", 23);
                    break;
                case 4:
                    strncpy(CaplCtrl_SignalName, "NMH_GW_Fkt_WakeUp", 18);
                    break;
                case 5:
                    strncpy(CaplCtrl_SignalName, "NMH_GW_KompSchutz", 18);
                    break;
                case 6:
                    strncpy(CaplCtrl_SignalName, "NMH_GW_Mute_Mode", 17);
                    break;
                case 7:
                    strncpy(CaplCtrl_SignalName, "NMH_GW_NL_0", 12);
                    break;
                case 8:
                    strncpy(CaplCtrl_SignalName, "NMH_GW_NL_1", 12);
                    break;
                case 9:
                    strncpy(CaplCtrl_SignalName, "NMH_GW_NL_2", 12);
                    break;
                case 10:
                    strncpy(CaplCtrl_SignalName, "NMH_GW_NL_3", 12);
                    break;
                case 11:
                    strncpy(CaplCtrl_SignalName, "NMH_GW_NL_4", 12);
                    break;
                case 12:
                    strncpy(CaplCtrl_SignalName, "NMH_GW_NL_5", 12);
                    break;
                case 13:
                    strncpy(CaplCtrl_SignalName, "NMH_GW_NL_6", 12);
                    break;
                case 14:
                    strncpy(CaplCtrl_SignalName, "NMH_GW_NL_7", 12);
                    break;
                case 15:
                    strncpy(CaplCtrl_SignalName, "NMH_GW_NL_aktiv_4", 18);
                    break;
                case 16:
                    strncpy(CaplCtrl_SignalName, "NMH_GW_NL_aktiv_5", 18);
                    break;
                case 17:
                    strncpy(CaplCtrl_SignalName, "NMH_GW_NL_aktiv_6", 18);
                    break;
                case 18:
                    strncpy(CaplCtrl_SignalName, "NMH_GW_NL_aktiv_7", 18);
                    break;
                case 19:
                    strncpy(CaplCtrl_SignalName, "NMH_GW_NL_aktiv_8", 18);
                    break;
                case 20:
                    strncpy(CaplCtrl_SignalName, "NMH_GW_NM_aktiv_Diagnose", 25);
                    break;
                case 21:
                    strncpy(CaplCtrl_SignalName, "NMH_GW_NM_aktiv_Klemme_15", 26);
                    break;
                case 22:
                    strncpy(CaplCtrl_SignalName, "NMH_GW_NM_aktiv_Start", 22);
                    break;
                case 23:
                    strncpy(CaplCtrl_SignalName, "NMH_GW_Normal_Mode_1", 21);
                    break;
                case 24:
                    strncpy(CaplCtrl_SignalName, "NMH_GW_Normal_Mode_2", 21);
                    break;
                case 25:
                    strncpy(CaplCtrl_SignalName, "NMH_GW_Per_WakeUp", 18);
                    break;
                case 26:
                    strncpy(CaplCtrl_SignalName, "NMH_GW_Start_1", 15);
                    break;
                case 27:
                    strncpy(CaplCtrl_SignalName, "NMH_GW_Start_2", 15);
                    break;
                case 28:
                    strncpy(CaplCtrl_SignalName, "NMH_GW_TimeOut_Fehler", 22);
                    break;
                case 29:
                    strncpy(CaplCtrl_SignalName, "NMH_GW_Transport_Mode", 22);
                    break;
            }
        }
        break;
        case FRM_HANDLE_Waehlhebel_1:
        {
            switch (SigIdx)
            {
                case 0:
                    strncpy(CaplCtrl_SignalName, "WH1_Init", 9);
                    break;
                case 1:
                    strncpy(CaplCtrl_SignalName, "WH1_Position", 13);
                    break;
                case 2:
                    strncpy(CaplCtrl_SignalName, "WH1_Position_inv", 17);
                    break;
                case 3:
                    strncpy(CaplCtrl_SignalName, "WH1_StaShiftlock", 17);
                    break;
                case 4:
                    strncpy(CaplCtrl_SignalName, "WH1_Status", 11);
                    break;
                case 5:
                    strncpy(CaplCtrl_SignalName, "WH1_Taster_betaetigt", 21);
                    break;
                case 6:
                    strncpy(CaplCtrl_SignalName, "WH1_Test_Flag", 14);
                    break;
                case 7:
                    strncpy(CaplCtrl_SignalName, "WH1_Testergebnis", 17);
                    break;
                case 8:
                    strncpy(CaplCtrl_SignalName, "WH1_Zaehler", 12);
                    break;
            }
        }
        break;
    }
}
/*@@end*/

/*@@caplFunc:Frm_SetSignal(long,long,long):*/
Frm_SetSignal (long FrmIdx, long SigIdx, long SigVal)
{
    switch (FrmIdx)
    {
        case FRM_HANDLE_ACC_System:
        {
            switch (SigIdx)
            {
                case 0:
                    MsgObj_ACC_System.ACS_ADR_Schub = SigVal;
                    break;
                case 1:
                    MsgObj_ACC_System.ACS_Anhaltewunsch = SigVal;
                    break;
                case 2:
                    MsgObj_ACC_System.ACS_Checksum = SigVal;
                    break;
                case 3:
                    MsgObj_ACC_System.ACS_Fehler = SigVal;
                    break;
                case 4:
                    MsgObj_ACC_System.ACS_FreigSollB = SigVal;
                    break;
                case 5:
                    MsgObj_ACC_System.ACS_MomEingriff = SigVal;
                    break;
                case 6:
                    MsgObj_ACC_System.ACS_Schubabsch = SigVal;
                    break;
                case 7:
                    MsgObj_ACC_System.ACS_Sollbeschl = SigVal;
                    break;
                case 8:
                    MsgObj_ACC_System.ACS_StSt_Info = SigVal;
                    break;
                case 9:
                    MsgObj_ACC_System.ACS_Sta_ADR = SigVal;
                    break;
                case 10:
                    MsgObj_ACC_System.ACS_Typ_ACC = SigVal;
                    break;
                case 11:
                    MsgObj_ACC_System.ACS_Zaehler = SigVal;
                    break;
                case 12:
                    MsgObj_ACC_System.ACS_max_AendGrad = SigVal;
                    break;
                case 13:
                    MsgObj_ACC_System.ACS_zul_Regelabw = SigVal;
                    break;
            }
        }
        break;
        case FRM_HANDLE_Airbag_1:
        {
            switch (SigIdx)
            {
                case 0:
                    MsgObj_Airbag_1.AB1_BF_Warnung = SigVal;
                    break;
                case 1:
                    MsgObj_Airbag_1.AB1_Beifahrer = SigVal;
                    break;
                case 2:
                    MsgObj_Airbag_1.AB1_Bf_Seite = SigVal;
                    break;
                case 3:
                    MsgObj_Airbag_1.AB1_Checksumme = SigVal;
                    break;
                case 4:
                    MsgObj_Airbag_1.AB1_Diagnose = SigVal;
                    break;
                case 5:
                    MsgObj_Airbag_1.AB1_Fa_Seite = SigVal;
                    break;
                case 6:
                    MsgObj_Airbag_1.AB1_Fehlereintr = SigVal;
                    break;
                case 7:
                    MsgObj_Airbag_1.AB1_Front = SigVal;
                    break;
                case 8:
                    MsgObj_Airbag_1.AB1_Gurt_Bf = SigVal;
                    break;
                case 9:
                    MsgObj_Airbag_1.AB1_Gurt_Fa = SigVal;
                    break;
                case 10:
                    MsgObj_Airbag_1.AB1_Heck = SigVal;
                    break;
                case 11:
                    MsgObj_Airbag_1.AB1_Intens = SigVal;
                    break;
                case 12:
                    MsgObj_Airbag_1.AB1_Lampe = SigVal;
                    break;
                case 13:
                    MsgObj_Airbag_1.AB1_Rollover = SigVal;
                    break;
                case 14:
                    MsgObj_Airbag_1.AB1_Status = SigVal;
                    break;
                case 15:
                    MsgObj_Airbag_1.AB1_Stellglied = SigVal;
                    break;
                case 16:
                    MsgObj_Airbag_1.AB1_System = SigVal;
                    break;
                case 17:
                    MsgObj_Airbag_1.AB1_Zaehler = SigVal;
                    break;
            }
        }
        break;
        case FRM_HANDLE_BSG_Last:
        {
            switch (SigIdx)
            {
                case 0:
                    MsgObj_BSG_Last.BSL_Ab_Batterie = SigVal;
                    break;
                case 1:
                    MsgObj_BSG_Last.BSL_Aussensp = SigVal;
                    break;
                case 2:
                    MsgObj_BSG_Last.BSL_BSG_2_alt = SigVal;
                    break;
                case 3:
                    MsgObj_BSG_Last.BSL_BSG_3_alt = SigVal;
                    break;
                case 4:
                    MsgObj_BSG_Last.BSL_Clima = SigVal;
                    break;
                case 5:
                    MsgObj_BSG_Last.BSL_Fehlereintr = SigVal;
                    break;
                case 6:
                    MsgObj_BSG_Last.BSL_Frontsch = SigVal;
                    break;
                case 7:
                    MsgObj_BSG_Last.BSL_Hecksch = SigVal;
                    break;
                case 8:
                    MsgObj_BSG_Last.BSL_Kl_15_Motor = SigVal;
                    break;
                case 9:
                    MsgObj_BSG_Last.BSL_Kl_L = SigVal;
                    break;
                case 10:
                    MsgObj_BSG_Last.BSL_Kuehlerlueft = SigVal;
                    break;
                case 11:
                    MsgObj_BSG_Last.BSL_LL_Anheb = SigVal;
                    break;
                case 12:
                    MsgObj_BSG_Last.BSL_LL_Anheb2 = SigVal;
                    break;
                case 13:
                    MsgObj_BSG_Last.BSL_Lenkradheiz = SigVal;
                    break;
                case 14:
                    MsgObj_BSG_Last.BSL_Motor_Haube = SigVal;
                    break;
                case 15:
                    MsgObj_BSG_Last.BSL_Parklicht = SigVal;
                    break;
                case 16:
                    MsgObj_BSG_Last.BSL_Sitzbelueft = SigVal;
                    break;
                case 17:
                    MsgObj_BSG_Last.BSL_Sitzheiz = SigVal;
                    break;
                case 18:
                    MsgObj_BSG_Last.BSL_Sta_LWR = SigVal;
                    break;
                case 19:
                    MsgObj_BSG_Last.BSL_Sta_StBat = SigVal;
                    break;
                case 20:
                    MsgObj_BSG_Last.BSL_Sta_UBat = SigVal;
                    break;
                case 21:
                    MsgObj_BSG_Last.BSL_Starterlaubnis = SigVal;
                    break;
                case 22:
                    MsgObj_BSG_Last.BSL_UBat = SigVal;
                    break;
                case 23:
                    MsgObj_BSG_Last.BSL_Wake_Up_ACAN = SigVal;
                    break;
                case 24:
                    MsgObj_BSG_Last.BSL_Wasserheiz = SigVal;
                    break;
                case 25:
                    MsgObj_BSG_Last.BSL_Weckursache_ACAN = SigVal;
                    break;
                case 26:
                    MsgObj_BSG_Last.BSL_ZAS_Kl_15 = SigVal;
                    break;
                case 27:
                    MsgObj_BSG_Last.BSL_ZAS_Kl_50 = SigVal;
                    break;
                case 28:
                    MsgObj_BSG_Last.BSL_ZAS_Kl_S = SigVal;
                    break;
                case 29:
                    MsgObj_BSG_Last.BSL_ZAS_Kl_X = SigVal;
                    break;
            }
        }
        break;
        case FRM_HANDLE_Bremse_1:
        {
            switch (SigIdx)
            {
                case 0:
                    MsgObj_Bremse_1.BR1_ABS_Brems = SigVal;
                    break;
                case 1:
                    MsgObj_Bremse_1.BR1_MSR_Anf = 0;
                    MsgObj_Bremse_1.BR1_ASRMo_fa = SigVal;
                    break;
                case 2:
                    MsgObj_Bremse_1.BR1_ASRMo_sl = SigVal;
                    break;
                case 3:
                    MsgObj_Bremse_1.BR1_ASR_Anf = SigVal;
                    break;
                case 4:
                    MsgObj_Bremse_1.BR1_ASR_ESP = SigVal;
                    break;
                case 5:
                    MsgObj_Bremse_1.BR1_ASR_Eingr = SigVal;
                    break;
                case 6:
                    MsgObj_Bremse_1.BR1_BKV_aktiv = SigVal;
                    break;
                case 7:
                    MsgObj_Bremse_1.BR1_Diagnose = SigVal;
                    break;
                case 8:
                    MsgObj_Bremse_1.BR1_EBV_Eingr = SigVal;
                    break;
                case 9:
                    MsgObj_Bremse_1.BR1_EDS_Eingr = SigVal;
                    break;
                case 10:
                    MsgObj_Bremse_1.BR1_ESPASR_passiv = SigVal;
                    break;
                case 11:
                    MsgObj_Bremse_1.BR1_ESP_Eingr = SigVal;
                    break;
                case 12:
                    MsgObj_Bremse_1.BR1_Ersatz_Kmh = SigVal;
                    break;
                case 13:
                    MsgObj_Bremse_1.BR1_Lampe_ABS = SigVal;
                    break;
                case 14:
                    MsgObj_Bremse_1.BR1_Lampe_ASR = SigVal;
                    break;
                case 15:
                    MsgObj_Bremse_1.BR1_Lampe_BK = SigVal;
                    break;
                case 16:
                    MsgObj_Bremse_1.BR1_Lichtschalt = SigVal;
                    break;
                case 17:
                    MsgObj_Bremse_1.BR1_MAD = SigVal;
                    break;
                case 18:
                    MsgObj_Bremse_1.BR1_MSR_Anf = SigVal;
                    break;
                case 19:
                    MsgObj_Bremse_1.BR1_MSR_Mo = SigVal;
                    break;
                case 20:
                    MsgObj_Bremse_1.BR1_MSR_Anf = 1;
                    MsgObj_Bremse_1.BR1_MSR_Mo_inv = SigVal;
                    break;
                case 21:
                    MsgObj_Bremse_1.BR1_Rad_kmh = SigVal;
                    break;
                case 22:
                    MsgObj_Bremse_1.BR1_StaDruckschw = SigVal;
                    break;
                case 23:
                    MsgObj_Bremse_1.BR1_Sta_ESP = SigVal;
                    break;
                case 24:
                    MsgObj_Bremse_1.BR1_Sta_MAD = SigVal;
                    break;
                case 25:
                    MsgObj_Bremse_1.BR1_Zaehler = SigVal;
                    break;
            }
        }
        break;
        case FRM_HANDLE_Bremse_3:
        {
            switch (SigIdx)
            {
                case 0:
                    MsgObj_Bremse_3.BR3_Fahrtr_HL = SigVal;
                    break;
                case 1:
                    MsgObj_Bremse_3.BR3_Fahrtr_HR = SigVal;
                    break;
                case 2:
                    MsgObj_Bremse_3.BR3_Fahrtr_VL = SigVal;
                    break;
                case 3:
                    MsgObj_Bremse_3.BR3_Fahrtr_VR = SigVal;
                    break;
                case 4:
                    MsgObj_Bremse_3.BR3_Rad_kmh_HL = SigVal;
                    break;
                case 5:
                    MsgObj_Bremse_3.BR3_Rad_kmh_HR = SigVal;
                    break;
                case 6:
                    MsgObj_Bremse_3.BR3_Rad_kmh_VL = SigVal;
                    break;
                case 7:
                    MsgObj_Bremse_3.BR3_Rad_kmh_VR = SigVal;
                    break;
            }
        }
        break;
        case FRM_HANDLE_Charisma_01:
        {
            switch (SigIdx)
            {
                case 0:
                    MsgObj_Charisma_01.CHA_Ziel_FahrPr_GE = SigVal;
                    break;
                case 1:
                    MsgObj_Charisma_01.CHA_Ziel_FahrPr_MO = SigVal;
                    break;
            }
        }
        break;
        case FRM_HANDLE_Clima_1:
        {
            switch (SigIdx)
            {
                case 0:
                    MsgObj_Clima_1.CL1_AC_Schalter = SigVal;
                    break;
                case 1:
                    MsgObj_Clima_1.CL1_Aussentemp = SigVal;
                    break;
                case 2:
                    MsgObj_Clima_1.CL1_Druck = SigVal;
                    break;
                case 3:
                    MsgObj_Clima_1.CL1_Einheit_Temp = SigVal;
                    break;
                case 4:
                    MsgObj_Clima_1.CL1_Fa_Zuheiz = SigVal;
                    break;
                case 5:
                    MsgObj_Clima_1.CL1_Fehlereintr = SigVal;
                    break;
                case 6:
                    MsgObj_Clima_1.CL1_Frontsch = SigVal;
                    break;
                case 7:
                    MsgObj_Clima_1.CL1_Gebl_last = SigVal;
                    break;
                case 8:
                    MsgObj_Clima_1.CL1_Hecksch = SigVal;
                    break;
                case 9:
                    MsgObj_Clima_1.CL1_Heizleist = SigVal;
                    break;
                case 10:
                    MsgObj_Clima_1.CL1_Kompr_Last = SigVal;
                    break;
                case 11:
                    MsgObj_Clima_1.CL1_Kompressor = SigVal;
                    break;
                case 12:
                    MsgObj_Clima_1.CL1_LL_Dz = SigVal;
                    break;
                case 13:
                    MsgObj_Clima_1.CL1_Luefter = SigVal;
                    break;
                case 14:
                    MsgObj_Clima_1.CL1_PTC_Hzg = SigVal;
                    break;
                case 15:
                    MsgObj_Clima_1.CL1_Restwaerme = SigVal;
                    break;
                case 16:
                    MsgObj_Clima_1.CL1_Sta_Druck = SigVal;
                    break;
                case 17:
                    MsgObj_Clima_1.CL1_Sta_Moment = SigVal;
                    break;
                case 18:
                    MsgObj_Clima_1.CL1_WAPU_Zuschaltung = SigVal;
                    break;
                case 19:
                    MsgObj_Clima_1.KL_Thermomanagement = SigVal;
                    break;
            }
        }
        break;
        case FRM_HANDLE_Diagnose_1:
        {
            switch (SigIdx)
            {
                case 0:
                    MsgObj_Diagnose_1.DI1_Jahr = SigVal;
                    break;
                case 1:
                    MsgObj_Diagnose_1.DI1_KM_Stand_alt = SigVal;
                    break;
                case 2:
                    MsgObj_Diagnose_1.DI1_Minute = SigVal;
                    break;
                case 3:
                    MsgObj_Diagnose_1.DI1_Monat = SigVal;
                    break;
                case 4:
                    MsgObj_Diagnose_1.DI1_Sekunde = SigVal;
                    break;
                case 5:
                    MsgObj_Diagnose_1.DI1_Stunde = SigVal;
                    break;
                case 6:
                    MsgObj_Diagnose_1.DI1_Tag = SigVal;
                    break;
                case 7:
                    MsgObj_Diagnose_1.DI1_VerlernZaehl = SigVal;
                    break;
                case 8:
                    MsgObj_Diagnose_1.DI1_Zeit_alt = SigVal;
                    break;
                case 9:
                    MsgObj_Diagnose_1.DI1_km_Stand = SigVal;
                    break;
            }
        }
        break;
        case FRM_HANDLE_EKompKlima_1:
        {
            switch (SigIdx)
            {
                case 0:
                    MsgObj_EKompKlima_1.EK1_Comp_Inv_stat = SigVal;
                    break;
                case 1:
                    MsgObj_EKompKlima_1.EK1_Comp_SCI_com_stat = SigVal;
                    break;
                case 2:
                    MsgObj_EKompKlima_1.EK1_Comp_current = SigVal;
                    break;
                case 3:
                    MsgObj_EKompKlima_1.EK1_Comp_main_stat = SigVal;
                    break;
                case 4:
                    MsgObj_EKompKlima_1.EK1_Comp_output_stat = SigVal;
                    break;
                case 5:
                    MsgObj_EKompKlima_1.EK1_Comp_ovld_stat = SigVal;
                    break;
                case 6:
                    MsgObj_EKompKlima_1.EK1_Comp_photo_temp = SigVal;
                    break;
                case 7:
                    MsgObj_EKompKlima_1.EK1_Comp_photo_temp_stat = SigVal;
                    break;
                case 8:
                    MsgObj_EKompKlima_1.EK1_Comp_rev_stat = SigVal;
                    break;
                case 9:
                    MsgObj_EKompKlima_1.EK1_KD_Fehler = SigVal;
                    break;
            }
        }
        break;
        case FRM_HANDLE_GRA_Neu:
        {
            switch (SigIdx)
            {
                case 0:
                    MsgObj_GRA_Neu.GRA_Abbrechen = SigVal;
                    break;
                case 1:
                    MsgObj_GRA_Neu.GRA_Checksum = SigVal;
                    break;
                case 2:
                    MsgObj_GRA_Neu.GRA_Down_kurz = SigVal;
                    break;
                case 3:
                    MsgObj_GRA_Neu.GRA_Down_lang = SigVal;
                    break;
                case 4:
                    MsgObj_GRA_Neu.GRA_Fehler_Bed = SigVal;
                    break;
                case 5:
                    MsgObj_GRA_Neu.GRA_Fehler_Tip = SigVal;
                    break;
                case 6:
                    MsgObj_GRA_Neu.GRA_Hauptschalt = SigVal;
                    break;
                case 7:
                    MsgObj_GRA_Neu.GRA_Kodierinfo = SigVal;
                    break;
                case 8:
                    MsgObj_GRA_Neu.GRA_Neu_Setzen = SigVal;
                    break;
                case 9:
                    MsgObj_GRA_Neu.GRA_Neu_Zaehler = SigVal;
                    break;
                case 10:
                    MsgObj_GRA_Neu.GRA_Recall = SigVal;
                    break;
                case 11:
                    MsgObj_GRA_Neu.GRA_Sender = SigVal;
                    break;
                case 12:
                    MsgObj_GRA_Neu.GRA_Sportschalter = SigVal;
                    break;
                case 13:
                    MsgObj_GRA_Neu.GRA_Sta_Limiter = SigVal;
                    break;
                case 14:
                    MsgObj_GRA_Neu.GRA_Tip_Down = SigVal;
                    break;
                case 15:
                    MsgObj_GRA_Neu.GRA_Tip_Up = SigVal;
                    break;
                case 16:
                    MsgObj_GRA_Neu.GRA_Typ_Hauptschalt = SigVal;
                    break;
                case 17:
                    MsgObj_GRA_Neu.GRA_Up_kurz = SigVal;
                    break;
                case 18:
                    MsgObj_GRA_Neu.GRA_Up_lang = SigVal;
                    break;
                case 19:
                    MsgObj_GRA_Neu.GRA_Zeitluecke = SigVal;
                    break;
            }
        }
        break;
        case FRM_HANDLE_Gate_Komf_1:
        {
            switch (SigIdx)
            {
                case 0:
                    MsgObj_Gate_Komf_1.BCM_CV_Taster = SigVal;
                    break;
                case 1:
                    MsgObj_Gate_Komf_1.BCM_Offroad_Taster = SigVal;
                    break;
                case 2:
                    MsgObj_Gate_Komf_1.BCM_Remotestart_Betrieb = SigVal;
                    break;
                case 3:
                    MsgObj_Gate_Komf_1.BSK_BT_geoeffnet = SigVal;
                    break;
                case 4:
                    MsgObj_Gate_Komf_1.BSK_HD_Hauptraste = SigVal;
                    break;
                case 5:
                    MsgObj_Gate_Komf_1.BSK_HL_geoeffnet = SigVal;
                    break;
                case 6:
                    MsgObj_Gate_Komf_1.BSK_HR_geoeffnet = SigVal;
                    break;
                case 7:
                    MsgObj_Gate_Komf_1.GK1_Abbl_VL_def = SigVal;
                    break;
                case 8:
                    MsgObj_Gate_Komf_1.GK1_Abbl_VR_def = SigVal;
                    break;
                case 9:
                    MsgObj_Gate_Komf_1.GK1_Abblendlicht = SigVal;
                    break;
                case 10:
                    MsgObj_Gate_Komf_1.GK1_AnhKonLamp = SigVal;
                    break;
                case 11:
                    MsgObj_Gate_Komf_1.GK1_Anh_abgesteckt = SigVal;
                    break;
                case 12:
                    MsgObj_Gate_Komf_1.GK1_Anhaenger = SigVal;
                    break;
                case 13:
                    MsgObj_Gate_Komf_1.GK1_BLS_ILM = SigVal;
                    break;
                case 14:
                    MsgObj_Gate_Komf_1.GK1_Blink_Autob = SigVal;
                    break;
                case 15:
                    MsgObj_Gate_Komf_1.GK1_Blinker_li = SigVal;
                    break;
                case 16:
                    MsgObj_Gate_Komf_1.GK1_Blinker_re = SigVal;
                    break;
                case 17:
                    MsgObj_Gate_Komf_1.GK1_BrLi_Anhaen = SigVal;
                    break;
                case 18:
                    MsgObj_Gate_Komf_1.GK1_BrLi_links = SigVal;
                    break;
                case 19:
                    MsgObj_Gate_Komf_1.GK1_BrLi_mitte = SigVal;
                    break;
                case 20:
                    MsgObj_Gate_Komf_1.GK1_BrLi_rechts = SigVal;
                    break;
                case 21:
                    MsgObj_Gate_Komf_1.GK1_Bremslicht = SigVal;
                    break;
                case 22:
                    MsgObj_Gate_Komf_1.GK1_SamFktNr = 1;
                    MsgObj_Gate_Komf_1.GK1_CharismaModus = SigVal;
                    break;
                case 23:
                    MsgObj_Gate_Komf_1.GK1_SamFktNr = 4;
                    MsgObj_Gate_Komf_1.GK1_DriveSelectModus_1 = SigVal;
                    break;
                case 24:
                    MsgObj_Gate_Komf_1.GK1_SamFktNr = 5;
                    MsgObj_Gate_Komf_1.GK1_DriveSelectModus_2 = SigVal;
                    break;
                case 25:
                    MsgObj_Gate_Komf_1.GK1_EDC_ILM = SigVal;
                    break;
                case 26:
                    MsgObj_Gate_Komf_1.GK1_ELV_verrieg = SigVal;
                    break;
                case 27:
                    MsgObj_Gate_Komf_1.GK1_SamFktNr = 2;
                    MsgObj_Gate_Komf_1.GK1_EfficiencyModus = SigVal;
                    break;
                case 28:
                    MsgObj_Gate_Komf_1.GK1_Fa_Tuerkont = SigVal;
                    break;
                case 29:
                    MsgObj_Gate_Komf_1.GK1_Fernlicht = SigVal;
                    break;
                case 30:
                    MsgObj_Gate_Komf_1.GK1_KW_Warm = SigVal;
                    break;
                case 31:
                    MsgObj_Gate_Komf_1.GK1_LS1_Fernlicht = SigVal;
                    break;
                case 32:
                    MsgObj_Gate_Komf_1.GK1_Nebel_ein = SigVal;
                    break;
                case 33:
                    MsgObj_Gate_Komf_1.GK1_ParkFrontWi = SigVal;
                    break;
                case 34:
                    MsgObj_Gate_Komf_1.GK1_Rueckfahr = SigVal;
                    break;
                case 35:
                    MsgObj_Gate_Komf_1.GK1_RueckfahrSch = SigVal;
                    break;
                case 36:
                    MsgObj_Gate_Komf_1.GK1_SH_Verbau = SigVal;
                    break;
                case 37:
                    MsgObj_Gate_Komf_1.GK1_SH_Zusatzfkt = SigVal;
                    break;
                case 38:
                    MsgObj_Gate_Komf_1.GK1_SH_laeuft = SigVal;
                    break;
                case 39:
                    MsgObj_Gate_Komf_1.GK1_SamFktNr = SigVal;
                    break;
                case 40:
                    MsgObj_Gate_Komf_1.GK1_SleepAckn = SigVal;
                    break;
                case 41:
                    MsgObj_Gate_Komf_1.GK1_SamFktNr = 3;
                    MsgObj_Gate_Komf_1.GK1_SportModus = SigVal;
                    break;
                case 42:
                    MsgObj_Gate_Komf_1.GK1_Sta_Anhaen = SigVal;
                    break;
                case 43:
                    MsgObj_Gate_Komf_1.GK1_Sta_ILM_F_1 = SigVal;
                    break;
                case 44:
                    MsgObj_Gate_Komf_1.GK1_Sta_Kessy_2 = SigVal;
                    break;
                case 45:
                    MsgObj_Gate_Komf_1.GK1_Sta_LSM = SigVal;
                    break;
                case 46:
                    MsgObj_Gate_Komf_1.GK1_Sta_Li_vorn = SigVal;
                    break;
                case 47:
                    MsgObj_Gate_Komf_1.GK1_Sta_Licht1 = SigVal;
                    break;
                case 48:
                    MsgObj_Gate_Komf_1.GK1_Sta_Licht2 = SigVal;
                    break;
                case 49:
                    MsgObj_Gate_Komf_1.GK1_Sta_Licht3 = SigVal;
                    break;
            }

            switch (SigIdx)
            {
                case 50:
                    MsgObj_Gate_Komf_1.GK1_Sta_RDK_Warn = SigVal;
                    break;
                case 51:
                    MsgObj_Gate_Komf_1.GK1_Sta_Stdhzg = SigVal;
                    break;
                case 52:
                    MsgObj_Gate_Komf_1.GK1_Sta_Tuerkont = SigVal;
                    break;
                case 53:
                    MsgObj_Gate_Komf_1.GK1_Warnblk_Status = SigVal;
                    break;
                case 54:
                    MsgObj_Gate_Komf_1.GK1_Wischer_vorn = SigVal;
                    break;
                case 55:
                    MsgObj_Gate_Komf_1.GK1_def_P_verr = SigVal;
                    break;
                case 56:
                    MsgObj_Gate_Komf_1.LDS_Stellung_AFL = SigVal;
                    break;
                case 57:
                    MsgObj_Gate_Komf_1.SH1_ein_Wasserpumpe = SigVal;
                    break;
                case 58:
                    MsgObj_Gate_Komf_1.WI1_Front_Wasch = SigVal;
                    break;
            }
        }
        break;
        case FRM_HANDLE_Gate_Komf_4:
        {
            switch (SigIdx)
            {
                case 0:
                    MsgObj_Gate_Komf_4.GK1_Sta_LSM = SigVal;
                    break;
                case 1:
                    MsgObj_Gate_Komf_4.GK4_Ladesteckerentr_Anf = SigVal;
                    break;
                case 2:
                    MsgObj_Gate_Komf_4.GK4_Sta_MFA_6 = SigVal;
                    break;
                case 3:
                    MsgObj_Gate_Komf_4.LS1_P_verriegelt = SigVal;
                    break;
                case 4:
                    MsgObj_Gate_Komf_4.MA6_Reichweite = SigVal;
                    break;
                case 5:
                    MsgObj_Gate_Komf_4.MA6_km_Reichweite = SigVal;
                    break;
                case 6:
                    MsgObj_Gate_Komf_4.MA6_mls_Reichweite = SigVal;
                    break;
            }
        }
        break;
        case FRM_HANDLE_Klima_EV_1:
        {
            switch (SigIdx)
            {
                case 0:
                    MsgObj_Klima_EV_1.EKK_Status = SigVal;
                    break;
                case 1:
                    MsgObj_Klima_EV_1.EKK_Status_Vorstrg = SigVal;
                    break;
                case 2:
                    MsgObj_Klima_EV_1.EKK_Strom = SigVal;
                    break;
                case 3:
                    MsgObj_Klima_EV_1.KL_Charisma_FahrPr = SigVal;
                    break;
                case 4:
                    MsgObj_Klima_EV_1.KL_Charisma_Status = SigVal;
                    break;
                case 5:
                    MsgObj_Klima_EV_1.KL_HV_Anf = SigVal;
                    break;
                case 6:
                    MsgObj_Klima_EV_1.KL_HV_ein = SigVal;
                    break;
                case 7:
                    MsgObj_Klima_EV_1.KL_Innengeblaese = SigVal;
                    break;
                case 8:
                    MsgObj_Klima_EV_1.KL_Kompr_Drehzahl_Soll = SigVal;
                    break;
                case 9:
                    MsgObj_Klima_EV_1.KL_PTC_Soll = SigVal;
                    break;
                case 10:
                    MsgObj_Klima_EV_1.KL_Standklima_Status = SigVal;
                    break;
                case 11:
                    MsgObj_Klima_EV_1.KL_Standklima_Strg_Kluefter = SigVal;
                    break;
                case 12:
                    MsgObj_Klima_EV_1.KL_Ventil_Batterie_Anf = SigVal;
                    break;
                case 13:
                    MsgObj_Klima_EV_1.KL_Ventil_vor_Motor_Anf = SigVal;
                    break;
                case 14:
                    MsgObj_Klima_EV_1.KL_Wake_Up_ACAN = SigVal;
                    break;
                case 15:
                    MsgObj_Klima_EV_1.PTC_Pumpe_Ist = SigVal;
                    break;
                case 16:
                    MsgObj_Klima_EV_1.PTC_Pumpe_Status = SigVal;
                    break;
                case 17:
                    MsgObj_Klima_EV_1.PTC_Strom = SigVal;
                    break;
            }
        }
        break;
        case FRM_HANDLE_Kombi_1:
        {
            switch (SigIdx)
            {
                case 0:
                    MsgObj_Kombi_1.KO1_ABS_Lampe = SigVal;
                    break;
                case 1:
                    MsgObj_Kombi_1.KO1_ACC_AnzFhl = SigVal;
                    break;
                case 2:
                    MsgObj_Kombi_1.KO1_ACC_Inkons = SigVal;
                    break;
                case 3:
                    MsgObj_Kombi_1.KO1_ASRESP_Lampe = SigVal;
                    break;
                case 4:
                    MsgObj_Kombi_1.KO1_Airbag_Lampe = SigVal;
                    break;
                case 5:
                    MsgObj_Kombi_1.KO1_Brems_Lampe = SigVal;
                    break;
                case 6:
                    MsgObj_Kombi_1.KO1_Bremsinfo = SigVal;
                    break;
                case 7:
                    MsgObj_Kombi_1.KO1_Handbremse = SigVal;
                    break;
                case 8:
                    MsgObj_Kombi_1.KO1_Kuehlmittel = SigVal;
                    break;
                case 9:
                    MsgObj_Kombi_1.KO1_LDW_AnzFeh = SigVal;
                    break;
                case 10:
                    MsgObj_Kombi_1.KO1_La_Ladekon = SigVal;
                    break;
                case 11:
                    MsgObj_Kombi_1.KO1_Lenkh_Lampe = SigVal;
                    break;
                case 12:
                    MsgObj_Kombi_1.KO1_OBD_Tank = SigVal;
                    break;
                case 13:
                    MsgObj_Kombi_1.KO1_Oeldruck = SigVal;
                    break;
                case 14:
                    MsgObj_Kombi_1.KO1_Quelle_kmh = SigVal;
                    break;
                case 15:
                    MsgObj_Kombi_1.KO1_SILA_gueltig = SigVal;
                    break;
                case 16:
                    MsgObj_Kombi_1.KO1_SleepInd = SigVal;
                    break;
                case 17:
                    MsgObj_Kombi_1.KO1_Sta_Oeldr = SigVal;
                    break;
                case 18:
                    MsgObj_Kombi_1.KO1_Sta_Tank = SigVal;
                    break;
                case 19:
                    MsgObj_Kombi_1.KO1_Stellglieder = SigVal;
                    break;
                case 20:
                    MsgObj_Kombi_1.KO1_Tankinhalt = SigVal;
                    break;
                case 21:
                    MsgObj_Kombi_1.KO1_Tankstop = SigVal;
                    break;
                case 22:
                    MsgObj_Kombi_1.KO1_Vorgluehen = SigVal;
                    break;
                case 23:
                    MsgObj_Kombi_1.KO1_Wakeup_Komfort = SigVal;
                    break;
                case 24:
                    MsgObj_Kombi_1.KO1_Warn_Tank = SigVal;
                    break;
                case 25:
                    MsgObj_Kombi_1.KO1_Zaehler = SigVal;
                    break;
                case 26:
                    MsgObj_Kombi_1.KO1_Zeitluecke = SigVal;
                    break;
                case 27:
                    MsgObj_Kombi_1.KO1_angez_kmh = SigVal;
                    break;
                case 28:
                    MsgObj_Kombi_1.KO1_kmh = SigVal;
                    break;
                case 29:
                    MsgObj_Kombi_1.KO1_kmh_mph = SigVal;
                    break;
            }
        }
        break;
        case FRM_HANDLE_Kombi_2:
        {
            switch (SigIdx)
            {
                case 0:
                    MsgObj_Kombi_2.KB2_Auto_eKiSi = SigVal;
                    break;
                case 1:
                    MsgObj_Kombi_2.KB2_EasyEntry = SigVal;
                    break;
                case 2:
                    MsgObj_Kombi_2.KB2_MFA_Strecke_Einheit = SigVal;
                    break;
                case 3:
                    MsgObj_Kombi_2.KB2_Req_IstZu_Solldruecke = SigVal;
                    break;
                case 4:
                    MsgObj_Kombi_2.KBI_rotes_P_verbaut = SigVal;
                    break;
                case 5:
                    MsgObj_Kombi_2.KO2_Aussen_T = SigVal;
                    break;
                case 6:
                    MsgObj_Kombi_2.KO2_Bel_Displ = SigVal;
                    break;
                case 7:
                    MsgObj_Kombi_2.KO2_Bel_Schalt = SigVal;
                    break;
                case 8:
                    MsgObj_Kombi_2.KO2_Fehlereintr = SigVal;
                    break;
                case 9:
                    MsgObj_Kombi_2.KO2_GRA_High = SigVal;
                    break;
                case 10:
                    MsgObj_Kombi_2.KO2_MFA_v_Einheit = SigVal;
                    break;
                case 11:
                    MsgObj_Kombi_2.KO2_OBD_Nib_Temp = SigVal;
                    break;
                case 12:
                    MsgObj_Kombi_2.KO2_Oelwarn = SigVal;
                    break;
                case 13:
                    MsgObj_Kombi_2.KO2_PLA_Displaystatus = SigVal;
                    break;
                case 14:
                    MsgObj_Kombi_2.KO2_Passiv_Autolock = SigVal;
                    break;
                case 15:
                    MsgObj_Kombi_2.KO2_Sta_Auss_T = SigVal;
                    break;
                case 16:
                    MsgObj_Kombi_2.KO2_Sta_Displ = SigVal;
                    break;
                case 17:
                    MsgObj_Kombi_2.KO2_Sta_Schalt = SigVal;
                    break;
                case 18:
                    MsgObj_Kombi_2.KO2_Temp_Einheit = SigVal;
                    break;
                case 19:
                    MsgObj_Kombi_2.KO2_Verb_TOG = SigVal;
                    break;
                case 20:
                    MsgObj_Kombi_2.KO2_WFS_Schl_Ort = SigVal;
                    break;
                case 21:
                    MsgObj_Kombi_2.KO2_Wischwasser = SigVal;
                    break;
                case 22:
                    MsgObj_Kombi_2.KO2_gef_Auss_T = SigVal;
                    break;
                case 23:
                    MsgObj_Kombi_2.KO_Segeln_Menuestatus = SigVal;
                    break;
                case 24:
                    MsgObj_Kombi_2.KO_Segeln_Zustandswechsel = SigVal;
                    break;
            }
        }
        break;
        case FRM_HANDLE_NMH_Gateway:
        {
            switch (SigIdx)
            {
                case 0:
                    MsgObj_NMH_Gateway.NMH_GW_Abschaltstufe_aktiv = SigVal;
                    break;
                case 1:
                    MsgObj_NMH_Gateway.NMH_GW_CAN_Diag_deaktiv = SigVal;
                    break;
                case 2:
                    MsgObj_NMH_Gateway.NMH_GW_Car_WakeUp = SigVal;
                    break;
                case 3:
                    MsgObj_NMH_Gateway.NMH_GW_Eindraht_Fehler = SigVal;
                    break;
                case 4:
                    MsgObj_NMH_Gateway.NMH_GW_Fkt_WakeUp = SigVal;
                    break;
                case 5:
                    MsgObj_NMH_Gateway.NMH_GW_KompSchutz = SigVal;
                    break;
                case 6:
                    MsgObj_NMH_Gateway.NMH_GW_Mute_Mode = SigVal;
                    break;
                case 7:
                    MsgObj_NMH_Gateway.NMH_GW_NL_0 = SigVal;
                    break;
                case 8:
                    MsgObj_NMH_Gateway.NMH_GW_NL_1 = SigVal;
                    break;
                case 9:
                    MsgObj_NMH_Gateway.NMH_GW_NL_2 = SigVal;
                    break;
                case 10:
                    MsgObj_NMH_Gateway.NMH_GW_NL_3 = SigVal;
                    break;
                case 11:
                    MsgObj_NMH_Gateway.NMH_GW_NL_4 = SigVal;
                    break;
                case 12:
                    MsgObj_NMH_Gateway.NMH_GW_NL_5 = SigVal;
                    break;
                case 13:
                    MsgObj_NMH_Gateway.NMH_GW_NL_6 = SigVal;
                    break;
                case 14:
                    MsgObj_NMH_Gateway.NMH_GW_NL_7 = SigVal;
                    break;
                case 15:
                    MsgObj_NMH_Gateway.NMH_GW_NL_aktiv_4 = SigVal;
                    break;
                case 16:
                    MsgObj_NMH_Gateway.NMH_GW_NL_aktiv_5 = SigVal;
                    break;
                case 17:
                    MsgObj_NMH_Gateway.NMH_GW_NL_aktiv_6 = SigVal;
                    break;
                case 18:
                    MsgObj_NMH_Gateway.NMH_GW_NL_aktiv_7 = SigVal;
                    break;
                case 19:
                    MsgObj_NMH_Gateway.NMH_GW_NL_aktiv_8 = SigVal;
                    break;
                case 20:
                    MsgObj_NMH_Gateway.NMH_GW_NM_aktiv_Diagnose = SigVal;
                    break;
                case 21:
                    MsgObj_NMH_Gateway.NMH_GW_NM_aktiv_Klemme_15 = SigVal;
                    break;
                case 22:
                    MsgObj_NMH_Gateway.NMH_GW_NM_aktiv_Start = SigVal;
                    break;
                case 23:
                    MsgObj_NMH_Gateway.NMH_GW_Normal_Mode_1 = SigVal;
                    break;
                case 24:
                    MsgObj_NMH_Gateway.NMH_GW_Normal_Mode_2 = SigVal;
                    break;
                case 25:
                    MsgObj_NMH_Gateway.NMH_GW_Per_WakeUp = SigVal;
                    break;
                case 26:
                    MsgObj_NMH_Gateway.NMH_GW_Start_1 = SigVal;
                    break;
                case 27:
                    MsgObj_NMH_Gateway.NMH_GW_Start_2 = SigVal;
                    break;
                case 28:
                    MsgObj_NMH_Gateway.NMH_GW_TimeOut_Fehler = SigVal;
                    break;
                case 29:
                    MsgObj_NMH_Gateway.NMH_GW_Transport_Mode = SigVal;
                    break;
            }
        }
        break;
        case FRM_HANDLE_Waehlhebel_1:
        {
            switch (SigIdx)
            {
                case 0:
                    MsgObj_Waehlhebel_1.WH1_Init = SigVal;
                    break;
                case 1:
                    MsgObj_Waehlhebel_1.WH1_Position = SigVal;
                    break;
                case 2:
                    MsgObj_Waehlhebel_1.WH1_Position_inv = SigVal;
                    break;
                case 3:
                    MsgObj_Waehlhebel_1.WH1_StaShiftlock = SigVal;
                    break;
                case 4:
                    MsgObj_Waehlhebel_1.WH1_Status = SigVal;
                    break;
                case 5:
                    MsgObj_Waehlhebel_1.WH1_Taster_betaetigt = SigVal;
                    break;
                case 6:
                    MsgObj_Waehlhebel_1.WH1_Test_Flag = SigVal;
                    break;
                case 7:
                    MsgObj_Waehlhebel_1.WH1_Testergebnis = SigVal;
                    break;
                case 8:
                    MsgObj_Waehlhebel_1.WH1_Zaehler = SigVal;
                    break;
            }
        }
        break;
    }
}
/*@@end*/

/*@@caplFunc:GetSignalVal(int,int):*/
int GetSignalVal (int FrmIdx, int SigIdx)
{
    int SigVal;

    switch (FrmIdx)
    {
        case FRM_HANDLE_ACC_System:
        {
            switch (SigIdx)
            {
                case 0:
                    SigVal = MsgObj_ACC_System.ACS_ADR_Schub;
                    break;
                case 1:
                    SigVal = MsgObj_ACC_System.ACS_Anhaltewunsch;
                    break;
                case 2:
                    SigVal = MsgObj_ACC_System.ACS_Checksum;
                    break;
                case 3:
                    SigVal = MsgObj_ACC_System.ACS_Fehler;
                    break;
                case 4:
                    SigVal = MsgObj_ACC_System.ACS_FreigSollB;
                    break;
                case 5:
                    SigVal = MsgObj_ACC_System.ACS_MomEingriff;
                    break;
                case 6:
                    SigVal = MsgObj_ACC_System.ACS_Schubabsch;
                    break;
                case 7:
                    SigVal = MsgObj_ACC_System.ACS_Sollbeschl;
                    break;
                case 8:
                    SigVal = MsgObj_ACC_System.ACS_StSt_Info;
                    break;
                case 9:
                    SigVal = MsgObj_ACC_System.ACS_Sta_ADR;
                    break;
                case 10:
                    SigVal = MsgObj_ACC_System.ACS_Typ_ACC;
                    break;
                case 11:
                    SigVal = MsgObj_ACC_System.ACS_Zaehler;
                    break;
                case 12:
                    SigVal = MsgObj_ACC_System.ACS_max_AendGrad;
                    break;
                case 13:
                    SigVal = MsgObj_ACC_System.ACS_zul_Regelabw;
                    break;
            }
        }
        break;
        case FRM_HANDLE_Airbag_1:
        {
            switch (SigIdx)
            {
                case 0:
                    SigVal = MsgObj_Airbag_1.AB1_BF_Warnung;
                    break;
                case 1:
                    SigVal = MsgObj_Airbag_1.AB1_Beifahrer;
                    break;
                case 2:
                    SigVal = MsgObj_Airbag_1.AB1_Bf_Seite;
                    break;
                case 3:
                    SigVal = MsgObj_Airbag_1.AB1_Checksumme;
                    break;
                case 4:
                    SigVal = MsgObj_Airbag_1.AB1_Diagnose;
                    break;
                case 5:
                    SigVal = MsgObj_Airbag_1.AB1_Fa_Seite;
                    break;
                case 6:
                    SigVal = MsgObj_Airbag_1.AB1_Fehlereintr;
                    break;
                case 7:
                    SigVal = MsgObj_Airbag_1.AB1_Front;
                    break;
                case 8:
                    SigVal = MsgObj_Airbag_1.AB1_Gurt_Bf;
                    break;
                case 9:
                    SigVal = MsgObj_Airbag_1.AB1_Gurt_Fa;
                    break;
                case 10:
                    SigVal = MsgObj_Airbag_1.AB1_Heck;
                    break;
                case 11:
                    SigVal = MsgObj_Airbag_1.AB1_Intens;
                    break;
                case 12:
                    SigVal = MsgObj_Airbag_1.AB1_Lampe;
                    break;
                case 13:
                    SigVal = MsgObj_Airbag_1.AB1_Rollover;
                    break;
                case 14:
                    SigVal = MsgObj_Airbag_1.AB1_Status;
                    break;
                case 15:
                    SigVal = MsgObj_Airbag_1.AB1_Stellglied;
                    break;
                case 16:
                    SigVal = MsgObj_Airbag_1.AB1_System;
                    break;
                case 17:
                    SigVal = MsgObj_Airbag_1.AB1_Zaehler;
                    break;
            }
        }
        break;
        case FRM_HANDLE_BSG_Last:
        {
            switch (SigIdx)
            {
                case 0:
                    SigVal = MsgObj_BSG_Last.BSL_Ab_Batterie;
                    break;
                case 1:
                    SigVal = MsgObj_BSG_Last.BSL_Aussensp;
                    break;
                case 2:
                    SigVal = MsgObj_BSG_Last.BSL_BSG_2_alt;
                    break;
                case 3:
                    SigVal = MsgObj_BSG_Last.BSL_BSG_3_alt;
                    break;
                case 4:
                    SigVal = MsgObj_BSG_Last.BSL_Clima;
                    break;
                case 5:
                    SigVal = MsgObj_BSG_Last.BSL_Fehlereintr;
                    break;
                case 6:
                    SigVal = MsgObj_BSG_Last.BSL_Frontsch;
                    break;
                case 7:
                    SigVal = MsgObj_BSG_Last.BSL_Hecksch;
                    break;
                case 8:
                    SigVal = MsgObj_BSG_Last.BSL_Kl_15_Motor;
                    break;
                case 9:
                    SigVal = MsgObj_BSG_Last.BSL_Kl_L;
                    break;
                case 10:
                    SigVal = MsgObj_BSG_Last.BSL_Kuehlerlueft;
                    break;
                case 11:
                    SigVal = MsgObj_BSG_Last.BSL_LL_Anheb;
                    break;
                case 12:
                    SigVal = MsgObj_BSG_Last.BSL_LL_Anheb2;
                    break;
                case 13:
                    SigVal = MsgObj_BSG_Last.BSL_Lenkradheiz;
                    break;
                case 14:
                    SigVal = MsgObj_BSG_Last.BSL_Motor_Haube;
                    break;
                case 15:
                    SigVal = MsgObj_BSG_Last.BSL_Parklicht;
                    break;
                case 16:
                    SigVal = MsgObj_BSG_Last.BSL_Sitzbelueft;
                    break;
                case 17:
                    SigVal = MsgObj_BSG_Last.BSL_Sitzheiz;
                    break;
                case 18:
                    SigVal = MsgObj_BSG_Last.BSL_Sta_LWR;
                    break;
                case 19:
                    SigVal = MsgObj_BSG_Last.BSL_Sta_StBat;
                    break;
                case 20:
                    SigVal = MsgObj_BSG_Last.BSL_Sta_UBat;
                    break;
                case 21:
                    SigVal = MsgObj_BSG_Last.BSL_Starterlaubnis;
                    break;
                case 22:
                    SigVal = MsgObj_BSG_Last.BSL_UBat;
                    break;
                case 23:
                    SigVal = MsgObj_BSG_Last.BSL_Wake_Up_ACAN;
                    break;
                case 24:
                    SigVal = MsgObj_BSG_Last.BSL_Wasserheiz;
                    break;
                case 25:
                    SigVal = MsgObj_BSG_Last.BSL_Weckursache_ACAN;
                    break;
                case 26:
                    SigVal = MsgObj_BSG_Last.BSL_ZAS_Kl_15;
                    break;
                case 27:
                    SigVal = MsgObj_BSG_Last.BSL_ZAS_Kl_50;
                    break;
                case 28:
                    SigVal = MsgObj_BSG_Last.BSL_ZAS_Kl_S;
                    break;
                case 29:
                    SigVal = MsgObj_BSG_Last.BSL_ZAS_Kl_X;
                    break;
            }
        }
        break;
        case FRM_HANDLE_Bremse_1:
        {
            switch (SigIdx)
            {
                case 0:
                    SigVal = MsgObj_Bremse_1.BR1_ABS_Brems;
                    break;
                case 1:
                    SigVal = MsgObj_Bremse_1.BR1_ASRMo_fa;
                    break;
                case 2:
                    SigVal = MsgObj_Bremse_1.BR1_ASRMo_sl;
                    break;
                case 3:
                    SigVal = MsgObj_Bremse_1.BR1_ASR_Anf;
                    break;
                case 4:
                    SigVal = MsgObj_Bremse_1.BR1_ASR_ESP;
                    break;
                case 5:
                    SigVal = MsgObj_Bremse_1.BR1_ASR_Eingr;
                    break;
                case 6:
                    SigVal = MsgObj_Bremse_1.BR1_BKV_aktiv;
                    break;
                case 7:
                    SigVal = MsgObj_Bremse_1.BR1_Diagnose;
                    break;
                case 8:
                    SigVal = MsgObj_Bremse_1.BR1_EBV_Eingr;
                    break;
                case 9:
                    SigVal = MsgObj_Bremse_1.BR1_EDS_Eingr;
                    break;
                case 10:
                    SigVal = MsgObj_Bremse_1.BR1_ESPASR_passiv;
                    break;
                case 11:
                    SigVal = MsgObj_Bremse_1.BR1_ESP_Eingr;
                    break;
                case 12:
                    SigVal = MsgObj_Bremse_1.BR1_Ersatz_Kmh;
                    break;
                case 13:
                    SigVal = MsgObj_Bremse_1.BR1_Lampe_ABS;
                    break;
                case 14:
                    SigVal = MsgObj_Bremse_1.BR1_Lampe_ASR;
                    break;
                case 15:
                    SigVal = MsgObj_Bremse_1.BR1_Lampe_BK;
                    break;
                case 16:
                    SigVal = MsgObj_Bremse_1.BR1_Lichtschalt;
                    break;
                case 17:
                    SigVal = MsgObj_Bremse_1.BR1_MAD;
                    break;
                case 18:
                    SigVal = MsgObj_Bremse_1.BR1_MSR_Anf;
                    break;
                case 19:
                    SigVal = MsgObj_Bremse_1.BR1_MSR_Mo;
                    break;
                case 20:
                    SigVal = MsgObj_Bremse_1.BR1_MSR_Mo_inv;
                    break;
                case 21:
                    SigVal = MsgObj_Bremse_1.BR1_Rad_kmh;
                    break;
                case 22:
                    SigVal = MsgObj_Bremse_1.BR1_StaDruckschw;
                    break;
                case 23:
                    SigVal = MsgObj_Bremse_1.BR1_Sta_ESP;
                    break;
                case 24:
                    SigVal = MsgObj_Bremse_1.BR1_Sta_MAD;
                    break;
                case 25:
                    SigVal = MsgObj_Bremse_1.BR1_Zaehler;
                    break;
            }
        }
        break;
        case FRM_HANDLE_Bremse_3:
        {
            switch (SigIdx)
            {
                case 0:
                    SigVal = MsgObj_Bremse_3.BR3_Fahrtr_HL;
                    break;
                case 1:
                    SigVal = MsgObj_Bremse_3.BR3_Fahrtr_HR;
                    break;
                case 2:
                    SigVal = MsgObj_Bremse_3.BR3_Fahrtr_VL;
                    break;
                case 3:
                    SigVal = MsgObj_Bremse_3.BR3_Fahrtr_VR;
                    break;
                case 4:
                    SigVal = MsgObj_Bremse_3.BR3_Rad_kmh_HL;
                    break;
                case 5:
                    SigVal = MsgObj_Bremse_3.BR3_Rad_kmh_HR;
                    break;
                case 6:
                    SigVal = MsgObj_Bremse_3.BR3_Rad_kmh_VL;
                    break;
                case 7:
                    SigVal = MsgObj_Bremse_3.BR3_Rad_kmh_VR;
                    break;
            }
        }
        break;
        case FRM_HANDLE_Charisma_01:
        {
            switch (SigIdx)
            {
                case 0:
                    SigVal = MsgObj_Charisma_01.CHA_Ziel_FahrPr_GE;
                    break;
                case 1:
                    SigVal = MsgObj_Charisma_01.CHA_Ziel_FahrPr_MO;
                    break;
            }
        }
        break;
        case FRM_HANDLE_Clima_1:
        {
            switch (SigIdx)
            {
                case 0:
                    SigVal = MsgObj_Clima_1.CL1_AC_Schalter;
                    break;
                case 1:
                    SigVal = MsgObj_Clima_1.CL1_Aussentemp;
                    break;
                case 2:
                    SigVal = MsgObj_Clima_1.CL1_Druck;
                    break;
                case 3:
                    SigVal = MsgObj_Clima_1.CL1_Einheit_Temp;
                    break;
                case 4:
                    SigVal = MsgObj_Clima_1.CL1_Fa_Zuheiz;
                    break;
                case 5:
                    SigVal = MsgObj_Clima_1.CL1_Fehlereintr;
                    break;
                case 6:
                    SigVal = MsgObj_Clima_1.CL1_Frontsch;
                    break;
                case 7:
                    SigVal = MsgObj_Clima_1.CL1_Gebl_last;
                    break;
                case 8:
                    SigVal = MsgObj_Clima_1.CL1_Hecksch;
                    break;
                case 9:
                    SigVal = MsgObj_Clima_1.CL1_Heizleist;
                    break;
                case 10:
                    SigVal = MsgObj_Clima_1.CL1_Kompr_Last;
                    break;
                case 11:
                    SigVal = MsgObj_Clima_1.CL1_Kompressor;
                    break;
                case 12:
                    SigVal = MsgObj_Clima_1.CL1_LL_Dz;
                    break;
                case 13:
                    SigVal = MsgObj_Clima_1.CL1_Luefter;
                    break;
                case 14:
                    SigVal = MsgObj_Clima_1.CL1_PTC_Hzg;
                    break;
                case 15:
                    SigVal = MsgObj_Clima_1.CL1_Restwaerme;
                    break;
                case 16:
                    SigVal = MsgObj_Clima_1.CL1_Sta_Druck;
                    break;
                case 17:
                    SigVal = MsgObj_Clima_1.CL1_Sta_Moment;
                    break;
                case 18:
                    SigVal = MsgObj_Clima_1.CL1_WAPU_Zuschaltung;
                    break;
                case 19:
                    SigVal = MsgObj_Clima_1.KL_Thermomanagement;
                    break;
            }
        }
        break;
        case FRM_HANDLE_Diagnose_1:
        {
            switch (SigIdx)
            {
                case 0:
                    SigVal = MsgObj_Diagnose_1.DI1_Jahr;
                    break;
                case 1:
                    SigVal = MsgObj_Diagnose_1.DI1_KM_Stand_alt;
                    break;
                case 2:
                    SigVal = MsgObj_Diagnose_1.DI1_Minute;
                    break;
                case 3:
                    SigVal = MsgObj_Diagnose_1.DI1_Monat;
                    break;
                case 4:
                    SigVal = MsgObj_Diagnose_1.DI1_Sekunde;
                    break;
                case 5:
                    SigVal = MsgObj_Diagnose_1.DI1_Stunde;
                    break;
                case 6:
                    SigVal = MsgObj_Diagnose_1.DI1_Tag;
                    break;
                case 7:
                    SigVal = MsgObj_Diagnose_1.DI1_VerlernZaehl;
                    break;
                case 8:
                    SigVal = MsgObj_Diagnose_1.DI1_Zeit_alt;
                    break;
                case 9:
                    SigVal = MsgObj_Diagnose_1.DI1_km_Stand;
                    break;
            }
        }
        break;
        case FRM_HANDLE_EKompKlima_1:
        {
            switch (SigIdx)
            {
                case 0:
                    SigVal = MsgObj_EKompKlima_1.EK1_Comp_Inv_stat;
                    break;
                case 1:
                    SigVal = MsgObj_EKompKlima_1.EK1_Comp_SCI_com_stat;
                    break;
                case 2:
                    SigVal = MsgObj_EKompKlima_1.EK1_Comp_current;
                    break;
                case 3:
                    SigVal = MsgObj_EKompKlima_1.EK1_Comp_main_stat;
                    break;
                case 4:
                    SigVal = MsgObj_EKompKlima_1.EK1_Comp_output_stat;
                    break;
                case 5:
                    SigVal = MsgObj_EKompKlima_1.EK1_Comp_ovld_stat;
                    break;
                case 6:
                    SigVal = MsgObj_EKompKlima_1.EK1_Comp_photo_temp;
                    break;
                case 7:
                    SigVal = MsgObj_EKompKlima_1.EK1_Comp_photo_temp_stat;
                    break;
                case 8:
                    SigVal = MsgObj_EKompKlima_1.EK1_Comp_rev_stat;
                    break;
                case 9:
                    SigVal = MsgObj_EKompKlima_1.EK1_KD_Fehler;
                    break;
            }
        }
        break;
        case FRM_HANDLE_GRA_Neu:
        {
            switch (SigIdx)
            {
                case 0:
                    SigVal = MsgObj_GRA_Neu.GRA_Abbrechen;
                    break;
                case 1:
                    SigVal = MsgObj_GRA_Neu.GRA_Checksum;
                    break;
                case 2:
                    SigVal = MsgObj_GRA_Neu.GRA_Down_kurz;
                    break;
                case 3:
                    SigVal = MsgObj_GRA_Neu.GRA_Down_lang;
                    break;
                case 4:
                    SigVal = MsgObj_GRA_Neu.GRA_Fehler_Bed;
                    break;
                case 5:
                    SigVal = MsgObj_GRA_Neu.GRA_Fehler_Tip;
                    break;
                case 6:
                    SigVal = MsgObj_GRA_Neu.GRA_Hauptschalt;
                    break;
                case 7:
                    SigVal = MsgObj_GRA_Neu.GRA_Kodierinfo;
                    break;
                case 8:
                    SigVal = MsgObj_GRA_Neu.GRA_Neu_Setzen;
                    break;
                case 9:
                    SigVal = MsgObj_GRA_Neu.GRA_Neu_Zaehler;
                    break;
                case 10:
                    SigVal = MsgObj_GRA_Neu.GRA_Recall;
                    break;
                case 11:
                    SigVal = MsgObj_GRA_Neu.GRA_Sender;
                    break;
                case 12:
                    SigVal = MsgObj_GRA_Neu.GRA_Sportschalter;
                    break;
                case 13:
                    SigVal = MsgObj_GRA_Neu.GRA_Sta_Limiter;
                    break;
                case 14:
                    SigVal = MsgObj_GRA_Neu.GRA_Tip_Down;
                    break;
                case 15:
                    SigVal = MsgObj_GRA_Neu.GRA_Tip_Up;
                    break;
                case 16:
                    SigVal = MsgObj_GRA_Neu.GRA_Typ_Hauptschalt;
                    break;
                case 17:
                    SigVal = MsgObj_GRA_Neu.GRA_Up_kurz;
                    break;
                case 18:
                    SigVal = MsgObj_GRA_Neu.GRA_Up_lang;
                    break;
                case 19:
                    SigVal = MsgObj_GRA_Neu.GRA_Zeitluecke;
                    break;
            }
        }
        break;
        case FRM_HANDLE_Gate_Komf_1:
        {
            switch (SigIdx)
            {
                case 0:
                    SigVal = MsgObj_Gate_Komf_1.BCM_CV_Taster;
                    break;
                case 1:
                    SigVal = MsgObj_Gate_Komf_1.BCM_Offroad_Taster;
                    break;
                case 2:
                    SigVal = MsgObj_Gate_Komf_1.BCM_Remotestart_Betrieb;
                    break;
                case 3:
                    SigVal = MsgObj_Gate_Komf_1.BSK_BT_geoeffnet;
                    break;
                case 4:
                    SigVal = MsgObj_Gate_Komf_1.BSK_HD_Hauptraste;
                    break;
                case 5:
                    SigVal = MsgObj_Gate_Komf_1.BSK_HL_geoeffnet;
                    break;
                case 6:
                    SigVal = MsgObj_Gate_Komf_1.BSK_HR_geoeffnet;
                    break;
                case 7:
                    SigVal = MsgObj_Gate_Komf_1.GK1_Abbl_VL_def;
                    break;
                case 8:
                    SigVal = MsgObj_Gate_Komf_1.GK1_Abbl_VR_def;
                    break;
                case 9:
                    SigVal = MsgObj_Gate_Komf_1.GK1_Abblendlicht;
                    break;
                case 10:
                    SigVal = MsgObj_Gate_Komf_1.GK1_AnhKonLamp;
                    break;
                case 11:
                    SigVal = MsgObj_Gate_Komf_1.GK1_Anh_abgesteckt;
                    break;
                case 12:
                    SigVal = MsgObj_Gate_Komf_1.GK1_Anhaenger;
                    break;
                case 13:
                    SigVal = MsgObj_Gate_Komf_1.GK1_BLS_ILM;
                    break;
                case 14:
                    SigVal = MsgObj_Gate_Komf_1.GK1_Blink_Autob;
                    break;
                case 15:
                    SigVal = MsgObj_Gate_Komf_1.GK1_Blinker_li;
                    break;
                case 16:
                    SigVal = MsgObj_Gate_Komf_1.GK1_Blinker_re;
                    break;
                case 17:
                    SigVal = MsgObj_Gate_Komf_1.GK1_BrLi_Anhaen;
                    break;
                case 18:
                    SigVal = MsgObj_Gate_Komf_1.GK1_BrLi_links;
                    break;
                case 19:
                    SigVal = MsgObj_Gate_Komf_1.GK1_BrLi_mitte;
                    break;
                case 20:
                    SigVal = MsgObj_Gate_Komf_1.GK1_BrLi_rechts;
                    break;
                case 21:
                    SigVal = MsgObj_Gate_Komf_1.GK1_Bremslicht;
                    break;
                case 22:
                    SigVal = MsgObj_Gate_Komf_1.GK1_CharismaModus;
                    break;
                case 23:
                    SigVal = MsgObj_Gate_Komf_1.GK1_DriveSelectModus_1;
                    break;
                case 24:
                    SigVal = MsgObj_Gate_Komf_1.GK1_DriveSelectModus_2;
                    break;
                case 25:
                    SigVal = MsgObj_Gate_Komf_1.GK1_EDC_ILM;
                    break;
                case 26:
                    SigVal = MsgObj_Gate_Komf_1.GK1_ELV_verrieg;
                    break;
                case 27:
                    SigVal = MsgObj_Gate_Komf_1.GK1_EfficiencyModus;
                    break;
                case 28:
                    SigVal = MsgObj_Gate_Komf_1.GK1_Fa_Tuerkont;
                    break;
                case 29:
                    SigVal = MsgObj_Gate_Komf_1.GK1_Fernlicht;
                    break;
                case 30:
                    SigVal = MsgObj_Gate_Komf_1.GK1_KW_Warm;
                    break;
                case 31:
                    SigVal = MsgObj_Gate_Komf_1.GK1_LS1_Fernlicht;
                    break;
                case 32:
                    SigVal = MsgObj_Gate_Komf_1.GK1_Nebel_ein;
                    break;
                case 33:
                    SigVal = MsgObj_Gate_Komf_1.GK1_ParkFrontWi;
                    break;
                case 34:
                    SigVal = MsgObj_Gate_Komf_1.GK1_Rueckfahr;
                    break;
                case 35:
                    SigVal = MsgObj_Gate_Komf_1.GK1_RueckfahrSch;
                    break;
                case 36:
                    SigVal = MsgObj_Gate_Komf_1.GK1_SH_Verbau;
                    break;
                case 37:
                    SigVal = MsgObj_Gate_Komf_1.GK1_SH_Zusatzfkt;
                    break;
                case 38:
                    SigVal = MsgObj_Gate_Komf_1.GK1_SH_laeuft;
                    break;
                case 39:
                    SigVal = MsgObj_Gate_Komf_1.GK1_SamFktNr;
                    break;
                case 40:
                    SigVal = MsgObj_Gate_Komf_1.GK1_SleepAckn;
                    break;
                case 41:
                    SigVal = MsgObj_Gate_Komf_1.GK1_SportModus;
                    break;
                case 42:
                    SigVal = MsgObj_Gate_Komf_1.GK1_Sta_Anhaen;
                    break;
                case 43:
                    SigVal = MsgObj_Gate_Komf_1.GK1_Sta_ILM_F_1;
                    break;
                case 44:
                    SigVal = MsgObj_Gate_Komf_1.GK1_Sta_Kessy_2;
                    break;
                case 45:
                    SigVal = MsgObj_Gate_Komf_1.GK1_Sta_LSM;
                    break;
                case 46:
                    SigVal = MsgObj_Gate_Komf_1.GK1_Sta_Li_vorn;
                    break;
                case 47:
                    SigVal = MsgObj_Gate_Komf_1.GK1_Sta_Licht1;
                    break;
                case 48:
                    SigVal = MsgObj_Gate_Komf_1.GK1_Sta_Licht2;
                    break;
                case 49:
                    SigVal = MsgObj_Gate_Komf_1.GK1_Sta_Licht3;
                    break;
            }

            switch (SigIdx)
            {
                case 50:
                    SigVal = MsgObj_Gate_Komf_1.GK1_Sta_RDK_Warn;
                    break;
                case 51:
                    SigVal = MsgObj_Gate_Komf_1.GK1_Sta_Stdhzg;
                    break;
                case 52:
                    SigVal = MsgObj_Gate_Komf_1.GK1_Sta_Tuerkont;
                    break;
                case 53:
                    SigVal = MsgObj_Gate_Komf_1.GK1_Warnblk_Status;
                    break;
                case 54:
                    SigVal = MsgObj_Gate_Komf_1.GK1_Wischer_vorn;
                    break;
                case 55:
                    SigVal = MsgObj_Gate_Komf_1.GK1_def_P_verr;
                    break;
                case 56:
                    SigVal = MsgObj_Gate_Komf_1.LDS_Stellung_AFL;
                    break;
                case 57:
                    SigVal = MsgObj_Gate_Komf_1.SH1_ein_Wasserpumpe;
                    break;
                case 58:
                    SigVal = MsgObj_Gate_Komf_1.WI1_Front_Wasch;
                    break;
            }
        }
        break;
        case FRM_HANDLE_Gate_Komf_4:
        {
            switch (SigIdx)
            {
                case 0:
                    SigVal = MsgObj_Gate_Komf_4.GK1_Sta_LSM;
                    break;
                case 1:
                    SigVal = MsgObj_Gate_Komf_4.GK4_Ladesteckerentr_Anf;
                    break;
                case 2:
                    SigVal = MsgObj_Gate_Komf_4.GK4_Sta_MFA_6;
                    break;
                case 3:
                    SigVal = MsgObj_Gate_Komf_4.LS1_P_verriegelt;
                    break;
                case 4:
                    SigVal = MsgObj_Gate_Komf_4.MA6_Reichweite;
                    break;
                case 5:
                    SigVal = MsgObj_Gate_Komf_4.MA6_km_Reichweite;
                    break;
                case 6:
                    SigVal = MsgObj_Gate_Komf_4.MA6_mls_Reichweite;
                    break;
            }
        }
        break;
        case FRM_HANDLE_Klima_EV_1:
        {
            switch (SigIdx)
            {
                case 0:
                    SigVal = MsgObj_Klima_EV_1.EKK_Status;
                    break;
                case 1:
                    SigVal = MsgObj_Klima_EV_1.EKK_Status_Vorstrg;
                    break;
                case 2:
                    SigVal = MsgObj_Klima_EV_1.EKK_Strom;
                    break;
                case 3:
                    SigVal = MsgObj_Klima_EV_1.KL_Charisma_FahrPr;
                    break;
                case 4:
                    SigVal = MsgObj_Klima_EV_1.KL_Charisma_Status;
                    break;
                case 5:
                    SigVal = MsgObj_Klima_EV_1.KL_HV_Anf;
                    break;
                case 6:
                    SigVal = MsgObj_Klima_EV_1.KL_HV_ein;
                    break;
                case 7:
                    SigVal = MsgObj_Klima_EV_1.KL_Innengeblaese;
                    break;
                case 8:
                    SigVal = MsgObj_Klima_EV_1.KL_Kompr_Drehzahl_Soll;
                    break;
                case 9:
                    SigVal = MsgObj_Klima_EV_1.KL_PTC_Soll;
                    break;
                case 10:
                    SigVal = MsgObj_Klima_EV_1.KL_Standklima_Status;
                    break;
                case 11:
                    SigVal = MsgObj_Klima_EV_1.KL_Standklima_Strg_Kluefter;
                    break;
                case 12:
                    SigVal = MsgObj_Klima_EV_1.KL_Ventil_Batterie_Anf;
                    break;
                case 13:
                    SigVal = MsgObj_Klima_EV_1.KL_Ventil_vor_Motor_Anf;
                    break;
                case 14:
                    SigVal = MsgObj_Klima_EV_1.KL_Wake_Up_ACAN;
                    break;
                case 15:
                    SigVal = MsgObj_Klima_EV_1.PTC_Pumpe_Ist;
                    break;
                case 16:
                    SigVal = MsgObj_Klima_EV_1.PTC_Pumpe_Status;
                    break;
                case 17:
                    SigVal = MsgObj_Klima_EV_1.PTC_Strom;
                    break;
            }
        }
        break;
        case FRM_HANDLE_Kombi_1:
        {
            switch (SigIdx)
            {
                case 0:
                    SigVal = MsgObj_Kombi_1.KO1_ABS_Lampe;
                    break;
                case 1:
                    SigVal = MsgObj_Kombi_1.KO1_ACC_AnzFhl;
                    break;
                case 2:
                    SigVal = MsgObj_Kombi_1.KO1_ACC_Inkons;
                    break;
                case 3:
                    SigVal = MsgObj_Kombi_1.KO1_ASRESP_Lampe;
                    break;
                case 4:
                    SigVal = MsgObj_Kombi_1.KO1_Airbag_Lampe;
                    break;
                case 5:
                    SigVal = MsgObj_Kombi_1.KO1_Brems_Lampe;
                    break;
                case 6:
                    SigVal = MsgObj_Kombi_1.KO1_Bremsinfo;
                    break;
                case 7:
                    SigVal = MsgObj_Kombi_1.KO1_Handbremse;
                    break;
                case 8:
                    SigVal = MsgObj_Kombi_1.KO1_Kuehlmittel;
                    break;
                case 9:
                    SigVal = MsgObj_Kombi_1.KO1_LDW_AnzFeh;
                    break;
                case 10:
                    SigVal = MsgObj_Kombi_1.KO1_La_Ladekon;
                    break;
                case 11:
                    SigVal = MsgObj_Kombi_1.KO1_Lenkh_Lampe;
                    break;
                case 12:
                    SigVal = MsgObj_Kombi_1.KO1_OBD_Tank;
                    break;
                case 13:
                    SigVal = MsgObj_Kombi_1.KO1_Oeldruck;
                    break;
                case 14:
                    SigVal = MsgObj_Kombi_1.KO1_Quelle_kmh;
                    break;
                case 15:
                    SigVal = MsgObj_Kombi_1.KO1_SILA_gueltig;
                    break;
                case 16:
                    SigVal = MsgObj_Kombi_1.KO1_SleepInd;
                    break;
                case 17:
                    SigVal = MsgObj_Kombi_1.KO1_Sta_Oeldr;
                    break;
                case 18:
                    SigVal = MsgObj_Kombi_1.KO1_Sta_Tank;
                    break;
                case 19:
                    SigVal = MsgObj_Kombi_1.KO1_Stellglieder;
                    break;
                case 20:
                    SigVal = MsgObj_Kombi_1.KO1_Tankinhalt;
                    break;
                case 21:
                    SigVal = MsgObj_Kombi_1.KO1_Tankstop;
                    break;
                case 22:
                    SigVal = MsgObj_Kombi_1.KO1_Vorgluehen;
                    break;
                case 23:
                    SigVal = MsgObj_Kombi_1.KO1_Wakeup_Komfort;
                    break;
                case 24:
                    SigVal = MsgObj_Kombi_1.KO1_Warn_Tank;
                    break;
                case 25:
                    SigVal = MsgObj_Kombi_1.KO1_Zaehler;
                    break;
                case 26:
                    SigVal = MsgObj_Kombi_1.KO1_Zeitluecke;
                    break;
                case 27:
                    SigVal = MsgObj_Kombi_1.KO1_angez_kmh;
                    break;
                case 28:
                    SigVal = MsgObj_Kombi_1.KO1_kmh;
                    break;
                case 29:
                    SigVal = MsgObj_Kombi_1.KO1_kmh_mph;
                    break;
            }
        }
        break;
        case FRM_HANDLE_Kombi_2:
        {
            switch (SigIdx)
            {
                case 0:
                    SigVal = MsgObj_Kombi_2.KB2_Auto_eKiSi;
                    break;
                case 1:
                    SigVal = MsgObj_Kombi_2.KB2_EasyEntry;
                    break;
                case 2:
                    SigVal = MsgObj_Kombi_2.KB2_MFA_Strecke_Einheit;
                    break;
                case 3:
                    SigVal = MsgObj_Kombi_2.KB2_Req_IstZu_Solldruecke;
                    break;
                case 4:
                    SigVal = MsgObj_Kombi_2.KBI_rotes_P_verbaut;
                    break;
                case 5:
                    SigVal = MsgObj_Kombi_2.KO2_Aussen_T;
                    break;
                case 6:
                    SigVal = MsgObj_Kombi_2.KO2_Bel_Displ;
                    break;
                case 7:
                    SigVal = MsgObj_Kombi_2.KO2_Bel_Schalt;
                    break;
                case 8:
                    SigVal = MsgObj_Kombi_2.KO2_Fehlereintr;
                    break;
                case 9:
                    SigVal = MsgObj_Kombi_2.KO2_GRA_High;
                    break;
                case 10:
                    SigVal = MsgObj_Kombi_2.KO2_MFA_v_Einheit;
                    break;
                case 11:
                    SigVal = MsgObj_Kombi_2.KO2_OBD_Nib_Temp;
                    break;
                case 12:
                    SigVal = MsgObj_Kombi_2.KO2_Oelwarn;
                    break;
                case 13:
                    SigVal = MsgObj_Kombi_2.KO2_PLA_Displaystatus;
                    break;
                case 14:
                    SigVal = MsgObj_Kombi_2.KO2_Passiv_Autolock;
                    break;
                case 15:
                    SigVal = MsgObj_Kombi_2.KO2_Sta_Auss_T;
                    break;
                case 16:
                    SigVal = MsgObj_Kombi_2.KO2_Sta_Displ;
                    break;
                case 17:
                    SigVal = MsgObj_Kombi_2.KO2_Sta_Schalt;
                    break;
                case 18:
                    SigVal = MsgObj_Kombi_2.KO2_Temp_Einheit;
                    break;
                case 19:
                    SigVal = MsgObj_Kombi_2.KO2_Verb_TOG;
                    break;
                case 20:
                    SigVal = MsgObj_Kombi_2.KO2_WFS_Schl_Ort;
                    break;
                case 21:
                    SigVal = MsgObj_Kombi_2.KO2_Wischwasser;
                    break;
                case 22:
                    SigVal = MsgObj_Kombi_2.KO2_gef_Auss_T;
                    break;
                case 23:
                    SigVal = MsgObj_Kombi_2.KO_Segeln_Menuestatus;
                    break;
                case 24:
                    SigVal = MsgObj_Kombi_2.KO_Segeln_Zustandswechsel;
                    break;
            }
        }
        break;
        case FRM_HANDLE_NMH_Gateway:
        {
            switch (SigIdx)
            {
                case 0:
                    SigVal = MsgObj_NMH_Gateway.NMH_GW_Abschaltstufe_aktiv;
                    break;
                case 1:
                    SigVal = MsgObj_NMH_Gateway.NMH_GW_CAN_Diag_deaktiv;
                    break;
                case 2:
                    SigVal = MsgObj_NMH_Gateway.NMH_GW_Car_WakeUp;
                    break;
                case 3:
                    SigVal = MsgObj_NMH_Gateway.NMH_GW_Eindraht_Fehler;
                    break;
                case 4:
                    SigVal = MsgObj_NMH_Gateway.NMH_GW_Fkt_WakeUp;
                    break;
                case 5:
                    SigVal = MsgObj_NMH_Gateway.NMH_GW_KompSchutz;
                    break;
                case 6:
                    SigVal = MsgObj_NMH_Gateway.NMH_GW_Mute_Mode;
                    break;
                case 7:
                    SigVal = MsgObj_NMH_Gateway.NMH_GW_NL_0;
                    break;
                case 8:
                    SigVal = MsgObj_NMH_Gateway.NMH_GW_NL_1;
                    break;
                case 9:
                    SigVal = MsgObj_NMH_Gateway.NMH_GW_NL_2;
                    break;
                case 10:
                    SigVal = MsgObj_NMH_Gateway.NMH_GW_NL_3;
                    break;
                case 11:
                    SigVal = MsgObj_NMH_Gateway.NMH_GW_NL_4;
                    break;
                case 12:
                    SigVal = MsgObj_NMH_Gateway.NMH_GW_NL_5;
                    break;
                case 13:
                    SigVal = MsgObj_NMH_Gateway.NMH_GW_NL_6;
                    break;
                case 14:
                    SigVal = MsgObj_NMH_Gateway.NMH_GW_NL_7;
                    break;
                case 15:
                    SigVal = MsgObj_NMH_Gateway.NMH_GW_NL_aktiv_4;
                    break;
                case 16:
                    SigVal = MsgObj_NMH_Gateway.NMH_GW_NL_aktiv_5;
                    break;
                case 17:
                    SigVal = MsgObj_NMH_Gateway.NMH_GW_NL_aktiv_6;
                    break;
                case 18:
                    SigVal = MsgObj_NMH_Gateway.NMH_GW_NL_aktiv_7;
                    break;
                case 19:
                    SigVal = MsgObj_NMH_Gateway.NMH_GW_NL_aktiv_8;
                    break;
                case 20:
                    SigVal = MsgObj_NMH_Gateway.NMH_GW_NM_aktiv_Diagnose;
                    break;
                case 21:
                    SigVal = MsgObj_NMH_Gateway.NMH_GW_NM_aktiv_Klemme_15;
                    break;
                case 22:
                    SigVal = MsgObj_NMH_Gateway.NMH_GW_NM_aktiv_Start;
                    break;
                case 23:
                    SigVal = MsgObj_NMH_Gateway.NMH_GW_Normal_Mode_1;
                    break;
                case 24:
                    SigVal = MsgObj_NMH_Gateway.NMH_GW_Normal_Mode_2;
                    break;
                case 25:
                    SigVal = MsgObj_NMH_Gateway.NMH_GW_Per_WakeUp;
                    break;
                case 26:
                    SigVal = MsgObj_NMH_Gateway.NMH_GW_Start_1;
                    break;
                case 27:
                    SigVal = MsgObj_NMH_Gateway.NMH_GW_Start_2;
                    break;
                case 28:
                    SigVal = MsgObj_NMH_Gateway.NMH_GW_TimeOut_Fehler;
                    break;
                case 29:
                    SigVal = MsgObj_NMH_Gateway.NMH_GW_Transport_Mode;
                    break;
            }
        }
        break;
        case FRM_HANDLE_Waehlhebel_1:
        {
            switch (SigIdx)
            {
                case 0:
                    SigVal = MsgObj_Waehlhebel_1.WH1_Init;
                    break;
                case 1:
                    SigVal = MsgObj_Waehlhebel_1.WH1_Position;
                    break;
                case 2:
                    SigVal = MsgObj_Waehlhebel_1.WH1_Position_inv;
                    break;
                case 3:
                    SigVal = MsgObj_Waehlhebel_1.WH1_StaShiftlock;
                    break;
                case 4:
                    SigVal = MsgObj_Waehlhebel_1.WH1_Status;
                    break;
                case 5:
                    SigVal = MsgObj_Waehlhebel_1.WH1_Taster_betaetigt;
                    break;
                case 6:
                    SigVal = MsgObj_Waehlhebel_1.WH1_Test_Flag;
                    break;
                case 7:
                    SigVal = MsgObj_Waehlhebel_1.WH1_Testergebnis;
                    break;
                case 8:
                    SigVal = MsgObj_Waehlhebel_1.WH1_Zaehler;
                    break;
            }
        }
        break;
    }

    return (SigVal);
}
/*@@end*/

/*@@caplFunc:ShowPrompt():*/
ShowPrompt ()
{
    int SigVal = 0;

    switch (CaplCtrl_LevelActv)
    {
        /* currently no level selected */
        case CAPLCTRL_LEVEL_NOSEL:
        {
            if (CaplCtrl_PromptMode == CAPLCTRL_PROMPTMODE_NUM)
            {
                write("# > %s", CaplCtrl_InputBuf);
            }
            else
            {
                write("# > %s", CaplCtrl_CharBuf);
            }
        }
        break;

        case CAPLCTRL_LEVEL_FRAME:
        {
            GetFrameName(CaplCtrl_FrameActv);

            if (CaplCtrl_PromptMode == CAPLCTRL_PROMPTMODE_NUM)
            {
                write("# %s> %s", CaplCtrl_FrameName, CaplCtrl_InputBuf);
            }
            else
            {
                write("# %s> %s", CaplCtrl_FrameName, CaplCtrl_CharBuf);
            }
        }
        break;

        case CAPLCTRL_LEVEL_SIGNAL:
        {
            GetFrameName(CaplCtrl_FrameActv);
            GetSignalName(CaplCtrl_FrameActv, CaplCtrl_SignalActv);

            SigVal = GetSignalVal(CaplCtrl_FrameActv, CaplCtrl_SignalActv);

            if (CaplCtrl_PromptMode == CAPLCTRL_PROMPTMODE_NUM)
            {
                write("# %s.%s = %d> %s", CaplCtrl_FrameName, CaplCtrl_SignalName, SigVal, CaplCtrl_InputBuf);
            }
            else
            {
                write("# %s.%s = %d> %s", CaplCtrl_FrameName, CaplCtrl_SignalName, SigVal, CaplCtrl_CharBuf);
            }
        }
        break;
    }
}
/*@@end*/

/*@@caplFunc:Frm_CalcChecksumCRC8(int, message*, byte):*/
byte Frm_CalcChecksumCRC8(int FrmIdx, message *MsgObj, byte endval)
{
    int idx;
    byte crc;

    /* calculate CRC8 checksum */
    crc = 0xFF;
    /* IMPORTANT NOTE: assumes CRC8 is in byte 0 */
    for (idx = 1; idx < MsgObj.DLC; idx++)
    {
        crc = CRC8_tab_256[(MsgObj.BYTE(idx) ^ crc)];
    }
    crc = CRC8_tab_256[(endval ^ crc)];
    crc = ~crc;

    /* checksum calculation disabled, make sure checksum is wrong */
    if (Frm_MsgChksmEna[FrmIdx] == 0)
    {
        crc = ~crc;
    }

   	return (crc);
}
/*@@end*/

/*@@caplFunc:Frm_CalcChecksumCRC8Id(int, message*):*/
byte Frm_CalcChecksumCRC8Id(int FrmIdx, message *MsgObj)
{
    byte crcid;

    /* XOR high byte and low byte of CAN ID - used as checksum end value */
	crcid = MsgObj.ID;
    crcid = crcid ^ ((MsgObj.ID >> 8) & 0xFF);

    return Frm_CalcChecksumCRC8(FrmIdx, MsgObj, crcid);
}
/*@@end*/

/*@@caplFunc:Frm_CalcChecksumCRC8Dyn(int, message*, int):*/
byte Frm_CalcChecksumCRC8Dyn(int FrmIdx, message *MsgObj, int MsgCnt)
{
    byte crcid;
    byte ChksmEndVal[FRM_NUM_MAX][16] =
    {
        { 0x00,0x00,0x00,0x00,0x00,0x00,0x00,0x00,0x00,0x00,0x00,0x00,0x00,0x00,0x00,0x00 },
        { 0x00,0x00,0x00,0x00,0x00,0x00,0x00,0x00,0x00,0x00,0x00,0x00,0x00,0x00,0x00,0x00 },
        { 0x00,0x00,0x00,0x00,0x00,0x00,0x00,0x00,0x00,0x00,0x00,0x00,0x00,0x00,0x00,0x00 },
        { 0x00,0x00,0x00,0x00,0x00,0x00,0x00,0x00,0x00,0x00,0x00,0x00,0x00,0x00,0x00,0x00 },
        { 0x00,0x00,0x00,0x00,0x00,0x00,0x00,0x00,0x00,0x00,0x00,0x00,0x00,0x00,0x00,0x00 },
        { 0x00,0x00,0x00,0x00,0x00,0x00,0x00,0x00,0x00,0x00,0x00,0x00,0x00,0x00,0x00,0x00 },
        { 0x00,0x00,0x00,0x00,0x00,0x00,0x00,0x00,0x00,0x00,0x00,0x00,0x00,0x00,0x00,0x00 },
        { 0x00,0x00,0x00,0x00,0x00,0x00,0x00,0x00,0x00,0x00,0x00,0x00,0x00,0x00,0x00,0x00 },
        { 0x00,0x00,0x00,0x00,0x00,0x00,0x00,0x00,0x00,0x00,0x00,0x00,0x00,0x00,0x00,0x00 },
        { 0x00,0x00,0x00,0x00,0x00,0x00,0x00,0x00,0x00,0x00,0x00,0x00,0x00,0x00,0x00,0x00 },
        { 0x00,0x00,0x00,0x00,0x00,0x00,0x00,0x00,0x00,0x00,0x00,0x00,0x00,0x00,0x00,0x00 },
        { 0x00,0x00,0x00,0x00,0x00,0x00,0x00,0x00,0x00,0x00,0x00,0x00,0x00,0x00,0x00,0x00 },
        { 0x00,0x00,0x00,0x00,0x00,0x00,0x00,0x00,0x00,0x00,0x00,0x00,0x00,0x00,0x00,0x00 },
        { 0x00,0x00,0x00,0x00,0x00,0x00,0x00,0x00,0x00,0x00,0x00,0x00,0x00,0x00,0x00,0x00 },
        { 0x00,0x00,0x00,0x00,0x00,0x00,0x00,0x00,0x00,0x00,0x00,0x00,0x00,0x00,0x00,0x00 },
        { 0x00,0x00,0x00,0x00,0x00,0x00,0x00,0x00,0x00,0x00,0x00,0x00,0x00,0x00,0x00,0x00 },
        { 0x00,0x00,0x00,0x00,0x00,0x00,0x00,0x00,0x00,0x00,0x00,0x00,0x00,0x00,0x00,0x00 }
    };

    /* checksum end value is based on message counter value */
    crcid = ChksmEndVal[FrmIdx][MsgCnt];

    return Frm_CalcChecksumCRC8(FrmIdx, MsgObj, crcid);
}
/*@@end*/

/*@@caplFunc:Frm_CalcChecksumXOR(int, message*, int):*/
byte Frm_CalcChecksumXOR(int FrmIdx, message *MsgObj, int dChksmIdx)
{
    int idx;
    byte chksm;

    /* reset checksum byte */
    MsgObj.BYTE(dChksmIdx) = 0;

    /* init checksum value */
    chksm = 0;

    /* calculate checksum */
    for (idx = 0; idx < MsgObj.DLC; idx++)
    {
        if (idx != dChksmIdx)
        {
            /* XOR all bytes */
            chksm = chksm ^ MsgObj.BYTE(idx);
        }
    }

    /* checksum calculation disabled, make sure checksum is wrong */
    if (Frm_MsgChksmEna[FrmIdx] == 0)
    {
        chksm = ~chksm;
    }

	return (chksm);
}
/*@@end*/

/*@@caplFunc:Frm_CalcChecksumXORID(int, message*, int):*/
byte Frm_CalcChecksumXORID(int FrmIdx, message *MsgObj, int dChksmIdx)
{
    int idx;
    byte chksm;

    /* reset checksum byte */
    MsgObj.BYTE(dChksmIdx) = 0;

    /* init checksum value */
    chksm = 0;

    /* calculate checksum */
    for (idx = 0; idx < MsgObj.DLC; idx++)
    {
        if (idx != dChksmIdx)
        {
            /* XOR all bytes */
            chksm = chksm ^ MsgObj.BYTE(idx);
        }
    }

    /* add high and low byte of CAN ID */
    chksm = chksm ^ (MsgObj.ID & 0xFF);
    chksm = chksm ^ ((MsgObj.ID >> 8) & 0xFF);

    /* checksum calculation disabled, make sure checksum is wrong */
    if (Frm_MsgChksmEna[FrmIdx] == 0)
    {
        chksm = ~chksm;
    }

	return (chksm);
}
/*@@end*/

/*@@caplFunc:Frm_CalcChecksumLW1(int, message*, int):*/
byte Frm_CalcChecksumLW1(int FrmIdx, message *MsgObj, int dChksmIdx)
{
    int idx;
    byte chksm;

    /* reset checksum byte */
    MsgObj.BYTE(dChksmIdx) = 0;

    /* init checksum value */
    chksm = 0;

    /* calculate checksum */
    chksm = ((MsgObj.BYTE(0) + MsgObj.BYTE(1) + MsgObj.BYTE(2) + MsgObj.BYTE(3) + MsgObj.BYTE(5)) & 0xFF);
    chksm = ~chksm;

    /* checksum calculation disabled, make sure checksum is wrong */
    if (Frm_MsgChksmEna[FrmIdx] == 0)
    {
        chksm = ~chksm;
    }

	return (chksm);
}
/*@@end*/

/*@@caplFunc:Frm_CalcMsgCounter(int):*/
int Frm_CalcMsgCounter(int FrmIdx)
{
    /* IMPORTANT NOTE: currently it is assumed that message counter is 4 bit long */
    if (Frm_MsgCounterEna[FrmIdx] != 0)
    {
        Frm_MsgCounter[FrmIdx] ++;
        Frm_MsgCounter[FrmIdx] &= 0x0F;
    }

    return (Frm_MsgCounter[FrmIdx]);
}
/*@@end*/

/*@@caplFunc:FrmSch_EnableFrame(long):*/
FrmSch_EnableFrame(long FrmIdx)
{
    /* enable TX of CAN frame */
    FrmSched_FrmEna[FrmIdx] = 1;
}
/*@@end*/

/*@@caplFunc:FrmSch_DisableFrame(long):*/
FrmSch_DisableFrame(long FrmIdx)
{
    /* enable TX of CAN frame */
    FrmSched_FrmEna[FrmIdx] = 0;
}
/*@@end*/

/*@@caplFunc:FrmSch_EnableAllFrames():*/
FrmSch_EnableAllFrames()
{
    int FrmIdx;

    for (FrmIdx = 0; FrmIdx < FRM_NUM_MAX; FrmIdx++)
    {
        /* enable scheduler for all frames */
        FrmSched_FrmEna[FrmIdx] = 1;
    }
}
/*@@end*/

/*@@caplFunc:FrmSch_DisableAllFrames():*/
FrmSch_DisableAllFrames()
{
    int FrmIdx;

    for (FrmIdx = 0; FrmIdx < FRM_NUM_MAX; FrmIdx++)
    {
        /* disable scheduler for all frames */
        FrmSched_FrmEna[FrmIdx] = 0;
    }
}
/*@@end*/

/*@@caplFunc:Frm_EnableMsgCounter(long):*/
Frm_EnableMsgCounter(long FrmIdx)
{
    /* enable message counter calculation */
    Frm_MsgCounterEna[FrmIdx] = 1;
}
/*@@end*/

/*@@caplFunc:Frm_DisableMsgCounter(long):*/
Frm_DisableMsgCounter(long FrmIdx)
{
    /* disable message counter calculation */
    Frm_MsgCounterEna[FrmIdx] = 0;
}
/*@@end*/

/*@@caplFunc:Frm_EnableChksm(long):*/
Frm_EnableChksm(long FrmIdx)
{
    /* enable checksum calculation */
    Frm_MsgChksmEna[FrmIdx] = 1;
}
/*@@end*/

/*@@caplFunc:Frm_DisableChksm(long):*/
Frm_DisableChksm(long FrmIdx)
{
    /* disable checksum calculation */
    Frm_MsgChksmEna[FrmIdx] = 0;
}
/*@@end*/
