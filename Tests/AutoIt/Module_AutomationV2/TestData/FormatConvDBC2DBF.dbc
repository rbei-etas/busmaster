VERSION ""

NS_ :

BS_:

BU_:

BO_ 0 msg1: 8 Vector__XXX
 SG_ sig1 : 0|64@1- (1,0) [-9.22337E+018|9.22337E+018] "" Vector__XXX

BO_ 2 msg2: 8 Vector__XXX
 SG_ sig2 : 56|1@1- (1,0) [0|1] "" Vector__XXX
 SG_ sig3 : 57|1@1- (1,0) [0|1] "" Vector__XXX
